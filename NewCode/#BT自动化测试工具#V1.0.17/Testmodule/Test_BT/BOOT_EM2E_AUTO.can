/*@!Encoding:936*/
includes
{
  #if X64
    #pragma library("AES_128.dll")
    #pragma library("AES_CBC.dll")
  #else
    #pragma library("AES_128.dll")
    #pragma library("AES_CBC.dll")
  #endif
}

variables
{
  word fixByte_[16] = {0x40,0x21,0x07,0x49,0x10,0xD0,0x27,0x15,0x2A,0x19,0x0F,0x1F,0xAC,0x3E,0xFD,0x75}; // Geely3.0 APP
  word fixByte_Bt[16] = {0xff,0xff,0xff,0xff,0xff,0xff,0xff,0xff,0xff,0xff,0xff,0xff,0xff,0xff,0xff,0xff};// Geely3.0 BT
  word fixByte_2[16] = {0x2b,0x7e,0x15,0x16,0x28,0xae,0xd2,0xa6,0xab,0xf7,0x15,0x88,0x09,0xcf,0x4f,0x3c}; //瑞驰
  word fixByte_Chery_BT[16] = {0xA6,0xD4,0x0C,0x53,0xD1,0xC1,0x69,0x41,0xD6,0x80,0xF1,0xE4,0x93,0x45,0x61,0x96}; //T1V_BT
  word fixByte_Chery_APP[16] = {0x6C,0xA7,0xEB,0xBA,0xD8,0xE2,0x8B,0xFA,0x03,0x58,0x8F,0x35,0x3F,0xD7,0x14,0x02}; //T1V_APP
  word fixByte_CCAG_APP[16] = {0x58,0x94,0x93,0x03,0x62,0xEB,0x75,0x94,0xCD,0x10,0x16,0x50,0x25,0x0D,0x4C,0xD2}; //长安_APP
  word fixByte_V8[16] = {0x52,0x3E,0x0D,0x8A,0x9F,0x6C,0x1B,0x47,0x26,0x3A,0x8D,0x0F,0x5E,0x9B,0x1C,0x7A}; //V8  BT掩码
  message 0x11 IGON = {dlc=8};               //用于控制旧老化板
  message *Relaymsg = {dlc=8};               //用于控制新老化板
  message 0x00 responseMsgs[10];             //用于接收发送诊断后的所有响应码
  struct Block 
  {
    dword BlockStartAddr;
    dword BlockVbtStartAddr;                 //数据开始的地址
    dword BlockDataLength;
    dword BlockVbtDataLength;                //数据的长度
//    byte dataBuffer[0x10];
//    byte dataVbtBuffer[0x10];               //数据区域(单块数据的Buffer，如果hex文件很大，则需要把次参数调大)
    byte dataBuffer[0x10000];
    byte dataVbtBuffer[0x10000];             //数据区域(单块数据的Buffer，如果hex文件很大，则需要把次参数调大)
    dword BlockEndAddr;                     //数据结束的地址(Bin文件新增)
    int FilePos;                            //文件位置,用于整个擦除时以文件进行擦除防止擦除无需擦除部分(Bin文件新增)
  }; 
  struct Block hexfile_app[20];              //创建数据块(主要根据HEX文件进行调整，hex有几个数据块就需要设置几个)
  struct Block hexfile_sbt[5];               //创建数据块(主要根据HEX文件进行调整，hex有几个数据块就需要设置几个)
  char  g_vbfFilePath[200];
  char  g_vbfFileName[200];   /*[VBF流式]裸文件名(不含目录),配合 setFilePath 使用*/
  dword g_vbfDataOffset;
  const BinDataSave_MaxLen = 0x600;
  byte BlockBin_Num;
  byte BlockBin_Flage = 0;                   //Bin文件标志，当其为0时采用hex流程
  byte BlockBin_Flash[0x500];                //文件中Flash单独存在，故单独装载
  byte HexBlockTotalNumber_app = 0;          //数据块总数
  byte HexBlockTotalNumber_sbt = 0;          //数据块总数
  byte VbtBlockTotalNumber_app = 0;          //数据块总数
  byte VbtBlockTotalNumber_sbt = 0;          //数据块总数
  word addrNum = 0;                          //记录当前刷写块数
  dword vbtStartAddr,loadvbtStartAddr; 
  dword vbtLength,loadvbtLength;
  dword hexStartAddr,loadhexStartAddr; 
  dword hexLength,loadhexLength;
  dword vbfLength;
  word  inx_7D;
  dword bytesLength;
  dword HexLength_sbt;
  dword VbtLength_sbt;
  dword HexLength_app;
  dword VbtLength_app; 
  char getCheckMemory[1000],getCheckMemory_sbt[1000];
  
  int RSALen;
  byte RSAData[500];
  dword cbfDataOffset;                         /* CBF 文件纯数据段在文件中的起始偏移 */
  dword cbfFileHandle;                         /* CBF 流式文件句柄,0 未打开 */
  int CBF_Flage;
  
  
  dword DriverAddr;                           /*驱动地址*/
  dword DriverSize;                           /*驱动大小*/
  dword Blocksize_36;                          /*每一个36服务的数据大小*/
  
  dword revID;                                /*控制器响应ID*/
  dword phyID;                                /*诊断物理寻址ID*/
  dword funID;                                /*诊断功能寻址ID*/
  
  double High_Volt;                           /*高电压边界值*/
  double Low_Volt;                            /*低电压边界值*/
  double Normal_Volt;                         /*正常电压*/
  double Normal_Curr = 10;                    /*正常电流*/
  dword TxMessage_ID;                         /*外发报文ID*/
  byte TxMessage_Pass=1;                      /*预期有外发报文*/
  byte TxMessage_Fail=0;                      /*预期无外发报文*/
  byte curAppValid;                           /*当前APP是否有效 0:无效 1:有效*/
  byte Burn_in_Board;                         /*老化板类型*/
  byte LHB_State = 0;                         /*老化板状态值*/
  byte LHB_State_New = 0x03;                  /*老化板状态值*/
  
  word Volt_Time=3000;                        /*调整电压后等待时间ms*/
  word waittime=5500;                         /*异常流程与正常刷写之间等待时间ms*/
  word p2exs;                                 /*服务器发送NRC78到下一响应的最长时间10ms*/
  word p2cmax;                                /*客户端等待单帧响应的最大等待时长ms，响应是多帧不要使用此参数*/
  dword NRC78_Cycle=2000;                     /*消极应答扩展（NRC78）的周期时间ms*/
  dword NRC78_RespTime=5000;                  /*消极应答扩展（NRC78）后收到响应的时间ms*/
  dword TxMessage_Time=2000;                  /*判断是否有外发报文时间*/
  dword Restart_Time=5000;                    /*ECU重启后等待时间ms*/
  byte SOS_Flage = 0;                         /*SOS刷写标志*/
  
  msTimer timer_3e80;
  long timer_3e80_count;
  long timer_3e80_index;
  
  char stepid[40];                            /*在报告上标识步骤*/
  word stepnum=0;                             /*步骤每进行一次加一*/
  dword glbHandle = 0;                        /*将打开的hex文件与读数据关联起来*/
  dword filehandle;                           /*将读数据关联起来*/
  byte hextype;                               /*'00'数据记录，'01'文件结束记录，'02'扩展地址段记录，'03'开始段地址记录，'04'扩展线性地址记录，'05'开始线性地址记录*/
  byte data36[0x10000];                      /*缓存整个页的36服务发送数据*/
  dword stream_blockcnt = 1;                 /*合并地址段流式36发送的跨段连续块计数器*/
  byte padding=0x00;                          /*hex文件没对齐时的填充*/
  
  byte hexFileNum = 0;                        /*所选择的HEX文件个数*/
  /*[流式改造-2026-09]bin 流式读取所需:每个文件栏对应一个打开的句柄与数据段起始偏移。
    多文件栏(hexFileNum<=3)各自独立,刷写时按栏打开/读取/关闭,避免整文件常驻内存。*/
  dword binFileHandle[3];                     /*bin 文件句柄,0未打开*/
  dword binDataOffset[3];                     /*各栏 bin 数据段在文件中的起始偏移*/
  byte  binBlockIndex[3];                     /*各栏在 hexfile_app 中的起始 block 索引*/
  byte  binBlockCount[3];                     /*各栏包含的 block 数量*/
  byte cantpHandle;                           /*将传输层的各个函数关联起来*/
  dword hexFlage[3];                          /*标志位 '0'为选择了文件 '1'为未选择文件*/
  dword eraseaddr[3][30];                     /*eraseaddr用于存储起始地址*/
  dword eraselength[3][30];                   /*eraselength用于存储地址长度*/
  word eraseadd=0;
  byte Continueaddr[3][30];
  byte ContinueBlocCount = 0;
  dword EraseAddr,EraseLength;
  dword length34;
  byte Flash_DataFormatId=0x00;               /*FlashDriver的指定数据格式标识*/
  byte App_DataFormatId=0x00;                 /*App的指定数据格式标识*/
  byte Flash_AddrAndLenId=0x44;               /*FlashDriver的指定地址和长度格式标识*/
  byte App_AddrAndLenId=0x44;                 /*App的指定地址和长度格式标识*/
  word countcnt1,countcnt2;                   /*countcnt1用于块编号连续计数，countcnt2用于计算传输数据位置*/
  dword countcnt3;                            /*用Geely3.0块编号连续计数*/
  dword AddrNum;                              /*用Geely3.0地址块编计数*/
  
  //用于每个服务的各个字节判断
  byte PassState_31[5];                 /*响应31服务时的事务状态*/
  word DataLengthmax_34;                /*响应34服务时的数据最大长度*/
  byte Negative_response = 0x7F;        /*用于消极响应*/
  byte NRC78_max = 15;                  /*NRC78连续响应的最大次数*/
  byte ReBlocknum_max;                  /*36数据块允许重复发送最大次数*/
  byte ReBlocknum_Flage = 0;            /*数据块多次重复是否积极响应*/
  
  //用于故障注入后中断刷写流程
  byte Exit_Pre_Prog = 0;          /*预编程阶段 时退出流程标志位*/
  byte Exit_Re_Prog = 0;           /*主编程阶段 时退出流程标志位*/
  byte Exit_Post_Prog = 0;         /*后编程阶段 时退出流程标志位*/
  byte Exit_Download = 0;          /*数据下载阶段 时退出流程标志位*/
  
  byte Exit_1002 = 0;              /*执行到10 02时退出流程标志位*/
  byte Exit_1003 = 0;              /*执行到10 03时退出流程标志位*/
  byte Exit_22 = 0;                /*执行到22 时退出流程标志位*/
  byte Exit_27 = 0;                /*执行到27 时退出流程标志位*/
  byte Exit_2E = 0;                /*执行到2E 时退出流程标志位*/
  byte Exit_34_f = 0;              /*执行到Flash 34时退出流程标志位*/
  byte Exit_36_f = 0;              /*执行到Flash 36时退出流程标志位*/
  byte Exit_37_f = 0;              /*执行到Flash 37时退出流程标志位*/
  byte Exit_0202_f = 0;            /*执行到Flash 02 02时退出流程标志位*/
  byte Exit_0301 = 0;              /*执行到31 01 03 01时退出流程标志位*/
  byte Exit_ff00 = 0;              /*执行到31 01 FF 00时退出流程标志位*/
  byte Exit_03ff00 = 0;            /*执行到31 03 FF 00时退出流程标志位*/
  byte Exit_02ff00 = 0;            /*执行到31 02 FF 00时退出流程标志位*/
  byte Exit_34_a = 0;              /*执行到APP 34时退出流程标志位*/
  byte Exit_36_a = 0;              /*执行到APP 36时退出流程标志位*/   
  byte Exit_37_a = 0;              /*执行到APP 37时退出流程标志位*/
  byte Exit_0202_a = 0;            /*执行到APP 02 02时退出流程标志位*/
  byte Exit_0205 = 0;              /*执行到APP 02 05时退出流程标志位*/
  byte Exit_ff01 = 0;              /*执行到31 01 FF 01时退出流程标志位*/
  byte Exit_03ff01 = 0;            /*执行到31 03 FF 01时退出流程标志位*/
  byte Exit_02ff01 = 0;            /*执行到31 02 FF 01时退出流程标志位*/
  byte Exit_DA04 = 0;              /*执行到31 01 DA 04时退出流程标志位*/
  byte Exit_03DA04 = 0;            /*执行到31 01 DA 04时退出流程标志位*/
  byte Exit_02DA04 = 0;            /*执行到31 01 DA 04时退出流程标志位*/
  byte Exit_11 = 0;                /*执行到ECU复位 11时退出流程标志位*/
  byte Exit_14 = 0;                /*执行到14 FF FF FF时退出流程标志位*/
  
  byte Break_Download = 0;         /*数据下载时退出循环标志位*/
  byte Continue_36_a = 0;          /*执行到APP 36时跳过当前数据下载循环标志位*/
  int END_Pos = -1;                /*执行到APP 36完成后，再发送一个数据块标志位*/
  int Geely3_36_Status = -1;       /*用于判断36下载是否完成状态，异常下载为0，正常下载为1*/
  int GAC_3601_03 = 0;             /*广汽36 01后发送36 03标志*/
  int GAC_3602_01 = 0;             /*广汽36 02后发送36 01标志*/
  
  /*用于调整预期响应，-1为积极响应、0为不响应、其它为NRC响应码*/
  byte noCheck;            /*是否判断诊断响应，0：按预期结果判断，1：不判断响应*/
  int Resp_14 = -1;        /*请求14 清除故障码时的期望响应，默认为-1*/
  int Resp_2E = -1;        /*请求2E 写数据时的期望响应，默认为-1*/
  int Resp_22 = -1;        /*请求22 读数据时的期望响应，默认为-1*/
  int Resp_1001 = -1;      /*请求10 01时的期望响应，默认为-1*/
  int Resp_1002 = -1;      /*请求10 02时的期望响应，默认为-1*/
  int Resp_1003 = -1;      /*请求10 03时的期望响应，默认为-1*/
  int Resp_0203 = -1;      /*请求31 01 02 03时的期望响应，默认为-1*/
  int Resp_85 = -1;        /*请求85 82时的期望响应，默认为-1*/
  int Resp_28 = -1;        /*请求28 81 01时的期望响应，默认为-1*/
  int Resp_2701 = -1;      /*请求27 01时的期望响应，默认为-1*/
  int Resp_2702 = -1;      /*请求27 02时的期望响应，默认为-1*/
  int Resp_2702_2 = -1;    /*第二次请求27 02时的期望响应，默认为-1*/
  int Resp_34_f = -1;      /*Flash请求34时的期望响应，默认为-1*/
  int Resp_34_a = -1;      /*App请求34时的期望响应，默认为-1*/
  int Resp_36_f = -1;      /*Flash请求36时的期望响应，默认为-1*/
  int Resp_36_a = -1;      /*App请求36时的期望响应，默认为-1*/
  int Resp_37_f = -1;      /*Flash请求37时的期望响应，默认为-1*/
  int Resp_37_a = -1;      /*App请求37时的期望响应，默认为-1*/
  int Resp_0301 = -1;      /*Geely3.0 激活SBL的期望响应，默认为-1*/
  int Resp_0205 = -1;      /*Geely3.0 完全性检测的期望响应，默认为-1*/
  int Resp_0202_f = -1;    /*Flash下载驱动请求31 01 02 02时的期望响应，默认为-1*/
  int Resp_0202_a = -1;    /*App下载数据请求31 01 02 02时的期望响应，默认为-1*/
  int Resp_01DD02 = -1;    /*App下载数据请求31 01 DD 02时的期望响应，默认为-1*/
  int Resp_ff00 = -1;      /*请求31 01 FF 00时的期望响应，默认为-1*/
  int Resp_03ff00 = -1;    /*请求31 03 FF 00时的期望响应，默认为-1*/
  int Resp_02ff00 = -1;    /*请求31 02 FF 00时的期望响应，默认为-1*/
  int Resp_ff01 = -1;      /*请求31 01 FF 01时的期望响应，默认为-1*/
  int Resp_DA04 = -1;      /*请求31 01 DA 04时的期望响应，默认为-1*/
  int Resp_11 = -1;        /*请求11 01时的期望响应，默认为-1*/
  
  byte TC_PowerDown_Before_FF00;  /*可靠性测试：内存擦除前切断电源*/
  byte TC_PowerDown_In_FF00;      /*可靠性测试：内存擦除中切断电源*/
  byte TC_PowerDown_After_FF00;   /*可靠性测试：内存擦除后切断电源*/
  byte TC_PowerDown_In_36A;       /*可靠性测试：数据块传输中切断电源*/
  byte TC_PowerDown_After_36A;    /*可靠性测试：数据块传输后切断电源*/
  byte TC_PowerDown_Before_0202A; /*可靠性测试：0202检查前切断电源*/
  byte TC_PowerDown_Before_FF01;  /*可靠性测试：FF01应用程序有效性检查前切断电源*/
  byte TC_PowerDown_After_FF01;   /*可靠性测试：FF01应用程序有效性检查后切断电源*/
  byte TC_K15_Before_FF00;        /*可靠性测试：内存擦除前下点火*/
  byte TC_K15_After_FF00;         /*可靠性测试：内存擦除后下点火*/
  byte TC_K15_In_36A;             /*可靠性测试：数据块传输中下点火*/
  byte TC_K15_After_36A;          /*可靠性测试：数据块传输后下点火*/
  byte TC_K15_Before_0202A;       /*可靠性测试：0202检查前下点火*/
  byte TC_K15_Before_FF01;        /*可靠性测试：FF01应用程序有效性检查前下点火*/
  byte TC_K15_After_FF01;         /*可靠性测试：FF01应用程序有效性检查后下点火*/
  byte TC_BusOff_Before_FF00;     /*可靠性测试：内存擦除前BusOff*/
  byte TC_BusOff_After_FF00;      /*可靠性测试：内存擦除后BusOff*/
  byte TC_BusOff_In_36A;          /*可靠性测试：数据块传输中BusOff*/
  byte TC_BusOff_After_36A;       /*可靠性测试：数据块传输后BusOff*/
  byte TC_BusOff_Before_0202A;    /*可靠性测试：0202检查前BusOff*/
  byte TC_BusOff_Before_FF01;     /*可靠性测试：FF01应用程序有效性检查前BusOff*/
  byte TC_BusOff_After_FF01;      /*可靠性测试：FF01应用程序有效性检查后BusOff*/
  
  long Loop_Add_Time = 0;        /*性能测试：循环累加时间*/
  long Loop_Add_Times = 0;       /*性能测试：循环累加次数*/
     
  byte BT_1003;            /*APP无效下是否支持10 03；0:支持 1:不支持*/
  byte BT_85;              /*APP无效下是否支持85；0:支持 1:不支持*/
  byte BT_28;              /*APP无效下是否支持28；0:支持 1:不支持*/
  byte BT_14;              /*APP无效下是否支持14；0:支持 1:不支持*/
  byte Unnormal_FF01;      /*异常流程下FF 01是否正响应；0:正响应 1:负响应*/
  word UnsupportDID;       /*不支持的DID*/
  int Down_f_a = -1;       /*下载所处位置，0为flashdriver下载，1位app下载*/
  byte PostProg_Recover = 0;   /*是否需要在后编程恢复故障,不需要为0，需要为1*/
  
  
  byte Seed_AES[16];       /*AES安全算法*/
  byte SeedLevel;          /*安全算法等级*/
  dword LogNum = 0;        /*Logging编号*/
  byte Alternate_DownLoad_Flage = 0;  /*交替刷写标志，默认不开启*/
  
  /*dword i,j,x;*/
  word current_crc16;      /*本次数据段的CRC16校验值*/
  word crc16[25];          /*用于存储每段数据的校验值*/
  word calcrc16;           /*用于校验所有数据的中间缓存*/
  dword calcrc32;          /*用于校验所有数据的中间缓存*/
  word NRC78_flag;
  dword Download_Count;    /*用于1000次刷写测试计数*/
  dword Change_CompilePro; /*用于广汽刷写压力测试时统计0201返回值*/
  dword Change_ReadPro;    /*用于广汽刷写压力测试时统计0200返回值*/
  /*-------------------------------------------------------Geely3.0 [31 01 02 12] 数据校验-----------------------------------------------------------------------*/
  byte signature_App[256] = {
    0x46, 0x64, 0xF4, 0xC0, 0x1B, 0xD4, 0xDF, 0xF1, 0x46, 0xf5, 0x57, 0xcb, 0x43, 0x2b, 0x3c, 0x50, 0xf8, 0x77, 0x60, 0x0d, 0x3a, 0x37, 0xd8, 0xfc, 
    0x55, 0x1b, 0x6e, 0xb1, 0x1a, 0x72, 0xc4, 0xc4, 0xd2, 0x6f, 0x54, 0x99, 0xc5, 0x3b, 0x71, 0xcf, 0xc8, 0x78, 0x39, 0x04, 0x83, 0xf9, 0x1c, 0x63, 
    0xfd, 0x31, 0x73, 0x07, 0x42, 0x42, 0x39, 0x81, 0x61, 0x38, 0x74, 0x84, 0x90, 0xd5, 0x0b, 0x7c, 0xf2, 0x41, 0x97, 0xa3, 0x3d, 0xf8, 0x3e, 0xeb, 
    0xd1, 0xc8, 0x6b, 0x24, 0xe2, 0xd8, 0xf1, 0x59, 0x62, 0x9b, 0xd0, 0xb8, 0xc3, 0xc1, 0x1e, 0xaf, 0x98, 0x72, 0x38, 0x7f, 0xa7, 0xf7, 0x32, 0x72, 
    0x4d, 0xbf, 0xaa, 0x79, 0x3e, 0x40, 0x13, 0x04, 0xd4, 0x27, 0x81, 0x39, 0xcd, 0xcb, 0xf5, 0x73, 0x2a, 0x5f, 0xc7, 0x76, 0x91, 0xd3, 0x40, 0xa6, 
    0x08, 0x6b, 0x91, 0xab, 0x4c, 0x94, 0xf9, 0x5e, 0x6d, 0xce, 0xd4, 0xdd, 0xce, 0xa0, 0x40, 0x43, 0x97, 0x82, 0x4c, 0x9e, 0xf0, 0x49, 0xde, 0xaa, 
    0x80, 0x01, 0x95, 0xbb, 0x10, 0x8b, 0xa2, 0x65, 0x10, 0xe5, 0xae, 0xf6, 0x8b, 0xfd, 0xa8, 0x4f, 0x51, 0x49, 0x4a, 0x2b, 0x8b, 0xbb, 0x1e, 0xe7, 
    0xa8, 0xb2, 0x7b, 0xa4, 0xf7, 0xd9, 0x22, 0xba, 0xf3, 0xc6, 0x29, 0x38, 0xdf, 0xaf, 0x08, 0x14, 0xc3, 0x95, 0xdd, 0x2a, 0x44, 0x29, 0x3b, 0x4d, 
    0x51, 0x2d, 0x36, 0xbe, 0x13, 0xec, 0xd3, 0x92, 0x7b, 0xfc, 0x78, 0x87, 0xa8, 0x26, 0x95, 0x3c, 0x6b, 0xbc, 0x7c, 0x76, 0x0d, 0xa3, 0xfd, 0xc2, 
    0x4b, 0x89, 0x63, 0xd6, 0x43, 0xc5, 0x4e, 0xab, 0x5e, 0x8d, 0x59, 0xb1, 0xef, 0x0d, 0x3f, 0x49, 0x26, 0x4b, 0x89, 0x2b, 0x32, 0x60, 0x8d, 0x38, 
    0x49, 0x0e, 0x7a, 0x86, 0xa6, 0x20, 0x2f, 0x17, 0x3d, 0x54, 0xfc, 0x09, 0x70, 0x93, 0x91, 0x0e
  };
  /*--------------------------------------------------------------------------------------------------------------------------------------------------------------*/
 
  /*------------------------------------------------------------------不同驱动------------------------------------------------------------------------------------*/
  byte J80J3_F[0x292] = 
  {
    0x80,0x07,0xE1,0x00,0x80,0xFF,0x58,0x02,0x0A,0xE8,0xE0,0xE9,0xB2,0x05,0x1D,0x50,0xC5,0x0D,0x26,0x06,0x30,0x6C,0x00,0x00,0x80,0xFF,0x4A,0x02,0x0A,0xE0,0xFC,0xC7,
    0x60,0xF9,0x8A,0x00,0x0A,0xE8,0x1D,0x50,0x40,0x06,0xFF,0x00,0x80,0x07,0xE1,0x70,0x06,0xD8,0x07,0xD0,0x08,0xC8,0x26,0x06,0x72,0x6C,0x00,0x00,0x80,0xFF,0x26,0x02,
    0x0A,0xE8,0x1B,0x30,0x1A,0x38,0x19,0x40,0xFD,0xC7,0x60,0xF9,0x8A,0x00,0x0A,0xE0,0x1C,0x50,0x40,0x06,0xFF,0x70,0x80,0x07,0xE1,0x30,0x06,0xE0,0x07,0xD8,0x08,0xD0,
    0x00,0xEA,0x1A,0x40,0x1C,0x30,0x1B,0x38,0xC8,0x42,0x80,0xFF,0xFE,0x01,0x1D,0x50,0x40,0x06,0xFF,0x30,0x80,0x07,0xE1,0x30,0x06,0xD8,0x07,0xD0,0x26,0x06,0xC4,0x6C,
    0x00,0x00,0x80,0xFF,0xE0,0x01,0x0A,0xE8,0x1B,0x30,0x1A,0x38,0xFD,0xC7,0x60,0xF9,0x8A,0x00,0x0A,0xE0,0x1C,0x50,0x40,0x06,0xFF,0x30,0x80,0x07,0xE1,0x00,0x26,0x06,
    0x10,0x6D,0x00,0x00,0x80,0xFF,0xBE,0x01,0x0A,0xE8,0xFD,0xC7,0x60,0xF9,0x8A,0x00,0x0A,0xE0,0x1C,0x50,0x40,0x06,0xFF,0x00,0x8C,0x07,0xE1,0x00,0x00,0xEA,0x84,0x07,
    0x05,0x0A,0x06,0xFF,0xE0,0x09,0xFA,0x2D,0x80,0xFF,0xA6,0x01,0x26,0x06,0x60,0x0F,0x00,0x00,0x80,0xFF,0xA2,0x01,0x0A,0xE0,0xE0,0xE1,0xB2,0x05,0x01,0xEA,0xB5,0x25,
    0x05,0x0A,0x63,0x0F,0x01,0x00,0x63,0x07,0x09,0x00,0x63,0x07,0x0C,0x00,0x63,0x07,0x11,0x00,0xE0,0x07,0x60,0x01,0x23,0x36,0x00,0x00,0x80,0xFF,0x80,0x01,0xB5,0x05,
    0x80,0xFF,0x80,0x01,0x23,0x0F,0x15,0x00,0x61,0x0A,0xB2,0xFD,0xE0,0x87,0x60,0x01,0x23,0x0F,0x15,0x00,0xE0,0x09,0xB2,0x05,0x02,0xEA,0xD5,0x05,0x01,0x0A,0x84,0x07,
    0x0D,0x0A,0x06,0xFF,0x1D,0x50,0x4C,0x06,0xFF,0x00,0x8C,0x07,0xE1,0x10,0x06,0xE0,0x07,0xD8,0x00,0xEA,0x02,0x0A,0x63,0x0F,0x01,0x00,0x63,0xE7,0x09,0x00,0x63,0xDF,
    0x0C,0x00,0x01,0x0A,0x63,0x0F,0x11,0x00,0xE0,0x07,0x60,0x01,0x23,0x36,0x00,0x00,0x80,0xFF,0x2A,0x01,0xB5,0x05,0x80,0xFF,0x2A,0x01,0x23,0x0F,0x15,0x00,0x61,0x0A,
    0xB2,0xFD,0xE0,0x87,0x60,0x01,0x23,0x0F,0x15,0x00,0xE0,0x09,0xBA,0x05,0x00,0xEA,0x85,0x0D,0x23,0x0F,0x15,0x00,0x69,0x0A,0xBA,0x05,0x01,0xEA,0xA5,0x05,0x02,0xEA,
    0x1D,0x50,0x4C,0x06,0xFF,0x10,0x8C,0x07,0xE1,0x30,0x06,0xE0,0x07,0xD8,0x08,0xD0,0x00,0xEA,0x01,0x0A,0x63,0x0F,0x01,0x00,0x63,0xDF,0x09,0x00,0x63,0xD7,0x0C,0x00,
    0x63,0xE7,0x05,0x00,0x01,0x0A,0x63,0x0F,0x11,0x00,0xE0,0x07,0x60,0x01,0x23,0x36,0x00,0x00,0x80,0xFF,0xC8,0x00,0xB5,0x05,0x80,0xFF,0xC8,0x00,0x23,0x0F,0x15,0x00,
    0x61,0x0A,0xB2,0xFD,0xE0,0x87,0x60,0x01,0x23,0x0F,0x15,0x00,0xE0,0x09,0xBA,0x05,0x00,0xEA,0xA5,0x05,0x01,0xEA,0x1D,0x50,0x4C,0x06,0xFF,0x30,0x80,0x07,0xE1,0x30,
    0x06,0xE0,0x07,0xD8,0x08,0xD0,0x00,0xEA,0x1C,0x30,0x1B,0x38,0x1A,0x40,0x80,0xFF,0x98,0x00,0x1D,0x50,0x40,0x06,0xFF,0x30,0x8C,0x07,0xE1,0x10,0x06,0xE0,0x07,0xD8,
    0x00,0xEA,0x63,0x07,0x01,0x00,0x63,0xE7,0x09,0x00,0x63,0xDF,0x0C,0x00,0x01,0x0A,0x63,0x0F,0x11,0x00,0xE0,0x07,0x60,0x01,0x23,0x36,0x00,0x00,0x80,0xFF,0x5E,0x00,
    0xB5,0x05,0x80,0xFF,0x5E,0x00,0x23,0x0F,0x15,0x00,0x61,0x0A,0xB2,0xFD,0xE0,0x87,0x60,0x01,0x23,0x0F,0x15,0x00,0xE0,0x09,0xBA,0x05,0x00,0xEA,0xA5,0x05,0x01,0xEA,
    0x1D,0x50,0x4C,0x06,0xFF,0x10,0x80,0x07,0x61,0x00,0x00,0xEA,0x80,0xFF,0x40,0x00,0x84,0x07,0x0D,0x02,0x06,0xFF,0x1D,0x50,0x40,0x06,0x7F,0x00,0xE0,0x02,0x70,0x55,
    0x22,0x01,0xE0,0x02,0x26,0x68,0x22,0x01,0xE0,0x02,0xBA,0x59,0x22,0x01,0xE0,0x02,0x68,0x57,0x22,0x01,0xE0,0x02,0x0C,0xA3,0x22,0x01,0xE0,0x02,0x1E,0x98,0x22,0x01,
    0xE0,0x02,0xA8,0x9E,0x22,0x01,0xE0,0x02,0xE2,0x59,0x22,0x01,0xE0,0x02,0x8C,0x57,0x22,0x01
  };
  byte J80J3_A[0x300] = 
  {
    0x91,0x00,0xF0,0xFA,0xD9,0xFF,0x54,0x55,0xB7,0x04,0x18,0xF0,0x7B,0x00,0x00,0x0A,0x7E,0x05,0xDA,0x50,0x74,0xFF,0x82,0x02,0x3C,0x0E,0xB7,0x04,0x18,0xF0,0x7B,0x00,
    0xF0,0x0A,0x7E,0x05,0xDA,0x5D,0x74,0xFF,0x82,0x02,0x3C,0x05,0x0D,0x00,0x80,0x04,0x82,0x12,0x3C,0x01,0x00,0x90,0x00,0x00,0x00,0x00,0x00,0x00,0x00,0x00,0x00,0x00,
    0x91,0x10,0xF0,0xFA,0xD9,0xFF,0x90,0x9A,0x91,0x10,0xF0,0x2A,0xD9,0x22,0x98,0x9A,0x91,0x10,0xF0,0x4A,0xD9,0x44,0xA8,0xAA,0x91,0x10,0xF0,0x5A,0xD9,0x55,0xA8,0xAA,
    0x74,0xF4,0xDA,0x01,0x74,0x2F,0xDA,0x80,0x74,0x4F,0xDA,0x50,0x74,0x5F,0x0D,0x00,0x80,0x04,0x00,0x90,0x00,0x00,0x00,0x00,0x00,0x00,0x00,0x00,0x00,0x00,0x00,0x00,
    0x91,0x00,0xF0,0xFA,0xD9,0xFF,0x70,0x75,0x74,0xF5,0xB0,0x4F,0x74,0xF6,0x0D,0x00,0x80,0x04,0x00,0x90,0x00,0x00,0x00,0x00,0x00,0x00,0x00,0x00,0x00,0x00,0x00,0x00,
    0x3C,0x01,0x91,0x00,0x80,0xFF,0x19,0xFF,0x10,0x02,0x82,0x10,0x0F,0x40,0x00,0x00,0x26,0x0F,0xEE,0xF8,0x0D,0x00,0x80,0x04,0x00,0x90,0x00,0x00,0x00,0x00,0x00,0x00,
    0x91,0x10,0xF0,0xFA,0xD9,0xFF,0x90,0x9A,0x91,0x10,0xF0,0x2A,0xD9,0x22,0x98,0x9A,0x91,0x10,0xF0,0x4A,0xD9,0x44,0xA8,0xAA,0x91,0x10,0xF0,0x5A,0xD9,0x55,0xA8,0xAA,
    0x74,0xF4,0xDA,0x00,0x74,0x2F,0xDA,0xA0,0x74,0x4F,0xDA,0xAA,0x74,0x5F,0x0D,0x00,0x80,0x04,0x00,0x90,0x00,0x00,0x00,0x00,0x00,0x00,0x00,0x00,0x00,0x00,0x00,0x00,
    0x0D,0x00,0x40,0x03,0x91,0x30,0x00,0xFF,0xD9,0xFF,0x30,0x36,0x54,0xFF,0x37,0x0F,0x6E,0xF1,0x8F,0xFF,0x83,0x81,0x3C,0x01,0x91,0x30,0x00,0xFF,0xD9,0xFF,0x30,0x36,
    0x54,0xFF,0x2E,0x17,0x96,0x01,0xB7,0x0F,0x81,0xF0,0x37,0x8F,0x0E,0xF1,0x74,0xFF,0xB7,0x0F,0x01,0xF0,0x96,0x02,0x74,0xFF,0x3C,0x01,0x54,0xFF,0x16,0x01,0xDF,0x1F,
    0xFE,0x7F,0x91,0x00,0x00,0xF7,0xD9,0xFF,0x88,0x83,0xD4,0xFF,0x2D,0x0F,0x00,0x00,0x91,0x30,0x00,0xFF,0xD9,0xFF,0x30,0x36,0x54,0xFF,0x2E,0x17,0x96,0x01,0xB7,0x0F,
    0x81,0xF0,0x37,0x8F,0x0E,0xF1,0x74,0xFF,0x96,0x01,0x96,0x02,0x74,0xFF,0x3C,0x01,0x54,0xFF,0x6F,0x0F,0xFF,0x7F,0x91,0x00,0x00,0xF7,0xD9,0xFF,0x88,0x83,0xC8,0x1F,
    0x82,0x34,0x2D,0x0F,0x00,0x00,0x0D,0x00,0x00,0x03,0x00,0x90,0x00,0x00,0x00,0x00,0x00,0x00,0x00,0x00,0x00,0x00,0x00,0x00,0x00,0x00,0x00,0x00,0x00,0x00,0x00,0x00,
    0x02,0x49,0x40,0x4C,0x8F,0xB5,0x1F,0xA0,0x0D,0x00,0x40,0x03,0x91,0x30,0x00,0xFF,0xD9,0xFF,0x30,0x36,0x54,0xFF,0x37,0x0F,0x6E,0xF1,0x8F,0xFF,0x83,0xB1,0x3C,0x01,
    0x82,0x0C,0x3C,0x73,0xDA,0x20,0x03,0xFC,0x0A,0x89,0x91,0x00,0x00,0xF7,0xD9,0xFF,0x88,0x83,0xC8,0x2F,0x02,0x84,0x2D,0x0F,0x00,0x00,0x91,0x00,0x00,0xF7,0xD9,0xFF,
    0x88,0x83,0xC8,0x1F,0x82,0x34,0x2D,0x0F,0x00,0x00,0x82,0x0D,0x3C,0x22,0x91,0x00,0x00,0xF7,0xD9,0xFF,0x88,0x83,0xC8,0x3F,0x8F,0xDD,0x1F,0xF0,0x8F,0x2C,0x00,0x00,
    0x42,0x0F,0x53,0x2F,0x20,0xF0,0x53,0x4F,0x20,0xF0,0x10,0xC2,0x54,0x25,0x8F,0xDD,0x1F,0xF0,0x8F,0x2C,0x00,0x00,0x42,0x0F,0x53,0x2F,0x20,0xF0,0xC2,0x1F,0x53,0x4F,
    0x20,0xF0,0x10,0xC2,0x54,0x26,0x02,0x84,0x2D,0x0F,0x00,0x00,0x8B,0x8D,0x00,0xD0,0xDA,0x20,0x3F,0xFD,0xDE,0xFF,0x91,0x30,0x00,0xFF,0xD9,0xFF,0x30,0x36,0x54,0xFF,
    0x2E,0x17,0x96,0x01,0xB7,0x0F,0x81,0xF0,0x37,0xBF,0x0E,0xF1,0x74,0xFF,0xB7,0x0F,0x01,0xF0,0x96,0x02,0x74,0xFF,0x3C,0x01,0x54,0xFF,0x16,0x01,0xDF,0x1F,0xFE,0x7F,
    0x91,0x00,0x00,0xF7,0xD9,0xFF,0x88,0x83,0xC8,0x4F,0x02,0x84,0x2D,0x0F,0x00,0x00,0x91,0x30,0x00,0xFF,0xD9,0xFF,0x30,0x36,0x54,0xFF,0x2E,0x17,0x96,0x01,0xB7,0x0F,
    0x81,0xF0,0x37,0xBF,0x0E,0xF1,0x74,0xFF,0x96,0x01,0x96,0x02,0x74,0xFF,0x3C,0x01,0x54,0xFF,0x6F,0x0F,0xFF,0x7F,0x91,0x00,0x00,0xF7,0xD9,0xFF,0x88,0x83,0xC8,0x1F,
    0x82,0x34,0x2D,0x0F,0x00,0x00,0xC2,0x1C,0x3F,0xAC,0x8E,0xFF,0x0D,0x00,0x00,0x03,0x00,0x90,0x00,0x00,0x00,0x00,0x00,0x00,0x00,0x00,0x00,0x00,0x00,0x00,0x00,0x00,
    0x00,0x00,0x00,0x00,0x00,0x00,0x00,0x00,0x00,0x00,0x00,0x00,0x00,0x00,0x00,0x00,0x00,0x00,0x00,0x00,0x00,0x00,0x00,0x00,0x00,0x00,0x00,0x00,0x00,0x00,0x00,0x00,
    0x00,0x00,0x00,0x00,0x00,0x00,0x00,0x00,0x00,0x00,0x00,0x00,0x00,0x00,0x00,0x00,0x00,0x00,0x00,0x00,0x00,0x00,0x00,0x00,0x00,0x00,0x00,0x00,0x00,0x00,0x00,0x00
  };
  byte J80J3_B[0x308] = 
  {
    0x18,0x21,0x06,0xC8,0x00,0x80,0xDF,0x01,0x1B,0x81,0x09,0x28,0x01,0x3D,0x01,0x4E,0x78,0x00,0x02,0x49,0x48,0x53,0x18,0x81,0x80,0x08,0x78,0x00,0x02,0x4F,0x01,0x3F,
    0xC2,0x71,0x67,0xF7,0x7A,0x02,0x00,0x14,0x48,0x53,0x48,0x14,0x78,0x00,0x02,0x4D,0x01,0x3F,0x2A,0x0F,0x7A,0x02,0x00,0x82,0x18,0x61,0x80,0x0C,0x01,0xD4,0x01,0xE5,
    0x78,0x00,0x02,0x49,0xC4,0xE1,0xC5,0xD1,0xC6,0xC1,0xC3,0x71,0x2A,0x07,0x7A,0x12,0x00,0x1A,0x48,0x03,0x70,0xE8,0xE0,0x00,0x50,0x87,0x21,0xF8,0x78,0x00,0x02,0x1D,
    0x01,0x3F,0x2A,0x0F,0x7A,0x02,0x00,0x52,0x2A,0x0E,0x7A,0x12,0x00,0x1A,0x48,0x13,0x70,0xE8,0xE0,0x00,0x50,0x87,0x21,0xFC,0x78,0x00,0x02,0x01,0x01,0x3F,0x2A,0x0F,
    0x7A,0x02,0x00,0x36,0x2A,0x0D,0x7A,0x12,0x00,0x1A,0x48,0x23,0x70,0xE8,0xE0,0x00,0x50,0x87,0x22,0x00,0x78,0x00,0x01,0xE5,0x01,0x3F,0x2A,0x0F,0x7A,0x02,0x00,0x1A,
    0x2A,0x0C,0x7A,0x12,0x00,0x14,0x48,0x33,0x70,0xE8,0xE0,0x00,0x50,0x87,0x22,0x04,0x78,0x00,0x01,0xC9,0x01,0x3F,0x01,0xF3,0xCF,0x01,0x00,0x90,0x1B,0x81,0x08,0x28,
    0x18,0x21,0x80,0x38,0x00,0x04,0x44,0x00,0x18,0x21,0x06,0xB0,0x00,0x80,0x54,0x01,0x00,0x54,0x01,0x37,0x01,0x45,0x18,0x61,0x80,0x30,0x01,0x74,0x78,0x00,0x01,0xAD,
    0xCC,0x71,0xD3,0x71,0xCD,0x71,0xD4,0x71,0xCE,0x71,0xD5,0x71,0xCF,0x71,0xD6,0x71,0x50,0xE1,0x00,0x40,0xD7,0x71,0x48,0x06,0x70,0xE8,0xE0,0x00,0x54,0xC7,0x21,0xC0,
    0x48,0x13,0x18,0x81,0x80,0x0C,0x78,0x00,0x01,0x93,0x2A,0x03,0x7A,0x02,0x00,0x18,0x78,0x00,0x01,0x99,0x18,0x61,0x80,0x08,0x78,0x00,0x01,0xA1,0x70,0x23,0xA9,0x03,
    0x7A,0x12,0xFF,0xF0,0x50,0x01,0x00,0x54,0x00,0x90,0x18,0x21,0x80,0x50,0x00,0x04,0x18,0x21,0x06,0xC8,0x00,0x80,0xDF,0x01,0x1B,0xA1,0x09,0x2C,0x01,0x3E,0x01,0x5D,
    0x7C,0xDF,0x10,0x70,0x48,0x06,0x70,0xE8,0xE0,0x00,0x54,0xC7,0x21,0xC0,0x18,0x61,0x80,0x14,0x01,0xE4,0x01,0xF5,0x01,0xD6,0x78,0x00,0x01,0x71,0x01,0x30,0x2A,0x03,
    0x7A,0x02,0x00,0x54,0x78,0x00,0x01,0x45,0x18,0x61,0x80,0x14,0x18,0x81,0x80,0x08,0x78,0x00,0x01,0x69,0x70,0x23,0xA9,0x03,0x7A,0x12,0xFF,0xEC,0x01,0x30,0x2A,0x03,
    0x7A,0x02,0x00,0x34,0x01,0xE3,0x01,0xF4,0x01,0xD5,0x63,0x86,0x18,0xE1,0x80,0x0C,0x71,0x1F,0x7F,0xFF,0x78,0x00,0x01,0x55,0x01,0x30,0x2A,0x03,0x7A,0x02,0x00,0x18,
    0x01,0xE3,0x01,0xF4,0x70,0xA0,0x01,0x20,0x18,0xC1,0x80,0x10,0x2C,0x07,0x78,0x00,0x01,0x4B,0x01,0x30,0x01,0x03,0xCF,0x01,0x00,0x90,0x1B,0xA1,0x08,0x2C,0x18,0x21,
    0x80,0x38,0x00,0x04,0x18,0x21,0x06,0xC8,0x00,0x80,0xDF,0x01,0x1B,0xA1,0x09,0x2C,0x01,0x37,0x01,0x45,0x18,0x61,0x80,0x08,0x01,0x74,0x78,0x00,0x00,0xAF,0xC3,0xF1,
    0xC4,0xE1,0xC5,0xD1,0xC2,0x71,0x2A,0x07,0x7A,0x12,0x00,0x18,0x48,0x03,0x70,0xE8,0xE0,0x00,0x50,0x87,0x0C,0x84,0x78,0x00,0x00,0x83,0x2A,0x03,0x7A,0x02,0x00,0x4E,
    0x2A,0x0F,0x7A,0x12,0x00,0x18,0x48,0x13,0x70,0xE8,0xE0,0x00,0x50,0x87,0x0C,0x88,0x78,0x00,0x00,0x69,0x2A,0x03,0x7A,0x02,0x00,0x34,0x2A,0x0E,0x7A,0x12,0x00,0x18,
    0x48,0x23,0x70,0xE8,0xE0,0x00,0x50,0x87,0x0C,0x8C,0x78,0x00,0x00,0x4F,0x2A,0x03,0x7A,0x02,0x00,0x1A,0x48,0x03,0x2A,0x0D,0x7A,0x12,0x00,0x12,0x48,0x33,0x70,0xE8,
    0xE0,0x00,0x50,0x87,0x0C,0x90,0x78,0x00,0x00,0x33,0xCF,0x01,0x00,0x90,0x1B,0xA1,0x08,0x2C,0x18,0x21,0x80,0x38,0x00,0x04,0x71,0x80,0xE0,0xFB,0x1D,0x8C,0x91,0xE8,
    0x7D,0x89,0x03,0xA6,0x00,0x06,0x44,0x00,0x71,0x80,0xE0,0xFB,0x1D,0x8C,0x93,0x4C,0x7D,0x89,0x03,0xA6,0x00,0x06,0x44,0x00,0x71,0x80,0xE0,0xFB,0x1D,0x8C,0x91,0xFC,
    0x7D,0x89,0x03,0xA6,0x00,0x06,0x44,0x00,0x71,0x80,0xE0,0xFA,0x1D,0x8C,0x45,0xAC,0x7D,0x89,0x03,0xA6,0x00,0x06,0x44,0x00,0x71,0x80,0xE0,0xFB,0x1D,0x8C,0x94,0x5C,
    0x7D,0x89,0x03,0xA6,0x00,0x06,0x44,0x00,0x71,0x80,0xE0,0xFA,0x1D,0x8C,0x45,0x9C,0x7D,0x89,0x03,0xA6,0x00,0x06,0x44,0x00,0x71,0x80,0xE0,0xFB,0x1D,0x8C,0x91,0x64,
    0x7D,0x89,0x03,0xA6,0x00,0x06,0x44,0x00,0x71,0x80,0xE0,0xFB,0x1D,0x8C,0x96,0xDC,0x7D,0x89,0x03,0xA6,0x00,0x06,0x44,0x00,0x71,0x80,0xE0,0xFB,0x1D,0x8C,0x97,0xAC,
    0x7D,0x89,0x03,0xA6,0x00,0x06,0x44,0x00,0x71,0x80,0xE0,0xFB,0x1D,0x8C,0x98,0x94,0x7D,0x89,0x03,0xA6,0x00,0x06,0x44,0x00,0x71,0x80,0xE0,0xFB,0x1D,0x8C,0x99,0x34,
    0x7D,0x89,0x03,0xA6,0x00,0x06,0x44,0x00
  };
  byte Z65H[0x1BC] = 
  {
    0x88,0x8F,0xE6,0xF8,0xC2,0xF6,0xE0,0x1B,0xB8,0xB8,0xF2,0xF2,0xBC,0xF6,0xF2,0xF3,0xBE,0xF6,0xDA,0xE0,0x22,0x0F,0xB8,0x28,0x42,0x8E,0xC2,0xF6,0x3D,0x09,0xF2,0xF2,
    0xBC,0xF6,0xF2,0xF3,0xBE,0xF6,0xF2,0xF4,0xC0,0xF6,0xDA,0xE0,0x74,0x0E,0xB8,0x28,0x98,0x8F,0xDB,0x00,0xF0,0x54,0xF2,0xFB,0xC4,0xF6,0xF2,0xFC,0xC6,0xF6,0x76,0xFB,
    0xAA,0x00,0xF0,0xDB,0x7C,0xED,0x5C,0x2C,0x70,0xCD,0x66,0xFB,0xFF,0x3F,0xE6,0xFD,0x50,0x00,0xDC,0x4C,0xB8,0xDB,0xF0,0xB2,0x7C,0xEB,0x5C,0x23,0x70,0x3B,0x66,0xF2,
    0xFF,0x3F,0xE6,0xFB,0xAA,0x00,0xDC,0x43,0xB8,0xB2,0xDA,0xE0,0x7C,0x0F,0xC0,0x42,0x48,0x20,0x3D,0x36,0xE0,0x0B,0xF2,0xFC,0xC4,0xF6,0xF2,0xFD,0xC6,0xF6,0x76,0xFC,
    0xF2,0x00,0xF0,0xEC,0x7C,0xEE,0x5C,0x2D,0x70,0xDE,0x66,0xFC,0xFF,0x3F,0x98,0xE5,0xDC,0x4D,0xB8,0xEC,0x86,0xFB,0x3F,0x00,0x8D,0xEE,0xF2,0xFB,0xC4,0xF6,0xF2,0xFC,
    0xC6,0xF6,0x76,0xFB,0xAA,0x00,0xF0,0xDB,0x7C,0xED,0x5C,0x2C,0x70,0xCD,0x66,0xFB,0xFF,0x3F,0xE6,0xFD,0xA0,0x00,0xDC,0x4C,0xB8,0xDB,0xF2,0xFB,0xC4,0xF6,0xF2,0xFC,
    0xC6,0xF6,0x76,0xFB,0x5A,0x00,0xF0,0xDB,0x7C,0xED,0x5C,0x2C,0x70,0xCD,0x66,0xFB,0xFF,0x3F,0xE6,0xFD,0xAA,0x00,0xDC,0x4C,0xB8,0xDB,0xDA,0xE0,0x7C,0x0F,0xC0,0x42,
    0xDB,0x00,0xF2,0xFB,0xC4,0xF6,0xF2,0xFC,0xC6,0xF6,0x76,0xFB,0xAA,0x00,0xF0,0xDB,0x7C,0xED,0x5C,0x2C,0x70,0xCD,0x66,0xFB,0xFF,0x3F,0xE6,0xFD,0x80,0x00,0xDC,0x4C,
    0xB8,0xDB,0xF2,0xFB,0xC4,0xF6,0xF2,0xFC,0xC6,0xF6,0x76,0xFB,0x54,0x00,0xF0,0xDB,0x7C,0xED,0x5C,0x2C,0x70,0xCD,0x66,0xFB,0xFF,0x3F,0xE6,0xFD,0xAA,0x00,0xDC,0x4C,
    0xB8,0xDB,0xF0,0xB2,0x7C,0xEB,0x5C,0x23,0x70,0x3B,0x66,0xF2,0xFF,0x3F,0xE0,0x3B,0xDC,0x43,0xB8,0xB2,0xDA,0xE0,0x7C,0x0F,0xC0,0x42,0xDB,0x00,0xD7,0x40,0xFF,0x03,
    0xF2,0xFB,0x06,0x3F,0xE6,0xFC,0x20,0x20,0xF6,0xFC,0xEA,0xE9,0x8A,0xFB,0xF6,0x00,0x8A,0xFB,0xF4,0x10,0xD7,0x50,0xFF,0x03,0xF2,0xFB,0x08,0x3F,0xF2,0xFC,0x0A,0x3F,
    0x8A,0xFB,0x02,0x00,0x9A,0xFB,0x10,0x10,0xF2,0xFD,0xC4,0xF6,0xF2,0xFE,0xC6,0xF6,0x76,0xFD,0xAA,0x00,0xF0,0x4D,0x7C,0xE4,0x5C,0x2E,0x70,0xE4,0x66,0xFD,0xFF,0x3F,
    0xE6,0xF4,0xF5,0x00,0xDC,0x4E,0xB8,0x4D,0x8A,0xFB,0x04,0x50,0x8A,0xFB,0x02,0x40,0x9A,0xFC,0x12,0x40,0xF2,0xFB,0xC4,0xF6,0xF2,0xFC,0xC6,0xF6,0x76,0xFB,0xAA,0x00,
    0xF0,0xDB,0x7C,0xED,0x5C,0x2C,0x70,0xCD,0x66,0xFB,0xFF,0x3F,0xE6,0xFD,0xF0,0x00,0xDC,0x4C,0xB8,0xDB,0xE1,0x14,0xDB,0x00,0xE1,0x04,0xDB,0x00
  };
  word crc16tab[256] =
  {
    0x0000, 0x1021, 0x2042, 0x3063, 0x4084, 0x50A5, 0x60C6, 0x70E7,0x8108, 0x9129, 0xA14A, 0xB16B, 0xC18C, 0xD1AD, 0xE1CE, 0xF1EF,
    0x1231, 0x0210, 0x3273, 0x2252, 0x52B5, 0x4294, 0x72F7, 0x62D6,0x9339, 0x8318, 0xB37B, 0xA35A, 0xD3BD, 0xC39C, 0xF3FF, 0xE3DE,
    0x2462, 0x3443, 0x0420, 0x1401, 0x64E6, 0x74C7, 0x44A4, 0x5485,0xA56A, 0xB54B, 0x8528, 0x9509, 0xE5EE, 0xF5CF, 0xC5AC, 0xD58D,
    0x3653, 0x2672, 0x1611, 0x0630, 0x76D7, 0x66F6, 0x5695, 0x46B4,0xB75B, 0xA77A, 0x9719, 0x8738, 0xF7DF, 0xE7FE, 0xD79D, 0xC7BC,
    0x48C4, 0x58E5, 0x6886, 0x78A7, 0x0840, 0x1861, 0x2802, 0x3823,0xC9CC, 0xD9ED, 0xE98E, 0xF9AF, 0x8948, 0x9969, 0xA90A, 0xB92B,
    0x5AF5, 0x4AD4, 0x7AB7, 0x6A96, 0x1A71, 0x0A50, 0x3A33, 0x2A12,0xDBFD, 0xCBDC, 0xFBBF, 0xEB9E, 0x9B79, 0x8B58, 0xBB3B, 0xAB1A,
    0x6CA6, 0x7C87, 0x4CE4, 0x5CC5, 0x2C22, 0x3C03, 0x0C60, 0x1C41,0xEDAE, 0xFD8F, 0xCDEC, 0xDDCD, 0xAD2A, 0xBD0B, 0x8D68, 0x9D49,
    0x7E97, 0x6EB6, 0x5ED5, 0x4EF4, 0x3E13, 0x2E32, 0x1E51, 0x0E70,0xFF9F, 0xEFBE, 0xDFDD, 0xCFFC, 0xBF1B, 0xAF3A, 0x9F59, 0x8F78,
    0x9188, 0x81A9, 0xB1CA, 0xA1EB, 0xD10C, 0xC12D, 0xF14E, 0xE16F,0x1080, 0x00A1, 0x30C2, 0x20E3, 0x5004, 0x4025, 0x7046, 0x6067,
    0x83B9, 0x9398, 0xA3FB, 0xB3DA, 0xC33D, 0xD31C, 0xE37F, 0xF35E,0x02B1, 0x1290, 0x22F3, 0x32D2, 0x4235, 0x5214, 0x6277, 0x7256,
    0xB5EA, 0xA5CB, 0x95A8, 0x8589, 0xF56E, 0xE54F, 0xD52C, 0xC50D,0x34E2, 0x24C3, 0x14A0, 0x0481, 0x7466, 0x6447, 0x5424, 0x4405,
    0xA7DB, 0xB7FA, 0x8799, 0x97B8, 0xE75F, 0xF77E, 0xC71D, 0xD73C,0x26D3, 0x36F2, 0x0691, 0x16B0, 0x6657, 0x7676, 0x4615, 0x5634,
    0xD94C, 0xC96D, 0xF90E, 0xE92F, 0x99C8, 0x89E9, 0xB98A, 0xA9AB,0x5844, 0x4865, 0x7806, 0x6827, 0x18C0, 0x08E1, 0x3882, 0x28A3,
    0xCB7D, 0xDB5C, 0xEB3F, 0xFB1E, 0x8BF9, 0x9BD8, 0xABBB, 0xBB9A,0x4A75, 0x5A54, 0x6A37, 0x7A16, 0x0AF1, 0x1AD0, 0x2AB3, 0x3A92,
    0xFD2E, 0xED0F, 0xDD6C, 0xCD4D, 0xBDAA, 0xAD8B, 0x9DE8, 0x8DC9,0x7C26, 0x6C07, 0x5C64, 0x4C45, 0x3CA2, 0x2C83, 0x1CE0, 0x0CC1,
    0xEF1F, 0xFF3E, 0xCF5D, 0xDF7C, 0xAF9B, 0xBFBA, 0x8FD9, 0x9FF8,0x6E17, 0x7E36, 0x4E55, 0x5E74, 0x2E93, 0x3EB2, 0x0ED1, 0x1EF0
  };
  dword crc32tab[256] = 
  {
    0x00000000, 0x77073096, 0xee0e612c, 0x990951ba,0x076dc419, 0x706af48f, 0xe963a535, 0x9e6495a3,0x0edb8832, 0x79dcb8a4, 0xe0d5e91e, 0x97d2d988,
    0x09b64c2b, 0x7eb17cbd, 0xe7b82d07, 0x90bf1d91,0x1db71064, 0x6ab020f2, 0xf3b97148, 0x84be41de,0x1adad47d, 0x6ddde4eb, 0xf4d4b551, 0x83d385c7,
    0x136c9856, 0x646ba8c0, 0xfd62f97a, 0x8a65c9ec,0x14015c4f, 0x63066cd9, 0xfa0f3d63, 0x8d080df5,0x3b6e20c8, 0x4c69105e, 0xd56041e4, 0xa2677172,
    0x3c03e4d1, 0x4b04d447, 0xd20d85fd, 0xa50ab56b,0x35b5a8fa, 0x42b2986c, 0xdbbbc9d6, 0xacbcf940,0x32d86ce3, 0x45df5c75, 0xdcd60dcf, 0xabd13d59,
    0x26d930ac, 0x51de003a, 0xc8d75180, 0xbfd06116,0x21b4f4b5, 0x56b3c423, 0xcfba9599, 0xb8bda50f,0x2802b89e, 0x5f058808, 0xc60cd9b2, 0xb10be924,
    0x2f6f7c87, 0x58684c11, 0xc1611dab, 0xb6662d3d,0x76dc4190, 0x01db7106, 0x98d220bc, 0xefd5102a,0x71b18589, 0x06b6b51f, 0x9fbfe4a5, 0xe8b8d433,
    0x7807c9a2, 0x0f00f934, 0x9609a88e, 0xe10e9818,0x7f6a0dbb, 0x086d3d2d, 0x91646c97, 0xe6635c01,0x6b6b51f4, 0x1c6c6162, 0x856530d8, 0xf262004e,
    0x6c0695ed, 0x1b01a57b, 0x8208f4c1, 0xf50fc457,0x65b0d9c6, 0x12b7e950, 0x8bbeb8ea, 0xfcb9887c,0x62dd1ddf, 0x15da2d49, 0x8cd37cf3, 0xfbd44c65,
    0x4db26158, 0x3ab551ce, 0xa3bc0074, 0xd4bb30e2,0x4adfa541, 0x3dd895d7, 0xa4d1c46d, 0xd3d6f4fb,0x4369e96a, 0x346ed9fc, 0xad678846, 0xda60b8d0,
    0x44042d73, 0x33031de5, 0xaa0a4c5f, 0xdd0d7cc9,0x5005713c, 0x270241aa, 0xbe0b1010, 0xc90c2086,0x5768b525, 0x206f85b3, 0xb966d409, 0xce61e49f,
    0x5edef90e, 0x29d9c998, 0xb0d09822, 0xc7d7a8b4,0x59b33d17, 0x2eb40d81, 0xb7bd5c3b, 0xc0ba6cad,0xedb88320, 0x9abfb3b6, 0x03b6e20c, 0x74b1d29a,
    0xead54739, 0x9dd277af, 0x04db2615, 0x73dc1683,0xe3630b12, 0x94643b84, 0x0d6d6a3e, 0x7a6a5aa8,0xe40ecf0b, 0x9309ff9d, 0x0a00ae27, 0x7d079eb1,
    0xf00f9344, 0x8708a3d2, 0x1e01f268, 0x6906c2fe,0xf762575d, 0x806567cb, 0x196c3671, 0x6e6b06e7,0xfed41b76, 0x89d32be0, 0x10da7a5a, 0x67dd4acc,
    0xf9b9df6f, 0x8ebeeff9, 0x17b7be43, 0x60b08ed5,0xd6d6a3e8, 0xa1d1937e, 0x38d8c2c4, 0x4fdff252,0xd1bb67f1, 0xa6bc5767, 0x3fb506dd, 0x48b2364b,
    0xd80d2bda, 0xaf0a1b4c, 0x36034af6, 0x41047a60,0xdf60efc3, 0xa867df55, 0x316e8eef, 0x4669be79,0xcb61b38c, 0xbc66831a, 0x256fd2a0, 0x5268e236,
    0xcc0c7795, 0xbb0b4703, 0x220216b9, 0x5505262f,0xc5ba3bbe, 0xb2bd0b28, 0x2bb45a92, 0x5cb36a04,0xc2d7ffa7, 0xb5d0cf31, 0x2cd99e8b, 0x5bdeae1d,
    0x9b64c2b0, 0xec63f226, 0x756aa39c, 0x026d930a,0x9c0906a9, 0xeb0e363f, 0x72076785, 0x05005713,0x95bf4a82, 0xe2b87a14, 0x7bb12bae, 0x0cb61b38,
    0x92d28e9b, 0xe5d5be0d, 0x7cdcefb7, 0x0bdbdf21,0x86d3d2d4, 0xf1d4e242, 0x68ddb3f8, 0x1fda836e,0x81be16cd, 0xf6b9265b, 0x6fb077e1, 0x18b74777,
    0x88085ae6, 0xff0f6a70, 0x66063bca, 0x11010b5c,0x8f659eff, 0xf862ae69, 0x616bffd3, 0x166ccf45,0xa00ae278, 0xd70dd2ee, 0x4e048354, 0x3903b3c2,
    0xa7672661, 0xd06016f7, 0x4969474d, 0x3e6e77db,0xaed16a4a, 0xd9d65adc, 0x40df0b66, 0x37d83bf0,0xa9bcae53, 0xdebb9ec5, 0x47b2cf7f, 0x30b5ffe9,
    0xbdbdf21c, 0xcabac28a, 0x53b39330, 0x24b4a3a6,0xbad03605, 0xcdd70693, 0x54de5729, 0x23d967bf,0xb3667a2e, 0xc4614ab8, 0x5d681b02, 0x2a6f2b94,
    0xb40bbe37, 0xc30c8ea1, 0x5a05df1b, 0x2d02ef8d
  };
}


on preStart
{
  @sysvar::Prog_power::K30 = 0;
  testWaitForTimeout(100);
  @sysvar::Prog_power::K30Volt = 12;
  @sysvar::Prog_power::K30Curr = 5;
  @sysvar::Prog_power::K30 = 1;
}

on timer timer_3e80
{
  message 0x7DF msg={dlc=8};
  msg.byte(0)=0x2;
  msg.byte(1)=0x3E;
  msg.byte(2)=0x80;
  output(msg);
  if(funID == 0x7FF)
  {
    message 0x7FF msg={dlc=8};
    msg.byte(0)=0x2;
    msg.byte(1)=0x3E;
    msg.byte(2)=0x80;
    output(msg);
  }
  timer_3e80_index++;
  if(timer_3e80_index==timer_3e80_count)
  {
    cancelTimer(timer_3e80);
    timer_3e80_index=0;
  }
  else
  {
    setTimerCyclic(timer_3e80,@AUTO::Handshake_Send_Time);
  }
  
}


//dword MX_Chery(dword z,dword y,dword sum,dword k)
//{
//  dword Part[3];
//  int i;
//  for(i=0;i<3;i++)
//    Part[i] = 0;
//  Part[0] = ((z>>5)^(y<<2));
//  Part[1] = (((y>>3)^(z<<4))^(sum^y));
//  Part[2] = (k^z);
//  return Part[0] + Part[1] + Part[2];
//}
//void LevelIMMO(byte Seed[],byte PIN[],byte Skey[])
//{
//  dword v[4],PINP[4];
//  dword k[4] = {0xBE355A5C,0xD6952BBE,0x355A5CD6,0x952B784E};
//  dword p,q;
//  dword z,y,sum,e,DELTA;
//  int i,n,NotNull;
//  n = 2;
//  z = v[n-1];
//  y = v[0];
//  sum = 0;
//  NotNull = 0;
//  DELTA = 0x9E3779B9;
//  for(i=0;i<4;i++)
//  {
//    v[i] = (Seed[i*4+0]<<(8*3)) + (Seed[i*4+1]<<(8*2)) + (Seed[i*4+2]<<(8*1)) + (Seed[i*4+3]&0xFF);
//    PINP[i] = (PIN[i*4+0]<<(8*3)) + (PIN[i*4+1]<<(8*2)) + (PIN[i*4+2]<<(8*1)) + (PIN[i*4+3]&0xFF);
//    if(PINP[i]!=0)
//      NotNull = 1;
//  }
//  if(NotNull == 1)
//    k[0] = (k[0]^PINP[0]);
//  
//  q = 58;
//  do{
//    sum += DELTA;
//    e = (sum>>2)&3;
//    p=0;
//    for(p=0;p<n-1;p++)
//    {
//      y = v[p+1];
//      z = v[p]+= MX_Chery(z,y,sum,k[p&3^e]);
//      y = v[0];
//      z = v[n-1]+=MX_Chery(z,y,sum,k[p&3^e]);
//    }
//  }while(q-->0);
//}


/// <Bin>
/*
    获取二进制数据并装载
    输入：文件路径
    输入：起始装载数据块
    输入：起始装载数据块
    FileNum文件位置：第0个为Flash文件
*/
void BinFile_ReadAndSave(char FileName[],byte Start_Block,int FileNum)
{
  char FileName_Temp[400];
  int fileInx,n,BlockBin_NumTemp;
  dword i;
  int fileHandle_,result;
  qword AddBin,LenBin,IndexBin;
  byte DataTemp[BinDataSave_MaxLen]; 
  snprintf(FileName_Temp,elCount(FileName_Temp),"%s",FileName);
  fileInx = strlen(FileName_Temp);
  if(FileName_Temp[fileInx-3] == 'b' && FileName_Temp[fileInx-2] == 'i' && FileName_Temp[fileInx-1] == 'n')
  {
    fileHandle_ = OpenFileRead(FileName_Temp,1);
    result = fileGetBinaryBlock (DataTemp, elCount(DataTemp),fileHandle_);
    BlockBin_Flage = 1;
    BlockBin_NumTemp =BlockBin_Num + DataTemp[32];
    AddBin = 0;LenBin = 0;IndexBin = 32;
    IndexBin = IndexBin + DataTemp[32]*8 + 1;
    if(FileNum == 0)  //Flash处理，默认Flash仅一段，不存入结构体中，减少结构体占用大小
    {
      BlockBin_Num = 0;//起始时清除块计数
      IndexBin = 1; //Flash装载格式不一致，默认从0开始装载 区块数量 + 地址 + 长度 + 内容
      AddBin = (DataTemp[IndexBin+0]<<24)|(DataTemp[IndexBin+1]<<16)|(DataTemp[IndexBin+2]<<8)|(DataTemp[IndexBin+3]);
      LenBin = (DataTemp[IndexBin+4]<<24)|(DataTemp[IndexBin+5]<<16)|(DataTemp[IndexBin+6]<<8)|(DataTemp[IndexBin+7]);
      DriverAddr = AddBin;
      DriverSize = LenBin;
      IndexBin +=8;
      for(i=IndexBin;i<DriverSize + IndexBin;i++)
        BlockBin_Flash[i-IndexBin] = DataTemp[i];
      hexfile_app[0].FilePos = 0;
    }
    else
    {
      for(n=Start_Block;n<BlockBin_NumTemp;n++)
      {
        AddBin = (DataTemp[33+(n-Start_Block)*8]<<24)|(DataTemp[34+(n-Start_Block)*8]<<16)|(DataTemp[35+(n-Start_Block)*8]<<8)|(DataTemp[36+(n-Start_Block)*8]);
        LenBin = (DataTemp[37+(n-Start_Block)*8]<<24)|(DataTemp[38+(n-Start_Block)*8]<<16)|(DataTemp[39+(n-Start_Block)*8]<<8)|(DataTemp[40+(n-Start_Block)*8]);
        hexfile_app[n].BlockStartAddr = AddBin;
        hexfile_app[n].BlockDataLength = LenBin;
        hexfile_app[n].BlockEndAddr = hexfile_app[n].BlockStartAddr + hexfile_app[n].BlockDataLength - 1;
        hexfile_app[n].FilePos = FileNum; //从1开始，0为Flash部分
        /*[流式改造-2026-09]原将整段数据拷贝到 hexfile_app[n].dataBuffer[0x200000] 导致
          内存峰值4MB(栈DataTemp 2MB + 全局dataBuffer 2MB)。现 dataBuffer 缩为 0x1000 单页缓冲,
          实际数据在 _download_5_stream 中按 Blocksize_36 分页从文件流式读取。原拷贝循环已屏蔽:
          for(i=IndexBin;i<hexfile_app[n].BlockDataLength + IndexBin;i++)
            hexfile_app[n].dataBuffer[i-IndexBin] = DataTemp[i];
          IndexBin = IndexBin + hexfile_app[n].BlockDataLength;*/
      }
      BlockBin_Num = BlockBin_NumTemp;
      /*[流式改造-2026-09]记录该文件栏的流式元数据:数据段起始偏移、block 索引与数量。
        数据段在文件中连续排列,流式读取时按 block 顺序 fileGetBinaryBlock 即可覆盖。*/
      binDataOffset[FileNum]  = IndexBin;
      binBlockIndex[FileNum]  = Start_Block;
      binBlockCount[FileNum]  = BlockBin_NumTemp - Start_Block;
    }
    fileClose(fileHandle_);
  }
}
/// <Bin>
/*
    [流式改造-2026-09]bin 流式读取辅助函数:打开文件并跳过头部到数据段起始。
    输入：FileNum 文件栏编号(1,2,...)
    返回：文件句柄(0表示失败)。句柄存入 binFileHandle[FileNum] 供后续 BinFile_ReadPage 使用。
    说明:CAPL File I/O 无 fileSeek,利用 fileGetBinaryBlock 顺序读取特性,读取 binDataOffset
         字节丢弃以定位到数据段起始。buffer 大小取 0x200 覆盖头部最大值(30块*8+33=273)。
*/
dword BinFile_OpenStream(int FileNum)
{
  char filename[400];
  int fileHandle_;
  byte skipBuf[0x200];
  dword skipLen,readLen;
  /*路径选择与 _getEraseAddrBin 一致:支持 Alternate_DownLoad_Flage 切换文件栏组*/
  if(Alternate_DownLoad_Flage == 0 || Alternate_DownLoad_Flage == 1)
  {
    if(FileNum==1)
      sysGetVariableString(sysvar::AUTO::openFile_Bin1,filename,elCount(filename));
    else if(FileNum==2)
      sysGetVariableString(sysvar::AUTO::openFile_Bin2,filename,elCount(filename));
    else
      sysGetVariableString(sysvar::AUTO::openFile_Bin1,filename,elCount(filename));
  }
  else
  {
    if(FileNum==1)
      sysGetVariableString(sysvar::AUTO::openFile2_Bin1,filename,elCount(filename));
    else if(FileNum==2)
      sysGetVariableString(sysvar::AUTO::openFile2_Bin2,filename,elCount(filename));
    else
      sysGetVariableString(sysvar::AUTO::openFile2_Bin1,filename,elCount(filename));
  }
  fileHandle_ = OpenFileRead(filename,1);
  if(fileHandle_==0)
    return 0;
  skipLen = binDataOffset[FileNum];
  {
    dword remaining, thisSkip;
    remaining = skipLen;
    while(remaining > 0)
    {
      if(remaining > elCount(skipBuf))
        thisSkip = elCount(skipBuf);
      else
        thisSkip = remaining;
      readLen = fileGetBinaryBlock(skipBuf,thisSkip,fileHandle_);
      if((long)readLen != (long)thisSkip)
      {
        writeEx(-3,1,"[流式]跳过头部失败,剩余%d 实际读了%d,文件栏%d",remaining,readLen,FileNum);
        fileClose(fileHandle_);
        return 0;
      }
      remaining -= thisSkip;
    }
  }
  binFileHandle[FileNum] = fileHandle_;
  return fileHandle_;
}

/// <Bin>
/*
    [流式改造-2026-09]从已打开的 bin 文件流式读取一页数据。
    输入：fileHandle 文件句柄(BinFile_OpenStream 返回)
         pageBuf    页缓冲(调用方保证大小>=pageSize)
         pageSize   期望读取的字节数
    返回：实际读取的字节数(文件末尾可能小于pageSize)
    说明:fileGetBinaryBlock 从当前文件位置读取最多 pageSize 字节,顺序前进。
*/
dword BinFile_ReadPage(dword fileHandle,byte pageBuf[],dword pageSize)
{
  return fileGetBinaryBlock(pageBuf,pageSize,fileHandle);
}

/// <Bin>
/*
    [流式改造-2026-09]关闭 bin 流式文件句柄。
*/
void BinFile_CloseStream(int FileNum)
{
  if(binFileHandle[FileNum]!=0)
  {
    fileClose(binFileHandle[FileNum]);
    binFileHandle[FileNum] = 0;
  }
}

/// <Bin>
/*
    获取二进制数据并装载
    输入：文件路径
    输入：起始装载数据块
    输入：起始装载数据块
    FileNum文件位置：第0个为Flash文件
*/
void BinFile_ReadAndSaveOutPut(char FileName[],byte Start_Block,int FileNum)
{
  char FileName_Temp[400];
  int fileInx,i,n,BlockBin_NumTemp;
  int fileHandle_,result;
  qword AddBin,LenBin,IndexBin;
  byte DataTemp[BinDataSave_MaxLen]; 
  snprintf(FileName_Temp,elCount(FileName_Temp),"%s",FileName);
  fileInx = strlen(FileName_Temp);
  if(FileName_Temp[fileInx-3] == 'b' && FileName_Temp[fileInx-2] == 'i' && FileName_Temp[fileInx-1] == 'n')
  {
    BlockBin_Flage = 1;
    fileHandle_ = OpenFileRead(FileName_Temp,1);
    result = fileGetBinaryBlock (DataTemp, elCount(DataTemp),fileHandle_);
    
    BlockBin_NumTemp =BlockBin_Num + DataTemp[32];
    AddBin = 0;LenBin = 0;IndexBin = 0;
    IndexBin = IndexBin + DataTemp[32]*8 + 1;
    if(FileNum == 0)  //Flash处理，默认Flash仅一段，不存入结构体中，减少结构体占用大小
    {
      BlockBin_Num = 0;//起始时清除块计数
      
      IndexBin = 1; //Flash装载格式不一致，默认从0开始装载 区块数量 + 地址 + 长度 + 内容
      AddBin = (DataTemp[IndexBin+0]<<24)|(DataTemp[IndexBin+1]<<16)|(DataTemp[IndexBin+2]<<8)|(DataTemp[IndexBin+3]);
      LenBin = (DataTemp[IndexBin+4]<<24)|(DataTemp[IndexBin+5]<<16)|(DataTemp[IndexBin+6]<<8)|(DataTemp[IndexBin+7]);
//      AddBin = (DataTemp[33+(n-Start_Block)*8]<<24)|(DataTemp[34+(n-Start_Block)*8]<<16)|(DataTemp[35+(n-Start_Block)*8]<<8)|(DataTemp[36+(n-Start_Block)*8]);
//      LenBin = (DataTemp[37+(n-Start_Block)*8]<<24)|(DataTemp[38+(n-Start_Block)*8]<<16)|(DataTemp[39+(n-Start_Block)*8]<<8)|(DataTemp[40+(n-Start_Block)*8]);
      DriverAddr = AddBin;
      DriverSize = LenBin;
      for(i=0;i<50;i++)
        writeEx(-3,0,"DataTemp[%d] = %02X",i,DataTemp[i]);
      writeEx(-3,0,"--------------------------------");
      writeEx(-3,0,"DriverAddr =   0x%X",DriverAddr);
      writeEx(-3,0,"DriverSize =   0x%X",DriverSize);
      writeEx(-3,0,"--------------------------------");
    }
    else
    {
      for(n=Start_Block;n<BlockBin_NumTemp;n++)
      {
        AddBin = (DataTemp[33+(n-Start_Block)*8]<<24)|(DataTemp[34+(n-Start_Block)*8]<<16)|(DataTemp[35+(n-Start_Block)*8]<<8)|(DataTemp[36+(n-Start_Block)*8]);
        LenBin = (DataTemp[37+(n-Start_Block)*8]<<24)|(DataTemp[38+(n-Start_Block)*8]<<16)|(DataTemp[39+(n-Start_Block)*8]<<8)|(DataTemp[40+(n-Start_Block)*8]);
        hexfile_app[n].BlockStartAddr = AddBin;
        hexfile_app[n].BlockDataLength = LenBin;
        hexfile_app[n].BlockEndAddr = hexfile_app[n].BlockStartAddr + hexfile_app[n].BlockDataLength - 1;
        hexfile_app[n].FilePos = FileNum; //从1开始，0为Flash部分
        for(i=0;i<50;i++)
          writeEx(-3,0,"DataTemp[%d] = %02X",i,DataTemp[i]);
        writeEx(-3,0,"--------------------------------");
        writeEx(-3,0,"hexfile_app[%d].BlockStartAddr =    0x%X",n,hexfile_app[n].BlockStartAddr);
        writeEx(-3,0,"hexfile_app[%d].BlockDataLength =   0x%X",n,hexfile_app[n].BlockDataLength);
        writeEx(-3,0,"--------------------------------");
      }
      BlockBin_Num = BlockBin_NumTemp;
    }
    fileClose(fileHandle_);
  }
}

/// <Bin>
void Down_BinFlash()
{
  writeEx(-3,0,"开始下载Flash");
  //驱动下载34
  FlashDriver_34();
  if(Exit_34_f==1)
  {
    Exit_Re_Prog = 1;
    return;
  }
  //驱动下载36
  FlashDriver_36();
  if(Exit_36_f==1)
  {
    Exit_Re_Prog = 1;
    return;
  }
  //驱动下载37  
  FlashDriver_37();
  if(Exit_37_f==1)
  {
    Exit_Re_Prog = 1;
    return;
  }
  if(@AUTO::FlashDriver_Switch == 0xFF)
    _Send0202_f(BlockBin_Flash,DriverSize,phyID,Resp_0202_f);
  else
  {
    if(@AUTO::FlashDriver_Switch==1)//J80J3-F
      _Send0202_f(J80J3_F,DriverSize,phyID,Resp_0202_f);
    else if(@AUTO::FlashDriver_Switch==2)//J80J3-A
      _Send0202_f(J80J3_A,DriverSize,phyID,Resp_0202_f);
    else if(@AUTO::FlashDriver_Switch==3)//J80J3-B
      _Send0202_f(J80J3_B,DriverSize,phyID,Resp_0202_f);
    else if(@AUTO::FlashDriver_Switch==4)//Z65H
      _Send0202_f(Z65H,DriverSize,phyID,Resp_0202_f);
  }
  writeEx(-3,0,"Flash下载完毕");
}

/// <RSA>
/* ============================================================================
   RSA1 签名数据获取函数
   功能：从 sysvar::AUTO::RSA1 装载文件路径，读取文本格式的 0x.. 数据，
   解析为字节数组 RSAData[]，设置 RSALen，输出长度与完整 16 进制。
   对应文件：E:\TRAE_IDE_WorkSpace\BT_Download\CBF与RSA文件\验签1.rsa
   有效数据：384 字节（RSA-3072 签名值）
   ============================================================================ */
/* 十六进制 ASCII 字符转数值（'0'~'9','A'~'F','a'~'f'） */
byte RSA_HexCharToVal(byte c)
{
  if (c <= 0x39) return (byte)(c - 0x30);
  return (byte)((c & 0x0F) + 9);            /* 'A'/'a' 均为 0x?1，低4位+9 */
}
/// <RSA>
/* 0~15 转十六进制 ASCII 字符 */
byte RSA_ValToHexChar(byte v)
{
  return (byte)(v < 10 ? 0x30 + v : 0x37 + v);  /* 0x37+10=0x41='A' */
}
/// <RSA>
/* 扫描 ASCII 缓冲中的 "0x.." 数据，追加到 RSAData */
void RSA_ParseAscii(byte buf[], long n)
{
  long i = 0;

  while (i + 3 < n && RSALen < elCount(RSAData))
  {
    if (buf[i] == 0x30 && (buf[i + 1] | 0x20) == 0x78)   /* 'x'/'X' 统一按小写判断 */
    {
      RSAData[RSALen++] = (byte)((RSA_HexCharToVal(buf[i + 2]) << 4) | RSA_HexCharToVal(buf[i + 3]));
      i += 4;
    }
    else
      i++;
  }
}
/// <RSA>
/* 打印 RSAData 16 进制：spaced=1 每行16字节带偏移空格；spaced=0 每行32字节连续 hex */
void RSA_PrintHex(byte spaced)
{
  char  line[128];
  dword i, j, step, k;

  step = (spaced == 1) ? 16 : 32;
  for (i = 0; i < RSALen; i += step)
  {
    line[0] = 0;
    for (j = 0; j < step && (i + j) < RSALen; j++)
    {
      k = j * ((spaced == 1) ? 3 : 2);
      line[k]     = (char)RSA_ValToHexChar((byte)(RSAData[i + j] >> 4));
      line[k + 1] = (char)RSA_ValToHexChar((byte)(RSAData[i + j] & 0x0F));
      if (spaced == 1) { line[k + 2] = ' '; line[k + 3] = 0; }
      else              { line[k + 2] = 0; }
    }
    if (spaced == 1)
    {
      line[strlen(line) - 1] = 0;   /* 去掉末尾空格 */
      write("RSA1: [%04X] %s", i, line);
    }
    else
      write("RSA1: %s", line);
  }
}
/// <RSA>
void RSA_LoadFromSysvar(char filePath[])
{
  byte  rawBuf[8192];
  dword hFile;
  long  readLen;

  RSALen = 0;
  /* 打开文件（CAPL: openFileRead，mode 0=文本，与工程内 hex/vbf 读取一致） */
  hFile = openFileRead(filePath, 0);
  if (hFile == 0)
  {
    write("RSA1 ERR: 无法打开文件 %s", filePath);
    return;
  }
  /* CAPL: fileGetBinaryBlock 读取原始字节（文本形式 0x.., ...），返回实际读取字节数 */
  readLen = fileGetBinaryBlock(rawBuf, elCount(rawBuf), hFile);
  fileClose(hFile);
  if (readLen <= 0)
  {
    write("RSA1 ERR: 文件读取失败或为空 %s", filePath);
    return;
  }
  
  /* 解析 "0x10, 0xA9, ..." -> RSAData[] */
  RSA_ParseAscii(rawBuf, readLen);

  /* 输出长度与首尾字节 */
  write("RSA1: 文件路径 = %s", filePath);
  write("RSA1: 原始文件读取字节数 = %d 字节", readLen);
  write("RSA1: 解析后有效长度 = %d 字节 (0x%X)", RSALen, RSALen);
  if (RSALen > 0)
    write("RSA1: 首字节 = 0x%02X, 末字节 = 0x%02X", RSAData[0], RSAData[RSALen - 1]);

  /* 16 进制输出：分行带偏移 + 连续串 */
  write("RSA1: 分行 16 进制输出（每行 16 字节）：");
  RSA_PrintHex(1);
  write("RSA1: 连续 16 进制串（长度 %d 字符）：", RSALen * 2);
  RSA_PrintHex(0);
}

/// <CBF>
int CBFFile_ReadAndSave(char FileName[])
{
  int result,i,fileHandle;
  byte DataTemp[4096];
  word inx ;
  fileHandle = OpenFileRead(FileName,1);
  result = fileGetBinaryBlock(DataTemp,elCount(DataTemp),fileHandle);
  fileClose(fileHandle);
  hexfile_app[0].BlockStartAddr = 0;
  hexfile_app[0].BlockDataLength = 0;
  
  inx=Hexandchar_strstr(DataTemp,0,"start_address");
  if(inx>0)
  {
    inx+=5; // start_address":"0x
    for(i=0 ; i < 8; i++)
      hexfile_app[0].BlockStartAddr = hexfile_app[0].BlockStartAddr << 4 | char2byte(DataTemp[inx+i]);
    write("BlockStartAddr = %X",hexfile_app[0].BlockStartAddr);
  }
  inx=Hexandchar_strstr(DataTemp,0,"length");
  if(inx>0)
  {
    inx+=5;//length":"0x
    for(i=0 ; i < 8; i++)
      hexfile_app[0].BlockDataLength = hexfile_app[0].BlockDataLength << 4 | char2byte(DataTemp[inx+i]);
    write("BlockDataLength = %X",hexfile_app[0].BlockDataLength);
  }
  /* 定位 JSON 结束符 "}]}",其返回值指向 "}]}}" 之后;
     随后紧跟 10 字节二进制头(起始地址4B BE + 长度4B BE + 校验2B),再后即为纯刷写数据。
     若未找到 "}]}",回退到原偏移计算方式。 */
  inx=Hexandchar_strstr(DataTemp,0,"\"}]}");
  if(inx>0)
  {
    inx += 8; // 跳过 10 字节二进制头,定位到纯数据起始
  }
  else
    inx += 20; // 兜底 添加 }]} 地址 以及 长度 偏移，算出数据起始位置(8 上方长度起始 +3 后括号+8 地址与长度)
  cbfDataOffset = inx;
  hexfile_app[0].BlockEndAddr = hexfile_app[0].BlockStartAddr + hexfile_app[0].BlockDataLength;

//  writeEx(-3,0,"cbfDataOffset = %X",cbfDataOffset);
//  writeEx(-3,0,"BlockStartAddr = 0x%08X",hexfile_app[0].BlockStartAddr);
//  writeEx(-3,0,"BlockDataLength = 0x%08X",hexfile_app[0].BlockDataLength);
//  writeEx(-3,0,"BlockEndAddr = 0x%08X",hexfile_app[0].BlockEndAddr);
  return inx;
}
/// <CBF>
/*
    [CBF流式]打开 CBF 文件并跳过头部到纯数据段起始。
    路径取 sysvar::AUTO::CBF1,跳过 cbfDataOffset 字节(由 CBFFile_ReadAndSave 计算)。
    返回:文件句柄(0表示失败)。句柄存入全局 cbfFileHandle 供后续读取使用。
    说明:CAPL File I/O 无 fileSeek,利用 fileGetBinaryBlock 顺序丢弃 cbfDataOffset 字节定位。
*/
dword CBFFile_OpenStream()
{
  char filename[400];
  int fileHandle_;
  byte skipBuf[0x400];
  dword skipLen,readLen,remaining,thisSkip;
  sysGetVariableString(sysvar::AUTO::CBF1,filename,elCount(filename));
  fileHandle_ = OpenFileRead(filename,1);
  if(fileHandle_==0)
  {
    writeEx(-3,1,"[CBF流式]打开 CBF 文件失败:%s",filename);
    return 0;
  }
  skipLen = cbfDataOffset;
  remaining = skipLen;
  while(remaining > 0)
  {
    if(remaining > elCount(skipBuf))
      thisSkip = elCount(skipBuf);
    else
      thisSkip = remaining;
    readLen = fileGetBinaryBlock(skipBuf,thisSkip,fileHandle_);
    if((long)readLen != (long)thisSkip)
    {
      writeEx(-3,1,"[CBF流式]跳过头部失败,剩余%d 实际读了%d",remaining,readLen);
      fileClose(fileHandle_);
      return 0;
    }
    remaining -= thisSkip;
  }
  cbfFileHandle = fileHandle_;
  return fileHandle_;
}

/// <CBF>
/*
    [CBF流式]关闭 CBF 流式文件句柄。
*/
void CBFFile_CloseStream()
{
  if(cbfFileHandle!=0)
  {
    fileClose(cbfFileHandle);
    cbfFileHandle = 0;
  }
}


/// <DownLoad>
/*---------------------------------------------函数---------------------------------------------*/
/*不同的主机厂的参数初始化*/
void CarConfig_Init()
{
  if(@AUTO::Config_Switch==1) //BYD
  {
    revID=0x78B;                        //诊断接收ID
    phyID=0x783;                        //物理寻址ID
    funID=0x7DF;                        //功能寻址ID
    High_Volt = 16.0;                   //高电压边界值
    Low_Volt = 9.0;                     //低电压边界值
    Normal_Volt = 12.0;                 //正常电压
    DataLengthmax_34 = 0xFFF;           //响应34服务时的数据最大长度
    Blocksize_36 = DataLengthmax_34-2;  //36服务传输数据的数据块大小
    TxMessage_ID = 0x24C;               //外发报文ID
    p2cmax=50;                          //服务器响应的最长时间ms
    p2exs=500;                          //服务器发送NRC78到下一响应的最长时间10ms
    PassState_31[0] = 0x00;             //响应31服务时的事务状态
    SeedLevel = 0x1;                    //安全算法种子等级
    if(@AUTO::Security_Switch==1)
      SeedLevel = 0x03;
    NRC78_max = 15;                     //NRC78连续响应的最大次数
  }
  else if(@AUTO::Config_Switch==2) //ChangAn
  {
    revID=0x78D;                        //诊断接收ID
    phyID=0x785;                        //物理寻址ID
    funID=0x7DF;                        //功能寻址ID
    High_Volt = 16.5;                   //高电压边界值
    Low_Volt = 8.5;                     //低电压边界值
    Normal_Volt = 12;                   //正常电压
    DataLengthmax_34 = 0xFFF;  //0x402           //响应34服务时的数据最大长度
    Blocksize_36 = DataLengthmax_34-2;  //36服务传输数据的数据块大小
    TxMessage_ID = 0x170;               //外发报文ID
    p2cmax=50;                          //服务器响应的最长时间ms
    p2exs=500;                          //服务器发送NRC78到下一响应的最长时间10ms
    ReBlocknum_max = 4;                 //36数据块允许重复发送最大次数
    SeedLevel = 0x1;                    //安全算法种子等级
  }
  else if(@AUTO::Config_Switch==3) //Geely 1.0
  {
    revID=0x7DA;                        //诊断接收ID
    phyID=0x7D2;                        //物理寻址ID
    funID=0x7DF;                        //功能寻址ID
    High_Volt = 16;                     //高电压边界值
    Low_Volt = 9;                       //低电压边界值
    Normal_Volt = 12;                   //正常电压
    DataLengthmax_34 = 0x402;           //响应34服务时的数据最大长度
//     DataLengthmax_34 = 0xFFF;
    Blocksize_36 = DataLengthmax_34-2;  //36服务传输数据的数据块大小
    TxMessage_ID = 0x150;               //外发报文ID      
    p2cmax=50;                          //服务器响应的最长时间ms
    p2exs=200;                          //服务器发送NRC78到下一响应的最长时间10ms
    PassState_31[0] = 0x04;             //响应31服务时的事务状态
    ReBlocknum_max = 5;                 //36数据块允许重复发送最大次数
    ReBlocknum_Flage = 0;               //数据块多次重复是否积极响应,0否，1是
    SeedLevel = 0x11;                   //安全算法种子等级
//    Burn_in_Board = 0;                  //老化板类型
  }
  else if(@AUTO::Config_Switch==4) //Geely 3.0
  {
    revID=0x670;                        //诊断接收ID
    phyID=0x770;                        //物理寻址ID
    funID=0x7FF;                        //功能寻址ID
    High_Volt = 16;                     //高电压边界值
    Low_Volt = 9;                       //低电压边界值
    Normal_Volt = 12;                   //正常电压
    DataLengthmax_34 = 0x802;// 0xF02          //响应34服务时的数据最大长度
    Blocksize_36 = DataLengthmax_34-2;  //36服务传输数据的数据块大小
    TxMessage_ID = 0x46;                //外发报文ID      
    p2cmax=25;                          //服务器响应的最长时间ms
    p2exs=500;                          //服务器发送NRC78到下一响应的最长时间10ms
    PassState_31[0] = 0x10;             //响应31服务时的事务状态
    PassState_31[1] = 0x00;
    ReBlocknum_max = 5;                 //36数据块允许重复发送最大次数
    SeedLevel = 0x1;                    //安全算法种子等级
    @AUTO::EraseAddr_FBT = 0xA0000000;  //FBT的擦除地址
    @AUTO::EraseAddr_FBT = 0xA0030000;  //SBT的擦除地址
  }
  else if(@AUTO::Config_Switch==5) //鑫源
  {
    revID=0x628;                        //诊断接收ID
    phyID=0x6A8;                        //物理寻址ID
    funID=0x7DF;                        //功能寻址ID
    High_Volt = 16;                     //高电压边界值
    Low_Volt = 9;                       //低电压边界值
    Normal_Volt = 12;                   //正常电压
    DataLengthmax_34 = 0x82;            //响应34服务时的数据最大长度
    Blocksize_36 = DataLengthmax_34-2;  //36服务传输数据的数据块大小
    TxMessage_ID = 0x315;               //外发报文ID      
    p2cmax=50;                          //服务器响应的最长时间ms
    p2exs=200;                          //服务器发送NRC78到下一响应的最长时间10ms
    PassState_31[0] = 0x04;             //响应31服务时的事务状态
    ReBlocknum_max = 5;                 //36数据块允许重复发送最大次数
    SeedLevel = 0x11;                   //安全算法种子等级
  }
  else if(@AUTO::Config_Switch==6) //瑞驰
  {
    revID=0x7A3;                        //诊断接收ID
    phyID=0x723;                        //物理寻址ID
    funID=0x7DF;                        //功能寻址ID
    High_Volt = 16;                     //高电压边界值
    Low_Volt = 9;                       //低电压边界值
    Normal_Volt = 12;                   //正常电压
    DataLengthmax_34 = 0x402;           //响应34服务时的数据最大长度
    Blocksize_36 = DataLengthmax_34-2;  //36服务传输数据的数据块大小
    TxMessage_ID = 0x180;               //外发报文ID      
    p2cmax=50;                          //服务器响应的最长时间ms
    p2exs=500;                          //服务器发送NRC78到下一响应的最长时间10ms
    PassState_31[0] = 0x00;             //响应31服务时的事务状态
    PassState_31[1] = 0x01;             //响应31服务时的事务状态_传输错误时使用
    ReBlocknum_max = 5;                 //36数据块允许重复发送最大次数
    SeedLevel = 0x7;                    //安全算法种子等级
    BT_1003 = 0;                        //APP无效下是否支持10 03；0:支持 1:不支持
    BT_85 = 1;                          //APP无效下是否支持85；0:支持 1:不支持
    BT_28 = 1;                          //APP无效下是否支持85；0:支持 1:不支持
  }
  else if(@AUTO::Config_Switch==7) //奇瑞
  {
    revID=0x734;                        //诊断接收ID
    phyID=0x724;                        //物理寻址ID
    funID=0x7DF;                        //功能寻址ID
    High_Volt = 16;                     //高电压边界值
    Low_Volt = 9;                       //低电压边界值
    Normal_Volt = 12;                   //正常电压
    DataLengthmax_34 = 0x402;            //响应34服务时的数据最大长度  //0x402;
    Blocksize_36 = 0x82-2;  //36服务传输数据的数据块大小
    TxMessage_ID = 0x1D3;               //外发报文ID      
    p2cmax=50;                          //服务器响应的最长时间ms
    p2exs=500;                          //服务器发送NRC78到下一响应的最长时间10ms
    PassState_31[0] = 0x01;             //响应31服务时的事务状态
    PassState_31[1] = 0x02;             //响应31服务时的事务状态
    PassState_31[2] = 0x04;             //响应31服务时的事务状态
    ReBlocknum_max = 10;                //36数据块允许重复发送最大次数
    @AUTO::EraseAddr_FBT = 0x00000000;  //FBT的擦除地址
    SeedLevel = 0x3;                    //安全算法种子等级
    BT_1003 = 0;                        //APP无效下是否支持10 03；0:支持 1:不支持
    BT_85 = 0;                          //APP无效下是否支持85；0:支持 1:不支持
    BT_28 = 1;                          //APP无效下是否支持85；0:支持 1:不支持
  }
  else if(@AUTO::Config_Switch==8) //五菱
  {
    revID=0x758;                        //诊断接收ID
    phyID=0x750;                        //物理寻址ID
    funID=0x7DF;                        //功能寻址ID
    High_Volt = 16;                     //高电压边界值
    Low_Volt = 9;                       //低电压边界值
    Normal_Volt = 12;                   //正常电压
    DataLengthmax_34 = 0x402;           //响应34服务时的数据最大长度
    Blocksize_36 = DataLengthmax_34-2;  //36服务传输数据的数据块大小
    TxMessage_ID = 0x1E5;               //外发报文ID      
    p2cmax=50;                          //服务器响应的最长时间ms
    p2exs=500;                          //服务器发送NRC78到下一响应的最长时间10ms
    PassState_31[0] = 0x00;             //响应31服务时的事务状态
    ReBlocknum_max = 5;                 //36数据块允许重复发送最大次数
    NRC78_max = 3;                      //NRC78连续响应的最大次数
    SeedLevel = 0x5;                    //安全算法种子等级
    BT_1003 = 1;                        //APP无效下是否支持10 03；0:支持 1:不支持
    BT_85 = 1;                          //APP无效下是否支持85；0:支持 1:不支持
    BT_28 = 1;                          //APP无效下是否支持85；0:支持 1:不支持
  }
  else if(@AUTO::Config_Switch==9) //东风小康
  {
    revID=0x7A3;                        //诊断接收ID
    phyID=0x723;                        //物理寻址ID
    funID=0x7DF;                        //功能寻址ID
    High_Volt = 16;                     //高电压边界值
    Low_Volt = 9;                       //低电压边界值
    Normal_Volt = 12;                   //正常电压
    DataLengthmax_34 = 0x82;            //响应34服务时的数据最大长度
    Blocksize_36 = DataLengthmax_34-2;  //36服务传输数据的数据块大小
    TxMessage_ID = 0x180;               //外发报文ID      
    p2cmax=50;                          //服务器响应的最长时间ms
    p2exs=500;                          //服务器发送NRC78到下一响应的最长时间10ms
    PassState_31[0] = 0x00;             //响应31服务时的事务状态
    ReBlocknum_max = 6;                 //36数据块允许重复发送最大次数
    NRC78_max = 3;                      //NRC78连续响应的最大次数
    SeedLevel = 0x9;                    //安全算法种子等级
  }
  else if(@AUTO::Config_Switch==10) //赛力斯
  {
    revID=0x7A3;                        //诊断接收ID
    phyID=0x723;                        //物理寻址ID
    funID=0x7DF;                        //功能寻址ID
    High_Volt = 16;                     //高电压边界值
    Low_Volt = 9;                       //低电压边界值
    Normal_Volt = 12;                   //正常电压
    DataLengthmax_34 = 0x82;            //响应34服务时的数据最大长度
    Blocksize_36 = DataLengthmax_34-2;  //36服务传输数据的数据块大小
    TxMessage_ID = 0x180;               //外发报文ID      
    p2cmax=50;                          //服务器响应的最长时间ms
    p2exs=500;                          //服务器发送NRC78到下一响应的最长时间10ms
    PassState_31[0] = 0x00;             //响应31服务时的事务状态
    ReBlocknum_max = 6;                 //36数据块允许重复发送最大次数
    NRC78_max = 3;                      //NRC78连续响应的最大次数
    SeedLevel = 0x9;                    //安全算法种子等级
    UnsupportDID = 0xF187;              //不支持的DID
    Unnormal_FF01 = 1;                  //异常流程下FF 01是否正响应；0:正响应 1:负响应
  }
  else if(@AUTO::Config_Switch==11) //奇瑞T1V 5.0
  {
    revID=0x7A3;                        //诊断接收ID
    phyID=0x723;                        //物理寻址ID
    funID=0x7DF;                        //功能寻址ID
    High_Volt = 16;                     //高电压边界值
    Low_Volt = 9;                       //低电压边界值
    Normal_Volt = 12;                   //正常电压
    DataLengthmax_34 = 0xFFF;            //响应34服务时的数据最大长度  //0x402;
    Blocksize_36 = DataLengthmax_34-2;  //36服务传输数据的数据块大小
    p2cmax=50;                          //服务器响应的最长时间ms
    p2exs=500;                          //服务器发送NRC78到下一响应的最长时间10ms
    PassState_31[0] = 0x00;             //响应31服务时的事务状态
    ReBlocknum_max = 5;                //36数据块允许重复发送最大次数
    
    SeedLevel = 0x11;                    //安全算法种子等级
    BT_1003 = 0;                        //APP无效下是否支持10 03；0:支持 1:不支持
    BT_85 = 0;                          //APP无效下是否支持85；0:支持 1:不支持
    BT_28 = 0;                          //APP无效下是否支持85；0:支持 1:不支持
  }
  else if(@AUTO::Config_Switch==12) //广汽
  {
    revID=0x794;                        //诊断接收ID
    phyID=0x714;                        //物理寻址ID
  
    funID=0x7DF;                        //功能寻址ID
    High_Volt = 16;                     //高电压边界值
    Low_Volt = 9;                       //低电压边界值
    Normal_Volt = 12;                   //正常电压
    DataLengthmax_34 = 0xFFF;           //响应34服务时的数据最大长度  //0x402;
    Blocksize_36 = DataLengthmax_34-2;  //36服务传输数据的数据块大小
    p2cmax=50;                          //服务器响应的最长时间ms
    p2exs=200;                          //服务器发送NRC78到下一响应的最长时间10ms
    PassState_31[0] = 0x00;             //响应31服务时的事务状态
//    ReBlocknum_max = 3;                 //36数据块允许重复发送最大次数
    ReBlocknum_max = 4;                 //36数据块允许重复发送最大次数
    
    SeedLevel = 0x11;                    //安全算法种子等级
    BT_1003 = 0;                        //APP无效下是否支持10 03；0:支持 1:不支持
    BT_85 = 0;                          //APP无效下是否支持85；0:支持 1:不支持
    BT_28 = 0;                          //APP无效下是否支持85；0:支持 1:不支持
  }
  else if(@AUTO::Config_Switch==13) //V8
  {
    revID=0x749;                        //诊断接收ID
    phyID=0x741;                        //物理寻址ID
  
    funID=0x7DF;                        //功能寻址ID
    High_Volt = 16;                     //高电压边界值
    Low_Volt = 9;                       //低电压边界值
    Normal_Volt = 12;                   //正常电压
    DataLengthmax_34 = 0x402;           //响应34服务时的数据最大长度  //0x402;
    Blocksize_36 = DataLengthmax_34-2;  //36服务传输数据的数据块大小
    p2cmax=50;                          //服务器响应的最长时间ms
    p2exs=200;                          //服务器发送NRC78到下一响应的最长时间10ms
    PassState_31[0] = 0x00;             //响应31服务时的事务状态
//    ReBlocknum_max = 3;                 //36数据块允许重复发送最大次数
    ReBlocknum_max = 4;                 //36数据块允许重复发送最大次数
    
    SeedLevel = 0x11;                    //安全算法种子等级
    BT_1003 = 0;                        //APP无效下是否支持10 03；0:支持 1:不支持
    BT_85 = 0;                          //APP无效下是否支持85；0:支持 1:不支持
    BT_28 = 0;                          //APP无效下是否支持85；0:支持 1:不支持
  }
  /*--------------------------------------驱动数据----------------------------------*/
  if(@AUTO::FlashDriver_Switch==1)//J80J1-D
  {
    DriverAddr=0xFEDE0000;          //驱动地址
    DriverSize=0x00000292;          //驱动大小
  }
  else if(@AUTO::FlashDriver_Switch==2)//J80J3-A
  {
    DriverAddr=0xC0000000;          //驱动地址
    DriverSize=0x00000300;          //驱动大小
  }
  else if(@AUTO::FlashDriver_Switch==3)//J80J3-B
  {
    DriverAddr=0x40030000;          //驱动地址
    DriverSize=0x00000308;          //驱动大小
  }
  else if(@AUTO::FlashDriver_Switch==4)//Z65H
  {
    DriverAddr=0x00E00E40;          //驱动地址
    DriverSize=0x000001BC;          //驱动大小
  }
}
/// <Power>
/*****************新老化板******************/
//RelayON(端口X) ：端口X 黑色接口-黄色接口
//RelayOFF(端口X)：端口X 黑色接口-绿色接口
void RelayON(byte Ctr_state)
{
  Relaymsg.id=0x101;
  if(@Test::Burn_Board_Type==2)
    LHB_State = LHB_State_New;
  switch(Ctr_state)
  {//置为0
    case 1:LHB_State &= 0xFE;break;
    case 2:LHB_State &= 0xFD;break;
    case 3:LHB_State &= 0xFB;break;
    case 4:LHB_State &= 0xF7;break;
  }
  LHB_State_New = LHB_State;
  Relaymsg.byte(0) = LHB_State;
  output(Relaymsg);
}
/// <Power>
void RelayOFF(byte Ctr_state)
{ 
  Relaymsg.id=0x101;
  if(@Test::Burn_Board_Type==2)
    LHB_State = LHB_State_New;
  switch(Ctr_state)
  {//置为1
    case 1:LHB_State |= 1;break;
    case 2:LHB_State |= 2;break;
    case 3:LHB_State |= 4;break;
    case 4:LHB_State |= 8;break;
  }
  LHB_State_New = LHB_State;
  Relaymsg.byte(0) = LHB_State;
  output(Relaymsg);
}
/// <Power>
/*上点火*/
void _K15_ON()
{
  if(@Test::Burn_Board_Type==1)
    RelayON(2);
  else if(@Test::Burn_Board_Type==2)
    RelayOFF(2);
  else 
  {
    IGON.byte(0)=0x02;
    IGON.byte(1)=0x01;
    IGON.byte(2)=0x01;
    output(IGON);
  } 
  writeEx(-3,1,"/*---------- KL15 上电 ----------*/");
  testWaitForTimeout(200);
}
/// <Power>
/*下点火*/
void _K15_OFF()
{
  if(@Test::Burn_Board_Type==1)
    RelayOFF(2);
  else if(@Test::Burn_Board_Type==2)
    RelayON(2);
  else
  {
    IGON.byte(0)=0x02;
    IGON.byte(1)=0x01;
    IGON.byte(2)=0x00;
    output(IGON);
  }
  writeEx(-3,1,"/*---------- KL15 下电 ----------*/");
  testWaitForTimeout(200);
}
/// <Power>
/*上总电*/
void _K30_ON()
{
  if(@Test::Burn_Board_Type==1)
    RelayON(1);
  else if(@Test::Burn_Board_Type==2)
    RelayOFF(1);
  else 
  {
    IGON.byte(0)=0x02;
    IGON.byte(1)=0x27;
    IGON.byte(2)=0x01;
    output(IGON);
  }
  writeEx(-3,1,"/*---------- KL30 上电 ----------*/");
  testWaitForTimeout(200);
}

/// <Power>
/*下总电*/
void _K30_OFF()
{
  if(@Test::Burn_Board_Type==1)
    RelayOFF(1);
  else if(@Test::Burn_Board_Type==2)
    RelayON(1);
  else
  {
    IGON.byte(0)=0x02;
    IGON.byte(1)=0x27;
    IGON.byte(2)=0x00;
    output (IGON);
  } 
  writeEx(-3,1,"/*---------- KL30 下电 ----------*/");
  testWaitForTimeout(200);
}

/// <DownLoad>
void MainInit()
{
  _start_log();
  _Init_();
  testWaitForTimeout(100);
  writeclear(-1);
  stepnum=0;
}
/// <DownLoad>
void Deinit()
{
  _end_log();
  _Init_();
  testWaitForTimeout(Volt_Time);
}

//19
byte Check_APPValid()
{
  char comment[50];
  diagRequest ABS_ESP.FaultMemory_ReadAllIdentified req19;
  
  diagResize(req19,3);
  DiagSetPrimitiveByte(req19,0,0x19);
  DiagSetPrimitiveByte(req19,1,0x02);
  DiagSetPrimitiveByte(req19,2,0x01);
  _diagSendMsg(phyID,req19);
  
  testWaitForDiagRequestSent(req19,500);
  testWaitForDiagResponse(req19,1000);
  if(diagGetLastResponseCode(req19) == -1)
  {
    snprintf(comment,elCount(comment),"/*----------当前APP有效---------*/");
    writeEx(-3,1,comment);
    testCaseComment(comment);
    return 1;
  }
  else
  {
    snprintf(comment,elCount(comment),"/*----------当前APP无效---------*/");
    writeEx(-3,1,comment);
    testCaseComment(comment);
    return 0;
  }
}
byte Check_APPValid2()
{
  char comment[50];
  diagRequest ABS_ESP.FaultMemory_ReadAllIdentified req19;
  
  diagResize(req19,3);
  DiagSetPrimitiveByte(req19,0,0x19);
  DiagSetPrimitiveByte(req19,1,0x02);
  DiagSetPrimitiveByte(req19,2,0x01);
  _diagSendMsg(phyID,req19);
  
  testWaitForDiagResponse(req19,1000);
  if(diagGetLastResponseCode(req19) == -1)
  {
    snprintf(comment,elCount(comment),"/*----------当前APP有效---------*/");
    writeEx(-3,1,comment);
    testCaseComment(comment);
    @AUTO::APP_Invalid = 0;
    return 1;
  }
  else
  {
    snprintf(comment,elCount(comment),"/*----------当前APP无效---------*/");
    writeEx(-3,1,comment);
    testCaseComment(comment);
    if(@Faultinsert::TC_BT_AppValid == 1)
      @AUTO::APP_Invalid = 1;
    return 0;
  }
}
/// <DownLoad>
/*异常流程后初始化*/
void Resp_Init()
{
  //配置初始化
  @AUTO::APP_Valid = 0;               //APP有效标志位
  CarConfig_Init();
  Flash_DataFormatId=0x00;            //FlashDriver的指定数据格式标识
  App_DataFormatId=0x00;              //App的指定数据格式标识
  Flash_AddrAndLenId=0x44;            //FlashDriver的指定地址和长度格式标识
  App_AddrAndLenId=0x44;              //App的指定地址和长度格式标识
  
  //用于故障注入后中断刷写流程
  Exit_Pre_Prog = 0;          //预编程阶段 时退出流程标志位
  Exit_Re_Prog = 0;           //主编程阶段 时退出流程标志位
  Exit_Post_Prog = 0;         //后编程阶段 时退出流程标志位
  Exit_Download = 0;          //数据下载阶段 时退出流程标志位
  
  Exit_1002 = 0;              //执行到10 02时退出流程标志位
  Exit_1003 = 0;              //执行到10 03时退出流程标志位
  Exit_22 = 0;                //执行到22 时退出流程标志位
  Exit_27 = 0;                //执行到27 时退出流程标志位
  Exit_2E = 0;                //执行到2E 时退出流程标志位
  Exit_34_f = 0;              //执行到Flash 34时退出流程标志位
  Exit_36_f = 0;              //执行到Flash 36时退出流程标志位   
  Exit_37_f = 0;              //执行到Flash 37时退出流程标志位
  Exit_0202_f = 0;            //执行到Flash 02 02时退出流程标志位
  Exit_0301 = 0;              //执行到31 01 03 01时退出流程标志位
  Exit_ff00 = 0;              //执行到31 01 FF 00时退出流程标志位
  Exit_03ff00 = 0;            //执行到31 03 FF 00时退出流程标志位
  Exit_02ff00 = 0;            //执行到31 02 FF 00时退出流程标志位
  Exit_34_a = 0;              //执行到APP 34时退出流程标志位
  Exit_36_a = 0;              //执行到APP 36时退出流程标志位   
  Exit_37_a = 0;              //执行到APP 37时退出流程标志位
  Exit_0202_a = 0;            //执行到APP 02 02时退出流程标志位
  Exit_0205 = 0;              //执行到APP 02 05时退出流程标志位
  Exit_ff01 = 0;              //执行到31 01 FF 01时退出流程标志位
  Exit_03ff01 = 0;            //执行到31 03 FF 01时退出流程标志位
  Exit_02ff01 = 0;            //执行到31 02 FF 01时退出流程标志位
  Exit_DA04 = 0;              //执行到31 01 DA 04时退出流程标志位
  Exit_03DA04 = 0;            //执行到31 01 DA 04时退出流程标志位
  Exit_02DA04 = 0;            //执行到31 01 DA 04时退出流程标志位
  Exit_11 = 0;                //执行到ECU复位 11时退出流程标志位
  Exit_14 = 0;                //执行到14 FF FF FF时退出流程标志位
  
  Break_Download = 0;         //数据下载时退出标志位
  noCheck = 0;                //是否判断诊断响应，0：按预期结果判断，1：不判断响应
  
  TC_PowerDown_Before_FF00 = 0;  /*可靠性测试：内存擦除前切断电源*/
  TC_PowerDown_In_FF00 = 0;      /*可靠性测试：内存擦除中切断电源*/
  TC_PowerDown_After_FF00 = 0;   /*可靠性测试：内存擦除后切断电源*/
  TC_PowerDown_In_36A = 0;       /*可靠性测试：数据块传输中切断电源*/
  TC_PowerDown_After_36A = 0;    /*可靠性测试：数据块传输后切断电源*/
  TC_PowerDown_Before_0202A = 0; /*可靠性测试：0202检查前切断电源*/
  TC_PowerDown_Before_FF01 = 0;  /*可靠性测试：FF01应用程序有效性检查前切断电源*/
  TC_PowerDown_After_FF01 = 0;   /*可靠性测试：FF01应用程序有效性检查后切断电源*/
  TC_K15_Before_FF00 = 0;        /*可靠性测试：内存擦除前下点火*/
  TC_K15_After_FF00 = 0;         /*可靠性测试：内存擦除后下点火*/
  TC_K15_In_36A = 0;             /*可靠性测试：数据块传输中下点火*/
  TC_K15_After_36A = 0;          /*可靠性测试：数据块传输后下点火*/
  TC_K15_Before_0202A = 0;       /*可靠性测试：0202检查前下点火*/
  TC_K15_Before_FF01 = 0;        /*可靠性测试：FF01应用程序有效性检查前下点火*/
  TC_K15_After_FF01 = 0;         /*可靠性测试：FF01应用程序有效性检查后下点火*/
  TC_BusOff_Before_FF00 = 0;     /*可靠性测试：内存擦除前BusOff*/
  TC_BusOff_After_FF00 = 0;      /*可靠性测试：内存擦除后BusOff*/
  TC_BusOff_In_36A = 0;          /*可靠性测试：数据块传输中BusOff*/
  TC_BusOff_After_36A = 0;       /*可靠性测试：数据块传输后BusOff*/
  TC_BusOff_Before_0202A = 0;    /*可靠性测试：0202检查前BusOff*/
  TC_BusOff_Before_FF01 = 0;     /*可靠性测试：FF01应用程序有效性检查前BusOff*/
  TC_BusOff_After_FF01 = 0;      /*可靠性测试：FF01应用程序有效性检查后BusOff*/
  
  //把期望响应恢复默认
  Resp_14 = -1;        //请求14 清除故障码时的期望响应，默认为-1
  Resp_2E = -1;        //请求2E 写数据时的期望响应，默认为-1
  Resp_22 = -1;        //请求22 读数据时的期望响应，默认为-1
  Resp_1001 = -1;      //请求10 01时的期望响应，默认为-1
  Resp_1002 = -1;      //请求10 02时的期望响应，默认为-1
  Resp_1003 = -1;      //请求10 03时的期望响应，默认为-1
  Resp_0203 = -1;      //请求31 01 02 03时的期望响应，默认为-1
  Resp_85 = -1;        //请求85 82时的期望响应，默认为-1
  Resp_28 = -1;        //请求28 81 01时的期望响应，默认为-1
  Resp_2701 = -1;      //请求27 01时的期望响应，默认为-1
  Resp_2702 = -1;      //请求27 02时的期望响应，默认为-1
  Resp_2702_2 = -1;    //第二次请求27 02时的期望响应，默认为-1
  Resp_34_f = -1;      //Flash请求34时的期望响应，默认为-1
  Resp_34_a = -1;      //App请求34时的期望响应，默认为-1
  Resp_36_f = -1;      //Flash请求36时的期望响应，默认为-1
  Resp_36_a = -1;      //App请求36时的期望响应，默认为-1
  Resp_37_f = -1;      //Flash请求37时的期望响应，默认为-1
  Resp_37_a = -1;      //App请求37时的期望响应，默认为-1
  Resp_0301 = -1;      //Geely3.0 激活SBL的期望响应，默认为-1
  Resp_0205 = -1;      //Geely3.0 完全性检测的期望响应，默认为-1
  Resp_0202_f = -1;    //Flash下载驱动请求31 01 02 02时的期望响应，默认为-1
  Resp_0202_a = -1;    //App下载数据请求31 01 02 02时的期望响应，默认为-1
  Resp_ff00 = -1;      //请求31 01 FF 00时的期望响应，默认为-1
  Resp_03ff00 = -1;    //请求31 03 FF 00时的期望响应，默认为-1
  Resp_02ff00 = -1;    //请求31 02 FF 00时的期望响应，默认为-1
  Resp_ff01 = -1;      //请求31 01 FF 01时的期望响应，默认为-1
  Resp_DA04 = -1;      //请求31 01 DA 04时的期望响应，默认为-1
  Resp_11 = -1;        //请求11 01时的期望响应，默认为-1
  
  Geely3_36_Status = -1;       /*用于判断36下载是否完成状态，异常下载为0，正常下载为1*/
  TxMessage_Pass = 1;  //期望收到外发报文
  TxMessage_Fail = 0;  //期望无外发报文
  @AUTO::APP_Valid = 0; 
  PostProg_Recover = 0;   /*是否需要在后编程恢复故障,不需要为0，需要为1*/
  
  @Prog_power::K30 = 1;
  @Prog_power::K30Volt = Normal_Volt;     //电压恢复正常值
  
  diagStopTesterPresent("ABS_ESP_Functional");
  testWaitForTimeout(waittime);
  if(@AUTO::Config_Switch == 4)
    _Startreset(phyID,0x01,Resp_11);
}

/// <DownLoad>
void _Init_()
{
  diagStopTesterPresent("ABS_ESP_Functional");
  //配置初始化
  @AUTO::APP_Valid = 0;               //APP有效标志位
  SOS_Flage = 0;                      //SOS刷写标志
  Alternate_DownLoad_Flage = 0;       //交替刷写标志
  BlockBin_Flage = 0;
  CarConfig_Init();
  Flash_DataFormatId=0x00;            //FlashDriver的指定数据格式标识
  App_DataFormatId=0x00;              //App的指定数据格式标识
  Flash_AddrAndLenId=0x44;            //FlashDriver的指定地址和长度格式标识
  App_AddrAndLenId=0x44;              //App的指定地址和长度格式标识

  //用于故障注入后中断刷写流程
  Exit_Pre_Prog = 0;          //预编程阶段 时退出流程标志位
  Exit_Re_Prog = 0;           //主编程阶段 时退出流程标志位
  Exit_Post_Prog = 0;         //后编程阶段 时退出流程标志位
  Exit_Download = 0;          //数据下载阶段 时退出流程标志位
  
  Exit_1002 = 0;              //执行到10 02时退出流程标志位
  Exit_1003 = 0;              //执行到10 03时退出流程标志位
  Exit_22 = 0;                //执行到22 时退出流程标志位
  Exit_27 = 0;                //执行到27 时退出流程标志位
  Exit_2E = 0;                //执行到2E 时退出流程标志位
  Exit_34_f = 0;              //执行到Flash 34时退出流程标志位
  Exit_36_f = 0;              //执行到Flash 36时退出流程标志位   
  Exit_37_f = 0;              //执行到Flash 37时退出流程标志位
  Exit_0202_f = 0;            //执行到Flash 02 02时退出流程标志位
  Exit_0301 = 0;              //执行到31 01 03 01时退出流程标志位
  Exit_ff00 = 0;              //执行到31 01 FF 00时退出流程标志位
  Exit_03ff00 = 0;            //执行到31 03 FF 00时退出流程标志位
  Exit_02ff00 = 0;            //执行到31 02 FF 00时退出流程标志位
  Exit_34_a = 0;              //执行到APP 34时退出流程标志位
  Exit_36_a = 0;              //执行到APP 36时退出流程标志位   
  Exit_37_a = 0;              //执行到APP 37时退出流程标志位
  Exit_0202_a = 0;            //执行到APP 02 02时退出流程标志位
  Exit_0205 = 0;              //执行到APP 02 05时退出流程标志位
  Exit_ff01 = 0;              //执行到31 01 FF 01时退出流程标志位
  Exit_03ff01 = 0;            //执行到31 03 FF 01时退出流程标志位
  Exit_02ff01 = 0;            //执行到31 02 FF 01时退出流程标志位
  Exit_DA04 = 0;              //执行到31 01 DA 04时退出流程标志位
  Exit_03DA04 = 0;            //执行到31 01 DA 04时退出流程标志位
  Exit_02DA04 = 0;            //执行到31 01 DA 04时退出流程标志位
  Exit_11 = 0;                //执行到ECU复位 11时退出流程标志位
  Exit_14 = 0;                //执行到14 FF FF FF时退出流程标志位
  
  Break_Download = 0;         //数据下载时退出标志位
  noCheck = 0;                //是否判断诊断响应，0：按预期结果判断，1：不判断响应
  timer_3e80_index = 0;
  
  TC_PowerDown_Before_FF00 = 0;  /*可靠性测试：内存擦除前切断电源*/
  TC_PowerDown_In_FF00 = 0;      /*可靠性测试：内存擦除中切断电源*/
  TC_PowerDown_After_FF00 = 0;   /*可靠性测试：内存擦除后切断电源*/
  TC_PowerDown_In_36A = 0;       /*可靠性测试：数据块传输中切断电源*/
  TC_PowerDown_After_36A = 0;    /*可靠性测试：数据块传输后切断电源*/
  TC_PowerDown_Before_0202A = 0; /*可靠性测试：0202检查前切断电源*/
  TC_PowerDown_Before_FF01 = 0;  /*可靠性测试：FF01应用程序有效性检查前切断电源*/
  TC_PowerDown_After_FF01 = 0;   /*可靠性测试：FF01应用程序有效性检查后切断电源*/
  TC_K15_Before_FF00 = 0;        /*可靠性测试：内存擦除前下点火*/
  TC_K15_After_FF00 = 0;         /*可靠性测试：内存擦除后下点火*/
  TC_K15_In_36A = 0;             /*可靠性测试：数据块传输中下点火*/
  TC_K15_After_36A = 0;          /*可靠性测试：数据块传输后下点火*/
  TC_K15_Before_0202A = 0;       /*可靠性测试：0202检查前下点火*/
  TC_K15_Before_FF01 = 0;        /*可靠性测试：FF01应用程序有效性检查前下点火*/
  TC_K15_After_FF01 = 0;         /*可靠性测试：FF01应用程序有效性检查后下点火*/
  TC_BusOff_Before_FF00 = 0;     /*可靠性测试：内存擦除前BusOff*/
  TC_BusOff_After_FF00 = 0;      /*可靠性测试：内存擦除后BusOff*/
  TC_BusOff_In_36A = 0;          /*可靠性测试：数据块传输中BusOff*/
  TC_BusOff_After_36A = 0;       /*可靠性测试：数据块传输后BusOff*/
  TC_BusOff_Before_0202A = 0;    /*可靠性测试：0202检查前BusOff*/
  TC_BusOff_Before_FF01 = 0;     /*可靠性测试：FF01应用程序有效性检查前BusOff*/
  TC_BusOff_After_FF01 = 0;      /*可靠性测试：FF01应用程序有效性检查后BusOff*/
  
  //把期望响应恢复默认
  Resp_14 = -1;        //请求14 清除故障码时的期望响应，默认为-1
  Resp_2E = -1;        //请求2E 写数据时的期望响应，默认为-1
  Resp_22 = -1;        //请求22 读数据时的期望响应，默认为-1
  Resp_1001 = -1;      //请求10 01时的期望响应，默认为-1
  Resp_1002 = -1;      //请求10 02时的期望响应，默认为-1
  Resp_1003 = -1;      //请求10 03时的期望响应，默认为-1
  Resp_0203 = -1;      //请求31 01 02 03时的期望响应，默认为-1
  Resp_85 = -1;        //请求85 82时的期望响应，默认为-1
  Resp_28 = -1;        //请求28 81 01时的期望响应，默认为-1
  Resp_2701 = -1;      //请求27 01时的期望响应，默认为-1
  Resp_2702 = -1;      //请求27 02时的期望响应，默认为-1
  Resp_2702_2 = -1;    //第二次请求27 02时的期望响应，默认为-1
  Resp_34_f = -1;      //Flash请求34时的期望响应，默认为-1
  Resp_34_a = -1;      //App请求34时的期望响应，默认为-1
  Resp_36_f = -1;      //Flash请求36时的期望响应，默认为-1
  Resp_36_a = -1;      //App请求36时的期望响应，默认为-1
  Resp_37_f = -1;      //Flash请求37时的期望响应，默认为-1
  Resp_37_a = -1;      //App请求37时的期望响应，默认为-1
  Resp_0301 = -1;      //Geely3.0 激活SBL的期望响应，默认为-1
  Resp_0205 = -1;      //Geely3.0 完全性检测的期望响应，默认为-1
  Resp_0202_f = -1;    //Flash下载驱动请求31 01 02 02时的期望响应，默认为-1
  Resp_0202_a = -1;    //App下载数据请求31 01 02 02时的期望响应，默认为-1
  Resp_ff00 = -1;      //请求31 01 FF 00时的期望响应，默认为-1
  Resp_03ff00 = -1;    //请求31 03 FF 00时的期望响应，默认为-1
  Resp_02ff00 = -1;    //请求31 02 FF 00时的期望响应，默认为-1
  Resp_ff01 = -1;      //请求31 01 FF 01时的期望响应，默认为-1
  Resp_DA04 = -1;      //请求31 01 DA 04时的期望响应，默认为-1
  Resp_11 = -1;        //请求11 01时的期望响应，默认为-1
  Resp_01DD02 = -1;    //请求31 01 DD 02时的期望响应，默认为-1
  
  GAC_3601_03 = 0;
  Geely3_36_Status = -1;       /*用于判断36下载是否完成状态，异常下载为0，正常下载为1*/
  TxMessage_Pass = 1;         //期望收到外发报文
  TxMessage_Fail = 0;         //期望无外发报文
//  @AUTO::APP_Valid = 0; 
  PostProg_Recover = 0;   /*是否需要在后编程恢复故障,不需要为0，需要为1*/
  
  @Prog_power::K30 = 1;
  @Prog_power::K30Volt = Normal_Volt;     //电压恢复正常值
  @Prog_power::K30Curr = Normal_Curr;     //电流恢复正常值
  @Faultinsert::TC_BT_AppValid = 0;     //防止后续测试时故障注入无法恢复问题
}
//用于创建Log,根据TestCase标题命名
void creat_log(char function[])
{
  //用于创造Log
  char log_name[200] = "./Logging";
  char testCaseTitle[200];
  char order[200];  
  long Time[9];
  char timeBuffer[200];
  word i;
  i = 0;
  
  snprintf(timeBuffer,elCount(timeBuffer),"%s","");
  getLocalTime(Time);
  snprintf(timeBuffer,200,"%s%s",timeBuffer,"___");
  snprintf(timeBuffer,200,"%s%d",timeBuffer,Time[5]+1900);
  snprintf(timeBuffer,200,"%s%s",timeBuffer,"-");
  snprintf(timeBuffer,200,"%s%d",timeBuffer,Time[4]+1);
  snprintf(timeBuffer,200,"%s%s",timeBuffer,"-");
  snprintf(timeBuffer,200,"%s%d",timeBuffer,Time[3]);
  snprintf(timeBuffer,200,"%s%s",timeBuffer,"_");
  if(Time[2]<10)
  {
    snprintf(timeBuffer,200,"%s%02X",timeBuffer,Time[2]);
  }
  if(Time[2]>=10)
  {
    snprintf(timeBuffer,200,"%s%d",timeBuffer,Time[2]);
  }
  snprintf(timeBuffer,200,"%s%s",timeBuffer,"-");
  if(Time[1]<10)
  {
    snprintf(timeBuffer,200,"%s%02X",timeBuffer,Time[1]);
  }
  if(Time[1]>=10)
  {
    snprintf(timeBuffer,200,"%s%d",timeBuffer,Time[1]);
  }
  snprintf(timeBuffer,200,"%s%s",timeBuffer,"-");
  if(Time[0]<10)
  {
    snprintf(timeBuffer,200,"%s%02X",timeBuffer,Time[0]);
  }
  if(Time[0]>=10)
  {
    snprintf(timeBuffer,200,"%s%d",timeBuffer,Time[0]);
  }
  LogNum++;
  if(LogNum < 10)
  {
    order[0] = LogNum+48;
    order[1] = '.';
  }
  else if(LogNum < 100)
  {
    order[0] = (LogNum/10)+48;
    order[1] = (LogNum%10)+48;
    order[2] = '.';
  }
  else if(LogNum < 1000)
  {
    order[0] = (LogNum/100)+48;
    order[1] = (LogNum/10%10)+48;
    order[2] = (LogNum%10)+48;
    order[3] = '.';
  }
  else if(LogNum < 10000)
  {
    order[0] = (LogNum/1000)+48;
    order[1] = (LogNum/100%10)+48;
    order[2] = (LogNum/10%10)+48;
    order[3] = (LogNum%10)+48;
    order[4] = '.';
  }
  testGetCurrentTestCaseTitle(testCaseTitle,200);
  log_name[0] = 92;
//  log_name[8] = 92;
  strncat(log_name,function,199-strlen(log_name));
  strncat(log_name,order,199-strlen(log_name));
  strncat(log_name,testCaseTitle,199-strlen(log_name));
  strncat(log_name,timeBuffer,199-strlen(log_name));
  strncat(log_name,".asc",199-strlen(log_name));
  setLogFileName(log_name);
  for(i = 9; log_name[i] !='\0'; i++ )
    log_name[i] = '\0';
}

void _start_log()
{
  creat_log("//BT_Logging//");
  startLogging();
}

void _end_log()
{
  stopLogging();
}

//APP有效状态：1为进入APP无效，0为APP有效
void APP_Valid(int Valid)
{
  @AUTO::APP_Valid = Valid;
  MainTest_f();
}

/*-------------------------------------------------------预编程过程-------------------------------------------------------*/
void Pre_Programme_For_AppValidTest()
{
//  writeEx(-3,0,"开始预编程阶段");
  /*----------------------BYD预编程阶段-------------------------------*/
  if(@AUTO::Config_Switch==1)
  {
    //10 03
    enterExtend(phyID,0,Resp_1003);
    //安全访问
    Security_access();
    //31 01 02 03
    UpdateCheck(phyID,Resp_0203);
    //10 02
    enterProg(phyID,0,Resp_1002);
    
  }
  /*----------------------ChangAn预编程阶段-------------------------------*/
  else if(@AUTO::Config_Switch==2)
  {
    //10 03
    enterExtend(phyID,0,Resp_1003);
    //27 01 & 27 02
    Security_access();
    //31 01 02 03
    UpdateCheck(phyID,Resp_0203); 
    //10 02
    enterProg(phyID,0,Resp_1002);
  }
  /*----------------------Geely 1.0预编程阶段-------------------------------*/
  else if(@AUTO::Config_Switch==3)
  {
    //10 03
    enterExtend(phyID,0,Resp_1003);
    //10 02
    enterProg(phyID,0,Resp_1002);
  }
  /*----------------------Geely 3.0预编程阶段-------------------------------*/
  else if(@AUTO::Config_Switch==4)
  {
    enterExtend(phyID,0,Resp_1003);
    //10 02 / 10 82
    enterProg(phyID,0,-1);
  }
  /*-----------------------------鑫源 预编程阶段----------------------------*/
  else if(@AUTO::Config_Switch==5)
  {
    //10 83
    enterExtend(phyID,0,-1);
    //10 02
    enterProg(phyID,0,Resp_1002);
  }
  /*-----------------------------瑞驰 预编程阶段----------------------------*/
  else if(@AUTO::Config_Switch==6)
  {
    //10 03
    enterExtend(phyID,0,Resp_1003);
    testWaitForTimeout(100);
    //31 01 F0 02
    UpdateCheck(phyID,Resp_0203);
    //10 02
    enterProg(phyID,0,Resp_1002);
  }
  /*-----------------------------奇瑞 预编程阶段----------------------------*/
  else if(@AUTO::Config_Switch==7)
  {
    //10 03
    enterExtend(phyID,0,Resp_1003);
    //10 02
    enterProg(phyID,0,Resp_1002);
  }
  /*-----------------------------奇瑞T1V 5.0预编程阶段----------------------------*/
  else if(@AUTO::Config_Switch==11) 
  {
    //10 83
    enterExtend(phyID,0,Resp_1003);
    //31 01 02 03
    UpdateCheck(phyID,Resp_0203);
    //10 02
    enterProg(phyID,0,Resp_1002);
  }
  /*-----------------------------五菱 预编程阶段----------------------------*/
  else if(@AUTO::Config_Switch==8)
  {
    //10 03
    enterExtend(phyID,0,Resp_1003);
    //10 02
    enterProg(phyID,0,Resp_1002);
  }
  /*-----------------------------东风小康 预编程阶段----------------------------*/
  else if(@AUTO::Config_Switch==9)
  {
    //10 03
    enterExtend(phyID,0,Resp_1003);
    //安全访问 APP有效时27 01 无效时27 09
    if(curAppValid==1)
      SeedLevel=0x01;
    else
      SeedLevel=0x09;
    Security_access();
    //更新条件查询 31 01 02 03
    UpdateCheck(phyID,Resp_0203);
    //10 02
    enterProg(phyID,0,Resp_1002);
  }
  /*-----------------------------赛力斯 预编程阶段----------------------------*/
  else if(@AUTO::Config_Switch==10)
  {
    //10 83
    enterExtend(phyID,1,Resp_1003);
    testWaitForTimeout(200);
    //更新条件查询 31 01 02 03
    UpdateCheck(phyID,Resp_0203);
    //10 02
    enterProg(phyID,0,Resp_1002);
  }
  /*-----------------------------广汽 预编程阶段----------------------------*/
  else if(@AUTO::Config_Switch==12)
  {
    //10 03
    enterExtend(phyID,0,Resp_1003);
    testWaitForTimeout(200);
    //更新条件查询 31 01 02 03
    UpdateCheck(phyID,Resp_0203);
    //10 02
    enterProg(phyID,0,Resp_1002);
  }
//  writeEx(-3,0,"预编程完成");
}
/// <DownLoad>
/*-------------------------------------------------------预编程过程-------------------------------------------------------*/
void Pre_Programme()
{
  writeEx(-3,0,"开始预编程阶段");
  if(SOS_Flage == 1)
  {
    diagRequest ABS_ESP.ExtendedDiagnosticSession_Start req1003;
    @sysvar::Prog_power::K30 = 0;
    testWaitForTimeout(2000);
    @sysvar::Prog_power::K30 = 1;
    do{
      _diagSendMsg(phyID,req1003);
      testWaitForDiagRequestSent(req1003,50);
      testWaitForDiagResponse(req1003,50);
    }while(diagGetLastResponseCode(req1003) == 0);
  }
  /*----------------------BYD预编程阶段-------------------------------*/
  if(@AUTO::Config_Switch==1)
  {
    //10 03
    enterExtend(phyID,0,Resp_1003);
    //31 01 02 03
    UpdateCheck(phyID,Resp_0203);
    //10 83
    enterExtend(funID,1,Resp_1003);
    diagStartTesterPresent("ABS_ESP_Functional");
    //85 82
    DTC_Control(funID,1,0x02,Resp_85);
    //28 81 01
    Com_Control(funID,1,0x01,0x01,Resp_28);
  }
  /*----------------------ChangAn预编程阶段-------------------------------*/
  else if(@AUTO::Config_Switch==2)
  {
    //10 03
    enterExtend(phyID,0,Resp_1003);
    //10 83
    enterExtend(funID,1,Resp_1003);
    //27 01 & 27 02
    Security_access();
    diagStartTesterPresent("ABS_ESP_Functional");
    //22 F1 8A
    ReadIdentify(phyID,0xF18A,Resp_22);
    //22 F0 89
    ReadIdentify(phyID,0xF089,Resp_22);
    //22 F1 89
    ReadIdentify(phyID,0xF189,Resp_22);
    //31 01 02 03
    UpdateCheck(phyID,Resp_0203); 
    //85 82
    DTC_Control(funID,1,0x02,Resp_85);
    //28 83 03
    Com_Control(funID,1,0x03,0x03,Resp_28);
  }
  /*----------------------Geely 1.0预编程阶段-------------------------------*/
  else if(@AUTO::Config_Switch==3)
  {
    //故障注入：缺失整个预编程步骤
    if(@Faultinsert::TC_Miss_Pre==1)
    {
      Resp_1002 = 0x7E;
      Exit_1002 = 1;
    }
    else
    {
      //22 F1 93
      ReadIdentify(phyID,0xF193,Resp_22);
      //22 F1 80
      ReadIdentify(phyID,0xF180,Resp_22);
      //22 F1 87
      ReadIdentify(phyID,0xF187,Resp_22);
      //10 03
      enterExtend(funID,0,Resp_1003);
      diagStartTesterPresent("ABS_ESP_Functional");
      //85 02
      DTC_Control(funID,0,0x02,Resp_85);
      testWaitForTimeout(10);
      //28 03 01
      Com_Control(funID,0,0x03,0x01,Resp_28);
      testWaitForTimeout(10);
    }
  }
  /*----------------------Geely 3.0预编程阶段-------------------------------*/
  else if(@AUTO::Config_Switch==4)
  {
    //故障注入：电压异常测试---此部分测试更改位置到重编程部分，该部分暂时屏蔽
//    if(@Faultinsert::TC_ErrorVolt!=0)
//    {
//      Resp_1002 = 0x22;
//      Exit_1002 = 1;
//    }
    //10 02 / 10 82
    enterProg(phyID,0,Resp_1002);
    testWaitForTimeout(1000);
    
    curAppValid = Check_AppValid();
    
    testWaitForTimeout(1000);
    diagStartTesterPresent("ABS_ESP_Functional");
    if(Exit_1002==1)
    {
      Exit_Pre_Prog = 1;
      return;
    }
    //22 F1 86
    ReadIdentify(phyID,0xF186,Resp_22);
    //27 01 & 27 02通过安全访问
    Security_access_AES_CMAC();
    if(Exit_27==1)
    {
      Exit_Pre_Prog = 1;
      return;
    }
  }
  /*-----------------------------鑫源 预编程阶段----------------------------*/
  else if(@AUTO::Config_Switch==5)
  {
    //故障注入：缺失整个预编程步骤
    if(@Faultinsert::TC_Miss_Pre==1)
    {
      Resp_1002 = 0x7E;
      Exit_1002 = 1;
    }
    else
    {
      //10 83
      enterExtend(funID,1,Resp_1003);
      diagStartTesterPresent("ABS_ESP_Functional");    
      //85 82
      DTC_Control(funID,1,0x02,Resp_85);
      //28 83 01
      Com_Control(funID,1,0x03,0x01,Resp_28);
      //22 F1 80
      ReadIdentify(phyID,0xF180,Resp_22);
    }
  }
  /*-----------------------------瑞驰 预编程阶段----------------------------*/
  else if(@AUTO::Config_Switch==6)
  {
    //故障注入：缺失整个预编程步骤
    if(@Faultinsert::TC_Miss_Pre==1)
    {
      Resp_1002 = 0x7E;
      Exit_1002 = 1;
    }
    else
    {
      //10 03
      enterExtend(funID,0,Resp_1003);
      testWaitForTimeout(100);
      diagStartTesterPresent("ABS_ESP_Functional");
      //31 01 F0 02
      UpdateCheck(phyID,Resp_0203);
      //85 02
      DTC_Control(funID,0,0x02,Resp_85);
      testWaitForTimeout(1000);
      //28 03 01
      Com_Control(funID,0,0x03,0x01,Resp_28);
      testWaitForTimeout(1000);
      //22 F1 80
      ReadIdentify(phyID,0xF180,Resp_22);
    }
  }
  /*-----------------------------奇瑞 预编程阶段----------------------------*/
  else if(@AUTO::Config_Switch==7)
  {
    //10 03
    enterExtend(phyID,0,Resp_1003);
    diagStartTesterPresent("ABS_ESP_Functional");
    //85 02 
    DTC_Control(funID,0,0x02,Resp_85);
    //28 03 03
    Com_Control(funID,0,0x03,0x03,Resp_28);
    //进入10 02后 需要在25ms内响应首帧
    p2cmax = 25;
  }
  /*-----------------------------奇瑞T1V 5.0预编程阶段----------------------------*/
  else if(@AUTO::Config_Switch==11) 
  {
    //10 83
    enterExtend(funID,1,Resp_1003);
    diagStartTesterPresent("ABS_ESP_Functional");
    
    //故障注入：缺失整个预编程步骤
    if(@Faultinsert::TC_Miss_Pre==1)
    {
      return;
    }
    //31 01 02 03
    UpdateCheck(phyID,Resp_0203);
    //85 82 
    DTC_Control(funID,1,0x02,Resp_85);
    //28 83 03
    Com_Control(funID,1,0x03,0x03,Resp_28);
  }
  /*-----------------------------五菱 预编程阶段----------------------------*/
  else if(@AUTO::Config_Switch==8)
  {
    //故障注入：缺失整个预编程步骤
    if(@Faultinsert::TC_Miss_Pre==1)
    {
      return;
    }
//    //故障注入：电压异常测试  ---此部分更改位置到重编程部分故暂屏蔽
//    if(@Faultinsert::TC_ErrorVolt!=0)
//    {
//      Resp_22 = 0x31;
//    }
//    //22 F1 84
    if(@sysvar::AUTO::Config_SGMW_F184 == 1)
      ReadIdentify(phyID,0xF184,Resp_22);
    //22 F1 86
    if(@sysvar::AUTO::Config_SGMW_F186 == 1)
      ReadIdentify(phyID,0xF186,Resp_22);
//    //22 F1 8A
    if(@sysvar::AUTO::Config_SGMW_F18A == 1)
      ReadIdentify(phyID,0xF18A,Resp_22);
//    //22 F1 8B
    if(@sysvar::AUTO::Config_SGMW_F18B == 1)
      ReadIdentify(phyID,0xF18B,Resp_22);
//    //22 F1 8C
    if(@sysvar::AUTO::Config_SGMW_F18C == 1)
      ReadIdentify(phyID,0xF18C,Resp_22);
     //22 F1 7A
    if(@sysvar::AUTO::Config_SGMW_F17A == 1)
      ReadIdentify(phyID,0xF17A,Resp_22);
    //22 F1 90
    if(@sysvar::AUTO::Config_SGMW_F190 == 1)
      ReadIdentify(phyID,0xF190,Resp_22);
//    //22 F1 92
    if(@sysvar::AUTO::Config_SGMW_F192 == 1)
      ReadIdentify(phyID,0xF192,Resp_22);
//    //22 F1 93
    if(@sysvar::AUTO::Config_SGMW_F193 == 1)
      ReadIdentify(phyID,0xF193,Resp_22);
    //22 F1 94
    if(@sysvar::AUTO::Config_SGMW_F194 == 1)
      ReadIdentify(phyID,0xF194,Resp_22);
//    //22 F1 95
    if(@sysvar::AUTO::Config_SGMW_F195 == 1)
      ReadIdentify(phyID,0xF195,Resp_22);
//    //22 F1 B2
    if(@sysvar::AUTO::Config_SGMW_F1B2 == 1)
      ReadIdentify(phyID,0xF1B2,Resp_22);
//    //22 F1 B9
    if(@sysvar::AUTO::Config_SGMW_F1B9 == 1)
      ReadIdentify(phyID,0xF1B9,Resp_22);
    //22 F1 CB
    if(@sysvar::AUTO::Config_SGMW_F1CB == 1)
      ReadIdentify(phyID,0xF1CB,Resp_22);
//    //22 F1 91
    if(@sysvar::AUTO::Config_SGMW_F191 == 1)
      ReadIdentify(phyID,0xF191,Resp_22);
//    //22 F1 88
    if(@sysvar::AUTO::Config_SGMW_F188 == 1)
      ReadIdentify(phyID,0xF188,Resp_22);
    //22 F1 C1
    if(@sysvar::AUTO::Config_SGMW_F1C1 == 1)
      ReadIdentify(phyID,0xF1C1,Resp_22);
    //10 03
    enterExtend(funID,0,Resp_1003);
    diagStartTesterPresent("ABS_ESP_Functional");
    //85 02
    DTC_Control(funID,0,0x02,Resp_85);
    //28 03 03
    Com_Control(funID,0,0x03,0x03,Resp_28);
  }
  /*-----------------------------东风小康 预编程阶段----------------------------*/
  else if(@AUTO::Config_Switch==9)
  {
    //10 03
    enterExtend(phyID,0,Resp_1003);

    //22 F1 89
    ReadIdentify(phyID,0xF189,Resp_22);
    //22 F1 87
    ReadIdentify(phyID,0xF187,Resp_22);
    //10 83
    enterExtend(funID,1,Resp_1003);
    //安全访问 APP有效时27 01 无效时27 09
    if(curAppValid==1)
      SeedLevel=0x01;
    else
      SeedLevel=0x09;
    Security_access();
    diagStartTesterPresent("ABS_ESP_Functional");
    //更新条件查询 31 01 02 03
    UpdateCheck(phyID,Resp_0203);
    //85 82
    DTC_Control(funID,1,0x02,Resp_85);
    //28 83 01
    Com_Control(funID,1,0x03,0x01,Resp_28);
    //28 83 03
    Com_Control(funID,1,0x03,0x03,Resp_28);
  }
  /*-----------------------------赛力斯 预编程阶段----------------------------*/
  else if(@AUTO::Config_Switch==10)
  {
    //故障注入：缺失整个预编程步骤
    if(@Faultinsert::TC_Miss_Pre==1)
    {
      Resp_1002 = 0x22;
      Exit_1002 = 1;
      return;
    }
    //10 01
    enterDefault(phyID,0,Resp_1001);
    //22 F1 87
    ReadIdentify(phyID,0xF187,Resp_22);
    //10 83
    enterExtend(funID,1,Resp_1003);
    testWaitForTimeout(1000);
    //更新条件查询 31 01 02 03
    UpdateCheck(phyID,Resp_0203);
    //85 82
    DTC_Control(funID,1,0x02,Resp_85);
    testWaitForTimeout(1000);
    //28 83 03
    Com_Control(funID,1,0x03,0x03,Resp_28);
    testWaitForTimeout(1000);
  }
  /*-----------------------------广汽 预编程阶段----------------------------*/
  else if(@AUTO::Config_Switch==12)
  {
    //22 F1 87
//    ReadIdentify(phyID,0xF187,Resp_22);
    //10 03
    enterExtend(funID,0,Resp_1003);
    testWaitForTimeout(1000);
    //故障注入：缺失整个预编程步骤
    if(@Faultinsert::TC_Miss_Pre==1)
    {
      Resp_1002 = 0x22;
      Exit_1002 = 1;
      return;
    }
    //更新条件查询 31 01 02 03
    UpdateCheck(phyID,Resp_0203);
    //85 02
    DTC_Control(funID,0,0x02,Resp_85);
    testWaitForTimeout(1000);
    //28 03 03
    Com_Control(funID,1,0x03,0x03,Resp_28);
    testWaitForTimeout(1000);
  }
  /*-----------------------------V8 预编程阶段----------------------------*/
  else if(@AUTO::Config_Switch==13)
  {
    //10 03
    enterExtend(phyID,0,Resp_1003);
    //更新条件查询 31 01 02 03
    UpdateCheck(phyID,Resp_0203);
    //10 83
    enterExtend(funID,1,Resp_1003);
    
    diagStartTesterPresent("ABS_ESP_Functional");
    //85 82
    DTC_Control(funID,1,0x02,Resp_85);
    //28 83 03
    Com_Control(funID,1,0x03,0x03,Resp_28);
  }
  writeEx(-3,0,"预编程完成");
}
/// <DownLoad>
/*-------------------------------------------------------重编程过程-------------------------------------------------------*/
void Re_Programme()
{ 
  writeEx(-3,0,"开始重编程阶段");
  Down_f_a = 0;
  /*----------------------BYD重编程阶段-------------------------------*/
  if(@AUTO::Config_Switch==1)
  {
    if(SOS_Flage == 1)
    {
      SOS_Flage = 0;
      //安全访问
      Security_access();
      //10 02
      enterProg(phyID,0,Resp_1002);
      SOS_Flage = 1;
      Security_access();
    }
    else
    {
      Security_access();
      //10 02
      enterProg(phyID,0,Resp_1002);
    }
    if(Exit_1002==1)
    {
      Exit_Re_Prog = 1;
      return;
    }
    //第二次安全访问
    if(Resp_2702_2 != Resp_2702)//第二次过安全访问的预期结果
      Resp_2702 = Resp_2702_2;
    //故障注入：进入编程会话后 不执行27 01/27 02安全访问
    if(@Faultinsert::TC_Miss_27_2==1)
    {
      Resp_34_f = 0x33;
      Exit_34_f = 1;
    }
    else
      Security_access();
    
    Set_Battery_DownLoad();
    //驱动下载34
    FlashDriver_34();
    if(Exit_34_f==1)
    {
      Exit_Re_Prog = 1;
      return;
    }
    //驱动下载36
    FlashDriver_36();
    if(Exit_36_f==1)
    {
      Exit_Re_Prog = 1;
      return;
    }
    //驱动下载37
    FlashDriver_37();
    //驱动下载31 01 02 02
    FlashDriver_0202();
    if(Exit_0202_f==1)
    {
      Exit_Re_Prog = 1;
      return;
    }
  }
  /*----------------------ChangAn重编程阶段-------------------------------*/
  else if(@AUTO::Config_Switch==2)
  {
    //10 02
    enterProg(phyID,0,Resp_1002);
    //27 安全访问
    if(Resp_2702_2 != Resp_2702)//第二次过安全访问的预期结果
      Resp_2702 = Resp_2702_2;
    //故障注入：进入编程会话后 不执行27 01/27 02安全访问
    if(@Faultinsert::TC_Miss_27_2==1)
    {
      Resp_2E = 0x33;
      Exit_2E = 1;
    }
    else
      Security_access();
    //22 F1 70
    ReadIdentify(phyID,0xF170,Resp_22);
    //22 F1 71
    ReadIdentify(phyID,0xF171,Resp_22);
    //2E F1 84
    WriteIdentify(phyID,0xF184,Resp_2E);
    if(Exit_2E==1)
    {
      Exit_Re_Prog = 1;
      return;
    }
    
    Set_Battery_DownLoad();
    //驱动下载34
    FlashDriver_34();
    if(Exit_34_f==1)
    {
      Exit_Re_Prog = 1;
      return;
    }
    //驱动下载36
    FlashDriver_36();
    if(Exit_36_f==1)
    {
      Exit_Re_Prog = 1;
      return;
    }
    //驱动下载37
    FlashDriver_37();
    if(Exit_37_f==1)
    {
      Exit_Re_Prog = 1;
      return;
    }
    //驱动下载31 01 02 02
    FlashDriver_0202();
    if(Exit_0202_f==1)
    {
      Exit_Re_Prog = 1;
      return;
    }
  }
  /*------------------------------Geely 1.0重编程阶段-------------------------------*/
  else if(@AUTO::Config_Switch==3)
  {
    //10 02
    enterProg(phyID,0,Resp_1002);
    testWaitForTimeout(1000);
    if(Exit_1002==1)
    {
      Exit_Re_Prog = 1;
      return;
    }
    //27 11 & 27 12安全访问
    if(@Faultinsert::TC_Miss_27_1==1)
    {
      Resp_2E = 0x33;
      Exit_2E = 1;
    }
    else
      Security_access();
    if(Exit_27==1)
    {
      Exit_Re_Prog = 1;
      return;
    }
    testWaitForTimeout(500);
    //2E F1 98
    WriteIdentify(phyID,0xF198,Resp_2E);
    //2E F1 99
    WriteIdentify(phyID,0xF199,Resp_2E);
    if(Exit_2E==1)
    {
      Exit_Re_Prog = 1;
      return;
    }
    
    Set_Battery_DownLoad();
    //驱动下载34
    FlashDriver_34();
    if(Exit_34_f==1)
    {
      Exit_Re_Prog = 1;
      return;
    }
    //驱动下载36
    FlashDriver_36();
    if(Exit_36_f==1)
    {
      Exit_Re_Prog = 1;
      return;
    }
    //驱动下载37
    FlashDriver_37();
    //驱动下载31 01 02 02
    FlashDriver_0202();
    if(Exit_0202_f==1)
    {
      Exit_Re_Prog = 1;
      return;
    }
  }
  /*----------------------------Geely 3.0重编程阶段-------------------------------*/
  else if(@AUTO::Config_Switch==4)
  {
    dword VbtFlage;
    for(VbtFlage=0;VbtFlage<=1;VbtFlage++)
    {
      if(@Faultinsert::TC_Miss_34_F==1 && @Faultinsert::TC_Miss_36_F && @Faultinsert::TC_Miss_37_F)
      {
        PassState_31[0] = 0x10;
        PassState_31[1] = 0x06;
        Exit_0202_f = 1;
        break;
      }
    
      Set_Battery_DownLoad();
      //SBT 34请求下载
      SBT_34(VbtFlage);
      if(Exit_34_f==1)
      {
        Exit_Re_Prog = 1;
        return;
      }
      //SBT 36数据传输
      SBT_36(VbtFlage);
      if(Exit_36_f==1)
      {
        Exit_Re_Prog = 1;
        return;
      }
      //故障注入：步骤缺失Flash 37请求
      if(@Faultinsert::TC_Miss_37_F==1)
      {
        if(VbtFlage == 1)
        {
          Resp_34_a = 0x70;
          Resp_36_a = 0x31;
          Exit_34_a = 1;
          PassState_31[1] = 0x06;
          Resp_0301 = 0x22;
          Resp_ff00 = 0x31;
          
          break;
        }
      }
      //SBT 37退出传输
      SBT_37(VbtFlage);
      if(Exit_37_f==1)
      {
        Exit_Re_Prog = 1;
        return;
      }
    }
    //故障注入：下载完SBT后 直接请求完整性兼容校验
    if(@Faultinsert::TC_SBT37_0205==1)
    {
      _Send0205(phyID,Resp_0205);
      Exit_Re_Prog = 1;
      return;
    }
    //故障注入：下载完SBT后 增加请求完整性兼容校验
    if(@Faultinsert::TC_SBT37_0205==2)
    {
      _Send0205(phyID,Resp_0205);
      testWaitForTimeout(200);
    }
    //SBT 31 01 02 12签名校验
    _Send0212_F(phyID,0,Resp_0202_f);
    if(Exit_0202_f==1)
    {
      Exit_Re_Prog = 1;
      return;
    }
    //故障注入：SBT 0212后新增22读取服务
    if(@Faultinsert::TC_ReadAfter_0202F==1)
    {
      if(@AUTO::ReadIdentify == 0xF1A2)
        Resp_22 = 0x31;
      ReadIdentify(phyID,@AUTO::ReadIdentify,Resp_22);
    }
    //激活SBT 31 01 03 01
    _Send0301(phyID,Resp_0301);
    if(Exit_0301==1)
    {
      Exit_Re_Prog = 1;
      return;
    }
  }
  /*--------------------------------鑫源 重编程阶段-------------------------------*/
  else if(@AUTO::Config_Switch==5)
  {
    //10 02
    enterProg(phyID,0,Resp_1002);
    if(Exit_1002==1)
    {
      Exit_Re_Prog = 1;
      return;
    }
    //27 11 & 27 12安全访问
    Security_access();
    
    Set_Battery_DownLoad();
    //驱动下载34
    FlashDriver_34();
    if(Exit_34_f==1)
    {
      Exit_Re_Prog = 1;
      return;
    }
    //驱动下载36
    FlashDriver_36();
    if(Exit_36_f==1)
    {
      Exit_Re_Prog = 1;
      return;
    }
    //驱动下载37
    FlashDriver_37();
    if(Exit_37_f==1)
    {
      Exit_Re_Prog = 1;
      return;
    }
    //驱动下载数据校验31 01 02 01
    FlashDriver_0202();
    if(Exit_0202_f==1)
    {
      Exit_Re_Prog = 1;
      return;
    }
    //2E F1 98
    WriteIdentify(phyID,0xF198,Resp_2E);
    if(Exit_2E==1)
    {
      Exit_Re_Prog = 1;
      return;
    }
    //2E F1 99
    WriteIdentify(phyID,0xF199,Resp_2E);
  }
  /*--------------------------------瑞驰 重编程阶段-------------------------------*/
  else if(@AUTO::Config_Switch==6)
  {
    //10 02
    enterProg(phyID,0,Resp_1002);
    if(Exit_1002==1)
    {
      Exit_Re_Prog = 1;
      return;
    }
    //故障注入：步骤缺失 安全访问
    if(@Faultinsert::TC_Miss_27_1==1)
    {
      Resp_34_f = 0x33;
      Exit_34_f = 1;
    }
    //安全访问
    else
    {
      if(@AUTO::Security_Switch == 2)
        Security_access_AES_CMAC();
      else
        Security_access();
    }    
      
    if(Exit_27==1)
    {
      Exit_Re_Prog = 1;
      return;
    }
    
    Set_Battery_DownLoad();
    //驱动下载34
    FlashDriver_34();
    if(Exit_34_f==1)
    {
      Exit_Re_Prog = 1;
      return;
    }
    //驱动下载36
    FlashDriver_36();
    if(Exit_36_f==1)
    {
      Exit_Re_Prog = 1;
      return;
    }
    //驱动下载37
    FlashDriver_37();
    if(Exit_37_f==1)
    {
      Exit_Re_Prog = 1;
      return;
    }
    //驱动下载数据校验31 01 F0 01
    FlashDriver_0202();
    if(Exit_0202_f==1)
    {
      Exit_Re_Prog = 1;
      return;
    }
  }
  /*--------------------------------奇瑞 重编程阶段-------------------------------*/
  else if(@AUTO::Config_Switch==7)
  {
    //10 02
    enterProg(phyID,0,Resp_1002);
    p2cmax = 50;
    //安全访问27 03 & 27 04
    /*故障注入：步骤缺失 安全访问*/
    if(@Faultinsert::TC_Miss_27_1==1)
    {
      Resp_34_f = 0x33;
      Exit_34_f = 1;
    }
    else
    {
      Security_access();
    }
    
    Set_Battery_DownLoad();
    //驱动下载34
    FlashDriver_34();
    if(Exit_34_f==1)
    {
      Exit_Re_Prog = 1;
      return;
    }
    //驱动下载36
    FlashDriver_36();
    if(Exit_36_f==1)
    {
      Exit_Re_Prog = 1;
      return;
    }
    //驱动下载37
    FlashDriver_37();
    if(Exit_37_f==1)
    {
      Exit_Re_Prog = 1;
      return;
    }
  }
  /*--------------------------------奇瑞T1V 5.0 重编程阶段-------------------------------*/
  else if(@AUTO::Config_Switch==11) 
  {
    //10 02
    enterProg(phyID,0,Resp_1002);
    testWaitForTimeout(1000);
    /*故障注入：步骤缺失 安全访问*/
    if(@Faultinsert::TC_Miss_27_1==1)
    {
      Resp_34_f = 0x33;
      Exit_34_f = 1;
    }
    else
      Security_access_AES_CMAC();
    
    //22 F0 F0
//    ReadIdentify(phyID,0xF0F0,Resp_22);
    //2E F1 84
    WriteIdentify(phyID,0xF184,Resp_2E);
    
    
    Set_Battery_DownLoad();
    //驱动下载34
    FlashDriver_34();
    if(Exit_34_f==1)
    {
      Exit_Re_Prog = 1;
      return;
    }
    //驱动下载36
    FlashDriver_36();
    if(Exit_36_f==1)
    {
      Exit_Re_Prog = 1;
      return;
    }
    //驱动下载37
    FlashDriver_37();
    if(Exit_37_f==1)
    {
      Exit_Re_Prog = 1;
      return;
    }
    //驱动下载数据校验31 01 DD 02
    FlashDriver_0202();
    if(Exit_0202_f==1)
    {
      Exit_Re_Prog = 1;
      return;
    }
  }
  /*--------------------------------五菱 重编程阶段-------------------------------*/
  else if(@AUTO::Config_Switch==8)
  {
    //10 02
    enterProg(phyID,0,Resp_1002);
    //故障注入：步骤缺失 安全访问
    if(@Faultinsert::TC_Miss_27_1==1)
    {
      Resp_34_f = 0x33;
      Exit_34_f = 1;
    }
    else
    {
      //安全访问 27 05 & 27 06
      Security_access();
    }
    testWaitForTimeout(100);
    
    Set_Battery_DownLoad();
    //驱动下载34
    FlashDriver_34();
    if(Exit_34_f==1)
    {
      Exit_Re_Prog = 1;
      return;
    }
    //驱动下载36
    FlashDriver_36();
    if(Exit_36_f==1)
    {
      Exit_Re_Prog = 1;
      return;
    }
    //驱动下载37
    FlashDriver_37();
    if(Exit_37_f==1)
    {
      Exit_Re_Prog = 1;
      return;
    }
    //驱动下载数据校验31 01 DF FF
    FlashDriver_0202();
    if(Exit_0202_f==1)
    {
      Exit_Re_Prog = 1;
      return;
    }
  }
  /*--------------------------------东风小康 重编程阶段-------------------------------*/
  else if(@AUTO::Config_Switch==9)
  {
    //10 02
    enterProg(phyID,0,Resp_1002);
    //安全访问 进入BT后 安全访问等级变为27 09
    SeedLevel = 0x09;
    Security_access();
//    _Send2705B18E();
    //2E F1 84
    WriteIdentify(phyID,0xF184,Resp_2E);
    
    Set_Battery_DownLoad();
    //驱动下载34
    FlashDriver_34();
    if(Exit_34_f==1)
    {
      Exit_Re_Prog = 1;
      return;
    }
    //驱动下载36
    FlashDriver_36();
    if(Exit_36_f==1)
    {
      Exit_Re_Prog = 1;
      return;
    }
    //驱动下载37
    FlashDriver_37();
    if(Exit_37_f==1)
    {
      Exit_Re_Prog = 1;
      return;
    }
    //驱动下载数据校验31 01 02 02
    FlashDriver_0202();
    if(Exit_0202_f==1)
    {
      Exit_Re_Prog = 1;
      return;
    }
  }
  /*--------------------------------赛力斯 重编程阶段-------------------------------*/
  else if(@AUTO::Config_Switch==10)
  {
    //10 02
    enterProg(phyID,0,Resp_1002);
    if(Exit_34_f==1)
    {
      Exit_Re_Prog = 1;
      return;
    }
    //故障注入：步骤缺失 安全访问
    if(@Faultinsert::TC_Miss_27_1==1)
    {
      Resp_2E = 0x33;
      Exit_2E = 1;
    }
    else
    {
      //安全访问 27 09 & 27 0A
      Security_access();
      if(Exit_27==1)
      {
        Exit_Re_Prog = 1;
        return;
      }
    }
    //2E F1 84
    WriteIdentify(phyID,0xF184,Resp_2E);
    
    Set_Battery_DownLoad();
    //驱动下载34
    FlashDriver_34();
    if(Exit_34_f==1)
    {
      Exit_Re_Prog = 1;
      return;
    }
    //驱动下载36
    FlashDriver_36();
    if(Exit_36_f==1)
    {
      Exit_Re_Prog = 1;
      return;
    }
    //驱动下载37
    FlashDriver_37();
    if(Exit_37_f==1)
    {
      Exit_Re_Prog = 1;
      return;
    }
    //驱动下载数据校验31 01 DD 02
    FlashDriver_0202();
    if(Exit_0202_f==1)
    {
      Exit_Re_Prog = 1;
      return;
    }
  }
  /*--------------------------------广汽 重编程阶段-------------------------------*/
  else if(@AUTO::Config_Switch==12)
  {
    //10 02
    enterProg(phyID,0,Resp_1002);
    testWaitForTimeout(600);
    if(Exit_34_f==1)
    {
      Exit_Re_Prog = 1;
      return;
    }
    //故障注入：步骤缺失 安全访问
    if(@Faultinsert::TC_Miss_27_1==1)
    {
      Resp_2E = 0x33;
      Exit_2E = 1;
    }
    else
    {
      //安全访问 27 11 & 27 12
      Security_access();
      if(Exit_27==1)
      {
        Exit_Re_Prog = 1;
        return;
      }
    }
    //2E F1 84
    WriteIdentify(phyID,0xF184,Resp_2E);
    if(@Test::Loop_Test_Switch)
    {
      //22 02 01
      Change_CompilePro = ReadIdentify_GetData(phyID,0x0201);
    }
    Set_Battery_DownLoad();
    /*由于存在多个Logical blocks时需要重新进行Flash刷写,故Flash放到下载部分*/  
  }
  /*--------------------------------V8 重编程阶段-------------------------------*/
  else if(@AUTO::Config_Switch==13)
  {
    //10 02
    enterProg(phyID,0,Resp_1002);
    //安全访问 
    Security_access();
    //2E F1 84
    WriteIdentify(phyID,0xF184,Resp_2E);
    Set_Battery_DownLoad();
    //驱动下载34
    FlashDriver_34();
    if(Exit_34_f==1)
    {
      Exit_Re_Prog = 1;
      return;
    }
    //驱动下载36
    FlashDriver_36();
    if(Exit_36_f==1)
    {
      Exit_Re_Prog = 1;
      return;
    }
    //驱动下载37
    FlashDriver_37();
    if(Exit_37_f==1)
    {
      Exit_Re_Prog = 1;
      return;
    }
    //驱动下载数据校验31 01 02 02
    FlashDriver_0202();
    if(Exit_0202_f==1)
    {
      Exit_Re_Prog = 1;
      return;
    }
  }
  writeEx(-3,0,"重编程完成");
}
/// <DownLoad>
/*-------------------------------------------------------后编程过程-------------------------------------------------------*/
void Post_Programme()
{
  writeEx(-3,0,"开始后编程阶段");
  /*----------------------BYD后编程阶段-------------------------------*/
  if(@AUTO::Config_Switch==1)
  {
    //软硬件一致性检查 31 01 FF 01
    _SendFF01(phyID,Resp_ff01);
    if(Exit_ff01==1)
    {
      Exit_Post_Prog = 1;
      return;
    }
    //ECU复位 11 01
    _Startreset(phyID,0x01,Resp_11);
    if(Exit_11==1)
    {
      Exit_Post_Prog = 1;
      return;
    }
    //恢复报文发送 28 80 01
    Com_Control(funID,1,0x00,0x01,Resp_28);
    //打开DTC设置 85 81
    DTC_Control(funID,1,0x01,Resp_85);
    diagStopTesterPresent("ABS_ESP_Functional");
  }
  /*----------------------ChangAn后编程阶段-------------------------------*/
  else if(@AUTO::Config_Switch==2)
  {
    //软硬件一致性检查 31 01 FF 01
    _SendFF01(phyID,Resp_ff01);
    //ECU复位11 03
    _Startreset(phyID,0x03,Resp_11);
    if(Exit_11==1)
    {
      Exit_Post_Prog = 1;
      return;
    }
    //扩展会话模式10 03
    enterExtend(phyID,0,Resp_1003);
    //恢复报文发送28 80 03
    Com_Control(funID,1,0x00,0x03,Resp_28);
    //打开DTC设置 85 81
    DTC_Control(funID,1,0x01,Resp_85);
    //默认会话模式10 81
    enterDefault(funID,1,Resp_1001);
    diagStopTesterPresent("ABS_ESP_Functional");
  }
  /*----------------------Geely 1.0后编程阶段-------------------------------*/
  else if(@AUTO::Config_Switch==3)
  {
    //软硬件一致性检查 31 01 FF 01
    _SendFF01(phyID,Resp_ff01);
    if(Exit_ff01==1)
    {
      Exit_Post_Prog = 1;
      return;
    }
    //ECU复位11 01
    _Startreset(phyID,0x01,Resp_11);
    if(Exit_11==1)
    {
      Exit_Post_Prog = 1;
      return;
    }
    //扩展会话模式10 03
    enterExtend(funID,0,Resp_1003);
    //恢复报文发送 28 00 01
    Com_Control(funID,0,0x00,0x01,Resp_28);
    //打开DTC设置 85 01
    DTC_Control(funID,0,0x01,Resp_85);
    //默认会话模式10 01
    enterDefault(funID,0,Resp_1001);
    diagStopTesterPresent("ABS_ESP_Functional");
  }
  /*----------------------Geely 3.0后编程阶段-------------------------------*/
  else if(@AUTO::Config_Switch==4)
  {
    //31 01 02 05
    _Send0205(phyID,Resp_0205);
    //ECU复位 11 01
    _Startreset(phyID,0x01,Resp_11);
  }
  /*---------------------------鑫源 后编程阶段-------------------------------*/
  else if(@AUTO::Config_Switch==5)
  {
    //依赖性检测31 01 FF 01
    _SendFF01(phyID,Resp_ff01);
    if(Exit_ff01==1)
    {
      Exit_Post_Prog = 1;
      return;
    }
    //ECU复位11 01
    _Startreset(phyID,0x01,Resp_11);
    if(Exit_11==1)
    {
      Exit_Post_Prog = 1;
      return;
    }
    //扩展会话模式10 83
    enterExtend(funID,1,Resp_1003);
    //恢复报文发送28 80 01
    Com_Control(funID,1,0x00,0x01,Resp_28);
    //打开DTC设置85 81
    DTC_Control(funID,1,0x01,Resp_85);
    //默认会话模式10 81
    enterDefault(funID,1,Resp_1001);
    diagStopTesterPresent("ABS_ESP_Functional");
  }
  /*---------------------------瑞驰 后编程阶段-------------------------------*/
  else if(@AUTO::Config_Switch==6)
  {
    if(PostProg_Recover == 1)
    {
      if(@Faultinsert::TC_Pro_0203==1) //故障恢复：更新条件检测后进入编程会话
      {
        Resp_85 = -1;
        Resp_28 = -1;
      }
    }
    //依赖性检测31 01 FF 01
    _SendFF01(phyID,Resp_ff01);
    if(Exit_ff01==1)
    {
      Exit_Post_Prog = 1;
      return;
    }
    //ECU复位11 01
    _Startreset(phyID,0x01,Resp_11);
    if(Exit_11==1)
    {
      Exit_Post_Prog = 1;
      return;
    }
    //扩展会话模式10 03
    enterExtend(phyID,0,Resp_1003);
    testWaitForTimeout(500);
    //恢复报文发送28 00 03
    Com_Control(funID,0,0x00,0x03,Resp_28);
    //打开DTC设置85 81
    DTC_Control(funID,1,0x01,Resp_85);
    //默认会话模式10 01
    enterDefault(funID,0,Resp_1001);
    testWaitForTimeout(500);
    //清楚故障码 14 FF FF FF
    ClearDTC(phyID,Resp_14);
    diagStopTesterPresent("ABS_ESP_Functional");
  }
  /*---------------------------奇瑞 后编程阶段-------------------------------*/
  else if(@AUTO::Config_Switch==7)
  {
    word p2cmax_temp;
    p2cmax_temp = p2cmax;
    p2cmax = 100;
    //软件有效性检测31 01 DA 04
    _SendDA04(phyID,Resp_DA04);
    p2cmax = p2cmax_temp;
    if(Exit_DA04==1)
    {
      Exit_Post_Prog = 1;
      return;
    }
    //31 03 DA 04
    _Send03DA04(phyID,Resp_DA04);
    if(Exit_03DA04==1)
    {
      Exit_Post_Prog = 1;
      return;
    }
    //31 02 DA 04
    _Send02DA04(phyID,Resp_DA04);
    if(Exit_02DA04==1)
    {
      Exit_Post_Prog = 1;
      return;
    }
    //11 01
    _Startreset(phyID,0x01,Resp_11);
    if(Exit_11==1)
    {
      Exit_Post_Prog = 1;
      return;
    }
    p2cmax = 50;
    //10 03
    enterExtend(funID,0,Resp_1003);
    //28 00 03
    Com_Control(funID,0,0x00,0x03,Resp_28);
    //85 01
    DTC_Control(funID,0,0x01,Resp_85);
    //14 FF FF FF
    ClearDTC(funID,Resp_14);
    if(Exit_14==1)
    {
      Exit_Post_Prog = 1;
      return;
    }
    //10 01
    enterDefault(funID,0,Resp_1001);
    diagStopTesterPresent("ABS_ESP_Functional");
  }
  /*---------------------------奇瑞T1V 5.0  后编程阶段-------------------------------*/
  else if(@AUTO::Config_Switch==11)
  {
    word p2cmax_temp;
    p2cmax_temp = p2cmax;
    p2cmax = 100;
    
    //28 80 03
    Com_Control(funID,1,0x00,0x03,Resp_28);
    //11 01
    _Startreset(phyID,0x01,Resp_11);
    if(Exit_11==1)
    {
      Exit_Post_Prog = 1;
      return;
    }
    //22 F0 F2
//    ReadIdentify(phyID,0xF0F2,Resp_22);
    
    p2cmax = 50;
    //10 03
    enterExtend(phyID,0,Resp_1003);
    //14 FF FF FF
    ClearDTC(phyID,Resp_14);
    if(Exit_14==1)
    {
      Exit_Post_Prog = 1;
      return;
    }
    //85 81
    DTC_Control(funID,1,0x01,Resp_85);
    //10 81
    enterDefault(funID,1,Resp_1001);
    diagStopTesterPresent("ABS_ESP_Functional");
  }
  /*---------------------------五菱 后编程阶段-------------------------------*/
  else if(@AUTO::Config_Switch==8)
  {
    //软件有效性检测31 01 FF 01
    _SendFF01(phyID,Resp_ff01);
    if(Exit_ff01==1)
    {
      Exit_Post_Prog = 1;
      return;
    }
    //ECU复位 11 01
    _Startreset(funID,0x01,Resp_11);
    if(Exit_11==1)
    {
      Exit_Post_Prog = 1;
      return;
    }
    //清除故障 14 FF FF FF
    ClearDTC(funID,Resp_14);
    //10 03
    enterExtend(phyID,0,Resp_1003);
    diagStopTesterPresent("ABS_ESP_Functional");
  }
  /*---------------------------东风小康 后编程阶段-------------------------------*/
  else if(@AUTO::Config_Switch==9)
  {
    //软件有效性检测31 01 FF 01
    _SendFF01(phyID,Resp_ff01);
//    diagStartTesterPresent("ABS_ESP_Functional");
    //28 80 01
    Com_Control(funID,1,0x00,0x01,Resp_28);
    //28 80 03
    Com_Control(funID,1,0x00,0x03,Resp_28);
    testWaitForTimeout(1000);
    //ECU复位 11 01
    _Startreset(phyID,0x01,Resp_11);
    if(Exit_11==1)
    {
      Exit_Post_Prog = 1;
      return;
    }
    //清除故障 14 FF FF FF
    ClearDTC(phyID,Resp_14);
     //85 81
    DTC_Control(funID,1,0x01,Resp_85);
    //10 81
    enterDefault(funID,1,Resp_1001);
    diagStopTesterPresent("ABS_ESP_Functional");
  }
  /*---------------------------赛力斯 后编程阶段-------------------------------*/
  else if(@AUTO::Config_Switch==10)
  {
    //安全签名检查31 01 FF 01
    _SendFF01(phyID,Resp_ff01);
    //28 80 03
    Com_Control(funID,1,0x00,0x03,Resp_28);
    //ECU复位 11 01
    _Startreset(funID,0x01,Resp_11);
    if(Exit_11==1)
    {
      Exit_Post_Prog = 1;
      return;
    }
    //清除故障 14 FF FF FF
    ClearDTC(phyID,Resp_14);
    //85 81
    DTC_Control(funID,1,0x01,Resp_85);
    //10 81
    enterDefault(funID,1,Resp_1001);
    //22 F1 87
    ReadIdentify(phyID,0xF187,Resp_22);
  }
  /*---------------------------广汽 后编程阶段-------------------------------*/
  else if(@AUTO::Config_Switch==12)
  {
    //安全签名检查31 01 FF 01
    _SendFF01(phyID,Resp_ff01);
    
    if(@Test::Loop_Test_Switch)
    {
      //22 02 00
      Change_ReadPro = ReadIdentify_GetData(phyID,0x0200);
    }
    //2E F1 99
    WriteIdentify(phyID,0xF199,Resp_2E);
    //ECU复位 11 01
    _Startreset(funID,0x01,Resp_11);
    if(Exit_11==1)
    {
      Exit_Post_Prog = 1;
      return;
    }
  }
  /*---------------------------V8 后编程阶段-------------------------------*/
  else if(@AUTO::Config_Switch==13)
  {
    //ECU复位 11 01
    _Startreset(phyID,0x01,Resp_11);
    if(Exit_11==1)
    {
      Exit_Post_Prog = 1;
      return;
    }
    //10 81
    enterDefault(funID,1,Resp_1001);
    //清除故障 14 FF FF FF
    ClearDTC(funID,Resp_14);
  }
  testWaitForTimeout(3000);
  writeEx(-3,0,"后编程完成");
}

//使用物理寻址或功能寻址发送请求
//参数msgID:{phyID:物理寻址,funID:功能寻址}
//参数obj:诊断请求
void _diagSendMsg(dword msgID,diagRequest* obj)
{
  char comment[70];
  byte primitiveRaw[30];
  long size;
  byte i;
  
  size=DiagGetPrimitiveData(obj,primitiveRaw,elCount(primitiveRaw));
  
  if(msgID==phyID)
    snprintf(comment,elCount(comment),"已发送物理寻址请求:[%02X]",size);
  else
    snprintf(comment,elCount(comment),"已发送功能寻址请求:[%02X]",size);
  if(@Test::Loop_Test_Switch == 1 && primitiveRaw[0] == 0x36)
  {
    for(i=0;i<2;i++)
    {
      snprintf(comment,elCount(comment),"%s %02X",comment,primitiveRaw[i]);
    }
  }
  else
  {
    for(i=0;i<size;i++)
    {
      snprintf(comment,elCount(comment),"%s %02X",comment,primitiveRaw[i]);
    }
  }
  
  if(msgID==phyID)
    diagSendRequest(obj);
  else if(msgID==funID)
    diagSendFunctional(obj);
  testCaseComment(comment);
}

//默认会话模式
//参数msgID:{phyID:物理寻址,funID:功能寻址}
//参数Inhibitory_response:{1:抑制响应,0:非抑制响应}
//参数Passcondition:{-1:期望收到积极响应,0:期望不收到响应,>0:期望收到的NRC}
void enterDefault(dword msgID,int Inhibitory_response,int Passcondition)
{
  diagRequest ABS_ESP.DefaultSession_Start req1001;
  word Temp_p2cmax;
  Temp_p2cmax = p2cmax;
  stepnum++;
  snprintf(stepid,elCount(stepid),"步骤%02d：测试10服务默认会话",stepnum);
  if(Inhibitory_response == 1)
  {
    DiagSetPrimitiveByte(req1001,1,0x80|DiagGetPrimitiveByte(req1001,1));
    Passcondition = 0;
  }
  else if(Inhibitory_response == 0)
  {
    DiagSetPrimitiveByte(req1001,1,0x01);
    Passcondition = Resp_1001;
  }
  if(@AUTO::Config_Switch == 4)
  {
    p2cmax = 50;
  }
  _diagSendMsg(msgID,req1001);
//  testWaitForDiagRequestSent(req1001,200);
//  testWaitForDiagResponse(req1001,p2cmax);
//  _TestResult(req1001,stepid,Passcondition);
  _get_FC(req1001,msgID,stepid,Passcondition);
  
  p2cmax = Temp_p2cmax;
}

//编程会话模式
//参数msgID:{phyID:物理寻址,funID:功能寻址}
//参数Inhibitory_response:{1:抑制响应,0:非抑制响应}
//参数Passcondition:{-1:期望收到积极响应,0:期望不收到响应,>0:期望收到的NRC}
void enterProg(dword msgID,int Inhibitory_response,int Passcondition)
{
  diagRequest ABS_ESP.ProgrammingSession_Start req1002;
  char comment[70];
  stepnum++;
  snprintf(stepid,elCount(stepid),"步骤%02d：测试10服务编程会话",stepnum);
  if(Inhibitory_response == 1)
  {
    DiagSetPrimitiveByte(req1002,1,0x80|DiagGetPrimitiveByte(req1002,1));
    if(Passcondition == -1)
      Passcondition = 0;
  }
//  //奇瑞 APP无效时 10 02响应的p2cmax值为 50ms
//  if(@AUTO::Config_Switch==7 && curAppValid==0)
//  {
//    p2cmax = 50;
//  }
  //故障注入：步骤缺失10 02进入编程会话
  if(@Faultinsert::TC_Miss_1002 == 1)
  {
    if(@AUTO::Config_Switch==2)//ChangAn
    {
      Resp_2702_2 = 0x24;
      Resp_2E = 0x31;
      Exit_2E = 1;
    }
    else if(@AUTO::Config_Switch==3)//Geely 1.0 
    {
      Resp_2701 = 0x7E;
      Resp_2702 = 0x7E;
      Exit_27 = 1;
    }
    else if(@AUTO::Config_Switch==10)//赛力斯
    {
      Resp_2701 = 0x12;
      Resp_2702 = 0x12;
      Exit_27 = 1;
    }
    else if(@AUTO::Config_Switch==4)//Geely 3.0
    {
//      Resp_22 = 0x31;
//      Exit_22 = 1;
      Resp_2702 = 0x7F;
      Exit_27 = 1;
    }
    
    return;
  }
  else
  {
    _diagSendMsg(msgID,req1002);
    testWaitForDiagRequestSent(req1002,200);
    _get_FC(req1002,phyID,stepid,Passcondition);
  }
//  //故障注入：电压异常测试  ---此部分更改位置到重编程部分故暂屏蔽
//  if(@Faultinsert::TC_ErrorHighVolt_App == 1)
//  {
//    if(@Prog_power::K30Volt > High_Volt)
//    {
//      HighVolt_Resp(curAppValid);
//    }
//  }
//  if(@Faultinsert::TC_ErrorLowVolt_App == 1)
//  {
//    if(@Prog_power::K30Volt < Low_Volt)
//    {
//      LowVolt_Resp(curAppValid);
//    }
//  }
}
//扩展会话模式
//参数msgID:{phyID:物理寻址,funID:功能寻址}
//参数Inhibitory_response:{1:抑制响应,0:非抑制响应}
//参数Passcondition:{-1:期望收到积极响应,0:期望不收到响应,>0:期望收到的NRC}
void enterExtend(dword msgID,int Inhibitory_response,int Passcondition)
{
  diagRequest ABS_ESP.ExtendedDiagnosticSession_Start req1003;
  stepnum++;
  snprintf(stepid,elCount(stepid),"步骤%02d：测试10服务扩展会话",stepnum);
  
  if(Inhibitory_response == 1)
  {
    DiagSetPrimitiveByte(req1003,1,0x80|DiagGetPrimitiveByte(req1003,1));
    if(Passcondition == -1)
      Passcondition = 0;
  }
  else if(Inhibitory_response == 0)
  {
    if(BT_1003 == 1 && curAppValid==0)
    {
      Passcondition = 0x12;
    }
    else
    {
      DiagSetPrimitiveByte(req1003,1,0x03);
      Passcondition = Resp_1003;
    }
  }
  //故障注入：步骤缺失10 03扩展会话
  if(@Faultinsert::TC_Miss_1003 == 1)
  {
    if(@AUTO::Config_Switch==3)//Geely1.0
    {
      Resp_85 = 0;
      Resp_28 = 0;
    }
    else if(@AUTO::Config_Switch==6 || @AUTO::Config_Switch==10)//瑞驰 || 赛力斯
    {
      Resp_85 = 0;
      Resp_28 = 0;
      Resp_0203 = 0x7F;
    }
    Resp_1002 = 0x7E;
    Exit_1002 = 1;
    return;
  }
  else
  {
    _diagSendMsg(msgID,req1003);
    _get_FC(req1003,msgID,stepid,Passcondition);
  }
  //故障注入：进入扩展会话后超过5S
  if(@Faultinsert::TC_Wait_1003==1)
  {
    Resp_1002 = 0x7E;
    Exit_1002 = 1;
    testWaitForTimeout(6000);
  }
}
//14清除故障码
//参数msgID:{phyID:物理寻址,funID:功能寻址}
//参数Passcondition:{-1:期望收到积极响应,0:期望不收到响应,>0:期望收到的NRC}
void ClearDTC(dword msgID,int Passcondition)
{
  diagRequest ABS_ESP.FaultMemory_Clear req14;
  stepnum++;
  snprintf(stepid,elCount(stepid),"步骤%02d：测试14服务清除故障码",stepnum);
  
  diagResize(req14,4);
  DiagSetPrimitiveByte(req14,0,0x14);
  DiagSetPrimitiveByte(req14,1,0xFF);
  DiagSetPrimitiveByte(req14,2,0xFF);
  DiagSetPrimitiveByte(req14,3,0xFF);
  
  _diagSendMsg(msgID,req14);
  _get_FC(req14,msgID,stepid,Passcondition);
}
//22读取数据服务
//参数msgID:{phyID:物理寻址,funID:功能寻址}
//参数Identifier:数据标识符DID
//用于获取对应的返回值
dword ReadIdentify_GetData(dword msgID,word Identifier)
{
  diagRequest ABS_ESP.Primary_Bootloader_Software_Version_Number_Read req22;
  dword ResValue;
  int i,ResLen;
  DiagSetPrimitiveByte(req22,1,Identifier >> 8);
  DiagSetPrimitiveByte(req22,2,Identifier & 0xFF);
  
  _diagSendMsg(msgID,req22);
  testWaitForDiagRequestSent(req22,200);
  testReportWriteDiagObject(req22);
  diagSetP2Extended(-1);
  testWaitForDiagResponse(req22,p2cmax);
  do
  {
    if(diagGetLastResponseCode(req22)==0x78)
      testWaitForDiagResponse(req22,p2cmax*100);
  }while(diagGetLastResponseCode(req22)==0x78);
  testReportWriteDiagResponse(req22);
  if(diagGetLastResponseCode(req22) == -1)
  {
    ResValue = 0;
    ResLen = DiagGetRespPrimitiveSize(req22) - 3;
    for(i=0;i<ResLen;i++)
      ResValue = ResValue + (DiagGetRespPrimitiveByte(req22,i+3)<<((ResLen-1-i)*8));
  }
  return ResValue;
}

//22读取数据服务
//参数msgID:{phyID:物理寻址,funID:功能寻址}
//参数Identifier:数据标识符DID
//参数Passcondition:{-1:期望收到积极响应,0:期望不收到响应,>0:期望收到的NRC}
void ReadIdentify(dword msgID,word Identifier,int Passcondition)
{
  diagRequest ABS_ESP.Primary_Bootloader_Software_Version_Number_Read req22;
  byte result;
  result = 0;
  stepnum++;
  snprintf(stepid,elCount(stepid),"步骤%02d：测试22服务读数据",stepnum);
  
  DiagSetPrimitiveByte(req22,1,Identifier >> 8);
  DiagSetPrimitiveByte(req22,2,Identifier & 0xFF);
  
  //故障注入:步骤缺失22读取数据服务
  if(@Faultinsert::TC_Miss_22==1)
  {
    return;
  }
  _diagSendMsg(msgID,req22);
  _get_FC(req22,msgID,stepid,Passcondition);
  testWaitForTimeout(1000);
  //故障注入：刷写过程中读取不支持的DID
  if(@Faultinsert::TC_Error_22_DID==1)
  {
    @Faultinsert::TC_Error_22_DID = 0;//Add 
    ReadIdentify(msgID,UnsupportDID,0x31);
  }
}
//2E写入数据服务
//参数msgID:{phyID:物理寻址,funID:功能寻址}
//参数Identifier:数据标识符DID
//参数Passcondition:{-1:期望收到积极响应,0:期望不收到响应,>0:期望收到的NRC}
void WriteIdentify(dword msgID,dword Identifier,int Passcondition)
{
  diagRequest ABS_ESP.Primary_Bootloader_Software_Version_Number_Write req2E;
  long DateTime[9],DateYear,DateMonth,DateDay,Byte_High,Byte_Low;
  char comment[30];
  byte i;
  i = 0;
  
  stepnum++;
  snprintf(stepid,elCount(stepid),"步骤%02d：测试2E服务写数据",stepnum);
  
  DiagSetPrimitiveByte(req2E,1,Identifier>>8);
  DiagSetPrimitiveByte(req2E,2,Identifier&0xFF);
  
  //2E F1 84
  if(Identifier == 0xF184)
  {
    getLocalTime(DateTime);
    DateYear = (DateTime[5]+1900-2000) & 0xFF;   //本地时间年
    DateMonth = DateTime[4]+1;                   //本地时间月
    DateDay = DateTime[3];                       //本地时间日
    if(@AUTO::Config_Switch==2)//ChangAn
    {
      diagResize(req2E,0x0A);
      DiagSetPrimitiveByte(req2E,3,DateYear);
      DiagSetPrimitiveByte(req2E,4,DateMonth);
      DiagSetPrimitiveByte(req2E,5,DateDay);
      //故障注入：2E F1 84写入无效的数据
      if(@Faultinsert::TC_ErrorData_2E==1)
      {
        DiagSetPrimitiveByte(req2E,3,0xFF);
        DiagSetPrimitiveByte(req2E,4,0x0D);
        DiagSetPrimitiveByte(req2E,5,0x1F);
        Passcondition = 0x31;
        Resp_34_f = 0x22;
        Exit_34_f = 1;
      }
    }
    else if(@AUTO::Config_Switch==9)//东风小康
    {
      diagResize(req2E,0x0D);
      DiagSetPrimitiveByte(req2E,4,DateYear);
      DiagSetPrimitiveByte(req2E,5,DateMonth);
      DiagSetPrimitiveByte(req2E,6,DateDay);
    }
    else if(@AUTO::Config_Switch==11)//奇瑞T1V
    {
      diagResize(req2E,0x16);
      DiagSetPrimitiveByte(req2E,3,DateYear);
      DiagSetPrimitiveByte(req2E,4,DateMonth);
      DiagSetPrimitiveByte(req2E,5,DateDay);
      for(i=6;i<0x16;i++)
        DiagSetPrimitiveByte(req2E,i,0x20);
    }
    else if(@AUTO::Config_Switch==12)//广汽
    {
      char Year[20],Month[20],Day[20];
      snprintf(Year,elCount(Year),"0x%d",DateYear);
      snprintf(Month,elCount(Month),"0x%d",DateMonth);
      snprintf(Day,elCount(Day),"0x%d",DateDay);
      diagResize(req2E,0x0D);
      DiagSetPrimitiveByte(req2E,4,atol(Year));
      DiagSetPrimitiveByte(req2E,5,atol(Month));
      DiagSetPrimitiveByte(req2E,6,atol(Day));
    }
    else if(@AUTO::Config_Switch==13)//V8
    {
      diagResize(req2E,0x0C);
      DiagSetPrimitiveByte(req2E,3,DateYear);
      DiagSetPrimitiveByte(req2E,4,DateMonth);
      DiagSetPrimitiveByte(req2E,5,DateDay);
    }
  }
  //2E F1 99
  else if(Identifier == 0xF199)
  {
    diagResize(req2E,0x07);
    getLocalTime(DateTime);
    DateYear = (DateTime[5]+1900);      //本地时间年
    DateMonth = DateTime[4]+1;          //本地时间月
    DateDay = DateTime[3];
    Byte_High = ((DateYear/1000)<<4) | ((DateYear/100)%10);
    Byte_Low = (((DateYear/10)%10)<<4) | (DateYear%10);
    DateMonth = ((DateMonth/10)<<4) | (DateMonth % 10);
    DateDay = ((DateDay/10)<<4) | (DateDay % 10);
    DiagSetPrimitiveByte(req2E,3,Byte_High);
    DiagSetPrimitiveByte(req2E,4,Byte_Low);
    DiagSetPrimitiveByte(req2E,5,DateMonth);
    DiagSetPrimitiveByte(req2E,6,DateDay);
  }
  //2E F1 98
  else if(Identifier == 0xF198)
  {
    if(@AUTO::Config_Switch==3)//Geely 1.0
    {
      diagResize(req2E,0x13);
      for(i=3;i<0x13;i++)
        DiagSetPrimitiveByte(req2E,i,0x00);
    }
    else if(@AUTO::Config_Switch==5)//鑫源
    {
      diagResize(req2E,0x13);
      for(i=3;i<0x13;i++)
        DiagSetPrimitiveByte(req2E,i,0x00);
    }
  }
  
  //故障注入：步骤缺失2E写数据
  if(@Faultinsert::TC_Miss_2E==1)
  {
    if(@AUTO::Config_Switch==5)//鑫源
    {
//      PassState_31[0] = 0x04;
      Resp_ff00 = 0x22;
      Exit_ff00 = 1;
    }
    //ChangAn || 东风小康 || 赛力斯
    else if(@AUTO::Config_Switch==2 || @AUTO::Config_Switch==9 || @AUTO::Config_Switch==10)
    {
      Resp_34_f = 0x22;
      Exit_34_f = 1;
    }
    return;
  }
  //故障注入：2E写数据中功能寻址握手
  else if(@Faultinsert::TC_Handshake_in_2E==1)
  {
    _diagSendMsg(msgID,req2E);
    if(Identifier == 0xF199)
      testWaitForDiagRequestSent(req2E,10);
    else
      testWaitForMessage(msgID,1000);
    _handshake(funID);
    _get_FC(req2E,phyID,stepid,Passcondition);
  }
  else if(@Faultinsert::TC_Restart_after_2E == 1)
  {
    if(@AUTO::Config_Switch == 12)
    {
      _diagSendMsg(msgID,req2E);
      _get_FC(req2E,phyID,stepid,Passcondition);
      _Startreset(phyID,0x01,Resp_11);
      Resp_ff00 = 0x7F;
      Exit_ff00 = 1;
    }
  }
  else if(@Faultinsert::TC_DefaultSession_after_2E == 1)
  {
    if(@AUTO::Config_Switch == 12)
    {
      _diagSendMsg(msgID,req2E);
      _get_FC(req2E,phyID,stepid,Passcondition);
      enterDefault(funID,0,Resp_1001);
      testWaitForTimeout(Restart_Time);
      Resp_ff00 = 0x7F;
      Exit_ff00 = 1;
    }
  }
  else
  {
    _diagSendMsg(msgID,req2E);
    _get_FC(req2E,phyID,stepid,Passcondition);
  }
}
//更新条件查询31 01 02 03
//参数msgID:{phyID:物理寻址,funID:功能寻址}
//参数Passcondition:{-1:期望收到积极响应,0:期望不收到响应,>0:期望收到的NRC}
void UpdateCheck(dword msgID,int Passcondition)
{
  diagRequest ABS_ESP.Check_Memory_Start req0203;
  if(SOS_Flage == 1)
    return;
  stepnum++;
  snprintf(stepid,elCount(stepid),"步骤%02d：测试31服务更新条件查询",stepnum);

  //瑞驰
  if(@AUTO::Config_Switch==6)
  {
    diagResize(req0203,0x04);
    DiagSetPrimitiveByte(req0203,0,0x31);
    DiagSetPrimitiveByte(req0203,1,0x01);
    DiagSetPrimitiveByte(req0203,2,0xF0);
    DiagSetPrimitiveByte(req0203,3,0x02);
  }
  else
  {
    diagResize(req0203,0x04);
    DiagSetPrimitiveByte(req0203,0,0x31);
    DiagSetPrimitiveByte(req0203,1,0x01);
    DiagSetPrimitiveByte(req0203,2,0x02);
    DiagSetPrimitiveByte(req0203,3,0x03);
  }
  //故障注入：缺失步骤更新条件查询
  if(@Faultinsert::TC_Miss_0203==1)
  {
    Resp_1002 = 0x22;
    Exit_1002 = 1;
    return;
  }
  else
  {
    _diagSendMsg(msgID,req0203);
    testWaitForDiagRequestSent(req0203,1000);
    testWaitForDiagResponse(req0203,p2cmax);
    _TestResult(req0203,stepid,Passcondition);
//    _get_FC(req0203,msgID,stepid,Passcondition);
  }
  //故障注入：更新条件检测后进入编程会话
  if(@Faultinsert::TC_Pro_0203==1)
  {
    enterProg(phyID,0,-1);
    testWaitForTimeout(500);
    Resp_85 = 0;
    Resp_28 = 0;
    PostProg_Recover = 1;
  }
  //故障注入：更新条件检测后ECU 11复位
  if(@Faultinsert::TC_Restart_after_0203==1)
  {
    _Startreset(phyID,0x01,-1);
    testWaitForTimeout(Restart_Time);
    Resp_85 = 0;
    Resp_28 = 0;
    Resp_1002 = 0x7E;
    Exit_1002 = 1;
  }
  //故障注入：进入扩展会话后超过5S
  if(@Faultinsert::TC_Wait_0203==1)
  {
    diagStopTesterPresent("ABS_ESP_Functional");
    Resp_1002 = 0x7E;
    Resp_85 = 0;
    Resp_28 = 0;
    Exit_1002 = 1;
    testWaitForTimeout(6000);
  }
}
//控制DTC设置
//参数msgID:{phyID:物理寻址,funID:功能寻址}
//参数Inhibitory_response:{1:抑制响应,0:非抑制响应}
//参数DTC_Setting:{0x01:使能故障码设置,0x02:禁止故障码设置}
//参数Passcondition:{-1:期望收到积极响应,0:期望不收到响应,>0:期望收到的NRC}
void DTC_Control(dword msgID,int Inhibitory_response,dword DTC_Setting,int Passcondition)
{
  diagRequest ABS_ESP.DTC_Setting_Mode_On_Send req85;
  stepnum++;
  snprintf(stepid,elCount(stepid),"步骤%02d：测试85服务控制DTC设置",stepnum);
  
  DiagSetPrimitiveByte(req85,1,DTC_Setting);
  if(Inhibitory_response == 1)
  {
    DiagSetPrimitiveByte(req85,1,0x80|DiagGetPrimitiveByte(req85,1));
    Passcondition = 0;
  } 
  //APP无效时 不支持 85
  else if(BT_85==1 && curAppValid==0)
    Passcondition = 0x12;
  else
    Passcondition = Resp_85;
  
  if(msgID==funID && (Passcondition==0x12 || Passcondition==0x13))
  {
    Passcondition = 0;
  }
  else if((@AUTO::Config_Switch == 7 ||@AUTO::Config_Switch == 8) && msgID==funID)
    Passcondition = -1;
    
   _diagSendMsg(msgID,req85);
  _get_FC(req85,msgID,stepid,Passcondition);
}
//通讯控制设置
//参数msgID:{phyID:物理寻址,funID:功能寻址}
//参数Inhibitory_response:{1:抑制响应,0:非抑制响应}
//参数Com_Setting:{0x00:使能接收和发送,0x01:使能接收&禁止发送,0x03:禁止接收和发送}
//参数Passcondition:{-1:期望收到积极响应,0:期望不收到响应,>0:期望收到的NRC}
void Com_Control(dword msgID,int Inhibitory_response,dword Com_Setting,dword Type_Setting,int Passcondition)
{
  diagRequest ABS_ESP.EnableRxAndDisableTx_Control req28;
  stepnum++;
  snprintf(stepid,elCount(stepid),"步骤%02d：测试28服务控制通讯",stepnum);

  DiagSetPrimitiveByte(req28,1,Com_Setting);
  DiagSetPrimitiveByte(req28,2,Type_Setting);
  if(Inhibitory_response == 1)
  {
    DiagSetPrimitiveByte(req28,1,0X80|DiagGetPrimitiveByte(req28,1));
    Passcondition = 0;
  } 
  //APP无效时 不响应
  else if(BT_28==1 && curAppValid==0)
    Passcondition = 0x12;
  else
    Passcondition = Resp_28;
  
  if(msgID==funID && (Passcondition==0x12 || Passcondition==0x13))
  {
    if(@AUTO::Config_Switch == 7)
      Passcondition = -1;
    else
      Passcondition = 0;
  }
  else if((@AUTO::Config_Switch == 7 || @AUTO::Config_Switch == 8) && msgID==funID)
    Passcondition = -1;
  _diagSendMsg(msgID,req28);
  _get_FC(req28,msgID,stepid,Passcondition);
}
/// <Unlock>
/*发送22 F1 8C请求序列号*/
void _SendF18C(byte Serial_Num[])
{
//  diagRequest *req22;
  diagRequest ABS_ESP.Primary_Bootloader_Software_Version_Number_Read req22;
  byte i;
  i = 0;
  diagResize(req22,3);
  DiagSetPrimitiveByte(req22,0,0x22);
  DiagSetPrimitiveByte(req22,1,0xF1);
  DiagSetPrimitiveByte(req22,2,0x8C);
  diagSendRequest(req22);
  testWaitForDiagRequestSent(req22,1000);
  testWaitForDiagResponse(req22,1000);
  /*获取序列号后16位*/
  for(i=0; i<16; i++)
  {
    Serial_Num[i] = DiagGetRespPrimitiveByte(req22,i+6);
  }
}

/// <Unlock>
//安全访问27服务
void Security_access()
{
  diagRequest ABS_ESP.SeedLevel1_Request reqseed;
  diagRequest ABS_ESP.KeyLevel1_Send sendkey;
  dword seed;
  dword skey; 
  byte TempSeed[16],Size;
  /*ECU KEY固定*/
  byte ECU_KEY[16] = {0x64,0x1D,0xA0,0x0D,0x7F,0xB1,0x4B,0x51,0x8D,0xA4,0x2B,0xF4,0xEF,0x0C,0x24,0xF4};
  byte ECU_Key2[16] ={0x7d,0x0b,0xa5,0xb6,0xb5,0x7c,0x49,0x05,0x8d,0xf3,0xf9,0xad,0x2f,0x31,0x92,0xfb}; //BYD新
  /*iv初始向量固定*/
  byte iv[16] = {0x11,0x22,0x33,0x44,0x55,0x66,0x77,0x88,0x99,0x00,0x66,0x55,0x44,0x33,0x22,0x11};
  /*序列号*/
  byte Serial_Num[16];
  /*密钥KEY*/
  byte Secret_KEY[16];
  byte RA[16],R[16],r[16],ra[16];
  dword KEY_Len;
  double starttime;
  double endtime;
  byte i;
  if(@AUTO::Config_Switch == 1)
    memcpy(ECU_KEY,ECU_Key2,elCount(ECU_Key2));
  i = 0;
  starttime = 0;
  endtime = 0;
  KEY_Len = 16;
  seed = 0;
  
  stepnum++;
  snprintf(stepid,elCount(stepid),"步骤%02d：测试进入安全访问",stepnum);
  if(SOS_Flage == 1)
  {
    diagResize(reqseed,4);
    DiagSetPrimitiveByte(reqseed,1,0x05);
    DiagSetPrimitiveByte(reqseed,2,0xB1);
    DiagSetPrimitiveByte(reqseed,3,0x8E);
    _diagSendMsg(phyID,reqseed);
    testWaitForDiagRequestSent(reqseed,1000);
    testWaitForDiagResponse(reqseed,1000);
    return;
  }
    
  diagResize(reqseed,2);
  DiagSetPrimitiveByte(reqseed,1,SeedLevel);
  DiagSetPrimitiveByte(sendkey,1,SeedLevel+1);
  testWaitForTimeout(100);
  /*各主机厂通用算法*/
  if(@AUTO::Security_Switch==0)
  {
    diagRequest * req2701;
    diagSetTarget("ABS_ESP");
    diagResize(req2701,2);
    DiagSetPrimitiveByte(req2701,0,0x27);
    DiagSetPrimitiveByte(req2701,1,SeedLevel);
    /*发送27服务请求种子*/
    _diagSendMsg(phyID,req2701);
    diagSetP2Extended(-1);
    testWaitForDiagRequestSent(req2701,200);
    
    starttime = (double)timeNow()/100;
    testWaitForDiagResponse(req2701,p2cmax);
    if(diagGetLastResponseCode(req2701) == -1 || diagGetLastResponseCode(req2701) == 0x78 )
    {
      endtime = (double)timeNow()/100;
      if(diagGetLastResponseCode(req2701)==0x78)
      {
        if(endtime - starttime < p2cmax)
          testStepPass("","收到NRC78响应，响应时间为%fms",endtime - starttime);
        else
          testStepFail("","响应NRC78超时，响应时间为%fms",endtime - starttime);
        starttime = (double)timeNow()/100;
        testWaitForDiagResponse(req2701,p2cmax*100);
        endtime = (double)timeNow()/100;
      }
      if(endtime - starttime < p2cmax*100)
        testStepPass("","收到响应，响应时间为%fms",endtime - starttime);
      else
        testStepFail("","响应超时，响应时间为%fms",endtime - starttime);
    }
    else
    {
      testStepFail("","请求种子响应超时");
    }
    _TestResult(req2701,stepid,Resp_2701);
    /*获取响应种子大小*/
    Size = DiagGetRespPrimitiveSize(req2701);
//    writeEx(-3,1,"diagGetLastResponseCode(reqseed) = %d", diagGetLastResponseCode(reqseed));
    /*获取种子*/
    if(diagGetLastResponseCode(req2701)==-1)
    {
      for(i=2;i<Size;i++)
      {
        TempSeed[i-2] = DiagGetRespPrimitiveByte(req2701,i);
        seed |=  TempSeed[i-2] << ((Size-i-1)*8);
      }
    }
    else
       writeEx(-3,1,"/*-------------请求种子失败-------------*/");

    /*计算密钥*/
    _SecurityAccess(seed,skey);
    diagResize(sendkey,Size);
    for(i=2;i<Size;i++)
    {
      DiagSetPrimitiveByte(sendkey,i,skey>>((Size-i-1)*8) & 0xFF);
    }
  }
  /*AES_CBC安全算法*/
  else if(@AUTO::Security_Switch==1)
  {
    writeEx(-3,1,"采用AES_CBC安全算法");
    _SendF18C(Serial_Num);
    /*序列号移位*/
    LeftMove(Serial_Num);
    /*用ECU KEY加密移位后的序列号 获取密钥KEY*/
    AES128_CBC_encrypt_buffer(Secret_KEY,Serial_Num,KEY_Len,ECU_KEY,iv);
    testWaitForTimeout(100);
    //发送27服务请求种子
    diagSendRequest(reqseed);
    testWaitForDiagRequestSent(reqseed,1000);
    testWaitForDiagResponse(reqseed,1000);
    Size = DiagGetRespPrimitiveSize(reqseed);
    /*获取种子*/
    for(i=2;i<Size;i++)
    {
      RA[i-2] = DiagGetRespPrimitiveByte(reqseed,i);
    }
    /*用密钥KEY解密RA 得到ra`*/
    AES128_CBC_decrypt_buffer(ra,RA,KEY_Len,Secret_KEY,iv);
    /*ra逆向*/
    reverseNum(ra,16);
    /*用密钥KEY加密ra得到R*/
    AES128_CBC_encrypt_buffer(R,ra,KEY_Len,Secret_KEY,iv);
    diagResize(sendkey,Size);
    for(i=2;i<Size;i++)
      DiagSetPrimitiveByte(sendkey,i,R[i-2]);
  }
  else if(@AUTO::Security_Switch==2)
  {
    Security_access_AES_CMAC();
    testWaitForTimeout(100);
    return;
  }
  testWaitForTimeout(100);
  /*发送密钥*/
  if(@Faultinsert::TC_BT_AppValid == 1 && @Faultinsert::TC_Error_27Key == 1)
  {
//    Size = 6;
//    diagResize(sendkey,Size);
    for(i=2;i<Size;i++)
    {
      DiagSetPrimitiveByte(sendkey,i,0);
    }
    if(Loop_Add_Times > 0)
      @Faultinsert::TC_Miss_GetFc = 1;
  }
  _diagSendMsg(phyID,sendkey);
  testWaitForDiagRequestSent(sendkey,100);
  _get_FC(sendkey,phyID,stepid,Resp_2702);
}
/// <Unlock>
// Geely 3.0/瑞驰 AES_cmac 安全访问27服务,种子和密钥为16个字节
void Security_access_AES_CMAC()
{
  diagRequest ABS_ESP.SeedLevel1_Request reqseed;
  diagRequest ABS_ESP.KeyLevel1_Send sendkey;
  dword seed;
  dword skey; 
   
  DiagSetPrimitiveByte(reqseed,1,SeedLevel);
  DiagSetPrimitiveByte(sendkey,1,SeedLevel+1);
  
  if(@Faultinsert::TC_Miss_27_1 == 1)
  {
    Resp_34_f = 0x33;
    Exit_34_f = 1;
  }
  else if(@Faultinsert::TC_Error_27 == 1 || (@Faultinsert::TC_BT_AppValid == 1 && @Faultinsert::TC_Error_27Key == 1))
  {
    _diagSendMsg(phyID,reqseed);
    _saveMsg(p2cmax);
    _CheckCode(-1,4);
    testWaitForTimeout(200);
    diagResize(sendkey,18);
    _padding2702(1,sendkey);
    _diagSendMsg(phyID,sendkey);
    if(Loop_Add_Times > 0 && @Faultinsert::TC_BT_AppValid == 1 && @Faultinsert::TC_Error_27Key == 1)
      @Faultinsert::TC_Miss_GetFc = 1;
    _get_FC(sendkey,phyID,stepid,0x35);
    Resp_34_f = 0x33;
    Exit_34_f = 1;
  }
  else
  {
    testWaitForTimeout(500);  
    _diagSendMsg(phyID,reqseed);
    _saveMsg(p2cmax);
    _CheckCode(-1,4);
    testWaitForTimeout(200);
    diagResize(sendkey,18);
    _padding2702(0,sendkey);
    _diagSendMsg(phyID,sendkey);
//    _saveMsg(p2cmax);
    testWaitForDiagRequestSent(sendkey,1000);
//    testWaitForDiagResponse(sendkey,p2cmax*2);
    _get_FC(sendkey,phyID,stepid,Resp_2702);
    testWaitForTimeout(500);
  }
  testWaitForTimeout(150);
}
/// <Unlock>
/*数组逆向*/
void reverseNum(byte num[],dword size)
{
  dword startnum;
  dword temp;
  dword endnum;
  
  startnum = 0;
  endnum = size - 1;
  while(startnum < endnum)
  {
    temp = num[startnum];
    num[startnum] = num[endnum];
    num[endnum] = temp;
    startnum++;
    endnum--;
  }
}
/// <Unlock>
/*数组左移*/
void LeftMove(byte Serial_Num[])
{
  dword i;
  byte bit;
  byte carry;
  byte nextcarry;
  byte current;
  byte shif;  
  carry = 0;
  nextcarry = 0;
  bit = 3;
  for(i=15;i>=0;i--)
  {
    current = Serial_Num[i];
    shif = current << bit;
    shif |= carry;
    Serial_Num[i] = shif & 0xFF;
    carry = (current>>(8-bit)) & ((1<<bit)-1);
  }
}
/// <Unlock>
//用于五菱安全算法
word croshortright(word c, word b)
{
	word right;
	word left;
	word crorightvalue;
  right = c >> b;
  left = c << (16 - b);
  crorightvalue = left | right;
	return crorightvalue;
}
/// <Unlock>
//用于五菱安全算法
dword croleft(dword c, word b)
{
	dword left;
	dword right;
	dword croleftvalue;
  left = c << b;
  right = c >> (32 - b);
  croleftvalue = left | right;
	return croleftvalue;
}
/// <Unlock>
//用于五菱安全算法
dword mulu32(dword val1, dword val2)
{
	dword x, y, z, p;
  dword NC_UDS_KEYMASK=0x5c7d4ef3;
	x = (val1 & NC_UDS_KEYMASK) | ((~val1) & val2);
	y = ((croleft(val1, 1)) & (croleft(val2, 14)))
	        | ((croleft(NC_UDS_KEYMASK, 21)) & (~(croleft(val1, 30))));
	z = (croleft(val1, 17)) ^ (croleft(val2, 4))
	        ^ (croleft(NC_UDS_KEYMASK, 11));
	p = x ^ y ^ z;
	return p;
}
/// <Unlock>
//安全算法函数
//参数SaccSeed：请求种子
//参数SaccKey：安全访问密钥
void _SecurityAccess(dword SaccSeed,dword& SaccKey)
{
  byte i;
  i = 0;
  if(@AUTO::Config_Switch==1)//BYD
  {
    dword KeyK;
    dword KeyResult;
    KeyK=0X00000137;
    KeyResult = ((((SaccSeed >> 1) ^ SaccSeed) <<3) ^ (SaccSeed >>2));
    SaccKey = KeyResult ^ KeyK;
  }
  else if(@AUTO::Config_Switch==2)//CA
  {
    dword seed;
    dword key1;
    dword key2;
    seed = 0;
    for(i=0;i<16;i++)
      seed=seed|(SaccSeed>>(31-i*2)&(1<<i));
    for(i=0;i<16;i++)
      seed=seed|(SaccSeed<<(31-i*2)&(0X80000000>>i));
    key1=SaccSeed^0X70F77302;
    key2=seed^0X70F77302;
    SaccKey=key1+key2;
  }
  else if(@AUTO::Config_Switch==3)//Geely 1.0
  {
    byte i;
    byte XorArray[4];
    byte calData[4];
    byte skeybyte[4];
    
    //Geely 1.0
    XorArray[0]=0xC1;
    XorArray[1]=0x1C;
    XorArray[2]=0x12;
    XorArray[3]=0x81;
    
    //宝腾Z65M 924B
//    XorArray[0]=0x53;
//    XorArray[1]=0x4E;
//    XorArray[2]=0x22;
//    XorArray[3]=0xCD;
    
    calData[0]=0;
    calData[1]=0;
    calData[2]=0;
    calData[3]=0;
    for (i = 0;i < 4;i++)
    {
      calData[i] = ((SaccSeed>>(24-8*i))&0xFF)^ XorArray[i];/*修改秘钥传入方式为MSB*/
    }
    skeybyte[0] = ((calData[2] & 0x03) << 6)|((calData[3]&0xFC)>>2);
    skeybyte[1] = ((calData[3] & 0x03) << 6 )|(calData[0]&0x3F);
    skeybyte[2] = (calData[0] & 0xFC)|((calData[1] & 0xC0) >> 6);
    skeybyte[3] = (calData[1] & 0xFC)|(calData[2] & 0x03);
    SaccKey=skeybyte[0];
    SaccKey=(SaccKey<<8)|skeybyte[1];
    SaccKey=(SaccKey<<8)|skeybyte[2];
    SaccKey=(SaccKey<<8)|skeybyte[3];
    /*故障注入：发送错误密钥*/
    if(@Faultinsert::TC_Error_27==1)
    {
      SaccKey = SaccKey ^ 0xFFFFFFFF;
      Resp_2702 = 0x35;
      Resp_2E = 0x33;
      Exit_2E = 1;
    }
  }
  else if(@AUTO::Config_Switch==5)//鑫源
  {
    byte Seed[4];
    byte Skey[4];
    byte Xor[4]={0xA1,0x59,0xD4,0x30};
    byte Cal[4];
    byte i;
    Seed[0]=SaccSeed>>24;
    Seed[1]=SaccSeed>>16;
    Seed[2]=SaccSeed>>8;
    Seed[3]=SaccSeed; 
    for(i=0;i<4;i++)
    {
      Cal[i]=Seed[i]^Xor[i];
    }
    Skey[0]=((Cal[3]&0xF5)>>2) | ((Cal[0]&0x0F)<<6);
    Skey[1]=((Cal[2]&0x0F)<<4) | ((Cal[3]&0xC0)>>6);
    Skey[2]=((Cal[1]&0xFC)) | ((Cal[0]&0x3D));
    Skey[3]=((Cal[3]&0xE0)) | ((Cal[1]&0xF0)>>4);
    SaccKey=Skey[0];
    SaccKey=(SaccKey<<8)|Skey[1];
    SaccKey=(SaccKey<<8)|Skey[2];
    SaccKey=(SaccKey<<8)|Skey[3];
  }
  else if(@AUTO::Config_Switch==6)//瑞驰
  {
    byte i;
    dword tmpSaccSeed;
    dword mask = 0x5FD62190;//掩码5FD62190
    tmpSaccSeed = SaccSeed;
		for(i=0; i<32; i++)
		{
			if(tmpSaccSeed & 0x80000000)
			{
				tmpSaccSeed = tmpSaccSeed << 1;
				tmpSaccSeed = tmpSaccSeed ^ mask;
			}
			else
			{
				tmpSaccSeed = tmpSaccSeed << 1;
			}
		}
    SaccKey = tmpSaccSeed;
  }
  else if(@AUTO::Config_Switch==7)//奇瑞
  {
    byte Seed[2];
    dword remainder;
    byte n;
    byte i;
    Seed[0] = SaccSeed >> 8;
    Seed[1] = SaccSeed & 0xFF; 
    remainder =0xFFFE;
    for (n = 0; n < 2; n++)
    {
      remainder ^= ((Seed[n]) << 8);
      for (i = 0; i < 8; i++)
      {
        if (remainder & 0x8000)
        {
          if(remainder & 0x0080)
          {
            remainder = (remainder << 1) ^ 0x8408;
          }
          else
          {
            remainder = (remainder << 1) ^ 0x8025;
          }
        }
        else
        {
          remainder = (remainder << 1);
        }
      }
    }
    remainder = remainder & 0xFFFF;
    /*故障注入：安全访问密钥错误*/
    if(@Faultinsert::TC_Error_27==1)
    {
      Resp_2702 = 0x35;
      Resp_34_f = 0x33;
      Exit_34_f = 1;
      SaccKey = SaccSeed;
    }
    else
      SaccKey = remainder;
  }
  else if(@AUTO::Config_Switch==8)//五菱
  {
    word uds_key_mul[32] = 
    {
      0x7678, 0x9130, 0xd753, 0x750f, 0x72cb, 0x55f7, 0x13da, 0x786b, 
      0x372a, 0x4932, 0x0e7c, 0x3687, 0x3261, 0xa82c, 0x8935, 0xd00c, 
      0x1995, 0x4311, 0xb854, 0x0d8d, 0x9863, 0x1a21, 0xf753, 0xd6d3,
      0xb15d, 0x7f3d, 0x6821, 0x791c, 0x26c5, 0x2e37, 0x0e69, 0x64a0 
    };
    dword temp;
  	word index;
  	word mult1;
  	word mult2;
    dword NC_DEFAULT_SEED;
    dword NC_UDS_KEYMASK;
    NC_DEFAULT_SEED=0xA548FD85;
    NC_UDS_KEYMASK=0x5C7D4EF3;
    index = 0x5D39;
  	if(SaccSeed == 0) 
    {
  		SaccSeed = NC_DEFAULT_SEED;
  	}
  	for(temp=0x80000000;temp!=0;temp>>=1)
  	{
  		if(temp & SaccSeed) 
      {
  			index = croshortright(index,1);
  			if (temp & NC_UDS_KEYMASK) 
        {
  				index ^= 0x74c9;
  			}
  		}
  	}
  	mult1 = (uds_key_mul[(index >> 2) & ((1 << 5) - 1)] ^ index);
  	mult2 = (uds_key_mul[(index >> 8) &((1 << 5) - 1)] ^ index);
  	temp = (((dword) mult1) << 16) | ((dword) mult2);
  	temp = mulu32(SaccSeed,temp);
  	SaccKey = temp;
  }
  else if(@AUTO::Config_Switch==9 || @AUTO::Config_Switch==10)//东风小康 || 赛力斯
  {
    byte Seed[4];
    byte Skey[4];
    byte Xor[4]={0xD1,0x31,0x54,0x07};
    byte Cal[4];
    byte i;
    Seed[0]=(SaccSeed>>24)&0xFF;
    Seed[1]=(SaccSeed>>16)&0xFF;
    Seed[2]=(SaccSeed>>8)&0xFF;
    Seed[3]=SaccSeed&0xFF;
    
    for(i=0;i<4;i++)
      Cal[i]=Seed[i]^Xor[i];
    
    if(SeedLevel==0x01)
    {
      Skey[0]=((Cal[0]&0x0F)<<4)|(Cal[1]&0xF0);
      Skey[1]=((Cal[1]&0x0F)<<4)|((Cal[2]&0xF0)>>4);
      Skey[2]=(Cal[2]&0xF0)|((Cal[3]&0xF0)>>4);
      Skey[3]=((Cal[3]&0x0F)<<4)|(Cal[0]&0x0F);
    }
    else
    {
      Skey[0]=((Cal[0]&0x0f)<<4)|(Cal[1]&0x0f);
      Skey[1]=((Cal[1]&0xf0)>>4)|((Cal[2]&0x0f)<<4);
      Skey[2]=((Cal[2]&0xf0)>>4)|(Cal[3]&0xf0);
      Skey[3]=(Cal[3]&0x0f)|((Cal[0]&0xf0)>>4);
    }
    SaccKey=Skey[0];
    SaccKey=(SaccKey<<8)|Skey[1];
    SaccKey=(SaccKey<<8)|Skey[2];
    SaccKey=(SaccKey<<8)|Skey[3];
    /*故障注入：安全访问密钥错误*/
    if(@Faultinsert::TC_Error_27==1)
    {
      Resp_2702 = 0x35;
      Resp_2E = 0x33;
      Exit_2E = 1;
      SaccKey = SaccSeed;
    }
  }
  else if(@AUTO::Config_Switch== 12)
  {
    dword AppKeyConst = 0x19870413;
    SaccKey = ((SaccSeed + 0x19870424)|AppKeyConst)&0xFFFFFFFF;
  }
}

/// <Geely3.0>
//Geely3.0 SBT，34请求下载服务
void SBT_34(dword BlockVbtFlage)
{
  qword eraseAddr,eraseLength;
  byte i;
  i = 0;
  stepnum++;
  snprintf(stepid,elCount(stepid),"步骤%02d",stepnum);
  testStep(stepid,"开始测试SBT 34请求服务");
  eraseLength = 0;
  //故障注入：步骤缺失SBT 34请求下载
  if(@Faultinsert::TC_Miss_34_F==1)
  {
    Resp_36_f = 0x24;
    Exit_36_f = 1;
  }
  else
  {
    if(BlockVbtFlage == 0)
    {
      eraseAddr = hexfile_sbt[0].BlockStartAddr;
      for(i=0;i<HexBlockTotalNumber_sbt;i++)
      {
        eraseLength+=hexfile_sbt[i].BlockDataLength;
      }
      if(Flash_DataFormatId==0x10)
      {
        _Send34_SBT(loadhexStartAddr,loadhexLength,phyID,Resp_34_f);
      }
      else
      {
        _Send34_SBT(eraseAddr,eraseLength,phyID,Resp_34_f);
      }
    }
    else if(BlockVbtFlage == 1)
    {
      eraseAddr = hexfile_sbt[0].BlockVbtStartAddr;
      for(i=0;i<VbtBlockTotalNumber_sbt;i++)
      {
        eraseLength+=hexfile_sbt[i].BlockVbtDataLength;
      }
      eraseLength = eraseLength;
//      write("eraseLength = %x",eraseLength);
      if(Flash_DataFormatId==0x10)
      {
        _Send34_SBT(vbtStartAddr,vbtLength,phyID,Resp_34_f);
      }
      else
      {
        _Send34_SBT(eraseAddr,eraseLength,phyID,Resp_34_f);
      }
    }
  }
  
}
//Flash 34请求下载服务
void FlashDriver_34()
{
  stepnum++;
  snprintf(stepid,elCount(stepid),"步骤%02d：测试34服务请求Flash下载",stepnum);
  
  //故障注入：Geely 2E写数据后功能寻址复位
  if(@Faultinsert::TC_Restart_after_2E==1 && @AUTO::Config_Switch==3)
  {
    Resp_34_f=0x11;
    _Startreset(funID,0x01,Resp_11);
    Exit_34_f = 1;
  }
  //故障注入：Geely 2E写数据后功能寻址切换默认会话
  else if(@Faultinsert::TC_DefaultSession_after_2E==1 && @AUTO::Config_Switch==3)
  {
//    Resp_34_f=0x7F;
    Resp_34_f=0x11;
    enterDefault(funID,0,Resp_1001);
    testWaitForTimeout(Restart_Time);
    Exit_34_f = 1;
  }
  //故障注入：请求下载Flash的起始地址错误
  if(@Faultinsert::TC_ErrorAddr_Flash==1)
  {
    if(@AUTO::Config_Switch==1 || @AUTO::Config_Switch==3
    || @AUTO::Config_Switch==5 || @AUTO::Config_Switch==8)//BYD || Geely1.0 || 鑫源 || 五菱
    {
      Resp_34_f=0x31;
      Resp_36_f=0x24;
      Resp_37_f=0x24;
      Resp_0202_f=0x22;
      Exit_0202_f = 1;
    }
    else if(@AUTO::Config_Switch==2)//ChangAn
    {
      Resp_34_f=0x31;
      Resp_36_f=0x22;
      Resp_37_f=0x22;
      Resp_0202_f=0x22;
      Exit_0202_f = 1;
    }
    //瑞驰 || 奇瑞 || 东风小康 || 赛力斯
    else
    {
      Resp_34_f=0x31;
      Exit_34_f = 1;
    }
    DriverAddr=@AUTO::DriverAddr;
    _Send34_Flash(DriverAddr,DriverSize,phyID,Resp_34_f);
    return;
  }
  //故障注入：缺失步骤Flash 34请求
  else if(@Faultinsert::TC_Miss_34_F==1)
  {
    //不同主机厂，规范需求不同
    if(@AUTO::Config_Switch==1 || @AUTO::Config_Switch==5 
    || @AUTO::Config_Switch==8 || @AUTO::Config_Switch==10)//BYD || 鑫源 || 五菱 || 赛力斯
    {
      Resp_36_f=0x24;
      Resp_37_f=0x24;
      Resp_0202_f=0x22;
      Exit_0202_f = 1;
    }
    else if(@AUTO::Config_Switch==2)//ChangAn
    {
      Resp_36_f = 0x22;
      Exit_36_f = 1;
    }
    else if(@AUTO::Config_Switch==3 || @AUTO::Config_Switch==6 || @AUTO::Config_Switch==7)//Geely1.0 || 瑞驰 ||奇瑞
    {
      Resp_36_f = 0x24;
      Exit_36_f = 1;
    }
    else if(@AUTO::Config_Switch==11)//奇瑞T1V
    {
      Resp_36_f = 0x24;
      Resp_37_f = 0x24;
      PassState_31[0] = 0x06;
      Exit_0202_f = 1;
    }
    return;
  }
  //故障注入：请求下载Flash的数据内存大小错误
  else if(@Faultinsert::TC_ErrorAddrSize_Flash==1)
  {
    if(@AUTO::Config_Switch==1 || @AUTO::Config_Switch==3 
    || @AUTO::Config_Switch==5 || @AUTO::Config_Switch==8)//BYD || Geely1.0 || 鑫源 || 五菱
    {
      Resp_34_f=0x31;
      Resp_36_f=0x24;
      Resp_37_f=0x24;
      Resp_0202_f=0x22;
      Exit_0202_f = 1;
    }
    else if(@AUTO::Config_Switch==2)//CA
    {
      Resp_34_f=0x31;
      Resp_36_f=0x22;
      Resp_37_f=0x22;
      Resp_0202_f=0x22;
      Exit_0202_f = 1;
    }
    //瑞驰 || 奇瑞 || 东风小康 || 赛力斯
    else
    {
      Resp_34_f=0x31;
      Exit_34_f = 1;
    }
    _Send34_Flash(DriverAddr,@AUTO::DriverSize,phyID,Resp_34_f);
    return;
  }
  //故障注入：请求下载Flash的数据格式标识错误
  else if(@Faultinsert::TC_ErrorDataFormatId_Flash==1)
  {
    if(@AUTO::Config_Switch==1 || @AUTO::Config_Switch==5 || @AUTO::Config_Switch==8)//BYD || 鑫源 || 五菱
    {
      Flash_DataFormatId = 0x01;
      Resp_34_f = 0x31;
      Resp_36_f = 0x24;
      Resp_37_f = 0x24;
      Resp_0202_f = 0x22;
      _Send34_Flash(DriverAddr,DriverSize,phyID,Resp_34_f);
      Exit_0202_f = 1;
    }
    else if(@AUTO::Config_Switch==11) //奇瑞T1V
    {
      Flash_DataFormatId = 0x01;
      Resp_34_f = 0x31;
      Resp_36_f = 0x24;
      Resp_37_f = 0x24;
      _Send34_Flash(DriverAddr,DriverSize,phyID,Resp_34_f);
    }
    else //ChangAn || Geely1.0 || 瑞驰 || 奇瑞 || 赛力斯 
    {
      Flash_DataFormatId = 0x01;
      Resp_34_f = 0x31;
      _Send34_Flash(DriverAddr,DriverSize,phyID,Resp_34_f);
      Exit_34_f = 1;
    }
    return;
  }
  //故障注入：请求下载Flash的地址和长度格式标识错误
  else if(@Faultinsert::TC_ErrorAddrAndLenId_Flash==1)
  {
    //不同主机厂，规范需求不同
    if(@AUTO::Config_Switch==1)//BYD
    {
      Flash_AddrAndLenId=0x45;
      Resp_34_f=0x13;
      Resp_36_f=0x24;
      Resp_37_f=0x24;
      Resp_0202_f=0x22;
      _Send34_Flash(DriverAddr,DriverSize,phyID,Resp_34_f);
      Exit_0202_f = 1;
      return;
    }
    else if(@AUTO::Config_Switch==5 || @AUTO::Config_Switch==8)//鑫源 || 五菱
    {
      Flash_AddrAndLenId=0x43;
      Resp_34_f=0x31;
      Resp_36_f=0x24;
      Resp_37_f=0x24;
      Resp_0202_f=0x22;
      _Send34_Flash(DriverAddr,DriverSize,phyID,Resp_34_f);
      Exit_0202_f = 1;
      return;
    }
    else if(@AUTO::Config_Switch==11 )//奇瑞T1V
    {
      Flash_AddrAndLenId=0x43;
      Resp_34_f=0x31;
      Resp_36_f=0x24;
      Resp_37_f=0x24;
      _Send34_Flash(DriverAddr,DriverSize,phyID,Resp_34_f);
      Exit_0202_f = 1;
      return;
    }
    else //ChangAn || Geely1.0 || 瑞驰 || 奇瑞 || 赛力斯
    {
      Flash_AddrAndLenId=0x43;
      Resp_34_f=0x31;
      _Send34_Flash(DriverAddr,DriverSize,phyID,Resp_34_f);
      Exit_34_f = 1;
      return;
    }
  }
  else
  {
    _Send34_Flash(DriverAddr,DriverSize,phyID,Resp_34_f);
  }
  
  /*故障注入：Flash 34请求下载后 执行31 01 FF 00*/
  if(@Faultinsert::TC_34F_FF00==1)
  {
    Resp_ff00 = 0x72;
    Exit_34_f = 1;
    _Sendff00(eraseaddr[0][eraseadd],eraselength[0][eraseadd],phyID);
  }
}
//APP 34请求下载服务
//参数addr：请求下载的起始地址；
//参数length34：请求下载的地址大小；
void App_34(dword addr,dword length34)
{
  char casetitle[40];
  byte change1=0;
  byte change2=0;
  
  //故障注入：34 App请求起始地址错误
  if(@Faultinsert::TC_ErrorAddr_App==1)
  {
    if(@AUTO::Config_Switch==1 || @AUTO::Config_Switch==5 || @AUTO::Config_Switch==8)//BYD || 鑫源 || 五菱
    {
      addr = @AUTO::AppAddr;
      Resp_34_a = 0x31;
      Resp_36_a = 0x24;
      Resp_37_a = 0x24;
      Resp_0202_a = 0x22;
      _Send34_App(addr,length34,phyID,Resp_34_a);
      Break_Download = 1;
      Exit_0202_a = 1;
    }
    //ChangAn || Geely1.0 || 瑞驰 || 奇瑞 || 东风小康 || 赛力斯
    else
    {
      addr = @AUTO::AppAddr;
      Resp_34_a = 0x31;
      _Send34_App(addr,length34,phyID,Resp_34_a);
      Exit_34_a = 1;
    }
    return;
  }
  //故障注入：34 App请求地址大小错误
  else if(@Faultinsert::TC_ErrorAddrSize_App==1)
  {
    //BYD || 鑫源 || 五菱
    if(@AUTO::Config_Switch==1 || @AUTO::Config_Switch==5 || @AUTO::Config_Switch==8)
    {
      length34 = @AUTO::AppSize;
      Resp_34_a = 0x31;
      Resp_36_a = 0x24;
      Resp_37_a = 0x24;
      Resp_0202_a = 0x22;
      _Send34_App(addr,length34,phyID,Resp_34_a);
      Break_Download = 1;
      Exit_0202_a = 1;
    }
    //ChangAn || Geely1.0 || 瑞驰 || 奇瑞 || 东风小康 || 赛力斯
    else
    {
      length34 = @AUTO::AppSize;
      Resp_34_a = 0x31;
      _Send34_App(addr,length34,phyID,Resp_34_a);
      Exit_34_a = 1;
    }
    return;
  }
  //故障注入：34 App指定数据格式标识错误
  else if(@Faultinsert::TC_ErrorDataFormatId_App==1)
  {
    //BYD || 鑫源 || 五菱
    if(@AUTO::Config_Switch==1 || @AUTO::Config_Switch==5 || @AUTO::Config_Switch==8)
    {
      App_DataFormatId=0x01;
      Resp_34_a = 0x31;
      Resp_36_a = 0x24;
      Resp_37_a = 0x24;
      Resp_0202_a = 0x22;
      _Send34_App(addr,length34,phyID,Resp_34_a);
      Break_Download = 1;
      Exit_0202_a = 1;
    }
    //ChangAn || Geely1.0 || 瑞驰 || 奇瑞 || 赛力斯
    else
    {
      App_DataFormatId=0x01;
      Resp_34_a = 0x31;
      _Send34_App(addr,length34,phyID,Resp_34_a);
      Exit_34_a = 1;
    }
    return;
  }
  //故障注入：34 App指定地址和长度格式标识错误
  else if(@Faultinsert::TC_ErrorAddrAndLenId_App==1)
  {
    if(@AUTO::Config_Switch==1)//BYD
    {
      App_AddrAndLenId=0x45;
      Resp_34_a = 0x31;
      Resp_36_a = 0x24;
      Resp_37_a = 0x24;
      Resp_0202_a = 0x22;
      _Send34_App(addr,length34,phyID,Resp_34_a);
      Break_Download = 1;
      Exit_0202_a = 1;
    }
    else if(@AUTO::Config_Switch==5 || @AUTO::Config_Switch==8)//鑫源 || 五菱
    {
      App_AddrAndLenId=0x43;
      Resp_34_a = 0x31;
      Resp_36_a = 0x24;
      Resp_37_a = 0x24;
      Resp_0202_a = 0x22;
      _Send34_App(addr,length34,phyID,Resp_34_a);
      Break_Download = 1;
      Exit_0202_a = 1;
    }
    //ChangAn || Geely1.0 || 瑞驰 || 奇瑞 || 赛力斯
    else 
    {
      App_AddrAndLenId=0x43;
      Resp_34_a = 0x31;
      _Send34_App(addr,length34,phyID,Resp_34_a);
      Exit_34_a = 1;
    }
    return;
  }
  //故障注入：APP 34请求数据重复
  else if(@Faultinsert::TC_Re_34_A==1)
  {
    _Send34_App(addr,length34,phyID,Resp_34_a);
    Resp_34_a = 0x22;
    _Send34_App(addr,length34,phyID,Resp_34_a);
    Exit_34_a = 1;
    return;
  }
  //故障注入：步骤缺失App 34请求
  else if(@Faultinsert::TC_Miss_34_A==1)
  {
    if(@AUTO::Config_Switch==1 || @AUTO::Config_Switch==5 || @AUTO::Config_Switch==10)//BYD || 鑫源 || 赛力斯
    {
      Resp_36_a = 0x24;
      Resp_37_a = 0x24;
      Resp_0202_a = 0x22;
      Exit_0202_a = 1;
    }
    else if(@AUTO::Config_Switch==2)//ChangAn
    {
      Resp_36_a = 0x22;
      Exit_34_a = 0;
      Exit_36_a = 1;
    }
    //Geely 1.0 || 瑞驰 || 奇瑞 || 小康
    else
    {
      Resp_36_a = 0x24;
      Exit_34_a = 0;
      Exit_36_a = 1;
    }
    return;
  }
  else
  {
    //Geely 3.0
    if(@AUTO::Config_Switch==4)
    {
      
    }
    else
      _Send34_App(addr,length34,phyID,Resp_34_a);
  }
  testWaitForTimeout(200); //增加延时防止报错
}
//SBT 34请求下载
//参数Addr:驱动内存地址；Size:驱动内存大小；
//参数msgID:{phyID:物理寻址,funID:功能寻址}
//参数Passcondition:{-1:期望收到积极响应,0:期望不收到响应,>0:期望收到的NRC}
void _Send34_SBT(dword Addr,dword Size,dword msgID,int Passcondition)
{
  diagRequest ABS_ESP.Download_Request req34;
  
  //故障注入：SBT 34服务地址错误
  if(@Faultinsert::TC_ErrorLength_Flash==1)
  {
    Addr = @AUTO::DriverAddr;
    Passcondition = 0x31;
  }
  //故障注入：SBT 34服务内存大小错误
  if(@Faultinsert::TC_ErrorLength_Flash==1)
  {
    Size = @AUTO::DriverSize;
    Passcondition = 0x31;
  }
  
  DiagSetPrimitiveByte(req34,1,Flash_DataFormatId);
  DiagSetPrimitiveByte(req34,2,Flash_AddrAndLenId);
  DiagSetPrimitiveByte(req34,3,Addr>>24);
  DiagSetPrimitiveByte(req34,4,Addr>>16 & 0xFF);
  DiagSetPrimitiveByte(req34,5,Addr>>8 & 0xFF);
  DiagSetPrimitiveByte(req34,6,Addr & 0xFF);
  DiagSetPrimitiveByte(req34,7,Size>>24);
  DiagSetPrimitiveByte(req34,8,Size>>16 & 0xFF);
  DiagSetPrimitiveByte(req34,9,Size>>8 & 0xFF);
  DiagSetPrimitiveByte(req34,10,Size & 0xFF);
  
  //故障注入：SBT 34服务数据格式标识错误
  if(@Faultinsert::TC_ErrorDataFormatId_Flash==1)
  {
    DiagSetPrimitiveByte(req34,1,0x01);
    Passcondition = 0x31;
    Exit_34_f = 1;
  }
  //故障注入：SBT 34服务地址和长度格式标识错误
  else if(@Faultinsert::TC_ErrorAddrAndLenId_Flash==1)
  {
    DiagSetPrimitiveByte(req34,2,0x45);
    Passcondition = 0x13;
    if(@AUTO::Geely3_Config == 1) //P162
      Passcondition = 0x31;
    Exit_34_f = 1;
  }
  
  _SendAndWriteReport(req34,msgID);
  _get_FC(req34,msgID,stepid,Passcondition);

}
//Flash请求下载
//参数Addr:驱动内存地址；Length:驱动内存大小；
//参数msgID:{phyID:物理寻址,funID:功能寻址}
//参数Passcondition:{-1:期望收到积极响应,0:期望不收到响应,>0:期望收到的NRC}
void _Send34_Flash(dword Addr,dword Length,dword msgID,int Passcondition)
{
  diagRequest ABS_ESP.Download_Request req34;
  
  diagResize(req34,0x0B);
  DiagSetPrimitiveByte(req34,1,Flash_DataFormatId);
  DiagSetPrimitiveByte(req34,2,Flash_AddrAndLenId);
  DiagSetPrimitiveByte(req34,3,Addr>>24);
  DiagSetPrimitiveByte(req34,4,Addr>>16 & 0xFF);
  DiagSetPrimitiveByte(req34,5,Addr>>8 & 0xFF);
  DiagSetPrimitiveByte(req34,6,Addr & 0xFF);
  DiagSetPrimitiveByte(req34,7,Length>>24);
  DiagSetPrimitiveByte(req34,8,Length>>16 & 0xFF);
  DiagSetPrimitiveByte(req34,9,Length>>8 & 0xFF);
  DiagSetPrimitiveByte(req34,10,Length & 0xFF);
  
  /*奇瑞测试Flash 34 数据长度和长度格式标识同时错误*/
  if(@AUTO::Config_Switch==7 && @Faultinsert::TC_ErrorAddrAndLenId_Flash==1)
  {
    diagResize(req34,5);
    DiagSetPrimitiveByte(req34,1,Flash_DataFormatId);
    DiagSetPrimitiveByte(req34,2,Flash_AddrAndLenId);
    DiagSetPrimitiveByte(req34,3,Length>>8 & 0xFF);
    DiagSetPrimitiveByte(req34,4,Length & 0xFF);
    Passcondition = 0x31;
    Exit_34_f = 1;
  }
  /*小康 Flash 34请求服务的报文长度错误*/
  else if(@Faultinsert::TC_ErrorLength_Flash==1)
  {
    diagResize(req34,0x0C);
    Passcondition = 0x13;
    Exit_34_f = 1;
  }
  _diagSendMsg(msgID,req34);
  _get_FC(req34,msgID,stepid,Passcondition);
}
//APP请求下载
//参数addr:驱动内存地址；length:驱动内存大小；
//参数msgID:{phyID:物理寻址,funID:功能寻址}
//参数Passcondition:{-1:期望收到积极响应,0:期望不收到响应,>0:期望收到的NRC}
void _Send34_App(dword addr,dword length,dword msgID,int Passcondition)
{
  diagRequest ABS_ESP.Download_Request req34;
  
  stepnum++;
  snprintf(stepid,elCount(stepid),"步骤%02d：测试34服务请求APP下载",stepnum);
  
  diagResize(req34,0x0B);
  
  //故障注入：APP 34服务地址错误
  if(@Faultinsert::TC_ErrorAddr_App==1 && @AUTO::Config_Switch==4)
  {
    addr = @AUTO::AppAddr;
    Passcondition = 0x31;
    Resp_36_a = 0x24;
    Resp_37_a = 0x24;
//    Resp_0202_a = 0x24;
    PassState_31[1] = 0x06;
    Exit_0202_a = 1;
    if(@AUTO::Geely3_Config == 1)
    {
      Resp_0202_a = 0x24;
    }
  }
  //故障注入：APP 34服务地址大小错误
  if(@Faultinsert::TC_ErrorAddrSize_App==1 && @AUTO::Config_Switch==4)
  {
    length = @AUTO::AppSize;
    Passcondition = 0x31;
    Resp_36_a = 0x24;
    Resp_37_a = 0x24;
//    Resp_0202_a = 0x24;
    PassState_31[1] = 0x06;
    Exit_0202_a = 1;
    if(@AUTO::Geely3_Config == 1)
    {
      Resp_0202_a = 0x24;
    }
  }
  //故障注入：奇瑞APP 34数据长度和长度格式标识错误
  if(@Faultinsert::TC_ErrorAddrAndLenId_App==1 && @AUTO::Config_Switch==7)
  {
    diagResize(req34,0x05); 
  }
  
  DiagSetPrimitiveByte(req34,1,App_DataFormatId);
  DiagSetPrimitiveByte(req34,2,App_AddrAndLenId);
  DiagSetPrimitiveByte(req34,3,addr>>24);
  DiagSetPrimitiveByte(req34,4,addr>>16 & 0xFF);
  DiagSetPrimitiveByte(req34,5,addr>>8 & 0xFF);
  DiagSetPrimitiveByte(req34,6,addr & 0xFF);
  DiagSetPrimitiveByte(req34,7,length>>24);
  DiagSetPrimitiveByte(req34,8,length>>16 & 0xFF);
  DiagSetPrimitiveByte(req34,9,length>>8 & 0xFF);
  DiagSetPrimitiveByte(req34,10,length & 0xFF);
  
  //故障注入：APP 34服务报文长度错误
  if(@Faultinsert::TC_ErrorLength_App==1)
  {
    diagResize(req34,0x0C);
    Passcondition = 0x13;
    Exit_34_a = 1;
  }
  //故障注入：APP 34服务数据格式标识错误
  if(@Faultinsert::TC_ErrorDataFormatId_App==1 && @AUTO::Config_Switch==4)
  {
    DiagSetPrimitiveByte(req34,1,0x01);
    Passcondition = 0x31;
    Resp_36_a = 0x24;
    Resp_37_a = 0x24;
//    Resp_0202_a = 0x24;
    PassState_31[1] = 0x06;
    Exit_0202_a = 1;
    if(@AUTO::Geely3_Config == 1) //P162
    {
      Resp_0202_a = 0x24;
    }
  }
  //故障注入：APP 34服务地址和长度格式标识错误
  if(@Faultinsert::TC_ErrorAddrAndLenId_App==1 && @AUTO::Config_Switch==4)
  {
    DiagSetPrimitiveByte(req34,2,0x45);
    Passcondition = 0x31;//0x13;
    Resp_36_a = 0x24;
    Resp_37_a = 0x24;
    PassState_31[1] = 0x06;
    Exit_0202_a = 1;
    if(@AUTO::Geely3_Config == 1) //P162
    {
      Resp_0202_a = 0x24;
    }
  }
  _diagSendMsg(msgID,req34);
  _get_FC(req34,msgID,stepid,Passcondition);
}

//SBT 36数据下载
void SBT_36(dword VbtBlockFlage)
{
  byte i;
  i = 0;
  stepnum++;
  snprintf(stepid,elCount(stepid),"步骤%02d",stepnum);
  testStep(stepid,"开始测试SBT 36数据下载服务");
  
  //故障注入：步骤缺失SBT 36数据传输
  if(@Faultinsert::TC_Miss_36_F==1)
  {
    Resp_37_f = 0x24;
    Exit_37_f = 1;
  }
  else
  {
    if(VbtBlockFlage == 0)
    {
      //发送所有sbt地址块
      for(i=0;i<HexBlockTotalNumber_sbt;i++)
      {
        _Send36_SBT(hexfile_sbt[i],0);
      }
    }
    else if(VbtBlockFlage == 1)
    {
      //发送所有sbt地址块
      for(i=0;i<VbtBlockTotalNumber_sbt;i++)
      {
        _Send36_SBT(hexfile_sbt[i],1);
      }
    }
  }
}

void _Send36_SBT(struct Block hexBlock,byte state)
{
  diagRequest ABS_ESP.Download_Transmit req36;
  dword countcnt;
  qword remain,isLastLine;
  byte dataBuffer_error[0x10000];
  dword i;
  i = 0;
  
  countcnt = 0;
  isLastLine = 0;
  
  if(state==0)
  {
//    writeEx(-3,1,"hexBlock.BlockDataLength = 0x%X",hexBlock.BlockDataLength);
//    writeEx(-3,1,"Blocksize_36 = 0x%X",Blocksize_36);
//    for(i=Blocksize_36;i<= hexBlock.BlockDataLength;i+=Blocksize_36)
    if(hexBlock.BlockDataLength >= Blocksize_36 )
    {
      for(i = 0; i<= hexBlock.BlockDataLength; i += Blocksize_36)
      {
        countcnt = (countcnt + 1) & 0xFF;
        remain = hexBlock.BlockDataLength - i;
//        writeEx(-3,1,"remain = 0x%X",remain);
        if(remain < Blocksize_36)
        {
          if(@Faultinsert::TC_Error_36_F==1 )
          {
            _SendData_SBT(dataBuffer_error,i,Blocksize_36,countcnt);
            Resp_0301 = 0x22;
            Resp_37_f = 0x24;
            Resp_34_f = 0x70;
            Resp_36_f = 0x31;
            Exit_0301 = 1;
          }
          else
            _Senddata_SBT(hexBlock.dataBuffer,i,remain,countcnt);
          //故障注入: 36服务多传输一块
          if(@Faultinsert::TC_Continue_36_F==1)
          {
            countcnt = (countcnt + 1) & 0xFF;
             Resp_36_f = 0x31;
             Exit_36_f = 1;
            _Senddata_SBT(hexBlock.dataBuffer,i,remain,countcnt);
          }
          break;
        }
        //故障注入:SBT 36传输中直接37退出
        if(@Faultinsert::TC_Exit_in_36_F==1 && countcnt==2)
        {
          Resp_37_f = 0x24;
          Exit_37_f = 1;
          return;
        }
        //故障注入:SBT 36传输的数据错误
        else if(@Faultinsert::TC_Error_36_F==1 ) //&& countcnt == 1
        {
          _SendData_SBT(dataBuffer_error,i,Blocksize_36,countcnt);
          PassState_31[0] = 0x10;
          PassState_31[1] = 0x04;
          if(@AUTO::Geely3_Config == 1)
            PassState_31[1] = 0x06;
          Resp_0301 = 0x22;
          Exit_0301 = 1;
          Break_Download = 1; //仅刷写一个文件，后续文件占用时间过长
        }
        else
          _SendData_SBT(hexBlock.dataBuffer,i,Blocksize_36,countcnt);
        isLastLine = i;
      }
    }
    //判断是否全部传输完成
//    if(hexBlock.BlockDataLength - isLastLine > 0)
    else 
    {
      remain = hexBlock.BlockDataLength;
      countcnt = (countcnt + 1) & 0xFF;
      _Senddata_SBT(hexBlock.dataBuffer,0,remain,countcnt);
      //故障注入: 36服务多传输一块
      if(@Faultinsert::TC_Continue_36_F==1)
      {
        countcnt = (countcnt + 1) & 0xFF;
        Resp_36_f = 0x31;
        Exit_36_f = 1;
        _Senddata_SBT(hexBlock.dataBuffer,0 ,remain,countcnt);
      }
    }
  }
  else if(state==1)
  {
    for(i=0;i<=hexBlock.BlockVbtDataLength;i+=Blocksize_36)
    { 
      countcnt = (countcnt + 1) & 0xFF;
      remain = hexBlock.BlockVbtDataLength - i;
//      writeEx(-3,1,"remain = 0x%X",remain);
      if(remain < Blocksize_36)
      {
        //故障注入:sbt 36传输的数据错误
        if(@Faultinsert::TC_Error_36_F==1 ) //&& countcnt == 1
        {
          _SendData_SBT(dataBuffer_error,i,Blocksize_36,countcnt);
          break;
        }
        _Senddata_SBT(hexBlock.dataVbtBuffer,i,remain,countcnt);
        break;
      }
//      //故障注入:sbt 36传输中直接37退出
//      if(@Faultinsert::TC_Exit_in_36_F==1 && countcnt==2)
//      {
//        Resp_37_f = 0x24;
//        Exit_37_f = 1;
//        return;
//      }
      _SendData_SBT(hexBlock.dataVbtBuffer,i,Blocksize_36,countcnt);
//      isLastLine = i;
    }
//    //判断是否全部传输完成
//    if(hexBlock.BlockVbtDataLength - isLastLine > 0)
//    {
//      remain = hexBlock.BlockVbtDataLength - isLastLine;
//      countcnt = (countcnt + 1) & 0xFF;
////      _Senddata_SBT(hexBlock.dataVbtBuffer,hexBlock.BlockVbtDataLength,remain,countcnt);
//      _Senddata_SBT(hexBlock.dataVbtBuffer,isLastLine,remain,countcnt);
//    }
  }
  remain = 0;
  isLastLine = 0;
}

void FlashDriver_36()
{
  byte Error_J80J3_F[0x292];
  byte Error_J3_A[0x300];
  byte Error_J3_B[0x308];
  byte Error_Z65H[0x1BC];
  byte Error_BinFlash[0x500];
  
  stepnum++;
  snprintf(stepid,elCount(stepid),"步骤%02d：测试36服务Flash数据传输",stepnum);
  
  //故障注入：缺失步骤Flash 36请求
  if(@Faultinsert::TC_Miss_36_F==1)
  {
    //不同主机厂，需求规范不同
    if(@AUTO::Config_Switch==2)//ChangAn
    {
      Resp_37_f = 0x22;
      Resp_0202_f = 0x22;
      Exit_36_f = 0;
      Exit_0202_f = 1;
    }
    else if(@AUTO::Config_Switch==7)//奇瑞
    {
      Resp_37_f = 0x24;
      Exit_36_f = 0;
      Exit_37_f = 1;
    }
    else if(@AUTO::Config_Switch==11)//奇瑞T1V
    {
      Resp_37_f = 0x24;
      Exit_36_f = 0;
      Exit_37_f = 1;
      PassState_31[0] = 0x06;
    }
    //BYD || Geely1.0 || 鑫源 || 瑞驰 || 五菱 || 赛力斯
    else
    {
      Resp_37_f = 0x24;
      Resp_0202_f = 0x22;
      Exit_36_f = 0;
      Exit_0202_f = 1;
    }
    return;
  }
  //故障注入：Flash 36传输数据错误
  else if(@Faultinsert::TC_Error_36_F==1)
  {
    //不同主机厂，需求规范不同
    if(@AUTO::Config_Switch==1 || @AUTO::Config_Switch==6 
    || @AUTO::Config_Switch==8 || @AUTO::Config_Switch==9)//BYD || 瑞驰 || 五菱 || 东风小康
    {
      PassState_31[0] = 0x01;
      Exit_0202_f = 1;
    }
    else if(@AUTO::Config_Switch==2)//ChangAn
    {
      Resp_0202_f = 0x22;
      Exit_0202_f = 1;
    }
    else if(@AUTO::Config_Switch==3 || @AUTO::Config_Switch==5)//Geely1.0 || 鑫源
    {
      PassState_31[0] = 0x05;
      Exit_0202_f = 1;
    }
    else if(@AUTO::Config_Switch==11 )//T1V
    {
      PassState_31[0] = 0x01;
      Exit_0202_f = 1;
    }
    else if(@AUTO::Config_Switch==7)//奇瑞
    {
      Resp_ff00 = 0x72;
      Exit_ff00 = 1;
    }
    //不同驱动
//    if(BlockBin_Flage == 1)
//      _Send36_Flash(DriverAddr,Error_BinFlash,DriverSize);
//    else 
    if(@AUTO::FlashDriver_Switch == 0xFF)
      _Send36_Flash(DriverAddr,Error_BinFlash,DriverSize);
    else
    {
      if(@AUTO::FlashDriver_Switch==1)//J80J3-F
        _Send36_Flash(DriverAddr,Error_J80J3_F,DriverSize);
      else if(@AUTO::FlashDriver_Switch==2)//J80J3-A
        _Send36_Flash(DriverAddr,Error_J3_A,DriverSize);
      else if(@AUTO::FlashDriver_Switch==3)//J80J3-B
        _Send36_Flash(DriverAddr,Error_J3_B,DriverSize);
      else if(@AUTO::FlashDriver_Switch==4)//Z65H
        _Send36_Flash(DriverAddr,Error_Z65H,DriverSize);
      return;
    }
  }
  else
  {
//    if(BlockBin_Flage == 1)
//      _Send36_Flash(DriverAddr,BlockBin_Flash,DriverSize);
//    else 
    if(@AUTO::FlashDriver_Switch == 0xFF)
      _Send36_Flash(DriverAddr,BlockBin_Flash,DriverSize);
    else
    {
      //不同驱动
      if(@AUTO::FlashDriver_Switch==1)//J80J3-F
        _Send36_Flash(DriverAddr,J80J3_F,DriverSize);
      else if(@AUTO::FlashDriver_Switch==2)//J80J3-A
        _Send36_Flash(DriverAddr,J80J3_A,DriverSize);
      else if(@AUTO::FlashDriver_Switch==3)//J80J3-B
        _Send36_Flash(DriverAddr,J80J3_B,DriverSize);
      else if(@AUTO::FlashDriver_Switch==4)//Z65H
        _Send36_Flash(DriverAddr,Z65H,DriverSize);
    }
  }
  //故障注入：Flash 36传输完发送 FF 01
  if(@Faultinsert::TC_FF01_After_36F==1)
  {
    /*FF 01的响应 0:正响应 1:负响应*/
    if(Unnormal_FF01==1)
    {
      Resp_ff01 = 0x22;
    }
    else
    {
      PassState_31[0] = 0x01;
    }
    Exit_36_f = 1;
    _SendFF01(phyID,Resp_ff01);
  }
}

//Flash数据下载
//参数addr:驱动内存地址;  data36:数据内容;   length:驱动内存大小;
void _Send36_Flash(dword addr,byte data36[],dword length)
{
  diagRequest ABS_ESP.Download_Transmit req36;
  dword countcnt;
  dword remain;
  dword Re_Time;
  dword Blocksize_temp;
  byte j=0;
  Re_Time = 0;
  Blocksize_temp = Blocksize_36;
  
  //故障注入：Flash 36驱动下载连续重复发送同一个数据块时需要减小每个块的大小
  if(@Faultinsert::TC_Re_BlockNum_F==1 || @Faultinsert::TC_Exit_in_36_F==1)
    Blocksize_36 = 0x40;
   
  for(countcnt=1;countcnt<=0xFFFF;countcnt++)
  {
    //故障注入：Flash 36驱动下载数据未传输完直接37退出
    if(@Faultinsert::TC_Exit_in_36_F==1)
    {
      Blocksize_36 = 0x80;
      _Senddata(req36,Blocksize_36,countcnt,data36,phyID,Resp_36_f);
      countcnt++;
      //BYD || 鑫源
      if(@AUTO::Config_Switch==1 || @AUTO::Config_Switch==5)
      {
        Resp_37_f = 0x24;
        Resp_0202_f = 0x22;
        Exit_0202_f = 1;
        break;
      }
      //奇瑞
      else if(@AUTO::Config_Switch==7)
      {
        Resp_37_f = 0x24;
        Exit_37_f = 1;
        break;
      }
    }
    //故障注入：电压异常测试
    if(@Faultinsert::TC_ErrorVolt!=0 || @Faultinsert::TC_ErrorLowVolt_App == 1 || @Faultinsert::TC_ErrorHighVolt_App == 1)
    {
      if(countcnt == 1)
      {
        //低压刷写
        if(@Prog_power::K30Volt < Low_Volt)
        {
          LowVolt_Resp(curAppValid);
        }
        //高压刷写
        else if(@Prog_power::K30Volt > High_Volt)
        {
          HighVolt_Resp(curAppValid);
        }
      }
      else
      {
        /*APP有效情况下*/
        if(curAppValid==1)
        {
          /*Geely 1.0*/
          if(@AUTO::Config_Switch==3)
          {
            Resp_1002 = 0x22;
            Exit_1002 = 1;
          }
          else
          {
            Resp_36_f = 0x24;
            Exit_36_f = 1;
          }
        }
        /*APP无效情况下*/
        else
        {
          Resp_36_f = 0x24;
          Exit_36_f = 1;
        } 
      }
    }
    remain=length-Blocksize_36*(countcnt-1);
    if(remain<Blocksize_36)
    {
      if(remain==0)
        break;
      _Senddata(req36,remain,countcnt,data36,phyID,Resp_36_f);
      //故障注入：36下载完成后继续发送一个数据块
      if(@Faultinsert::TC_Continue_36_F==1)
      {
        countcnt++;
        END_Pos = 1;
        //奇瑞
        if(@AUTO::Config_Switch==7 || @AUTO::Config_Switch==11)
        {
          Resp_36_f = 0x24;
          Exit_36_f = 1;
        }
        else if(@AUTO::Config_Switch==12)
        {
          Resp_36_f = 0x72;
          Exit_36_f = 1;
        }
        else
        {
          Resp_36_f = 0x31;
          Exit_36_f = 1;
        }
        _Senddata(req36,remain,countcnt,data36,phyID,Resp_36_f);
        return;
      }
      break;
    }
    //故障注入：Flash 36驱动下载连续重复发送同一个数据块
    if(@Faultinsert::TC_Re_BlockNum_F==1 && countcnt==@Test::Block_Num)
    {
      Re_Time++;
      //需求不同：重复多次依旧积极响应
      if(ReBlocknum_Flage==1)
      {
        Resp_36_f = -1;
      }
      //当前重复次数大于最大重复次数
      else if(Re_Time > ReBlocknum_max)
      {
        Resp_36_f = 0x71;
      }
      countcnt = @Test::Block_Num;
      _Senddata(req36,Blocksize_36,countcnt,data36,phyID,Resp_36_f);
      if(Re_Time < @Test::Re_BlockTime)
        countcnt--;
      //当前重复次数达到预期重复次数
      else if(Re_Time == @Test::Re_BlockTime)
      {
        //需求不同：重复多次依旧积极响应
        if(ReBlocknum_Flage==1)
        {
          @Faultinsert::TC_Re_BlockNum_F = 0;
        }
        //预期重复次数大于最大重复次数
        else if(@Test::Re_BlockTime > ReBlocknum_max)
        {
          Exit_36_f = 1;
          return;
        }
        //预期重复次数小于最大重复次数
        else
        {
          @Faultinsert::TC_Re_BlockNum_F = 0;
        }
      }
    }
    //故障注入：第一个数据块编号不为1
    else if(@Faultinsert::TC_FirstBlockNum_F==1)
    {
      countcnt = @Test::FirstBlock_Num;
      Resp_36_f = 0x73;
      _Senddata(req36,Blocksize_36,countcnt,data36,phyID,Resp_36_f);
      //鑫源需求规范
      if(@AUTO::Config_Switch==5)
      {
        countcnt = 1;
        Resp_36_f = 0x24;
        _Senddata(req36,Blocksize_36,countcnt,data36,phyID,Resp_36_f);
      }
      Exit_36_f = 1;
      return;
    }
    //故障注入：数据块编号不连贯
    else if(@Faultinsert::TC_ErrorBlockNum_F==1 && countcnt==@Test::Block_Loc)
    {
      //不同主机厂，刷写规范不同
      if(@AUTO::Config_Switch==1)//BYD
      {
        countcnt = @Test::Block_Num;
        Resp_36_f = 0x73;
        _Senddata(req36,Blocksize_36,countcnt,data36,phyID,Resp_36_f);
        Exit_36_f = 1;
        return;
      }
      //CA || Geely1.0 || 鑫源 || 瑞驰 || 赛力斯
      else
      {
        if(@Test::Block_Num==@Test::Block_Loc - 1)
        {
          countcnt = @Test::Block_Num;
          _Senddata(req36,Blocksize_36,countcnt,data36,phyID,Resp_36_f);
          @Faultinsert::TC_ErrorBlockNum_F = 0;
        }
        else
        {
          countcnt = @Test::Block_Num;
          Resp_36_f = 0x73;
          _Senddata(req36,Blocksize_36,countcnt,data36,phyID,Resp_36_f);
          Exit_36_f = 1;
          return;
        }
      }
    }
    else
      _Senddata(req36,Blocksize_36,countcnt,data36,phyID,Resp_36_f);
    
    if(Break_Download==1)
    {
      break;
    }
  }
  Blocksize_36 = Blocksize_temp;
}
//参数addr:数据下载地址;  data36:数据内容;   length:数据内存大小;
void App_36(dword addr,byte data36[],dword length)
{
  stepnum++;
  snprintf(stepid,elCount(stepid),"步骤%02d：测试36服务APP数据传输",stepnum);
  
  //故障注入：缺失步骤App 36数据传输
  if(@Faultinsert::TC_Miss_36_A==1)
  {
    //BYD || 鑫源 || 五菱  || 赛力斯
    if(@AUTO::Config_Switch==1 || @AUTO::Config_Switch==5
    || @AUTO::Config_Switch==8 || @AUTO::Config_Switch==10)
    {
      Resp_37_a = 0x24;
      Resp_0202_a = 0x22;
      Exit_36_a = 0;
      Exit_0202_a = 1;
      Break_Download = 1;
    }
    //ChangAn
    else if(@AUTO::Config_Switch==2)
    {
      Resp_37_a = 0x22;
      Exit_36_a = 0;
      Exit_37_a = 1;
      Break_Download = 1;
    }
    //Geely1.0 || 瑞驰 || 奇瑞 || 小康
    else
    {
      Resp_37_a = 0x24;
      Exit_36_a = 0;
      Exit_37_a = 1;
      Break_Download = 1;
    }
    return;
  }
  //故障注入：低压下载APP
  else if(@Faultinsert::TC_LowVolt_36_A==1)
  {
    if(@AUTO::Config_Switch==1)//BYD
    {
      @Prog_power::K30Volt = 8;
      testWaitForTimeout(Volt_Time);
      Resp_36_a = 0x93;
      Resp_37_a = 0x24;
      Resp_0202_a = 0x22;
      Resp_ff01 = 0x22;
      Exit_ff01 = 1;
      Break_Download = 1;
    }
    else if(@AUTO::Config_Switch==2 || @AUTO::Config_Switch==3)//ChangAn || Geely1.0 
    {
      @Prog_power::K30Volt = 8;
      testWaitForTimeout(Volt_Time);
      Resp_36_a = 0x93;
      Resp_37_a = 0x22;
      Resp_0202_a = 0x22;
      Resp_ff01 = 0x22;
      Exit_ff01 = 1;
      Break_Download = 1;
    }
    else if(@AUTO::Config_Switch==6)//瑞驰
    {
      @Prog_power::K30Volt = 8;
      testWaitForTimeout(Volt_Time);
      Resp_36_a = 0x93;
      Resp_37_a = 0x24;
      Resp_0202_a = 0x22;
      Resp_ff01 = 0x22;
      Exit_ff01 = 1;
      Break_Download = 1;
    }
    else if(@AUTO::Config_Switch==5 || @AUTO::Config_Switch == 8)//鑫源 || 五菱
    {
      @Prog_power::K30Volt = 6;
      testWaitForTimeout(Volt_Time);
      Resp_36_a = 0x93;
      Resp_37_a = 0x22;
      Resp_0202_a = 0x22;
      Resp_ff01 = 0x22;
      Exit_ff01 = 1;
      Break_Download = 1;
    }
    else
    {
      @Prog_power::K30Volt = 8;
      testWaitForTimeout(Volt_Time);
      Resp_36_a = 0x93;
      Resp_37_a = 0x22;
      Resp_0202_a = 0x22;
      Resp_ff01 = 0x22;
      Exit_ff01 = 1;
      Break_Download = 1;
    }
    if(@AUTO::EraseMode_Switch==3 ) //|| @AUTO::Config_Switch ==12
      _Send36_App1(addr,data36,length);
    else
      _Send36_App(addr,data36,length);
  }
  //故障注入：高压下载APP
  else if(@Faultinsert::TC_HighVolt_36_A==1)
  {
    if(@AUTO::Config_Switch==1)//BYD
    {
      @Prog_power::K30Volt = 17;
      testWaitForTimeout(Volt_Time);
      Resp_36_a = 0x92;
      Resp_37_a = 0x24;
      Resp_0202_a = 0x22;
      Resp_ff01 = 0x22;
      Exit_ff01 = 1;
      Break_Download = 1;
    }
    else if(@AUTO::Config_Switch==2 || @AUTO::Config_Switch==3)//ChangAn || Geely1.0
    {
      @Prog_power::K30Volt = 17;
      testWaitForTimeout(Volt_Time);
      Resp_36_a = 0x92;
      Resp_37_a = 0x22;
      Resp_0202_a = 0x22;
      Resp_ff01 = 0x22;
      Exit_ff01 = 1;
      Break_Download = 1;
    }
    else if(@AUTO::Config_Switch==6)//瑞驰
    {
      @Prog_power::K30Volt = 17;
      testWaitForTimeout(Volt_Time);
      Resp_36_a = 0x92;
      Resp_37_a = 0x24;
      Resp_0202_a = 0x22;
      Resp_ff01 = 0x22;
      Exit_ff01 = 1;
      Break_Download = 1;
    }
    else if(@AUTO::Config_Switch==5)//鑫源
    {
      @Prog_power::K30Volt = 18;
      testWaitForTimeout(Volt_Time);
      Resp_36_a = 0x92;
      Resp_37_a = 0x24;
      Resp_0202_a = 0x22;
      Resp_ff01 = 0x22;
      Exit_ff01 = 1;
      Break_Download = 1;
    }
    else if(@AUTO::Config_Switch==8)//五菱
    {
      @Prog_power::K30Volt = 18;
      testWaitForTimeout(Volt_Time);
      Resp_36_a = 0x92;
      Resp_37_a = 0x22;
      Resp_0202_a = 0x22;
      Resp_ff01 = 0x22;
      Exit_ff01 = 1;
      Break_Download = 1;
    }
    if(@AUTO::EraseMode_Switch==3)//  || @AUTO::Config_Switch == 12
      _Send36_App1(addr,data36,length);
    else
      _Send36_App(addr,data36,length);
  }
  else
  {
    if(@AUTO::EraseMode_Switch==3 ) //广汽刷写段连续 || @AUTO::Config_Switch == 12
      _Send36_App1(addr,data36,length);
    else
      _Send36_App(addr,data36,length);
  }
  
  //故障注入：APP数据传输后功能寻址复位
  if(@Faultinsert::TC_Restart_after_36_A==1)
  {
    _Startreset(funID,0x01,Resp_11);
    Resp_36_a = 0x7F;
    Resp_37_a = 0x7F;
    Exit_37_a = 1;
    if(@AUTO::Config_Switch == 3)
      Resp_36_a = 0x7F;
  }
  //故障注入：APP数据传输后功能寻址切换默认会话
  else if(@Faultinsert::TC_DefaultSession_after_36_A==1)
  {
    enterDefault(funID,0,Resp_1001);
    Resp_36_a = 0x7F;
    Resp_37_a = 0x7F;
    Exit_37_a = 1;
  }
  //故障注入：APP数据传输完后发送 FF 01
  else if(@Faultinsert::TC_FF01_After_36A==1)
  {
    /*FF 01的响应 0:正响应 1:负响应*/
    if(Unnormal_FF01==1)
    {
      Resp_ff01 = 0x22;
    }
    else
    {
      PassState_31[0] = 0x01;
    }
    Exit_36_a = 1;
    _SendFF01(phyID,Resp_ff01);
  }
  /*可靠性测试：数据块传输完切断电源*/
  if(TC_PowerDown_After_36A==1)
  {
    _K30_OFF();
    testWaitForTimeout(10000);
    Exit_36_a = 1;
    _K30_ON();
  }
  /*可靠性测试：数据块传输完下点火*/
  if(TC_K15_After_36A==1)
  {
    _K15_OFF();
    testWaitForTimeout(10000);
    Exit_36_a = 1;
    _K15_ON();
  }
  /*可靠性测试：数据块传输完BusOff*/
  if(TC_BusOff_After_36A==1)
  {
    testWaitForTesterConfirmation("请制造BufOff故障",10000);
    testWaitForTimeout(10000);
    Exit_36_a = 1;
    testWaitForTesterConfirmation("请恢复故障",10000);
    return;
  }
}
/*合并地址段流式36发送:逐段加载+跨段连续块号36发送+CRC增量累积。
  仅MergeAddr_Switch==1时使用;data36仅缓存单段(0x10000)。
  调用前提:首段已由_loadpage装入data36,length34=首段长度,addr=首段地址,
  datanow指向下一条记录(04/05/01)。mergedTotal=eraselength[openhex][eraseadd]*/
void _App_36_merge(dword openhex,dword eraseadd,dword mergedTotal,dword firstSegLen,byte datanow[],dword& addr)
{
  diagRequest ABS_ESP.Download_Transmit req36;
  dword segLen;
  dword relOff;
  dword remain;
  word i;

  stepnum++;
  snprintf(stepid,elCount(stepid),"步骤%02d：测试36服务APP数据传输(合并流式)",stepnum);
  
  stream_blockcnt = 1;                          /*块计数器跨段连续,每个合并块重置*/
  crc16[eraseadd] = 0xFFFF;                     /*本块CRC16初值*/
  calcrc32 = 0xFFFFFFFF;                        /*CRC32累加初值*/
  segLen = firstSegLen;                         /*首段长度(由调用者传入,避免全局length34被局部变量遮蔽)*/

  /*故障注入:缺失步骤App 36数据传输*/
  if(@Faultinsert::TC_Miss_36_A==1)
  {
    if(@AUTO::Config_Switch==1 || @AUTO::Config_Switch==5
    || @AUTO::Config_Switch==8 || @AUTO::Config_Switch==10)
    {
      Resp_37_a = 0x24; Resp_0202_a = 0x22; Exit_36_a = 0; Exit_0202_a = 1; Break_Download = 1;
    }
    else if(@AUTO::Config_Switch==2)
    {
      Resp_37_a = 0x22; Exit_36_a = 0; Exit_37_a = 1; Break_Download = 1;
    }
    else
    {
      Resp_37_a = 0x24; Exit_36_a = 0; Exit_37_a = 1; Break_Download = 1;
    }
    return;
  }
  /*故障注入:低压下载APP*/
  else if(@Faultinsert::TC_LowVolt_36_A==1)
  {
    @Prog_power::K30Volt = 8;
    testWaitForTimeout(Volt_Time);
    Resp_36_a = 0x93; Resp_37_a = 0x24; Resp_0202_a = 0x22; Resp_ff01 = 0x22; Exit_ff01 = 1; Break_Download = 1;
  }
  /*故障注入:高压下载APP*/
  else if(@Faultinsert::TC_HighVolt_36_A==1)
  {
    @Prog_power::K30Volt = 17;
    testWaitForTimeout(Volt_Time);
    Resp_36_a = 0x92; Resp_37_a = 0x24; Resp_0202_a = 0x22; Resp_ff01 = 0x22; Exit_ff01 = 1; Break_Download = 1;
  }
  
  /*逐段加载+发送+CRC累积*/
  while(1)
  {
    /*故障注入:APP 36下载的数据错误(按段填充0xFF)*/
    if(@Faultinsert::TC_Error_36_A==1)
    {
      for(i=0;i<segLen;i++)
        data36[i] = 0xFF;
      PassState_31[0] = 0x01;
      Exit_0202_a = 1;
    }
    
    /*本段36数据发送:块号跨段连续,数据偏移段内相对*/
    relOff = 0;
    for(; ; stream_blockcnt++)
    {
      if((@Faultinsert::TC_LowVolt_36_A==1 || @Faultinsert::TC_HighVolt_36_A==1) && stream_blockcnt != 1)
        Resp_36_a = 0x24;
      
      remain = segLen - relOff;
      if(remain < Blocksize_36)
      {
        if(remain != 0)
        {
          _Senddata_merge(req36,remain,stream_blockcnt,data36,relOff,phyID,Resp_36_a);
          stream_blockcnt++;
        }
        break;
      }
      _Senddata_merge(req36,Blocksize_36,stream_blockcnt,data36,relOff,phyID,Resp_36_a);
      relOff += Blocksize_36;
      if(Exit_36_a == 1)
      {
        calcrc32 = calcrc32 ^ 0xFFFFFFFF;
        return;
      }
    }
    
    /*CRC累积(按段增量计算)*/
    crc16[eraseadd] = _caculateCrc16(crc16[eraseadd],data36,segLen);
    calcrc16 = _caculateCrc16(calcrc16,data36,segLen);
    calcrc32 = _caculateCrc32_1(calcrc32,data36,segLen);
    
    /*判断合并块内是否还有连续段*/
    if(datanow[3] != 4 || @AUTO::MergeAddr_Switch != 1)
      break;
    {
      dword nextaddr;
      nextaddr = ((dword)(((word)datanow[4]<<8)|datanow[5]))<<16;
      if(nextaddr >= eraseaddr[openhex][eraseadd] + eraselength[openhex][eraseadd])
        break;
    }

    /*加载下一段:解析04记录地址,读取首条00,重填data36*/
    {
      word addrh;
      addrh = ((word)datanow[4]<<8)|datanow[5];
      addr = (dword)addrh << 16;
    }
    _readhex(datanow);                         /*获取首条00记录*/
    _loadpage(data36,datanow,addr,segLen);      /*重填data36为下一段数据*/
  }
  
  calcrc32 = calcrc32 ^ 0xFFFFFFFF;
  
  /*故障注入:APP数据传输后功能寻址复位*/
  if(@Faultinsert::TC_Restart_after_36_A==1)
  {
    _Startreset(funID,0x01,Resp_11);
    Resp_36_a = 0x7F; Resp_37_a = 0x7F; Exit_37_a = 1;
  }
}
//App数据块下载
//参数addr:驱动内存地址;  data36:数据内容;   length:驱动内存大小;
void _Send36_App(dword addr,byte data36[],dword length)
{ 
  diagRequest ABS_ESP.Download_Transmit req36;
  dword countcnt;
  dword continue_cnt;
  dword remain;
  dword Re_Time;
  byte j=0;
  
  Re_Time = 0;
  for(countcnt=1;countcnt<=0xFFFF;countcnt++)
  {
    if((@Faultinsert::TC_LowVolt_36_A==1 || @Faultinsert::TC_HighVolt_36_A==1) && countcnt != 1)
    {
      Resp_36_a = 0x24;
    }
    remain=length-Blocksize_36*(countcnt-1);
    if(remain<Blocksize_36)
    {
      if(remain!=0)
      {
        _Senddata(req36,remain,countcnt,data36,phyID,Resp_36_a);
        countcnt++;
      }
      //故障注入：36下载完成后继续发送一个数据块
      if(@Faultinsert::TC_Continue_36_A==1)
      {
        END_Pos = 1;
        //奇瑞
        if(@AUTO::Config_Switch==7 || @AUTO::Config_Switch==11)
        {
          Resp_36_a = 0x24;
          Exit_36_a = 1;
        }
        //五菱
        else if(@AUTO::Config_Switch==8)
        {
          Resp_36_a = 0x24;
          Resp_37_a = 0x24;
          Exit_37_a = 1;
        }
        else
        {
          Resp_36_a = 0x31;
          Exit_36_a = 1;
        }

        _Senddata(req36,Blocksize_36,countcnt,data36,phyID,Resp_36_a);
        return;
      }
      break;
    }
    //故障注入：数据块大小变动
    if(@Faultinsert::TC_BlockSize==1)
    {
      Blocksize_36 = @Test::Block_Size - 2;
      //36数据块大于最大长度
      if(@Test::Block_Size>DataLengthmax_34)
      {
        if(@AUTO::Config_Switch==1)//BYD
        {
          //CAN刷写时不响应
          if(@AUTO::CANFD_Switch==0)
          {
            Resp_36_a = 0;
            Exit_36_a = 1;
          }
        }
        else 
          Exit_36_a = 1;
        _Senddata(req36,Blocksize_36,countcnt,data36,phyID,Resp_36_a);
        break;
//        return;
      }
      else
        _Senddata(req36,Blocksize_36,countcnt,data36,phyID,Resp_36_a);
    }
    //故障注入：第一个数据块编号不为1
    else if(@Faultinsert::TC_FirstBlockNum_A==1)
    {
      countcnt = @Test::FirstBlock_Num;
      Resp_36_a = 0x73;
      _Senddata(req36,Blocksize_36,countcnt,data36,phyID,Resp_36_a);
      Exit_36_a = 1;
      return;
    }
    //故障注入：数据块编号不连贯
    else if(@Faultinsert::TC_ErrorBlockNum_A==1 && countcnt==@Test::Block_Loc)
    {
      //不同主机厂，刷写规范不同
      //BYD
      if(@AUTO::Config_Switch==1)
      {
        countcnt = @Test::Block_Num;
        Resp_36_a = 0x73;
        _Senddata(req36,Blocksize_36,countcnt,data36,phyID,Resp_36_a);
        Exit_36_a = 1;
        return;
      }
      //CA || Geely 1.0 || 鑫源 || 瑞驰 || 奇瑞 || 五菱 || 赛力斯
      else
      {
        if(@Test::Block_Num==@Test::Block_Loc - 1)
        {
          countcnt = @Test::Block_Num;
          _Senddata(req36,Blocksize_36,countcnt,data36,phyID,Resp_36_a);
          @Faultinsert::TC_ErrorBlockNum_A = 0;
        }
        else
        {
          countcnt = @Test::Block_Num;
          Resp_36_a = 0x73;
          _Senddata(req36,Blocksize_36,countcnt,data36,phyID,Resp_36_a);
          Exit_36_a = 1;
          return;
        }
      }
    }
    //故障注入：连续重复发送相同编号数据块
    else if(@Faultinsert::TC_Re_BlockNum_A==1 && countcnt==@Test::Block_Num)
    {
      dword temp_count;
      Re_Time++;
      writeEx(-3,1,"第%d次重复发送36第%d块数据块",Re_Time,@Test::Block_Num);
      //当前重复次数大于最大重复次数
      if(Re_Time > ReBlocknum_max)
      {
        if(@AUTO::Config_Switch != 8)
          Resp_36_a = 0x71;
      }
      temp_count = @Test::Block_Num;
      _Senddata(req36,Blocksize_36,temp_count,data36,phyID,Resp_36_a);
      if(Re_Time < @Test::Re_BlockTime)
        countcnt--;
//        countcnt = @Test::Block_Num;
      //当前重复次数达到预期重复次数
      else if(Re_Time == @Test::Re_BlockTime)
      {
        //预期重复次数大于最大重复次数
        if(@Test::Re_BlockTime > ReBlocknum_max)
        {
          Exit_36_a = 1;
          return;
        }
        //预期重复次数小于最大重复次数
        else
          @Faultinsert::TC_Re_BlockNum_A = 0;
      }
    }
    else
      _Senddata(req36,Blocksize_36,countcnt,data36,phyID,Resp_36_a);
    
    if(Continueaddr[0][eraseadd] == 1 && @AUTO::Config_Switch == 9)
    {
      ContinueBlocCount = countcnt;
    }
    
    //故障注入：App 36传输数据时，电压故障
    if(@Faultinsert::TC_LowVolt_36_A == 1 || @Faultinsert::TC_HighVolt_36_A == 1)
    {
      @Prog_power::K30Volt = Normal_Volt;
      testWaitForTimeout(Volt_Time);
      @Faultinsert::TC_LowVolt_36_A == 0;
      @Faultinsert::TC_HighVolt_36_A == 0;
    }
    //故障注入：App 36数据传输中直接37退出
    if(@Faultinsert::TC_Exit_in_36_A==1)
    {
      //BYD || 五菱
      if(@AUTO::Config_Switch==1 || @AUTO::Config_Switch==8)
      {
        Resp_37_a = 0x24;
        Resp_0202_a = 0x22;
        Exit_0202_a = 1;
      }
      //CA
      else if(@AUTO::Config_Switch==2)
      {
        Resp_37_a = 0x22;
        Resp_ff01 = 0x22;
        Break_Download = 1;
        Exit_0202_a = 1;
      }
      //Geely1.0 || 瑞驰
      else if(@AUTO::Config_Switch==3 || @AUTO::Config_Switch==6)
      {
        Resp_37_a = 0x24;
        Resp_0202_a = 0x22;
        Resp_ff01 = 0x22;
        Break_Download = 1;
        Exit_ff01 = 1;
      }
      //奇瑞
      else if(@AUTO::Config_Switch==7)
      {
        Resp_37_a = 0x24;
        Exit_37_a = 1;
      }
      //东风小康
      else if(@AUTO::Config_Switch==9)
      {
        _SendFF01(phyID,0x22);
        Exit_36_a = 1;
      }
      return;
    }
    //故障注入：App 36数据传输中直接34请求
    if(@Faultinsert::TC_34_in_36_A==1)
    {
      Resp_34_a = 0x22;
      App_34(addr,length34);
      Exit_36_a = 1;
      return;
    }
    //故障注入：App 36数据未传输完发送FF 01
    if(@Faultinsert::TC_FF01_in_36A==1)
    {
      /*FF 01的响应 0:正响应 1:负响应*/
      if(Unnormal_FF01==1)
      {
        Resp_ff01 = 0x22;
      }
      else
      {
        PassState_31[0] = 0x01;
      }
      Exit_36_a = 1;
      _SendFF01(phyID,Resp_ff01);
      return;
    }
    /*可靠性测试：数据块传输中切断电源*/
    if(TC_PowerDown_In_36A==1)
    {
      _K30_OFF();
      testWaitForTimeout(10000);
      Exit_36_a = 1;
      _K30_ON();
      return;
    }
    /*可靠性测试：数据块传输中下点火*/
    if(TC_K15_In_36A==1)
    {
      _K15_OFF();
      testWaitForTimeout(10000);
      Exit_36_a = 1;
      _K15_ON();
      return;
    }
    /*可靠性测试：数据块传输中BusOff*/
    if(TC_BusOff_In_36A==1)
    {
      testWaitForTesterConfirmation("请制造BufOff故障",10000);
      testWaitForTimeout(10000);
      Exit_36_a = 1;
      testWaitForTesterConfirmation("请恢复故障",10000);
      return;
    }
  }
  //传输完成后，恢复电压
  if(@Faultinsert::TC_LowVolt_36_A==1 || @Faultinsert::TC_HighVolt_36_A==1)
  {
    @Prog_power::K30Volt = Normal_Volt;
    testWaitForTimeout(Volt_Time);
    @Faultinsert::TC_LowVolt_36_A == 0;
    @Faultinsert::TC_HighVolt_36_A == 0;
  }
}
//用于擦除方式3中App数据下载,块编号不会重置
//参数addr:驱动内存地址;  data36:数据内容;   length:驱动内存大小;
void _Send36_App1(dword addr,byte data36[],dword length)
{
  diagRequest ABS_ESP.Download_Transmit req36;
  dword remain;
  byte j=0;
  dword Re_Time;
  Re_Time = 0;
  countcnt2 = 1;
  
  for(countcnt1;countcnt1<=0xFFFF;countcnt1++)
  {
    remain=length-Blocksize_36*(countcnt2-1);
    if((@Faultinsert::TC_LowVolt_36_A==1 || @Faultinsert::TC_HighVolt_36_A==1) && countcnt1 != 1)
    {
      Resp_36_a = 0x24;
    }
    if(remain<=Blocksize_36)
    {
      if(remain!=0)
      {
        _Senddata1(req36,remain,countcnt1,data36,phyID,Resp_36_a);
        countcnt1++;
      }
      //故障注入：36下载完成后继续发送一个数据块
      if(@Faultinsert::TC_Continue_36_A==1 && END_Pos == 1)
      {
//        countcnt1++;
        //奇瑞
        if(@AUTO::Config_Switch==7 || @AUTO::Config_Switch==11)
        {
          Resp_36_a = 0x24;
          Exit_36_a = 1;
        }
        //五菱
        else if(@AUTO::Config_Switch==8)
        {
          Resp_36_a = 0x24;
          Resp_37_a = 0x24;
          Exit_37_a = 1;
        }
        else
        {
          Resp_36_a = 0x31;
          Exit_36_a = 1;
        }
        writeEx(-3,1,"36下载完成后继续发送一个数据块, remain = %d",remain);
        _Senddata1(req36,remain,countcnt1,data36,phyID,Resp_36_a);
        return;
      }
      break;
    }
    //故障注入：数据块大小变动
    if(@Faultinsert::TC_BlockSize==1)
    {
      Blocksize_36 = @Test::Block_Size;
      //36数据块大于最大长度
      if(@Test::Block_Size>DataLengthmax_34)
      {
        if(@AUTO::Config_Switch==1)//BYD
        {
          //CAN刷写时不响应
          if(@AUTO::CANFD_Switch==0)
          {
            Resp_36_a = 0;
            Exit_36_a = 1;
          }
        }
        else
        {
          Exit_36_a = 1;
        }
        _Senddata1(req36,Blocksize_36,countcnt1,data36,phyID,Resp_36_a);
        return;
      }
      else
        _Senddata1(req36,Blocksize_36,countcnt1,data36,phyID,Resp_36_a);
    }
    //故障注入：第一个数据块编号不为1
    else if(@Faultinsert::TC_FirstBlockNum_A==1)
    {
      countcnt1 = @Test::FirstBlock_Num;
      Resp_36_a = 0x73;
      _Senddata1(req36,Blocksize_36,countcnt1,data36,phyID,Resp_36_a);
      Exit_36_a = 1;
      return;
    }
    //故障注入：数据块编号不连贯
    else if(@Faultinsert::TC_ErrorBlockNum_A==1 && countcnt1==@Test::Block_Loc)
    {
      //不同主机厂，刷写规范不同
      if(@AUTO::Config_Switch==1)//BYD
      {
        countcnt1 = @Test::Block_Num;
        Resp_36_a = 0x73;
        _Senddata1(req36,Blocksize_36,countcnt1,data36,phyID,Resp_36_a);
        Exit_36_a = 1;
        return;
      }
      //CA || Geely 1.0 || 鑫源 || 瑞驰 || 奇瑞 || 五菱 || 奇瑞5.0
      else if(@AUTO::Config_Switch==2 || @AUTO::Config_Switch==3 || @AUTO::Config_Switch==5
           || @AUTO::Config_Switch==6 || @AUTO::Config_Switch==7 || @AUTO::Config_Switch==8
           || @AUTO::Config_Switch==11)
      {
        if(@Test::Block_Num==@Test::Block_Loc - 1)
        {
          countcnt1 = @Test::Block_Num;
          countcnt2 = @Test::Block_Num;
          _Senddata1(req36,Blocksize_36,countcnt1,data36,phyID,Resp_36_a);
          @Faultinsert::TC_ErrorBlockNum_A = 0;
        }
        else
        {
          countcnt1 = @Test::Block_Num;
          countcnt2 = @Test::Block_Num;
          Resp_36_a = 0x73;
          if(@AUTO::Config_Switch==11)
            Resp_36_a = 0x71;
          _Senddata1(req36,Blocksize_36,countcnt1,data36,phyID,Resp_36_a);
          Exit_36_a = 1;
          return;
        }
      }
    }
    //故障注入：连续发送相同编号数据块
    else if(@Faultinsert::TC_Re_BlockNum_A==1 && countcnt1==@Test::Block_Num)
    {
      Re_Time++;
      //当前重复次数大于最大重复次数
      if(Re_Time > ReBlocknum_max)
      {
        if(@AUTO::Config_Switch != 8)
          Resp_36_a = 0x71;
      }
      countcnt1 = @Test::Block_Num;
      countcnt2 = @Test::Block_Num;
      writeEx(-3,1,"/*----------第%d次重复发送第%d块数据块----------*/",Re_Time,@Test::Block_Num);
      _Senddata1(req36,Blocksize_36,countcnt1,data36,phyID,Resp_36_a);
      if(Re_Time < @Test::Re_BlockTime)
      {
        countcnt1--;
        countcnt2--;
      }
      //当前重复次数达到预期重复次数
      else if(Re_Time == @Test::Re_BlockTime)
      {
        //预期重复次数大于最大重复次数
        if(@Test::Re_BlockTime > ReBlocknum_max)
        {
          Exit_36_a = 1;
          return;
        }
        //预期重复次数小于最大重复次数
        else
        {
          @Faultinsert::TC_Re_BlockNum_A = 0;
        }
      }
    }
    else
    {
      _Senddata1(req36,Blocksize_36,countcnt1,data36,phyID,Resp_36_a);
    }
    countcnt2++;
    
    //故障注入：App 36传输数据时，电压故障
    if(@Faultinsert::TC_LowVolt_36_A == 1 || @Faultinsert::TC_HighVolt_36_A == 1)
    {
      break;
    }
    //故障注入：App 36数据传输中直接37退出
    if(@Faultinsert::TC_Exit_in_36_A==1)
    {
      //BYD || 五菱
      if(@AUTO::Config_Switch==1 || @AUTO::Config_Switch==8)
      {
        Resp_37_a = 0x24;
        Resp_0202_a = 0x22;
        Exit_0202_a = 1;
      }
      //CA
      else if(@AUTO::Config_Switch==2)
      {
        Resp_37_a = 0x22;
        Resp_ff01 = 0x22;
        Break_Download = 1;
        Exit_0202_a = 1;
      }
      //Geely1.0 || 瑞驰
      else if(@AUTO::Config_Switch==3 || @AUTO::Config_Switch==6)
      {
        Resp_37_a = 0x24;
        Resp_0202_a = 0x22;
        Resp_ff01 = 0x22;
        Break_Download = 1;
        Exit_ff01 = 1;
      }
      //奇瑞
      else if(@AUTO::Config_Switch==7 || @AUTO::Config_Switch==11)
      {
        Resp_37_a = 0x24;
        Exit_37_a = 1;
        Break_Download = 1;
      }
      //东风小康
      else if(@AUTO::Config_Switch==9)
      {
        _SendFF01(phyID,0x22);
        Exit_36_a = 1;
      }
      return;
    }
    //故障注入：App 36数据传输中直接34请求
    if(@Faultinsert::TC_34_in_36_A==1)
    {
      Resp_34_a = 0x22;
      App_34(addr,length34);
      Exit_36_a = 1;
      return;
    }
    //故障注入：App 36数据未传输完发送FF 01
    if(@Faultinsert::TC_FF01_in_36A==1)
    {
      /*FF 01的响应 0:正响应 1:负响应*/
      if(Unnormal_FF01==1)
      {
        Resp_ff01 = 0x22;
      }
      else
      {
        PassState_31[0] = 0x01;
      }
      Exit_36_a = 1;
      _SendFF01(phyID,Resp_ff01);
      return;
    }
    /*可靠性测试：数据块传输中切断电源*/
    if(TC_PowerDown_In_36A==1)
    {
      _K30_OFF();
      testWaitForTimeout(10000);
      Exit_36_a = 1;
      _K30_ON();
      return;
    }
    /*可靠性测试：数据块传输中下点火*/
    if(TC_K15_In_36A==1)
    {
      _K15_OFF();
      testWaitForTimeout(10000);
      Exit_36_a = 1;
      _K15_ON();
      return;
    }
    /*可靠性测试：数据块传输中BusOff*/
    if(TC_BusOff_In_36A==1)
    {
      testWaitForTesterConfirmation("请制造BufOff故障",10000);
      testWaitForTimeout(10000);
      Exit_36_a = 1;
      testWaitForTesterConfirmation("请恢复故障",10000);
      return;
    }
  }
  //传输完成后，恢复电压
  if(@Faultinsert::TC_LowVolt_36_A==1 || @Faultinsert::TC_HighVolt_36_A==1)
  {
    @Prog_power::K30Volt = Normal_Volt;
    testWaitForTimeout(Volt_Time);
  }
}

/// <Geely3.0>
//Geely3.0 36传输App
void _Send36_App(struct Block hexBlock,dword cnt36,byte state)
{
  qword remain,isLastLine;
  byte dataBuffer_error[10];
  dword i;
  
  i = 0;
  cnt36 = countcnt3;
  Geely3_36_Status = 0;
  //故障注入：36数据块大小调整
  if(@Faultinsert::TC_BlockSize==1)
  {
    Blocksize_36 = @Test::Block_Size;
    //数据块大小 > 允许传输最大值
    if(Blocksize_36 > DataLengthmax_34 - 2)
    {
      Exit_36_a = 1;
    }
  }
  if(state==0)
  {
    for(i=0;i<=hexBlock.BlockDataLength;i+=Blocksize_36)
    {
      remain = hexBlock.BlockDataLength - i;
      cnt36 = (cnt36 + 1) & 0xFF;
//      countcnt3 = cnt36;
      //判断是否全部传输完
      if(i > Blocksize_36 && Exit_36_a == 1)
      {
        Break_Download = 1; //发送两次后直接退出，防止后续持续等待1s报文响应而报文数据过大导致异常
        return;
      }
      if(remain <= Blocksize_36)
      {
//        _SendData_app(hexBlock.dataBuffer,hexBlock.BlockDataLength,remain,cnt36,Resp_36_a);
          _SendData_app(hexBlock.dataBuffer,i,remain,cnt36,Resp_36_a);
        //故障注入：APP 36服务传输的数据多传输一块
        if(@Faultinsert::TC_Continue_36_A==1 && AddrNum == HexBlockTotalNumber_app)
        {
          cnt36 = (cnt36 + 1) & 0xFF;
          Resp_36_a = 0x31;
          _SendData_app(hexBlock.dataBuffer,i,remain,cnt36,Resp_36_a);
          Resp_36_a = -1;
        }
        break;
      }
      if(@Faultinsert::TC_LowVolt_36_A==1 && i != 1)
      {
        Resp_36_a = 0x24;
      }
      //故障注入：首次发送36 00
      if(@Faultinsert::TC_FirstBlockNum_A==1)
      {
        cnt36 -= 1;
        Resp_36_a = 0x73;
        _SendData_app(hexBlock.dataBuffer,i,Blocksize_36,cnt36,Resp_36_a);
        Exit_36_a = 1;
        return;
      }
      //故障注入：36数据块编号不连贯
      else if(@Faultinsert::TC_ErrorBlockNum_A==1 && cnt36==@Test::Block_Loc)
      {
        cnt36 = @Test::Block_Num;
        i = @Test::Block_Num - 1;
        if(@Test::Block_Num == @Test::Block_Loc - 1)
        {
          _SendData_app(hexBlock.dataBuffer,i,Blocksize_36,cnt36,Resp_36_a);
          @Faultinsert::TC_ErrorBlockNum_A = 0;
          countcnt3 = countcnt3-1;  //重复发送后内部countcnt3计数会多累加一次，重新进入后会导致前面的负载错误
        }
        else
        {
          Resp_36_a = 0x73;
          _SendData_app(hexBlock.dataBuffer,i,Blocksize_36,cnt36,Resp_36_a);
          Exit_36_a = 1;
          return;
        }
      }
      else
      {
        if(@Faultinsert::TC_Error_36_A==1)
        {
          PassState_31[0] = 0x10;
          PassState_31[1] = 0x04;
          
          if(@AUTO::Geely3_Config == 1) //P162
          {
             PassState_31[0] = 0x10;
             PassState_31[1] = 0;
          }
          _SendData_app(dataBuffer_error,i,Blocksize_36,cnt36,Resp_36_a);
        }
        /*36 01时传输错误数据*/
        else if(@Faultinsert::TC_Error_3601==1 && cnt36==1)
        {
          PassState_31[0] = 0x10;
          PassState_31[1] = 0x04;
          if(@AUTO::Geely3_Config == 1)
          {
            PassState_31[0] = 0x10;
            PassState_31[1] = 0x00;
          }
          _SendData_app(dataBuffer_error,i,Blocksize_36,cnt36,Resp_36_a);
        }
        else
          _SendData_app(hexBlock.dataBuffer,i,Blocksize_36,cnt36,Resp_36_a);
      }
      //故障注入：36传输过程中直接37退出
      if(@Faultinsert::TC_Exit_in_36_A==1)
      {
        Resp_37_a = 0x24;
//        Resp_0202_a = 0x24;
        PassState_31[1] = 0x06;
        Exit_0202_a = 1;
        if(@sysvar::AUTO::Geely3_Config == 1) //P162
          Resp_0202_a = 0x24;
        return;
      }
      isLastLine = i;
    }
  }
  else if(state==1 && Exit_36_a == 0)
  {
    for(i=0;i<=hexBlock.BlockVbtDataLength;i+=Blocksize_36)
    {
      cnt36 = (cnt36 + 1) & 0xFF;
      remain = hexBlock.BlockVbtDataLength - i;
      //判断是否传输完成
      if(remain <= Blocksize_36)
      {
        _SendData_app(hexBlock.dataVbtBuffer,i,remain,cnt36,Resp_36_a);

        //故障注入：APP 36服务传输的数据多传输一块
        if(@Faultinsert::TC_Continue_36_A==1)
        {
          cnt36 = (cnt36 + 1) & 0xFF;
          Resp_36_a = 0x31;
          _SendData_app(hexBlock.dataBuffer,i,remain,cnt36,Resp_36_a);
          Resp_36_a = -1;
        }
        break;
      }
      _SendData_app(hexBlock.dataVbtBuffer,i,Blocksize_36,cnt36,Resp_36_a);
      isLastLine = i;
    }
  }
  Geely3_36_Status = 1;
  remain = 0;
  isLastLine = 0;
}

/*[流式改造-2026-09]_Send36_App 的流式版本:数据按页从 bin 文件读取,不再依赖整段 dataBuffer。
  故障注入逻辑与原 _Send36_App(struct Block,...) 一致;差异:TC_ErrorBlockNum_A 重发时文件不可回退,
  改用当前页 buffer 重发,块编号不连贯的测试目的仍可满足。仅实现 state==0(APP 数据),广汽 bin 无 Vbt。*/
void _Send36_App_stream(dword fileHandle,dword blockDataLength,dword cnt36,byte state)
{
  qword remain,isLastLine;
  byte dataBuffer_error[10];
  dword i,pageSize,readLen,Re_Time;
  int Pass_CRC;
  
  i = 0;
  Re_Time = 0;Pass_CRC = 0;
  cnt36 = countcnt3;
  Geely3_36_Status = 0;
  //故障注入：36数据块大小调整
  if(@Faultinsert::TC_BlockSize==1)
  {
    Blocksize_36 = @Test::Block_Size;
    if(Blocksize_36 > DataLengthmax_34 - 2)
      Exit_36_a = 1;
  }
  if(state==0)
  {
    for(i=0;i<=blockDataLength;i+=Blocksize_36)
    {
      remain = blockDataLength - i;
      cnt36 = (cnt36 + 1) & 0xFF;
      if(i > Blocksize_36 && Exit_36_a == 1)
      {
        Break_Download = 1;
        return;
      }
      if(remain <= Blocksize_36)
      {
        //最后一页:按剩余长度读取并发送
        pageSize = remain;
        readLen = BinFile_ReadPage(fileHandle,hexfile_app[0].dataBuffer,pageSize);
        /*0000开关:Padding_Zero=0关闭填充时,文件实际数据不足,按实际读取长度发送并累加CRC;
          =1开启填充时,数据不足部分自动补0按声明长度发送(原行为)*/
        if(@AUTO::Padding_Zero == 0)
        {
          if(readLen < pageSize)
            pageSize = readLen;
          if(pageSize == 0)
            break;
        }
        _SendData_app(hexfile_app[0].dataBuffer,0,pageSize,cnt36,Resp_36_a);
        if(@Faultinsert::TC_Continue_36_A==1 && AddrNum == HexBlockTotalNumber_app)
        {
          cnt36 = (cnt36 + 1) & 0xFF;
          Resp_36_a = 0x31;
          _SendData_app(hexfile_app[0].dataBuffer,0,pageSize,cnt36,Resp_36_a);
          Resp_36_a = -1;
        }
        calcrc32 = _caculateCrc32_1(calcrc32,hexfile_app[0].dataBuffer,pageSize);
        break;
      }
      if(@Faultinsert::TC_LowVolt_36_A==1 && i != 1)
        Resp_36_a = 0x24;
      //按页从文件流式读取到单页缓冲
      if((@Faultinsert::TC_ErrorBlockNum_A==1 && cnt36==@Test::Block_Loc) || (@Faultinsert::TC_Re_BlockNum_A==1 && cnt36 ==@Test::Block_Num && Re_Time != 0))
      {
        Pass_CRC = 1;
        //跳过读取
        if(GAC_3601_03 == 1)//针对36 01后发送36 03情况，做两次读取进行跳过02数据块
        {
          readLen = BinFile_ReadPage(fileHandle,hexfile_app[0].dataBuffer,Blocksize_36);
          readLen = BinFile_ReadPage(fileHandle,hexfile_app[0].dataBuffer,Blocksize_36);
        }
        if(GAC_3602_01 == 1)//针对36 02后发送36 01情况
        {
          int Temp;
          BinFile_CloseStream(1);
          Temp = BinFile_OpenStream(1);
          readLen = BinFile_ReadPage(fileHandle,hexfile_app[0].dataBuffer,Blocksize_36);
        }
      }
      else
      {
        Pass_CRC = 0;
        readLen = BinFile_ReadPage(fileHandle,hexfile_app[0].dataBuffer,Blocksize_36);
      }
      /*0000开关:Padding_Zero=0关闭填充时,文件实际数据不足,按实际读取长度发送并结束,不再补0*/
      if(@AUTO::Padding_Zero == 0 && readLen < Blocksize_36)
      {
        if(readLen > 0)
        {
          _SendData_app(hexfile_app[0].dataBuffer,0,readLen,cnt36,Resp_36_a);
          calcrc32 = _caculateCrc32_1(calcrc32,hexfile_app[0].dataBuffer,readLen);
        }
        break;
      }
      //故障注入：首次发送36 00
      if(@Faultinsert::TC_FirstBlockNum_A==1)
      {
        cnt36 -= 1;
        Resp_36_a = 0x73;
        _SendData_app(hexfile_app[0].dataBuffer,0,Blocksize_36,cnt36,Resp_36_a);
        Exit_36_a = 1;
        return;
      }
      //故障注入：36数据块编号不连贯
      else if(@Faultinsert::TC_ErrorBlockNum_A==1 && cnt36==@Test::Block_Loc)
      {
        cnt36 = @Test::Block_Num;
        i = @Test::Block_Num - 1;
        if(@Test::Block_Num == @Test::Block_Loc - 1)
        {
          _SendData_app(hexfile_app[0].dataBuffer,0,Blocksize_36,cnt36,Resp_36_a);
          @Faultinsert::TC_ErrorBlockNum_A = 0;
          countcnt3 = countcnt3-1;
        }
        else
        {
          Resp_36_a = 0x73;
          _SendData_app(hexfile_app[0].dataBuffer,0,Blocksize_36,cnt36,Resp_36_a);
          Exit_36_a = 1;
          return;
        }
      }//故障注入：连续重复发送相同编号数据块
      else if(@Faultinsert::TC_Re_BlockNum_A==1 && cnt36 ==@Test::Block_Num)
      {
        dword temp_count;
        i = @Test::Block_Num - 1;
        Re_Time++;
        writeEx(-3,1,"第%d次重复发送36第%d块数据块",Re_Time,@Test::Block_Num);
        //当前重复次数大于最大重复次数
        if(Re_Time > ReBlocknum_max)
          Resp_36_a = 0x71;
        temp_count = @Test::Block_Num;
        _SendData_app(hexfile_app[0].dataBuffer,0,Blocksize_36,temp_count,Resp_36_a);
        
        if(Re_Time < @Test::Re_BlockTime)
          cnt36--;
        //当前重复次数达到预期重复次数
        else if(Re_Time == @Test::Re_BlockTime)
        {
          //预期重复次数大于最大重复次数
          if(@Test::Re_BlockTime > ReBlocknum_max)
          {
            Exit_36_a = 1;
            return;
          }
          //预期重复次数小于最大重复次数
          else
            @Faultinsert::TC_Re_BlockNum_A = 0;
        }
      }
      else
      {
        if(@Faultinsert::TC_Error_36_A==1)
        {
          PassState_31[0] = 0x10;
          PassState_31[1] = 0x04;
          if(@AUTO::Geely3_Config == 1)
          {
            PassState_31[0] = 0x10;
            PassState_31[1] = 0;
          }
          _SendData_app(dataBuffer_error,0,Blocksize_36,cnt36,Resp_36_a);
        }
        else if(@Faultinsert::TC_Error_3601==1 && cnt36==1)
        {
          PassState_31[0] = 0x10;
          PassState_31[1] = 0x04;
          if(@AUTO::Geely3_Config == 1)
          {
            PassState_31[0] = 0x10;
            PassState_31[1] = 0x00;
          }
          _SendData_app(dataBuffer_error,0,Blocksize_36,cnt36,Resp_36_a);
        }
        else
          _SendData_app(hexfile_app[0].dataBuffer,0,Blocksize_36,cnt36,Resp_36_a);
      }
      //逐页累加 CRC32(替代原整段一次性计算)
      if(Pass_CRC == 1)
      {
        //跳过读取时同步跳过校验
      }
      else
        calcrc32 = _caculateCrc32_1(calcrc32,hexfile_app[0].dataBuffer,Blocksize_36);
      //故障注入：36传输过程中直接37退出
      if(@Faultinsert::TC_Exit_in_36_A==1)
      {
        Resp_37_a = 0x24;
        PassState_31[1] = 0x06;
        Exit_0202_a = 1;
        if(@sysvar::AUTO::Geely3_Config == 1)
          Resp_0202_a = 0x24;
        return;
      }
      isLastLine = i;
    }
  }
  Geely3_36_Status = 1;
  remain = 0;
  isLastLine = 0;
}

void _SendData_app(byte dataBuffer[],qword endPos,qword length,dword cnt,int Passcondition)
{
  diagRequest ABS_ESP.Download_Transmit req36;
  qword sendPos;
  diagResize(req36,length+2);
  DiagSetPrimitiveByte(req36,1,cnt & 0xFF);
//  if(AddrNum < HexBlockTotalNumber_app)
//    if(hexfile_app[AddrNum + 1].BlockDataLength > (Blocksize_36 - length))
//    {
//      diagResize(req36,Blocksize_36 + 2);  
//    }
  for(sendPos=endPos;sendPos<endPos+length;sendPos++)
  {
    if(sendPos>=elCount(dataBuffer))
      DiagSetPrimitiveByte(req36,sendPos-endPos+2,0);
    else
      DiagSetPrimitiveByte(req36,sendPos-endPos+2,dataBuffer[sendPos]);
  }
  countcnt3++;
  _diagSendMsg(phyID,req36);
  _get_FC(req36,phyID,stepid,Passcondition);
}

//数据下载
//参数req36:服务请求;
//参数length:下载数据时每个块的数据长度最大值
//参数count:数据块的编号
//参数msgID:{phyID:物理寻址,funID:功能寻址}
//参数Passcondition:{-1:期望收到积极响应,0:期望不收到响应,>0:期望收到的NRC}
void _Senddata(diagRequest* req36,word length,word count,byte data[],dword msgID,int Passcondition)
{
  word i;
  byte cnt;
  char comment[30];
  cnt=(byte)count;
  
  diagResize(req36,length+2);
  DiagSetPrimitiveByte(req36,1,cnt);
  //故障注入：36传输首个数据块编号不为1
  if(count==0)
    count = 1;
  //故障注入：36下载完成后继续发送一个数据块
  if((@Faultinsert::TC_Continue_36_A==1||@Faultinsert::TC_Continue_36_F==1) && END_Pos == 1)
  {
    count--;
    END_Pos--;
  }
  for(i=0;i<length;i++)
  {
    DiagSetPrimitiveByte(req36,i+2,data[Blocksize_36*(count-1)+i]);
  }
  _diagSendMsg(msgID,req36);
  //故障注入：36下载数据过程中功能寻址握手
  if(@Faultinsert::TC_Handshake_in_36_A==1 && Down_f_a == 1 && count !=1)
  {
    _handshake(funID);
    Down_f_a = -1;
  }
  _get_FC(req36,phyID,stepid,Passcondition);
}
/*合并地址段流式36发送:_Senddata的合并版,使用显式offset索引data36,
  解耦块号(绝对,跨段连续)与数据偏移(段内相对),使data36仅缓存单段数据*/
void _Senddata_merge(diagRequest* req36,word length,word count,byte data[],dword offset,dword msgID,int Passcondition)
{
  word i;
  byte cnt;
  char comment[30];
  cnt=(byte)count;
  diagResize(req36,length+2);
  DiagSetPrimitiveByte(req36,1,cnt);
  if(count==0)
    count = 1;
  for(i=0;i<length;i++)
  {
    DiagSetPrimitiveByte(req36,i+2,data[offset+i]);
  }
  _diagSendMsg(msgID,req36);
  if(@Faultinsert::TC_Handshake_in_36_A==1 && Down_f_a == 1 && count !=1)
  {
    _handshake(funID);
    Down_f_a = -1;
  }
  _get_FC(req36,phyID,stepid,Passcondition);
}
//参数req36:服务请求;
//参数length:下载数据时每个块的数据长度最大值
//参数count:数据块的编号
//参数msgID:{phyID:物理寻址,funID:功能寻址}
//参数Passcondition:{-1:期望收到积极响应,0:期望不收到响应,>0:期望收到的NRC}
void _Senddata1(diagRequest* req36,word length,word count,byte data[],dword msgID,int Passcondition)
{
  word i;
  byte cnt;
  char comment[30];
  cnt=(byte)count;
  diagResize(req36,length+2);
  DiagSetPrimitiveByte(req36,1,cnt);
  //故障注入：36传输首个数据块编号不为1
  if(count==0)
  {
    countcnt2 = 1;
  }
  //故障注入：36下载完成后继续发送一个数据块
  if(@Faultinsert::TC_Continue_36_A==1 && END_Pos > 0 && ((length34-Blocksize_36*(countcnt2-1)) <= Blocksize_36))
  {
//    if(END_Pos == 1)
////      countcnt2 = 1;
    END_Pos--;
  }
//  writeEx(-3,0,"Blocksize_36 = %X  countcnt2 = %d  count = %d",Blocksize_36,countcnt2,count);
  for(i=0;i<length;i++)
  {
    DiagSetPrimitiveByte(req36,i+2,data[Blocksize_36*(countcnt2-1)+i]);
  }
  _diagSendMsg(msgID,req36);
  //故障注入：36下载数据过程中功能寻址握手
  if(@Faultinsert::TC_Handshake_in_36_A==1 && Down_f_a == 1 && count !=1)
  {
    _handshake(funID);
    Down_f_a = -1;
  }
  _get_FC(req36,phyID,stepid,Passcondition);
}
//SBT 36传输数据
//参数dataBuffer:数据数组;
//参数endPos:传输数据的起始地址
//参数length:数据块的长度
//参数cnt:数据块编号
void _SendData_SBT(byte dataBuffer[],qword startPos,qword length,word cnt)
{
  diagRequest ABS_ESP.Download_Transmit req36;
  qword sendPos;
  
  diagResize(req36,length+2);
  DiagSetPrimitiveByte(req36,1,cnt & 0xFF);
  
  for(sendPos=startPos;sendPos<startPos+length;sendPos++)
  {
//    DiagSetPrimitiveByte(req36,sendPos-endPos+2,dataBuffer[sendPos-length]); //原来
    if(sendPos>=elCount(dataBuffer))
      DiagSetPrimitiveByte(req36,sendPos-startPos+2,0);
    else
      DiagSetPrimitiveByte(req36,sendPos-startPos+2,dataBuffer[sendPos]);//修复后
  }
  _diagSendMsg(phyID,req36);
  _get_FC(req36,phyID,stepid,Resp_36_f);
}

//SBT 37退出传输服务
void SBT_37(int State)
{
  stepnum++;
  snprintf(stepid,elCount(stepid),"步骤%02d",stepnum);
  testStep(stepid,"开始测试SBT 37退出数据传输");
  
  //故障注入：步骤缺失Flash 37请求
  if(@Faultinsert::TC_Miss_37_F==1 && State == 1)
  {
//    Resp_34_f = 0x70;
//    Exit_34_f = 1;
    return;
  }
  else
    _Send37(phyID,Resp_37_f);
}

//驱动下载完成后退出
void FlashDriver_37()
{
  diagRequest ABS_ESP.Download_Stop req37;
  dword crc32;
  stepnum++;
  snprintf(stepid,elCount(stepid),"步骤%02d：测试37服务Flash退出下载",stepnum);
 
  //故障注入：步骤缺失Flash 37请求
  if(@Faultinsert::TC_Miss_37_F==1)
  {
    //奇瑞
    if(@AUTO::Config_Switch==7)
    {
      Resp_ff00 = 0x72;
      Exit_37_f = 0;
      Exit_ff00 = 1;
    }
    else
    {
      Resp_0202_f = 0x22;
      Exit_37_f = 0;
      Exit_0202_f = 1;
    }
  }
  //东风小康,CRC32校验值在37发送
  else if(@AUTO::Config_Switch==9)
  {
    diagResize(req37,5);
    crc32=_caculateCrc32(Z65H,elCount(Z65H));
    crc32 = crc32^0xFFFFFFFF;
    //故障注入：Flash 37的CRC校验错误
    if(@Faultinsert::TC_Error_0202_F==1)
    {
      crc32 = crc32^0x00000000;
      PassState_31[0] = 0x01;
      Resp_ff00 = 0x22;
      Exit_ff00 = 1;
    }
    DiagSetPrimitiveByte(req37,1,crc32 >> 24 & 0xFF);
    DiagSetPrimitiveByte(req37,2,crc32 >> 16 & 0xFF);
    DiagSetPrimitiveByte(req37,3,crc32 >> 8 & 0xFF);
    DiagSetPrimitiveByte(req37,4,crc32 & 0xFF);
    
    _diagSendMsg(phyID,req37);
    _get_FC(req37,phyID,stepid,Resp_37_f);
  }
  else
    _Send37(phyID,Resp_37_f);
  //故障注入：小康 不执行Flash 0202和整个APP下载流程
  if(@Faultinsert::TC_37F_FF01==1)
  {
    _SendFF01(phyID,0x22);
    Exit_37_f = 1;
  }
}
//App数据下载完成后退出
void App_37()
{
  diagRequest ABS_ESP.Download_Stop req37;
  dword crc32;
  stepnum++;
  snprintf(stepid,elCount(stepid),"步骤%02d：测试37服务APP退出下载",stepnum);
  
  //故障注入：步骤缺失App 37请求
  if(@Faultinsert::TC_Miss_37_A==1)
  {
    //Geely3.0
    if(@AUTO::Config_Switch==4)
    {
      PassState_31[1] = 0x06;
      Exit_0202_a = 1;
      Exit_37_a = 0;
      Break_Download = 1;
      if(@AUTO::Geely3_Config == 1)
      {
        Resp_34_a = 0x70;
        Resp_36_a = 0x31;
        Resp_0202_a = 0x24;
      }
    }
    //奇瑞
    else if(@AUTO::Config_Switch==7)
    {
      //34、36、37全部缺失
      if(@Faultinsert::TC_Miss_34_A==1 && @Faultinsert::TC_Miss_36_A==1)
      {
        Resp_ff01 = 0x22;
        Exit_ff01 = 1;
        Exit_37_a = 0;
        Break_Download = 1;
      }
      else
      {
        Resp_34_a = 0x22;
        Exit_34_a = 1;
        Exit_37_a = 0;
      }
    }
    //东风小康
    else if(@AUTO::Config_Switch==9)
    {
      Resp_ff01 = 0x22;
      Resp_14 = 0x11;
      Exit_ff01 = 1;
      Exit_37_a = 0;
      Break_Download = 1;
    }
    //BYD || ChangAn || Geely1.0 || 鑫源 || 瑞驰 || 五菱 || 赛力斯
    else
    {
      Resp_0202_a = 0x22;
      Exit_0202_a = 1;
      Exit_37_a = 0;
      Break_Download = 1;
    }
    return;
  }
  //故障注入：请求37时报文数据过长
  else if(@Faultinsert::TC_ErrorLength_37_A==1)
  {
    diagResize(req37,0x03);
    Resp_37_a = 0x13;
    Exit_37_a = 1;
//    _SendAndWriteReport(req37,phyID);
//    _TestResult(req37,stepid,Resp_37_a);
    _diagSendMsg(phyID,req37);
    _get_FC(req37,phyID,stepid,Resp_37_a);
    Resp_37_a = 0x22;
  }
  
  //东风小康 37发送 CRC校验值
  if(@AUTO::Config_Switch==9)
  {
    diagResize(req37,5);
//    crc32=_caculateCrc32(data36,length34);
//    crc32 = crc32^0xFFFFFFFF;
    crc32 = calcrc32;
//    write("crc32 = %x",crc32);
    DiagSetPrimitiveByte(req37,1,crc32 >> 24 & 0xFF);
    DiagSetPrimitiveByte(req37,2,crc32 >> 16 & 0xFF);
    DiagSetPrimitiveByte(req37,3,crc32 >> 8 & 0xFF);
    DiagSetPrimitiveByte(req37,4,crc32 & 0xFF);
    
    _diagSendMsg(phyID,req37);
    _get_FC(req37,phyID,stepid,Resp_37_f);
  }
  else
    _Send37(phyID,Resp_37_a);
}
//退出下载
//参数msgID:{phyID:物理寻址,funID:功能寻址}
//参数Passcondition:{-1:期望收到积极响应,0:期望不收到响应,>0:期望收到的NRC}
void _Send37(dword msgID,int Passcondition)
{
  diagRequest ABS_ESP.Download_Stop req37;
  
  _diagSendMsg(msgID,req37);
//  writeEx(-3,1,"检测37响应是否为NRC:%x",Passcondition);
  _get_FC(req37,phyID,stepid,Passcondition);
}
//FlashDriver 数据校验
void FlashDriver_0202()
{
  stepnum++;
  snprintf(stepid,elCount(stepid),"步骤%02d：测试31服务Flash完整性校验",stepnum);
  //不同驱动
  if(@AUTO::FlashDriver_Switch==1)//J80J3_F
  {
    _Send0202_f(J80J3_F,elCount(J80J3_F),phyID,Resp_0202_f);
  }
  else if(@AUTO::FlashDriver_Switch==2)//J80J3-A
  {
    _Send0202_f(J80J3_A,elCount(J80J3_A),phyID,Resp_0202_f);
  }
  else if(@AUTO::FlashDriver_Switch==3)//J80J3-B
  {
    _Send0202_f(J80J3_B,elCount(J80J3_B),phyID,Resp_0202_f);
  }
  else if(@AUTO::FlashDriver_Switch==4)//Z65-H
  {
    _Send0202_f(Z65H,elCount(Z65H),phyID,Resp_0202_f);
  }
}

//SBT 31 01 02 12签名校验
//参数msgID:{phyID:物理寻址,funID:功能寻址}
//参数FileNum:{0:驱动,1:APP1,2:APP2,3:APP3,4:APP4}
//参数Passcondition:{-1:期望收到积极响应,0:期望不收到响应,>0:期望收到的NRC}
void _Send0212_F(dword msgID,int FileNum,int Passcondition)
{
  diagRequest ABS_ESP.Check_Memory_Start req0212;
  word toInt[256];
  dword i;
  i = 0;
  //设置报文属性
  diagResize(req0212,0x104);
  DiagSetPrimitiveByte(req0212,0,0x31);
  DiagSetPrimitiveByte(req0212,1,0x01);
  DiagSetPrimitiveByte(req0212,2,0x02);
  DiagSetPrimitiveByte(req0212,3,0x12);
  digitalSignature(toInt,FileNum);
  
  /*故障注入：SBT 0212错误的签名校验*/
  if(@Faultinsert::TC_Error_0202_F==1)
  {
    PassState_31[1] = 0x01;
    Resp_0301 = 0x22;
    Exit_0301 = 1;
    for(i=4;i<0x104;i++)
    {
      DiagSetPrimitiveByte(req0212,i,i);
    }
  }
  else
  {
    for(i=4;i<0x104;i++)
    {
      DiagSetPrimitiveByte(req0212,i,toInt[i-4]);
    }
  }
  
  /*故障注入：SBT 0212过程中中功能寻址握手*/
  if(@Faultinsert::TC_Handshake_in_0202F==1)
  {
    _diagSendMsg(msgID,req0212);
//    testWaitForMessage(msgID,1000);
    testWaitForDiagRequestSent(req0212,1000);
    _handshake(funID);
    _get_FC(req0212,msgID,stepid,Passcondition);
  }
  /*故障注入：SBT 0212后物理寻址复位11 01*/
  else if(@Faultinsert::TC_Restart_after_0202F==1)
  {
    _diagSendMsg(msgID,req0212);
    _get_FC(req0212,msgID,stepid,Passcondition);
    _Startreset(phyID,0x01,Resp_11);
    Resp_0301 = 0x31;
    Exit_0301 = 1;
  }
  /*故障注入：SBT 0212后功能寻址切换默认会话10 01*/
  else if(@Faultinsert::TC_DefaultSession_after_0202F==1)
  {
    _diagSendMsg(msgID,req0212);
    _get_FC(req0212,msgID,stepid,Passcondition);
    enterDefault(funID,0,Resp_1001);
    testWaitForTimeout(Restart_Time);
    Resp_0301 = 0x31;
    Exit_0301 = 1;
  }
  /*故障注入：步骤缺失 SBT 0212签名校验*/
  else if(@Faultinsert::TC_Miss_0202_F==1)
  {
    Resp_0301 = 0x22;
    Exit_0301 = 1;
    return;
  }
  /*故障注入：SBT 0212第一次发送错误签名，第二次发送正确签名*/
  else if(@Faultinsert::TC_FirstError_0202F==1)
  {
    /*第一次发送错误签名*/
    PassState_31[1] = 0x01;
    for(i=4;i<0x104;i++)
    {
      DiagSetPrimitiveByte(req0212,i,i);
    }
    _diagSendMsg(msgID,req0212);
    _get_FC(req0212,msgID,stepid,Passcondition);
    testWaitForTimeout(100);
    /*第二次发送正确签名*/
    PassState_31[1] = 0x00;
    for(i=4;i<0x104;i++)
    {
      DiagSetPrimitiveByte(req0212,i,toInt[i-4]);
    }
    _diagSendMsg(msgID,req0212);
    _get_FC(req0212,msgID,stepid,Passcondition);
    Exit_0202_f = 1;
  }
  else
  {
    _diagSendMsg(msgID,req0212);
    _get_FC(req0212,msgID,stepid,Passcondition);
  }
}
//APP 31 01 02 12签名校验
//参数msgID:{phyID:物理寻址,funID:功能寻址}
//参数FileNum:{0:驱动,1:APP1,2:APP2,3:APP3,4:APP4}
//参数Passcondition:{-1:期望收到积极响应,0:期望不收到响应,>0:期望收到的NRC}
void _Send0212_A(dword msgID,int FileNum,int Passcondition)
{
  diagRequest ABS_ESP.Check_Memory_Start req0212;
  word toInt[256];
  dword i;
  i = 0;
  //设置报文属性
  diagResize(req0212,0x104);
  DiagSetPrimitiveByte(req0212,0,0x31);
  DiagSetPrimitiveByte(req0212,1,0x01);
  DiagSetPrimitiveByte(req0212,2,0x02);
  DiagSetPrimitiveByte(req0212,3,0x12);
  digitalSignature(toInt,FileNum);
  
  //故障注入：步骤缺失 APP 02 12签名校验
  if(@Faultinsert::TC_Miss_0202_A==1)
  {
    PassState_31[1] = 0x41;
    Exit_0205 = 1;
    if(@AUTO::Geely3_Config == 1)
    {
      Resp_ff00 = 0x24;
      Resp_34_a = 0x70;
      Resp_36_a = 0x24;
      Resp_37_a = 0x24;
    }
    return;
  }
  //故障注入：APP 02 12错误校验发送无效签名
  if(@Faultinsert::TC_Error_0202_A==1)
  {
    PassState_31[1] = 0x01;
    Resp_0205 = 0x22;
    Exit_0205 = 1;
    Resp_ff00 = 0x24;
    Resp_34_a = 0x70;
    Resp_36_a = 0x24;
    Resp_37_a = 0x24;
    for(i=4;i<0x104;i++)
    {
      DiagSetPrimitiveByte(req0212,i,i);
    }
  }
  else
  {
    for(i=4;i<0x104;i++)
    {
      DiagSetPrimitiveByte(req0212,i,toInt[i-4]);
    }
  }
  
  //故障注入：APP 02 12校验过程中功能寻址握手
  if(@Faultinsert::TC_Handshake_in_0202A==1)
  {
    _diagSendMsg(msgID,req0212);
    testWaitForDiagRequestSent(req0212,1000);
    _handshake(funID);
    _get_FC(req0212,msgID,stepid,Passcondition);
    testWaitForTimeout(4000);
  }
  //故障注入：APP 02 12校验后物理寻址复位11 01
  else if(@Faultinsert::TC_Restart_after_0202A==1)
  {
    _diagSendMsg(msgID,req0212);
    _get_FC(req0212,msgID,stepid,Passcondition);
    _Startreset(phyID,0x01,Resp_11);
    Resp_ff00 = 0x31;//7F;
    Exit_ff00 = 1;
  }
  //故障注入：APP 02 12校验后功能寻址切换默认会话
  else if(@Faultinsert::TC_DefaultSession_after_0202A==1)
  {
    _diagSendMsg(msgID,req0212);
    _get_FC(req0212,msgID,stepid,Passcondition);
    enterDefault(funID,0,Resp_1001);
    testWaitForTimeout(Restart_Time);
    Resp_ff00 = 0x31; //0x7F
    Exit_ff00 = 1;
  }
  //故障注入：连续请求两次APP 02 12
  else if(@Faultinsert::TC_Re_0202A==1)
  {
    _diagSendMsg(msgID,req0212);
    _get_FC(req0212,msgID,stepid,Passcondition);
    Passcondition = 0x22;
    if(@AUTO::Config_Switch==4 && @AUTO::Geely3_Config == 1) //P162
    {
      Passcondition = 0x24;
    }
    testWaitForTimeout(100);
    _diagSendMsg(msgID,req0212);
    _get_FC(req0212,msgID,stepid,Passcondition);
  }
  //故障注入：第一次发送错误签名，第二次发送正确签名
  else if(@Faultinsert::TC_FirstError_0202A==1)
  {
    /*第一次发送错误签名*/
    PassState_31[1] = 0x01;
    for(i=4;i<0x104;i++)
    {
      DiagSetPrimitiveByte(req0212,i,i);
    }
    _diagSendMsg(msgID,req0212);
    _get_FC(req0212,msgID,stepid,Passcondition);
    testWaitForTimeout(100);
    /*第二次发送正确签名*/
    PassState_31[1] = 0x00;
    for(i=4;i<0x104;i++)
    {
      DiagSetPrimitiveByte(req0212,i,toInt[i-4]);
    }
    _diagSendMsg(msgID,req0212);
    _get_FC(req0212,msgID,stepid,Passcondition);
    Exit_0202_a = 1;
  }
//  else if((@Faultinsert::TC_ErrorDataFormatId_App==1 || @Faultinsert::TC_ErrorAddrAndLenId_App==1 || @Faultinsert::TC_ErrorAddrSize_App == 1 || @Faultinsert::TC_ErrorAddr_App ==1 || Geely3_36_Status == 0) && @AUTO::Config_Switch==4) //同时存在NRC24以及正响应06结果情况下均通过
//  {
//    _diagSendMsg(msgID,req0212);
//    testWaitForDiagResponse(req0212,p2cmax);
//    if(diagGetLastResponseCode(req0212) == 0 || diagGetLastResponseCode(req0212) == 0x78)
//      testWaitForDiagResponse(req0212,1000);
//    if(diagGetLastResponseCode(req0212) == 0)
//      testStepFail("","未收到应答");
//    else if(diagGetLastResponseCode(req0212) == 0x24)
//      testStepPass("","31 01 02 12收到反馈与期望一致");
//    else if(diagGetLastResponseCode(req0212) == -1)
//    {
//      if(DiagGetRespPrimitiveByte(req0212,5) == PassState_31[1])
//        testStepPass("","31 01 02 12收到反馈与期望一致");
//      else
//        testStepFail("","31 01 02 12收到反馈与期望不符");
//    }
//    else
//      testStepFail("","31 01 02 12收到反馈与期望不符");
//  }
  else
  {
    _diagSendMsg(msgID,req0212);
    _get_FC(req0212,msgID,stepid,Passcondition);
  }
}

//下载Flash驱动后校验
//参数data36:下载的数据数组及需要校验的值
//参数length34:下载数据的数组长度
//参数msgID:{phyID:物理寻址,funID:功能寻址}
//参数Passcondition:{-1:期望收到积极响应,0:期望不收到响应,>0:期望收到的NRC}
void _Send0202_f(byte data36[],dword length34,dword msgID,int Passcondition)
{
  diagRequest ABS_ESP.Check_Memory_Start req0202;
  diagRequest ABS_ESP.hardReset_Reset req1101;
  diagRequest ABS_ESP.DefaultSession_Start req1001;
  dword crc32;
  int i;
  
  //计算CRC32校验值
  crc32=_caculateCrc32(data36,length34);
  crc32 = crc32^0xFFFFFFFF;
  //设置诊断字节
  diagResize(req0202,8);
  DiagSetPrimitiveByte(req0202,0,0x31);
  DiagSetPrimitiveByte(req0202,1,0x01);
  DiagSetPrimitiveByte(req0202,2,0x02);
  DiagSetPrimitiveByte(req0202,3,0x02);
  DiagSetPrimitiveByte(req0202,4,crc32 >> 24);
  DiagSetPrimitiveByte(req0202,5,crc32 >> 16 & 0xFF);
  DiagSetPrimitiveByte(req0202,6,crc32 >> 8 & 0xFF);
  DiagSetPrimitiveByte(req0202,7,crc32 & 0xFF);
  
  //不同主机厂，规范不同
  //CA
  if(@AUTO::Config_Switch==2)
  {
    DiagSetPrimitiveByte(req0202,4,DriverAddr >> 24);
    DiagSetPrimitiveByte(req0202,5,DriverAddr >> 16 & 0xFF);
    DiagSetPrimitiveByte(req0202,6,DriverAddr >> 8 & 0xFF);
    DiagSetPrimitiveByte(req0202,7,DriverAddr & 0xFF);
  }
  //鑫源 31 01 02 01
  if(@AUTO::Config_Switch==5)
  {
    DiagSetPrimitiveByte(req0202,3,0x01);
  }
  //瑞驰 31 01 F0 01
  if(@AUTO::Config_Switch==6)
  {
    DiagSetPrimitiveByte(req0202,2,0xF0);
    DiagSetPrimitiveByte(req0202,3,0x01);
  }
  //五菱 31 01 DF FF
  if(@AUTO::Config_Switch==8)
  {
    DiagSetPrimitiveByte(req0202,2,0xDF);
    DiagSetPrimitiveByte(req0202,3,0xFF);
  }
  //东风小康 / V8  31 01 02 02
  if(@AUTO::Config_Switch==9 || @AUTO::Config_Switch==13)
  {
    diagResize(req0202,4);
  }
  //赛力斯 31 01 DD 02
  if(@AUTO::Config_Switch==10)
  {
    diagResize(req0202,4);
    DiagSetPrimitiveByte(req0202,2,0xDD);
    DiagSetPrimitiveByte(req0202,3,0x02);
  }
  //奇瑞 T1V 31 01 DD 02
  if(@AUTO::Config_Switch==11)
  {
    int i;
    diagResize(req0202,0x184);
    DiagSetPrimitiveByte(req0202,2,0xDD);
    DiagSetPrimitiveByte(req0202,3,0x02);
    for(i=0;i<RSALen;i++)
      DiagSetPrimitiveByte(req0202,i+4,RSAData[i]);
  }
  //故障注入：驱动校验CRC错误
  if(@Faultinsert::TC_Error_0202_F==1)
  {
    DiagSetPrimitiveByte(req0202,4,0xFF);
    DiagSetPrimitiveByte(req0202,5,0xFF);
    DiagSetPrimitiveByte(req0202,6,0xFF);
    DiagSetPrimitiveByte(req0202,7,0xFF);
    if(@AUTO::Config_Switch==1 || @AUTO::Config_Switch==6 || @AUTO::Config_Switch==8  )//BYD || 瑞驰 || 五菱 
    {
      PassState_31[0] = 0x01;
      Exit_0202_f = 1;
    }
    else if(@AUTO::Config_Switch==2)//ChangAn
    {
      Passcondition = 0x31;
      Exit_0202_f = 1;
    }
    else if(@AUTO::Config_Switch==3)//Geely1.0
    {
      PassState_31[0] = 0x05;
    }
    else if(@AUTO::Config_Switch==5)//鑫源
    {
      PassState_31[0] = 0x05;
      Exit_0202_f = 1;
    }
    else if(@AUTO::Config_Switch==11)//奇瑞T1V
    {
      for(i=4;i<RSALen;i++)
        DiagSetPrimitiveByte(req0202,i,0);
      PassState_31[0] = 0x06;
      Exit_0202_f = 1;
    }
    else //默认
    {
      PassState_31[0] = 0x01;
      Exit_0202_f = 1;
    }
    _diagSendMsg(msgID,req0202);
    testWaitForDiagRequestSent(req0202,1000);
    testWaitForDiagResponse(req0202,p2cmax);
    _TestResult(req0202,"0202",Passcondition);
  }
  //故障注入：驱动校验过程中功能寻址握手
  else if(@Faultinsert::TC_Handshake_in_0202F)
  {
    _diagSendMsg(msgID,req0202);
    testWaitForDiagRequestSent(req0202,1000);
    _handshake(funID);
    _get_FC(req0202,msgID,"0202",Passcondition);
    testWaitForTimeout(4000);
  }
  //故障注入：驱动校验后功能寻址复位11 01
  else if(@Faultinsert::TC_Restart_after_0202F)
  {
    _diagSendMsg(msgID,req0202);
    testWaitForDiagRequestSent(req0202,1000);
    testWaitForDiagResponse(req0202,p2cmax);
    _TestResult(req0202,"0202",Passcondition);
    if(@AUTO::Config_Switch==1)//BYD
    {
      _Startreset(phyID,0x01,Resp_11);
      Resp_ff00 = 0x7F;
      Exit_ff00 = 1;
    }
    else if(@AUTO::Config_Switch==2)//ChangAn
    {
      _Startreset(funID,0x03,Resp_11);
      Resp_ff00 = 0x7F;
      Exit_ff00 = 1;
    }
    else if(@AUTO::Config_Switch==5)//鑫源
    {
      _Startreset(funID,0x01,Resp_11);
      Resp_2E = 0x7F;
      Exit_2E = 1;
    }
    //Geely 1.0 || 瑞驰 || 五菱 || 赛力斯
    else
    {
      _Startreset(funID,0x01,Resp_11);
      Resp_ff00 = 0x7F;
      Exit_ff00 = 1;
    }
    return;
  }
  //故障注入：驱动校验后功能寻址默认会话10 01
  else if(@Faultinsert::TC_DefaultSession_after_0202F)
  { 
    _diagSendMsg(msgID,req0202);
    testWaitForDiagRequestSent(req0202,1000);
    testWaitForDiagResponse(req0202,p2cmax);
    _TestResult(req0202,"0202",Passcondition);
    enterDefault(funID,0,Resp_1001);
    testWaitForTimeout(Restart_Time);
    if(@AUTO::Config_Switch==5)//鑫源
    {
      Resp_2E = 0x7F;
      Exit_2E = 1;
    }
    else
    {
      Resp_ff00 = 0x7F;
      Exit_ff00 = 1;
    }
    return;
  }
  //故障注入：缺失步骤Flash 0202 CRC校验
  else if(@Faultinsert::TC_Miss_0202_F==1)
  {
    Resp_ff00 = 0x22;
    Exit_0202_f = 0;
    Exit_ff00 = 1;
    return;
  }
  else
  {
    _diagSendMsg(msgID,req0202);
    _get_FC(req0202,msgID,"0202",Passcondition);
  }
}

//下载App数据后校验
//参数data36:下载的数据数组及需要校验的值
//参数length34:下载数据的数组长度
//参数msgID:{phyID:物理寻址,funID:功能寻址}
//参数Passcondition:{-1:期望收到积极响应,0:期望不收到响应,>0:期望收到的NRC}
void _Send0202_a(byte data36[],dword length34,dword msgID,int Passcondition)
{
  diagRequest ABS_ESP.Check_Memory_Start req0202;
  diagRequest ABS_ESP.hardReset_Reset req1101;
  diagRequest ABS_ESP.DefaultSession_Start req1001;
  dword crc32;
  int i;
  stepnum++;
  snprintf(stepid,elCount(stepid),"步骤%02d：测试31服务APP完整性校验",stepnum);
  
  /*可靠性测试：0202检查前切断电源*/
  if(TC_PowerDown_Before_0202A==1)
  {
    _K30_OFF();
    testWaitForTimeout(10000);
    Exit_0202_a = 1;
    _K30_ON();
    return;
  }
  /*可靠性测试：0202检查前下点火*/
  if(TC_K15_Before_0202A==1)
  {
    _K15_OFF();
    testWaitForTimeout(10000);
    Exit_0202_a = 1;
    _K15_ON();
    return;
  }
  /*可靠性测试：0202检查前BusOff*/
  if(TC_BusOff_Before_0202A==1)
  {
    testWaitForTesterConfirmation("请制造BufOff故障",10000);
    testWaitForTimeout(10000);
    Exit_0202_a = 1;
    testWaitForTesterConfirmation("请恢复故障",10000);
    return;
  }
 
  //计算CRC32校验值、不同擦除方式的0202校验值不同
  if((@AUTO::EraseMode_Switch == 1 || @AUTO::EraseMode_Switch == 4) && @AUTO::MergeAddr_Switch != 1)
  {
    if(@AUTO::Config_Switch != 12)
      crc32 = _caculateCrc32(data36,length34);
    crc32 = crc32^0xFFFFFFFF;
  }
  else
  {
    /*合并块:data36仅缓存单段,使用_App_36_merge中增量累积的calcrc32*/
    crc32 = calcrc32^0xFFFFFFFF;
  }
  //设置诊断字节
  diagResize(req0202,8);
  DiagSetPrimitiveByte(req0202,0,0x31);
  DiagSetPrimitiveByte(req0202,1,0x01);
  DiagSetPrimitiveByte(req0202,2,0x02);
  DiagSetPrimitiveByte(req0202,3,0x02);
  DiagSetPrimitiveByte(req0202,4,crc32 >> 24);
  DiagSetPrimitiveByte(req0202,5,crc32 >> 16 & 0xFF);
  DiagSetPrimitiveByte(req0202,6,crc32 >> 8 & 0xFF);
  DiagSetPrimitiveByte(req0202,7,crc32 & 0xFF);
  
  //不同主机厂，诊断字节不一样
  //鑫源APP数据校验 31 01 02 01
  if(@AUTO::Config_Switch==5)
  {
    DiagSetPrimitiveByte(req0202,3,0x01);
  }
  //瑞驰APP数据校验 31 01 F0 01
  if(@AUTO::Config_Switch==6)
  {
    DiagSetPrimitiveByte(req0202,2,0xF0);
    DiagSetPrimitiveByte(req0202,3,0x01);
  }
  //五菱APP数据校验 31 01 DF FF
  if(@AUTO::Config_Switch==8)
  {
    DiagSetPrimitiveByte(req0202,2,0xDF);
    DiagSetPrimitiveByte(req0202,3,0xFF);
  }
  //东风小康APP数据校验 31 01 02 02
  if(@AUTO::Config_Switch==9 || @AUTO::Config_Switch==13 )
  {
    diagResize(req0202,4);
  }
  //赛力斯APP数据校验 31 01 DD 02
  if(@AUTO::Config_Switch==10)
  {
    diagResize(req0202,4);
    DiagSetPrimitiveByte(req0202,2,0xDD);
    DiagSetPrimitiveByte(req0202,3,0x02);
  }
  //奇瑞T1V APP数据校验 31 01 DD 02
  if(@AUTO::Config_Switch==11)
  {
    diagResize(req0202,0x184);
    DiagSetPrimitiveByte(req0202,2,0xDD);
    DiagSetPrimitiveByte(req0202,3,0x02);
    for(i=0;i<RSALen;i++)
      DiagSetPrimitiveByte(req0202,i+4,RSAData[i]);
    /*-------------------------------------*/
  }
  //故障注入：APP完整性CRC校验值错误
  if(@Faultinsert::TC_Error_0202_A==1)
  {
    DiagSetPrimitiveByte(req0202,4,0x00);
    DiagSetPrimitiveByte(req0202,5,0x00);
    DiagSetPrimitiveByte(req0202,6,0x00);
    DiagSetPrimitiveByte(req0202,7,0x00);
    //Geely 1.0
    if(@AUTO::Config_Switch==3)
    {
      PassState_31[0] = 0x05;
      Exit_0202_a = 1;
    }
    //瑞驰
    else if(@AUTO::Config_Switch==6)
    {
      PassState_31[0] = 0x01;
      Exit_0202_a = 1;
    }
    //鑫源
    else if(@AUTO::Config_Switch==5)
    {
      PassState_31[0] = 0x05;
      Resp_ff00 = 0x22;
      Exit_ff00 = 1;
    }
    //奇瑞T1V
    else if(@AUTO::Config_Switch==11)
    {
      for(i=4;i<RSALen+4;i++)
        DiagSetPrimitiveByte(req0202,i,0);
      PassState_31[0] = 0x05;
      Resp_ff00 = 0x22;
      Exit_ff00 = 1;
    }
    else
    {
      //不同的擦除方式，后续步骤不同
      if(@AUTO::EraseMode_Switch == 1 || @AUTO::EraseMode_Switch == 4)
      {
        Resp_ff00 = 0x22;
        Exit_ff00 = 1;
      }
      else
      {
        Resp_ff01 = 0x22;
        Exit_ff01 = 1;
      }
    }
  }
  //故障注入：数据校验过程中功能寻址握手
  if(@Faultinsert::TC_Handshake_in_0202A == 1)
  {
    _diagSendMsg(msgID,req0202);
//    testWaitForMessage(msgID,1000);
    testWaitForDiagRequestSent(req0202,1);
    _handshake(funID);
    _get_FC(req0202,msgID,"stepid",Passcondition);
    testWaitForTimeout(4000);
//    @Faultinsert::TC_Handshake_in_0202A = 0;
  }
  //故障注入：数据校验后功能寻址复位11 01
  else if(@Faultinsert::TC_Restart_after_0202A)
  {
    if(@AUTO::Config_Switch==1 || @AUTO::Config_Switch==5 
    || @AUTO::Config_Switch==6 || @AUTO::Config_Switch==10)//BYD || 鑫源 || 瑞驰 || 赛力斯
    {
      _diagSendMsg(msgID,req0202);
      testWaitForDiagRequestSent(req0202,1000);
//      testWaitForDiagResponse(req0202,p2cmax);
//      _TestResult(req0202,"stepid",Passcondition);
      _get_FC(req0202,msgID,"stepid",Passcondition);
      _Startreset(phyID,0x01,Resp_11);
      if(@AUTO::EraseMode_Switch==1)
      {
        Resp_ff00 = 0x7F;
        Exit_ff00 = 1;
      }
      /*选择了多个HEX文件*/
      else if(hexFlage[0]+hexFlage[1]+hexFlage[2] != 2)
      {
        Resp_ff00 = 0x7F;
        Exit_ff00 = 1;
      }
      else
      {
        Resp_ff01 = 0x7F;
        Exit_ff01 = 1;
      }
      return;
    }
    //Geely 1.0
    else
    {
      _diagSendMsg(msgID,req0202);
      testWaitForDiagRequestSent(req0202,1000);
//      testWaitForDiagResponse(req0202,p2cmax);
//      _TestResult(req0202,"stepid",Passcondition);
      _get_FC(req0202,msgID,"stepid",Passcondition);
      _Startreset(funID,0x01,Resp_11);
      if(@AUTO::EraseMode_Switch==1)
      {
        Resp_ff00 = 0x7F;
        Exit_ff00 = 1;
      }
      /*选择了多个HEX文件*/
      else if(hexFlage[0]+hexFlage[1]+hexFlage[2] != 2)
      {
        Resp_ff00 = 0x7F;
        Exit_ff00 = 1;
      }
      else
      {
        Resp_ff01 = 0x7F;
        Exit_ff01 = 1;
      }
      return;
    }
  }
  //故障注入：数据校验后功能寻址默认会话10 01
  else if(@Faultinsert::TC_DefaultSession_after_0202A)
  {
    _diagSendMsg(msgID,req0202);
    testWaitForDiagRequestSent(req0202,1000);
//    testWaitForDiagResponse(req0202,p2cmax);
//    _TestResult(req0202,"stepid",Passcondition);
    _get_FC(req0202,msgID,"stepid",Passcondition);
    enterDefault(funID,0,Resp_1001);
    testWaitForTimeout(Restart_Time);
    if(@AUTO::EraseMode_Switch==1)
    {
      Resp_ff00 = 0x7F;
      Exit_ff00 = 1;
    }
    /*选择了多个HEX文件*/
    else if(hexFlage[0]+hexFlage[1]+hexFlage[2] != 2)
    {
      Resp_ff00 = 0x7F;
      Exit_ff00 = 1;
    }
    else
    {
      Resp_ff01 = 0x7F;
      Exit_ff01 = 1;
    }
    return;
  }
  //故障注入：步骤缺失App 0202传输校验
  else if(@Faultinsert::TC_Miss_0202_A)
  {
    if(@AUTO::EraseMode_Switch==1)
    {
      Resp_ff00 = 0x22;
      Exit_ff00 = 1;
    }
    else
    {
      Resp_ff01 = 0x22;
      Exit_ff01 = 1;
    }
    return;
  }
  else
  {
    _diagSendMsg(msgID,req0202);
    _get_FC(req0202,msgID,"stepid",Passcondition);
  }
  
}

//Geely3.0 激活SBL
//参数msgID:{phyID:物理寻址,funID:功能寻址}
//参数Passcondition:{-1:期望收到积极响应,0:期望不收到响应,>0:期望收到的NRC}
void _Send0301(dword msgID,int Passcondition)
{
  diagRequest ABS_ESP.Check_Memory_Start req0301;
  dword startAddr;
  stepnum++;
  snprintf(stepid,elCount(stepid),"步骤%02d",stepnum);
  testStep(stepid,"开始测试激活SBL");
  diagResize(req0301,0x8);
  DiagSetPrimitiveByte(req0301,0,0x31);
  DiagSetPrimitiveByte(req0301,1,0x01);
  DiagSetPrimitiveByte(req0301,2,0x03);
  DiagSetPrimitiveByte(req0301,3,0x01);
  
  //故障注入：31 01 03 01地址错误
  if(@Faultinsert::TC_Error_0301==1)
  {
    startAddr = @AUTO::DriverAddr;
    Passcondition = 0x31;
    Exit_0301 = 1;
  }
  else
    startAddr = hexfile_sbt[0].BlockStartAddr;
  
  DiagSetPrimitiveByte(req0301,4,startAddr >> 24);
  DiagSetPrimitiveByte(req0301,5,(startAddr >> 16) & 0xFF);
  DiagSetPrimitiveByte(req0301,6,(startAddr >> 8) & 0xFF);
  DiagSetPrimitiveByte(req0301,7,startAddr & 0xFF);
  
  //故障注入：03 01过程中功能寻址握手
  if(@Faultinsert::TC_Handshake_in_0301==1)
  {
    _diagSendMsg(msgID,req0301);
    testWaitForDiagRequestSent(req0301,1000);
    _handshake(funID);
    _get_FC(req0301,msgID,stepid,Passcondition);
  }
  //故障注入：03 01后物理寻址复位11 01
  else if(@Faultinsert::TC_Restart_after_0301==1)
  {
    _diagSendMsg(msgID,req0301);
    _get_FC(req0301,msgID,stepid,Passcondition);
    _Startreset(phyID,0x01,Resp_11);
    Resp_ff00 = 0x31;
    Exit_ff00 = 1;
  }
  //故障注入：03 01后功能寻址切换默认会话10 01
  else if(@Faultinsert::TC_DefaultSession_after_0301==1)
  {
    _diagSendMsg(msgID,req0301);
    _get_FC(req0301,msgID,stepid,Passcondition);
    enterDefault(funID,0,Resp_1001);
    testWaitForTimeout(Restart_Time);
    Resp_ff00 = 0x31;
    Exit_ff00 = 1;
  }
  //故障注入：步骤缺失 31 01 03 01
  else if(@Faultinsert::TC_Miss_0301==1)
  {
    Resp_ff00 = 0x31;
    Exit_0301 = 0;
    Exit_ff00 = 1;
    return;
  }
  else
  {
    _diagSendMsg(msgID,req0301);
    _get_FC(req0301,msgID,stepid,Passcondition);
  }
  //故障注入：再次请求激活SBL
  if(@Faultinsert::TC_Re_0301==1)
  {
    _diagSendMsg(msgID,req0301);
    _get_FC(req0301,msgID,stepid,Passcondition);
    Exit_0301 = 1;
  }
}
//完全性检测
//参数msgID:{phyID:物理寻址,funID:功能寻址}
//参数Passcondition:{-1:期望收到积极响应,0:期望不收到响应,>0:期望收到的NRC}
void _Send0205(dword msgID,int Passcondition)
{
  diagRequest ABS_ESP.Check_Memory_Start req0205;
  stepnum++;
  snprintf(stepid,elCount(stepid),"步骤%02d",stepnum);
  testStep(stepid,"开始完全性检测 31 01 02 05");
  
  //故障注入：步骤缺失完全性检测 02 05
  if(@Faultinsert::TC_Miss_0205==1)
  {
    Exit_11 = 1;
    return;
  }
  diagResize(req0205,0x04);
  DiagSetPrimitiveByte(req0205,0,0x31);
  DiagSetPrimitiveByte(req0205,1,0x01);
  DiagSetPrimitiveByte(req0205,2,0x02);
  DiagSetPrimitiveByte(req0205,3,0x05);
  //故障注入：完全性检测02 05过程中功能寻址握手
  if(@Faultinsert::TC_Handshake_in_0205==1)
  {
    _diagSendMsg(msgID,req0205);
    testWaitForDiagRequestSent(req0205,1000);
    _handshake(funID);
    _get_FC(req0205,msgID,stepid,Passcondition);
  }
  //故障注入：完全性检测02 05后物理寻址复位11 01
  else if(@Faultinsert::TC_Restart_after_0205==1)
  {
    _diagSendMsg(msgID,req0205);
    _get_FC(req0205,msgID,stepid,Passcondition);
    _Startreset(phyID,0x01,Resp_11);
  }
  //故障注入：完全性检测02 05后功能寻址切换默认会话10 01
  else if(@Faultinsert::TC_DefaultSession_after_0205==1)
  {
    _diagSendMsg(msgID,req0205);
    _get_FC(req0205,msgID,stepid,Passcondition);
    enterDefault(funID,0,Resp_1001);
    testWaitForTimeout(Restart_Time);
  }
  else
  {
    _diagSendMsg(msgID,req0205);
    _get_FC(req0205,msgID,stepid,Passcondition);
  }
}

//一致性检查
//参数msgID:{phyID:物理寻址,funID:功能寻址}
//参数Passcondition:{-1:期望收到积极响应,0:期望不收到响应,>0:期望收到的NRC}
void _SendFF01(dword msgID,int Passcondition)
{
  diagRequest ABS_ESP.Check_Programming_Dependencies_Start reqff01;
    
  stepnum++;
  snprintf(stepid,elCount(stepid),"步骤%02d：测试31服务有效性校验",stepnum);
  testStep(stepid,"开始测试相关性校验");
  
  //设置诊断服务字节
  diagResize(reqff01,0x04);
  DiagSetPrimitiveByte(reqff01,0,0x31);
  DiagSetPrimitiveByte(reqff01,1,0x01);
  DiagSetPrimitiveByte(reqff01,2,0xFF);
  DiagSetPrimitiveByte(reqff01,3,0x01);
  
  /*可靠性测试：FF01应用程序有效性检查前切断电源*/
  if(TC_PowerDown_Before_FF01==1)
  {
    _K30_OFF();
    testWaitForTimeout(10000);
    Exit_ff01 = 1;
    _K30_ON();
    return;
  }
  /*可靠性测试：FF01应用程序有效性检查前下点火*/
  if(TC_K15_Before_FF01==1)
  {
    _K15_OFF();
    testWaitForTimeout(10000);
    Exit_ff01 = 1;
    _K15_ON();
    return;
  }
  /*可靠性测试：FF01应用程序有效性检查前BusOff*/
  if(TC_BusOff_Before_FF01==1)
  {
    testWaitForTesterConfirmation("请制造BufOff故障",10000);
    testWaitForTimeout(10000);
    Exit_ff01 = 1;
    testWaitForTesterConfirmation("请恢复故障",10000);
    return;
  }

  /*奇瑞31 01 FF 01*/
  if(@AUTO::Config_Switch==7)
  {
    //故障注入：FF 01依赖性检查过程中部分地址段未进行检查
    if(@Faultinsert::TC_FF01_Part==1 && @AUTO::EraseMode_Switch == 3)
    {
      EraseAddr = EraseAddr + (EraseLength >> 1) ;
      EraseLength = (EraseLength >> 1) | 1;
      Resp_DA04 = 0x22;
      Exit_DA04 = 1;
      Passcondition = 0x22;
    }
    diagResize(reqff01,0x0E);
    DiagSetPrimitiveByte(reqff01,4,EraseAddr >> 24);
    DiagSetPrimitiveByte(reqff01,5,EraseAddr >> 16 & 0xFF);
    DiagSetPrimitiveByte(reqff01,6,EraseAddr >> 8 & 0xFF);
    DiagSetPrimitiveByte(reqff01,7,EraseAddr & 0xFF);
    DiagSetPrimitiveByte(reqff01,8,EraseLength >> 24);
    DiagSetPrimitiveByte(reqff01,9,EraseLength >> 16 & 0xFF);
    DiagSetPrimitiveByte(reqff01,10,EraseLength >> 8 & 0xFF);
    DiagSetPrimitiveByte(reqff01,11,EraseLength & 0xFF);
    DiagSetPrimitiveByte(reqff01,12,current_crc16 >> 8);
    DiagSetPrimitiveByte(reqff01,13,current_crc16 & 0xFF);
  }
  
  //故障注入：步骤缺失 FF 01检查
  if(@Faultinsert::TC_Miss_FF01==1)
  {
    //奇瑞
    if(@AUTO::Config_Switch==7)
    {
      Resp_ff01 = 0x24;
      Exit_03ff01 = 1;
    }
    //东风小康
    else if(@AUTO::Config_Switch==9)
    {
      Resp_11 = 0x78;
      Exit_11 = 1;
    }
    else
    {
      Exit_11 = 1;
    }
    return;
  }
  //故障注入：FF 01检查后功能寻址握手
  else if(@Faultinsert::TC_Handshake_in_FF01==1)
  {
    _diagSendMsg(msgID,reqff01);
    testWaitForDiagRequestSent(reqff01,1000);
    _handshake(funID);
    _get_FC(reqff01,phyID,stepid,Passcondition);
    if(@AUTO::Config_Switch==11)
      testWaitForTimeout(1000);
  }
  //故障注入：FF 01检查后功能寻址复位
  else if(@Faultinsert::TC_Restart_after_FF01==1)
  {
    _diagSendMsg(msgID,reqff01);
    _get_FC(reqff01,phyID,stepid,Passcondition);
    _Startreset(phyID,0x01,Resp_11);
    Resp_ff01 = 0x7F;
    Resp_DA04 = 0x7F;
    Exit_DA04 = 1;
  }
  //故障注入：FF 01检查后功能寻址切换默认会话
  else if(@Faultinsert::TC_DefaultSession_after_FF01==1)
  {
    _diagSendMsg(msgID,reqff01);
    testWaitForDiagRequestSent(reqff01,1);
    _get_FC(reqff01,phyID,stepid,Passcondition);
    enterDefault(funID,0,Resp_1001);
    //Geely1.0 || 鑫源 || 五菱 
    if(@AUTO::Config_Switch==3 || @AUTO::Config_Switch==5 ) //|| @AUTO::Config_Switch==11  || 奇瑞  T1V
    {
      Resp_11 = 0x7F;
      Exit_11 = 1;
    }
    testWaitForTimeout(Restart_Time);
  }
  //故障注入：CA APP数据校验后功能寻址复位
  else if(@Faultinsert::TC_Restart_after_0202A==1 && @AUTO::Config_Switch==2)
  {
    _diagSendMsg(msgID,reqff01);
    testWaitForDiagRequestSent(reqff01,1);
    _get_FC(reqff01,phyID,stepid,Passcondition);
    _Startreset(funID,0x03,Resp_11);
  }
  //故障注入：CA APP数据校验后功能寻址切换默认会话
  else if(@Faultinsert::TC_DefaultSession_after_0202A==1 && @AUTO::Config_Switch==2)
  {
    _diagSendMsg(msgID,reqff01);
    testWaitForDiagRequestSent(reqff01,1);
    _get_FC(reqff01,phyID,stepid,Passcondition);
    enterDefault(funID,0,Resp_1001);
    testWaitForTimeout(Restart_Time);
  }
  //故障注入：31 01 FF 01的CRC校验错误
  else if(@Faultinsert::TC_Error_0202_A==1)
  {
    DiagSetPrimitiveByte(reqff01,12,0);
    DiagSetPrimitiveByte(reqff01,13,0);
    _diagSendMsg(msgID,reqff01);
    _get_FC(reqff01,phyID,stepid,Passcondition);
    PassState_31[0] = 0x02;
    Exit_02ff01 = 1;
  }
  else
  {
    _diagSendMsg(msgID,reqff01);
    testWaitForDiagRequestSent(reqff01,1);
    _get_FC(reqff01,phyID,stepid,Passcondition);
  }
  /*性能测试：验证是否在BT中擦除APP有效位*/
  if(@Faultinsert::TC_BT_AppValid == 1)
  { 
//    if(Loop_Add_Times > 0)
//      @Faultinsert::TC_Miss_GetFc = 1;
    
//    testEnableMsg(0x11);
//    _diagSendMsg(msgID,reqff01);
//    testWaitForDiagRequestSent(reqff01,100);
//    _get_FC(reqff01,msgID,"stepid",Passcondition);

    if(Loop_Add_Time > 0)
    {
      testWaitForTimeout(Loop_Add_Time);
      writeEx(-3,1,"等待：%dms",Loop_Add_Time);
    }
    _K30_OFF();
    Exit_ff01 = 1;
    testWaitForTimeout(2000);
    _K30_ON();
    testWaitForTimeout(2000);
    writeEx(-3,1,"等待：2s");

    Check_APPValid2();
//    testdisableMsg(0x11);
//    @Faultinsert::TC_Miss_GetFc = 0;
    return;
  }
  /*可靠性测试：FF01应用程序有效性检查后切断电源*/
  if(TC_PowerDown_After_FF01==1)
  {
    _K30_OFF();
    testWaitForTimeout(10000);
    Exit_ff01 = 1;
    _K30_ON();
    return;
  }
  /*可靠性测试：FF01应用程序有效性检查后下点火*/
  if(TC_K15_After_FF01==1)
  {
    _K15_OFF();
    testWaitForTimeout(10000);
    Exit_ff01 = 1;
    _K15_ON();
    return;
  }
  /*可靠性测试：FF01应用程序有效性检查后BusOff*/
  if(TC_BusOff_After_FF01==1)
  {
    testWaitForTesterConfirmation("请制造BufOff故障",10000);
    testWaitForTimeout(10000);
    Exit_ff01 = 1;
    testWaitForTesterConfirmation("请恢复故障",10000);
    return;
  }
}
//奇瑞 31 03 FF 01
//参数msgID:{phyID:物理寻址,funID:功能寻址}
//参数Passcondition:{-1:期望收到积极响应,0:期望不收到响应,>0:期望收到的NRC}
void _Send03FF01(dword msgID,int Passcondition)
{
  diagRequest ABS_ESP.Check_Programming_Dependencies_Start reqff01;
  
  diagResize(reqff01,4);
  DiagSetPrimitiveByte(reqff01,0,0x31);
  DiagSetPrimitiveByte(reqff01,1,0x03);
  DiagSetPrimitiveByte(reqff01,2,0xFF);
  DiagSetPrimitiveByte(reqff01,3,0x01);
  
  //故障注入：步骤缺失 31 03 FF 01
  if(@Faultinsert::TC_Miss_FF01_03==1)
  {
    if(@Faultinsert::TC_Miss_FF01==1)
    {
      Exit_03ff01 = 0;
      Exit_02ff01 = 1;
    }
    return;
  }
  if(@Faultinsert::TC_FF01_Part==1 && @AUTO::EraseMode_Switch == 3)
  {
    Passcondition = 0x24;
  }
  _diagSendMsg(msgID,reqff01);
  _get_FC(reqff01,msgID,stepid,Passcondition);
}
//奇瑞 31 02 FF 01
//参数msgID:{phyID:物理寻址,funID:功能寻址}
//参数Passcondition:{-1:期望收到积极响应,0:期望不收到响应,>0:期望收到的NRC}
void _Send02FF01(dword msgID,int Passcondition)
{
  diagRequest ABS_ESP.Check_Programming_Dependencies_Start reqff01;
  
  diagResize(reqff01,4);
  DiagSetPrimitiveByte(reqff01,0,0x31);
  DiagSetPrimitiveByte(reqff01,1,0x02);
  DiagSetPrimitiveByte(reqff01,2,0xFF);
  DiagSetPrimitiveByte(reqff01,3,0x01);
  
  //故障注入：步骤缺失 31 02 FF 01
  if(@Faultinsert::TC_Miss_FF01_02==1)
  {
    if(@Faultinsert::TC_Miss_FF01==1 && @Faultinsert::TC_Miss_FF01_03==1)
    {
      Exit_02ff01 = 0;
      Resp_DA04 = 0x22;
      Exit_DA04 = 1;
    }
    else
    {
      Resp_ff01 = 0x24;    
      Exit_ff01 = 1;
    }
    return;
  }
  if(@Faultinsert::TC_FF01_Part==1 && @AUTO::EraseMode_Switch == 3)
  {
    Passcondition = 0x24;
  }
  _diagSendMsg(msgID,reqff01);
  _get_FC(reqff01,msgID,stepid,Passcondition);
}

////奇瑞 31 01 DD 03
////参数msgID:{phyID:物理寻址,funID:功能寻址}
////参数Passcondition:{-1:期望收到积极响应,0:期望不收到响应,>0:期望收到的NRC}
//void _Send01DD03(dword msgID,int Passcondition)
//{
//  diagRequest ABS_ESP.Check_Programming_Dependencies_Start reqff01;
//  
//  diagResize(reqff01,4);
//  DiagSetPrimitiveByte(reqff01,0,0x31);
//  DiagSetPrimitiveByte(reqff01,1,0x01);
//  DiagSetPrimitiveByte(reqff01,2,0xDD);
//  DiagSetPrimitiveByte(reqff01,3,0x03);
//  
//  _diagSendMsg(msgID,reqff01);
//  _get_FC(reqff01,msgID,stepid,Passcondition);
//}

////奇瑞 31 01 DD 02
////参数msgID:{phyID:物理寻址,funID:功能寻址}
////参数Passcondition:{-1:期望收到积极响应,0:期望不收到响应,>0:期望收到的NRC}
//void _Send01DD02(dword msgID,int Passcondition)
//{
//  diagRequest ABS_ESP.Check_Programming_Dependencies_Start reqff01;
////  char Data[1000] = {0};
//  diagResize(reqff01,384);
//  DiagSetPrimitiveByte(reqff01,0,0x31);
//  DiagSetPrimitiveByte(reqff01,1,0x01);
//  DiagSetPrimitiveByte(reqff01,2,0xDD);
//  DiagSetPrimitiveByte(reqff01,3,0x02);
//  
//  _diagSendMsg(msgID,reqff01);
//  _get_FC(reqff01,msgID,stepid,Passcondition);
//}

//ECU复位
//参数msgID:{phyID:物理寻址,funID:功能寻址}
//参数ResetSetting:{01:硬件复位，03:软件复位}
//参数Passcondition:{-1:期望收到积极响应,0:期望不收到响应,>0:期望收到的NRC}
void _Startreset(dword msgID,dword ResetSetting,int Passcondition)
{
  diagRequest ABS_ESP.hardReset_Reset req11;
  stepnum++;
  snprintf(stepid,elCount(stepid),"步骤%02d：测试11服务复位重启",stepnum);
  
  DiagSetPrimitiveByte(req11,1,ResetSetting); 
  //故障注入：步骤缺失 ECU 11复位
  if(@Faultinsert::TC_Miss_11==1)
  {
    Resp_1003 = 0x7E;
    Exit_1003 = 1;
    return;
  }
  else
  {
    _diagSendMsg(msgID,req11);
    _get_FC(req11,msgID,stepid,Passcondition);
    testWaitForTimeout(Restart_Time);
//    curAppValid = Check_AppValid();
  }
}
/*
  软件有效性检测31 01 DA 04
  msgID:{phyID:物理寻址,funID:功能寻址}
  Passcondition:{-1:期望收到积极响应,0:期望不收到响应,>0:期望收到的NRC}
*/
void _SendDA04(dword msgID,int Passcondition)
{
  diagRequest ABS_ESP.Erase_Memory_Start req31;
  diagResize(req31,0x06);
  DiagSetPrimitiveByte(req31,0,0x31);
  DiagSetPrimitiveByte(req31,1,0x01);
  DiagSetPrimitiveByte(req31,2,0xDA);
  DiagSetPrimitiveByte(req31,3,0x04);
  DiagSetPrimitiveByte(req31,4,calcrc16 >> 8);
  DiagSetPrimitiveByte(req31,5,calcrc16 & 0xFF);
  
  //故障注入：31 01 DA04的CRC值错误
  if(@Faultinsert::TC_Error_DA04==1)
  {
    DiagSetPrimitiveByte(req31,4,0xFF);
    DiagSetPrimitiveByte(req31,5,0xFF);
    _diagSendMsg(msgID,req31);
    _get_FC(req31,msgID,stepid,Passcondition);
    PassState_31[0] = 0x02;
    Resp_14 = 0;
    Exit_14 = 1;
    return;
  }
  //故障注入：步骤缺失 31 01 DA 04
  if(@Faultinsert::TC_Miss_DA04==1)
  {
    Resp_DA04 = 0x24;
    Exit_03DA04 = 1;
    return;
  }
  _diagSendMsg(msgID,req31);
  //故障注入：DA 04检查过程中功能寻址握手
  if(@Faultinsert::TC_Handshake_in_DA04==1)
  {
    testWaitForDiagRequestSent(req31,500);
    _handshake(funID);
  }
  _get_FC(req31,msgID,stepid,Passcondition);
  //故障注入：DA 04检查后功能寻址复位
  if(@Faultinsert::TC_Restart_after_DA04==1)
  {
    Resp_DA04 = 0x7F;
    _Startreset(phyID,0x01,Resp_11);
  }
    /*性能测试：验证是否在BT中擦除APP有效位*/
  if(@Faultinsert::TC_BT_AppValid == 1)
  { 

    if(Loop_Add_Time > 0)
    {
      testWaitForTimeout(Loop_Add_Time);
      writeEx(-3,1,"等待：%dms",Loop_Add_Time);
    }
    _K30_OFF();
    Exit_ff01 = 1;
    testWaitForTimeout(2000);
    _K30_ON();
    testWaitForTimeout(2000);
    writeEx(-3,1,"等待：2s");

    Check_APPValid2();
    return;
  }
}
/*
  31 03 DA 04
  msgID:{phyID:物理寻址,funID:功能寻址}
  Passcondition:{-1:期望收到积极响应,0:期望不收到响应,>0:期望收到的NRC}
*/
void _Send03DA04(dword msgID,int Passcondition)
{
  diagRequest ABS_ESP.Erase_Memory_Start req31;
  diagResize(req31,0x04);
  DiagSetPrimitiveByte(req31,0,0x31);
  DiagSetPrimitiveByte(req31,1,0x03);
  DiagSetPrimitiveByte(req31,2,0xDA);
  DiagSetPrimitiveByte(req31,3,0x04);
  
  //故障注入：步骤缺失 31 03 DA 04
  if(@Faultinsert::TC_Miss_DA04_03==1)
  {
    if(@Faultinsert::TC_Miss_DA04==1)
    {
      Exit_03DA04 = 0;
      Exit_02DA04 = 1;
    }
    return;
  } 
  _diagSendMsg(msgID,req31);
  _get_FC(req31,msgID,stepid,Passcondition);
}
/*
  31 02 DA 04
  msgID:{phyID:物理寻址,funID:功能寻址}
  Passcondition:{-1:期望收到积极响应,0:期望不收到响应,>0:期望收到的NRC}
*/
void _Send02DA04(dword msgID,int Passcondition)
{
  diagRequest ABS_ESP.Erase_Memory_Start req31;
  diagResize(req31,0x04);
  DiagSetPrimitiveByte(req31,0,0x31);
  DiagSetPrimitiveByte(req31,1,0x02);
  DiagSetPrimitiveByte(req31,2,0xDA);
  DiagSetPrimitiveByte(req31,3,0x04);

  //故障注入：步骤缺失 31 02 DA 04
  if(@Faultinsert::TC_Miss_DA04_02==1)
  {
    if(@Faultinsert::TC_Miss_DA04==1 && @Faultinsert::TC_Miss_DA04_03==1)
    {
      Resp_14 = 0;
      Exit_14 = 1;
    }
    return;
  }
  _diagSendMsg(msgID,req31);
  _get_FC(req31,msgID,stepid,Passcondition);
}
/*
  奇瑞 31 03 FF 00服务
  msgID:{phyID:物理寻址,funID:功能寻址}
  Passcondition:{-1:期望收到积极响应,0:期望不收到响应,>0:期望收到的NRC}
*/
void _Send03FF00(dword msgID,int Passcondition)
{
  diagRequest ABS_ESP.Erase_Memory_Start reqff00;
  diagResize(reqff00,0x04);
  DiagSetPrimitiveByte(reqff00,0,0x31);
  DiagSetPrimitiveByte(reqff00,1,0x03);
  DiagSetPrimitiveByte(reqff00,2,0xFF);
  DiagSetPrimitiveByte(reqff00,3,0x00);
  
  /*故障注入：步骤缺失 不执行31 01 FF 00 和 31 03 FF 00*/
  if(@Faultinsert::TC_Miss_FF00_03==1)
  {
    if(@Faultinsert::TC_Miss_FF00==1)
    {
      Exit_03ff00 = 0;
      Exit_02ff00 = 1;
    }
    return;
  }
  _diagSendMsg(msgID,reqff00);
  _get_FC(reqff00,msgID,stepid,Passcondition);
}
/*
  奇瑞 31 02 FF 00服务
  msgID:{phyID:物理寻址,funID:功能寻址}
  Passcondition:{-1:期望收到积极响应,0:期望不收到响应,>0:期望收到的NRC}
*/
void _Send02FF00(dword msgID,int Passcondition)
{
  diagRequest ABS_ESP.Erase_Memory_Start reqff00;
  diagResize(reqff00,0x04);
  DiagSetPrimitiveByte(reqff00,0,0x31);
  DiagSetPrimitiveByte(reqff00,1,0x02);
  DiagSetPrimitiveByte(reqff00,2,0xFF);
  DiagSetPrimitiveByte(reqff00,3,0x00);
  
  /*故障注入：步骤缺失：不执行31 02擦除步骤*/
  if(@Faultinsert::TC_Miss_FF00_02==1)
  {
    if(@Faultinsert::TC_Miss_FF00==1 && @Faultinsert::TC_Miss_FF00_03==1)
    {
      Exit_02ff00 = 0;
      Resp_34_a = 0x70;
      Exit_34_a = 1;
    }
    return;
  }
  _diagSendMsg(msgID,reqff00);
  _get_FC(reqff00,msgID,stepid,Passcondition);
}
//31 01 FF 00擦除内存服务请求，在函数中添加故障注入的情况
//参数addr:起始地址
//参数size:地址大小
//参数msgID:{phyID:物理寻址,funID:功能寻址}
void _SendFF00(dword addr,dword size,dword msgID)
{
  diagRequest ABS_ESP.Erase_Memory_Start reqff00;
  diagRequest ABS_ESP.hardReset_Reset req1101;
  diagRequest ABS_ESP.DefaultSession_Start req1001;
  dword EraseLength;
  
  stepnum++;
  snprintf(stepid,elCount(stepid),"步骤%02d：测试31服务FF00擦除内存",stepnum);
  
  /*可靠性测试：内存擦除前切断电源*/
  if(TC_PowerDown_Before_FF00==1)
  {
    _K30_OFF();
    testWaitForTimeout(10000);
    Exit_ff00 = 1;
    _K30_ON();
    return;
  }
  /*可靠性测试：内存擦除前下点火*/
  if(TC_K15_Before_FF00==1)
  {
    _K15_OFF();
    testWaitForTimeout(10000);
    Exit_ff00 = 1;
    _K15_ON();
    return;
  }
  /*可靠性测试：内存擦除前BusOff*/
  if(TC_BusOff_Before_FF00==1)
  {
    testWaitForTesterConfirmation("请制造BufOff故障",10000);
    testWaitForTimeout(10000);
    Exit_ff00 = 1;
    testWaitForTesterConfirmation("请恢复故障",10000);
    return;
  }
  
  //故障注入：鑫源 2E写数据后功能寻址复位
  if(@Faultinsert::TC_Restart_after_2E && @AUTO::Config_Switch==5)
  {
    Resp_ff00 = 0x7F;
    _Startreset(funID,0x01,Resp_11);
    Exit_ff00 = 1;
  }
  //故障注入：鑫源 2E写数据后功能寻址切换默认会话
  else if(@Faultinsert::TC_DefaultSession_after_2E && @AUTO::Config_Switch==5)
  {
    Resp_ff00 = 0x7F;
    enterDefault(funID,0,Resp_1001);
    testWaitForTimeout(Restart_Time);
    Exit_ff00 = 1;
  }
  //故障注入：内存擦除的内存地址错误
  if(@Faultinsert::TC_Error_FF00_Addr==1)
  {
    if(@Faultinsert::TC_ErrorAddr_FBT==1)
      addr = @AUTO::EraseAddr_FBT;
    else if(@Faultinsert::TC_ErrorAddr_SBT==1)
      addr = @AUTO::EraseAddr_SBT;
    else
      addr = @AUTO::EraseAddr;
    if(@AUTO::Config_Switch==1)//BYD
    {
      if(@Faultinsert::TC_ErrorAddr_FBT==1 || @Faultinsert::TC_ErrorAddr_SBT==1)
      {
        Resp_ff00 = 0x72;
      }
      else
        Resp_ff00 = 0x31;
      Resp_34_a = 0x22;
      Resp_36_a = 0x24;
      Resp_37_a = 0x24;
      Resp_0202_a = 0x22;
      Exit_0202_a = 1;
    }
    else if(@AUTO::Config_Switch==7)//奇瑞 
    {
      Resp_ff00 = 0x31;
      Exit_ff00 = 1;
    }
    else if(@AUTO::Config_Switch==4)//Geely 3.0
    {
      if(@Faultinsert::TC_ErrorAddr_FBT==1) // || @Faultinsert::TC_ErrorAddr_SBT==1
      {
        Resp_ff00 = 0x72;
        if(@AUTO::Geely3_Config == 1)
          Resp_ff00 = 0x72;
      }
      else if(@Faultinsert::TC_ErrorAddr_SBT==1)
      {
        Resp_ff00 = 0x31;
        if(@AUTO::Geely3_Config == 1)
          Resp_ff00 = 0x31;
      }
      else
        Resp_ff00 = 0x31;
      Exit_ff00 = 1;
    }
    else //Geely 1.0 || 鑫源 || 瑞驰 || 五菱 || 东风小康 || 赛力斯
    {
      Resp_ff00 = 0x31;
      Exit_ff00 = 1;
    }
  }
  //故障注入：内存擦除的内存大小错误
  else if(@Faultinsert::TC_Error_FF00_Size==1)
  {
    size = @AUTO::EraseSize;
    if(@AUTO::Config_Switch==1)//BYD
    {
      Resp_ff00 = 0x31;
      Resp_34_a = 0x22;
      Resp_36_a = 0x24;
      Resp_37_a = 0x24;
      Resp_0202_a = 0x22;
      Exit_0202_a = 1;
    }
    else //Geely1.0 || Geely3.0 || 鑫源 || 瑞驰 || 奇瑞 || 五菱 || 赛力斯
    {
      Resp_ff00 = 0x31;
      Exit_ff00 = 1;
    }
  }
  /*故障注入：FF 00擦除过程中部分地址未进行擦除*/
  if(@Faultinsert::TC_FF00_Part==1 && @AUTO::EraseMode_Switch == 3)
  {
    addr = addr + (size >> 1);
    size = (size >> 1) | 1;
    Resp_34_a = 0x70;
    Exit_34_a = 1;
    @Faultinsert::TC_FF00_Part==0;
  }
  if(@AUTO::Config_Switch==1 || @AUTO::Config_Switch==3 
  || @AUTO::Config_Switch==5 || @AUTO::Config_Switch==11 || @AUTO::Config_Switch==12)//BYD || Geely1.0 || 鑫源 || T1V
  {
    diagResize(reqff00,0x0D);
    DiagSetPrimitiveByte(reqff00,4,App_AddrAndLenId);
    DiagSetPrimitiveByte(reqff00,5,addr>>24);
    DiagSetPrimitiveByte(reqff00,6,(addr>>16)&0xFF);
    DiagSetPrimitiveByte(reqff00,7,(addr>>8)&0xFF);
    DiagSetPrimitiveByte(reqff00,8,addr&0xFF);
    DiagSetPrimitiveByte(reqff00,9,size>>24);
    DiagSetPrimitiveByte(reqff00,10,(size>>16)&0xFF);
    DiagSetPrimitiveByte(reqff00,11,(size>>8)&0xFF);
    DiagSetPrimitiveByte(reqff00,12,size&0xFF);
  }
  //ChangAn || Geely3.0 || 瑞驰 ||奇瑞 || 五菱 || 小康 || 赛力斯
  else 
  {
    diagResize(reqff00,0x0C);
    DiagSetPrimitiveByte(reqff00,4,addr>>24);
    DiagSetPrimitiveByte(reqff00,5,(addr>>16)&0xFF);
    DiagSetPrimitiveByte(reqff00,6,(addr>>8)&0xFF);
    DiagSetPrimitiveByte(reqff00,7,addr&0xFF);
    DiagSetPrimitiveByte(reqff00,8,size>>24);
    DiagSetPrimitiveByte(reqff00,9,(size>>16)&0xFF);
    DiagSetPrimitiveByte(reqff00,10,(size>>8)&0xFF);
    DiagSetPrimitiveByte(reqff00,11,size&0xFF);
  }


  //故障注入：内存擦除的数据长度错误
  if(@Faultinsert::TC_Error_FF00_Length==1)
  {
    EraseLength = @AUTO::EraseLength;
    diagResize(reqff00,EraseLength);
    Resp_ff00 = 0x13;
    Exit_ff00 = 1;
  }
  
  //故障注入:内存擦除过程中功能寻址握手
  if(@Faultinsert::TC_Handshake_in_FF00==1)
  {
    _diagSendMsg(msgID,reqff00);
    testWaitForDiagRequestSent(reqff00,10);
    _handshake(funID);
    _get_FC(reqff00,phyID,stepid,Resp_ff00);
    testWaitForTimeout(4000);
  }
  //故障注入:内存擦除后功能寻址复位11 01
  else if(@Faultinsert::TC_Restart_after_FF00 && @AUTO::Config_Switch!=4)
  {
    _diagSendMsg(msgID,reqff00);
    _get_FC(reqff00,phyID,stepid,Resp_ff00);
    if(@AUTO::Config_Switch==1 || @AUTO::Config_Switch==7)//BYD || 奇瑞
    {
      _Startreset(phyID,0x01,Resp_11);
      Resp_ff00 = 0x7F;
      Resp_34_a = 0x7F;
      Exit_34_a = 1;
    }
    else if(@AUTO::Config_Switch==2)//ChangAn
    {
      _Startreset(funID,0x03,Resp_11);
      Resp_34_a = 0x7F;
      Exit_34_a = 1;
    }
    //Geely 1.0 || 鑫源 || 瑞驰 || 五菱 || 赛力斯
    else
    {
      _Startreset(funID,0x01,Resp_11);
      Resp_34_a = 0x7F;
      Exit_34_a = 1;
    }
    return;
  }
  //故障注入:内存擦除后功能寻址切换默认会话10 01
  else if(@Faultinsert::TC_DefaultSession_after_FF00 && @AUTO::Config_Switch!=4)
  {
    _diagSendMsg(msgID,reqff00);
    testWaitForDiagRequestSent(reqff00,200);
    _get_FC(reqff00,phyID,stepid,Resp_ff00);
//    if(@AUTO::Config_Switch == 8) //五菱不响应
//      Resp_1001 = 0;
    enterDefault(funID,0,Resp_1001);
    testWaitForTimeout(Restart_Time);
    Resp_34_a = 0x7F;
    Exit_34_a = 1;
    return;
  }
  //故障注入：步骤缺失FF 00擦除请求
  else if(@Faultinsert::TC_Miss_FF00)
  {
    if(@AUTO::Config_Switch==4)//Geely 3.0
    {
      Resp_34_a = 0x70;//0x24;
      Exit_34_a = 1;
    }
    else if(@AUTO::Config_Switch==7)//奇瑞
    {
      Resp_ff00 = 0x24;
      Exit_03ff00 = 1;
    }
    else
    {
      Resp_34_a = 0x22;
      Exit_34_a = 1;
    }
    return;
  }
  //故障注入：FF00擦除过程中断电
  else if(@Faultinsert::TC_FF00_K30_OFF==1)
  {
    //Geely3.0
    if(@AUTO::Config_Switch==4)
    {
      _diagSendMsg(msgID,reqff00);
      _K30_OFF();
      _K30_ON();
      testWaitForTimeout(2500);
      ReadIdentify(phyID,0xF186,-1);
      enterProg(phyID,0,-1);
      Break_Download = 1;
      Exit_ff00 = 1;
    }
    //奇瑞
    else if(@AUTO::Config_Switch==7)
    {
      _diagSendMsg(msgID,reqff00);
      @Prog_power::K30 = 0;
      Resp_ff00 = 0x78;
      Exit_ff00 = 1;
      _get_FC(reqff00,phyID,stepid,Resp_ff00);
    }
  }
  else
  {
    _diagSendMsg(msgID,reqff00);
    /*可靠性测试：内存擦除中切断电源*/
    if(TC_PowerDown_In_FF00==1)
    {
      _K30_OFF();
      testWaitForTimeout(10000);
      Exit_ff00 = 1;
      _K30_ON();
      return;
    }
    _get_FC(reqff00,phyID,stepid,Resp_ff00);
    testWaitForTimeout(100); //20260421：防止11服务被干扰  待验证
  }
  //故障注入：31 01 FF 00后直接DA04依赖性检测
  if(@Faultinsert::TC_FF00_DA04==1)
  {
    Resp_DA04 = 0x22;
    _SendDA04(phyID,Resp_DA04);
    Exit_ff00 = 1;
  }
  //APP无效
  if(@AUTO::APP_Valid == 1)
  {
    Exit_ff00 = 1;
    return;
  }
  /*可靠性测试：内存擦除后切断电源*/
  if(TC_PowerDown_After_FF00==1)
  {
    _K30_OFF();
    testWaitForTimeout(10000);
    Exit_ff00 = 1;
    _K30_ON();
    return;
  }
  /*可靠性测试：内存擦除后下点火*/
  if(TC_K15_After_FF00==1)
  {
    _K15_OFF();
    testWaitForTimeout(10000);
    Exit_ff00 = 1;
    _K15_ON();
    return;
  }
  /*可靠性测试：内存擦除后BusOff*/
  if(TC_BusOff_After_FF00==1)
  {
    testWaitForTesterConfirmation("请制造BufOff故障",10000);
    testWaitForTimeout(10000);
    Exit_ff00 = 1;
    testWaitForTesterConfirmation("请恢复故障",10000);
    return;
  }
}
//发送握手指令
//参数msgID:{phyID:物理寻址,funID:功能寻址}
void _handshake(dword msgID)
{
  byte data[2];
  byte handle;
  byte i;
  i = 0;
  data[0] = 0x3E;data[1] = 0x80;
  handle=CanTpCreateConnection(0);
  CanTpSetTxIdentifier(handle,msgID);
  CanTpSetPadding(handle,0x55);
  for(i=0;i<20;i++)
  {
    CanTpSendData(handle,data,elCount(data));
  }
}
//发送一定次数的握手指令,
//参数msgID:{phyID:物理寻址,funID:功能寻址}
//times:{发送次数}
int _handshake_times(message *Msg,dword msgID,int times)
{
  byte data[2],handle;
  int i,Flage;
  double Start_Time,End_Time,Diff_Time;
  diagStopTesterPresent("ABS_ESP_Functional");
  i = 0;
  data[0] = 0x3E;data[1] = 0x80;
  handle=CanTpCreateConnection(0);
  CanTpSetTxIdentifier(handle,msgID);
  CanTpSetPadding(handle,0x55);
  End_Time = 0;
  Flage = 0;
  Start_Time=(double)timeNow()/100;
  if(testWaitForMessage(revID,@AUTO::Handshake_NRC78_Time))
  {
    End_Time=(double)timeNow()/100;
    testGetWaitEventMsgData(Msg);
    Flage = 1;
  }
  Diff_Time = @AUTO::Handshake_NRC78_Time - (End_Time - Start_Time);
  if(Diff_Time>0.5 && Diff_Time < @AUTO::Handshake_NRC78_Time) //舍弃过短时间
    testWaitForTimeout(_max(1,(int)Diff_Time));
  for(i=0;i<times;i++)
  {
    CanTpSendData(handle,data,elCount(data));
    Start_Time=(double)timeNow()/100;
    if(testWaitForMessage(revID,@AUTO::Handshake_Send_Time))
    {
      End_Time=(double)timeNow()/100;
      testGetWaitEventMsgData(Msg);
      Flage = 1;
    }
    Diff_Time = @AUTO::Handshake_Send_Time - (End_Time - Start_Time);
    if(Diff_Time>0.5 && Diff_Time<@AUTO::Handshake_Send_Time) //舍弃过短时间
      testWaitForTimeout(_max(1,(int)Diff_Time));
  }
  diagStartTesterPresent("ABS_ESP_Functional");
  return Flage;
}

//int _handshake_times(dword msgID,int times)
//{
//  byte data[2];
//  byte handle;
//  byte i;
//  diagStopTesterPresent("ABS_ESP_Functional");
//  i = 0;
//  data[0] = 0x3E;data[1] = 0x80;
//  handle=CanTpCreateConnection(0);
//  CanTpSetTxIdentifier(handle,msgID);
//  CanTpSetPadding(handle,0x55);
//  testWaitForTimeout(@AUTO::Handshake_NRC78_Time);
//  for(i=0;i<times;i++)
//  {
//    CanTpSendData(handle,data,elCount(data));
//    testWaitForTimeout(@AUTO::Handshake_Send_Time);
//  }
//  diagStartTesterPresent("ABS_ESP_Functional");
//  return 0;
//}

//CRC16校验算法
word _caculateCrc16(word crc16,byte data[],dword size)
{
  dword tmp;
  dword i;
  for(i=0;i<size;i++)
  {
    tmp=(crc16>>8)^data[i];
    crc16=((crc16<<8)^crc16tab[tmp]) & 0xFFFF;
  }
  return crc16;
}
//CRC32校验算法
dword  _caculateCrc32(byte data[],dword size)
{
    dword i;
    dword crc_32;
    crc_32=0xFFFFFFFF;
    for (i = 0; i < size; i++)
    {
      crc_32 = crc32tab[(crc_32 ^ data[i]) & 0xff] ^ (crc_32 >> 8);
    }
    return crc_32;
}
//用于擦除方式2和3中的CRC算法，区别在于crc_32的初始化不同；
dword _caculateCrc32_1(dword crc_32,byte data[],dword size)
{
    dword i;
    for (i = 0; i < size; i++)
    {
      crc_32 = crc32tab[(crc_32 ^ data[i]) & 0xff] ^ ((crc_32 >> 8)&0x00FFFFFF);
    }
    return crc_32;
}
//一行一行读取hex文件，将每2个16进制数组成一个字节，并装填到datahex[]数组中；
void _readhex(byte datahex[])
{
  char buffer[100];
  byte length;
  byte type;
  byte n;
  filehandle=fileGetStringSZ(buffer,elcount(buffer),glbHandle);

  //将字符串转换为可操作的16进制数，buffer[0]是“：”，表示每一行的开始
  for(n=1;n<100;n++)
  {
    if(buffer[n]==0)
      break;
    if(buffer[n]>=0X30&&buffer[n]<=0X39) //数字0~9转换
      buffer[n]=buffer[n]-0X30;
    if(buffer[n]>=0X41&&buffer[n]<=0X46)//字母A~F转换
      buffer[n]=buffer[n]-0X37;
  }
  
  //将转换后的字符串每两个字符组合成一个字节的数
  for(n=0;n<40;n++)
    datahex[n]=(buffer[2*n+1]<<4)|buffer[(n+1)*2];
}

//读取hex文件中每一行数据到datanow[]，并将其装填到data36[]，并返回地址和长度
byte _loadpage(byte data36[],byte datanow[],dword& addr,dword& length34)
{
  word addrh;
  word addrl;
  byte datanext[50];
    
  hextype=datanow[3];
  if(hextype==0)
  {
    byte linelength;
    dword totallength;
    dword addrlnow;
    dword addrlnext;
    word j;
    totallength=0;          
    addrl=((word)datanow[1]<<8)|datanow[2];
    if(addrl%0x20!=0 )//针对开头就没对齐0x20 && @AUTO::Config_Switch != 9
    {
      for(j=0;j<(addrl%0x20);j++)
      {
        data36[j]=padding;
        totallength+=1;
      }
      addrl-=(addrl%0x20);
    }
    addr=addr&0xFFFF0000;
    addr=addr|addrl;
    while(totallength<=0x10000)
    {
      linelength = datanow[0];
      
      addrlnow=((dword)datanow[1]<<8)|datanow[2];//这一行的16位地址
      _readhex(datanext);//获取下一行数据
      addrlnext=((dword)datanext[1]<<8)|datanext[2];//下一行的16位地址
      
      //判断本地址块是否结束，结束之前将这一行的数据装载到data36，并将下一行的数据赋给这一行
      if(_breakpage(addrlnow,addrlnext,datanext))
      {
        for(j=0;j<linelength;j++)
          data36[totallength+j]=datanow[j+4];
        totallength+=linelength;
        
        memcpy(datanow,datanext,elCount(datanext));
        break;
      }
      else
      {
        //根据这一行和下一行的地址差值减去这一行的长度判断是否需要填充，并将数据装载到data36
        if((addrlnext-addrlnow)==linelength)
        {
          for(j=0;j<linelength;j++)
            data36[totallength+j]=datanow[j+4];
          totallength+=linelength;
        }
        else
        {
          for(j=0;j<linelength;j++)
            data36[totallength+j]=datanow[j+4];
          totallength+=linelength;
          
          for(j=0;j<(addrlnext-(addrlnow+linelength));j++)
          {
            data36[totallength]=padding;
            totallength++;
          }
        }
        //将下一行的数据重新装载到这一行
        memcpy(datanow,datanext,elCount(datanext));
      }
      
    }
//    write("totallength = 0x%x",totallength);
    if(Continueaddr[0][eraseadd] == 2)
    {
      length34 += totallength;
    }
    else
      length34 = totallength;
    
    if(((datanow[3] == 1) || (datanow[3] == 5)) && @Faultinsert::TC_Continue_36_A == 1) 
    {
      write("/*--------------- 读取到最后一行 ---------------*/");
      END_Pos = 2; 
    }
    return 1;
  }
  else if(hextype==5)
    return 0;
  else if(hextype==1)
  {
    return 0;
  }
  else
    return 0;
}

//读取hex文件中每一行数据到datanow[]，并将其装填到data36[]，并返回地址和长度
byte _loadpage1(byte data36[],byte datanow[],dword& addr,dword& length34)
{
  word addrh;
  word addrl;
  byte datanext[50];
    
  hextype=datanow[3];
  if(hextype==0)
  {
    byte linelength;
    dword totallength;
    dword addrlnow;
    dword addrlnext;
    word j;
    totallength = length34;          
    addrl=((word)datanow[1]<<8)|datanow[2];
    if(addrl%0x20!=0 )//针对开头就没对齐0x20 && @AUTO::Config_Switch != 9
    {
      for(j=0;j<(addrl%0x20);j++)
      {
        data36[totallength + j]=padding;
        totallength+=1;
      }
      addrl-=(addrl%0x20);
    }
    addr=addr&0xFFFF0000;
    addr=addr|addrl;
    while(totallength<=0x10000)
    {
      linelength = datanow[0];
      
      addrlnow=((dword)datanow[1]<<8)|datanow[2];//这一行的16位地址
      _readhex(datanext);//获取下一行数据
      addrlnext=((dword)datanext[1]<<8)|datanext[2];//下一行的16位地址
      
      //判断本地址块是否结束，结束之前将这一行的数据装载到data36，并将下一行的数据赋给这一行
      if(_breakpage(addrlnow,addrlnext,datanext))
      {
        for(j=0;j<linelength;j++)
          data36[totallength+j]=datanow[j+4];
        totallength+=linelength;
        
        memcpy(datanow,datanext,elCount(datanext));
        break;
      }
      else
      {

        //根据这一行和下一行的地址差值减去这一行的长度判断是否需要填充，并将数据装载到data36
        if((addrlnext-addrlnow)==linelength)
        {
          for(j=0;j<linelength;j++)
          {
            data36[totallength+j]=datanow[j+4];
            write("datanow[%d+4] = %x;",j,datanow[j+4]);
          }
          totallength+=linelength;
        }
        else
        {
          for(j=0;j<linelength;j++)
            data36[totallength+j]=datanow[j+4];
          totallength+=linelength;
          
          for(j=0;j<(addrlnext-(addrlnow+linelength));j++)
          {
            data36[totallength]=padding;
            totallength++;
          }
        }
        //将下一行的数据重新装载到这一行
        memcpy(datanow,datanext,elCount(datanext));
      }
      
    }
//    if(Continueaddr[0][eraseadd] == 2)
//    {
//      length34 += totallength;
//    }
//    else
      length34 = totallength;
    
    if(datanow[3] == 1 && @Faultinsert::TC_Continue_36_A == 1) 
    {
      writeEx(-3,1,"/*--------------- 读取到最后一行 ---------------*/");
      END_Pos = 2; 
    }
    return 1;
  }
  else if(hextype==5)
    return 0;
  else if(hextype==1)
  {
    return 0;
  }
  else
    return 0;
}

//判断是否读取到最后一行
byte _breakpage(word addrlnow,word addrlnext,byte datanext[])
{
  /*word addrh;
  addrh=(word)(addr>>16);*/
  if((addrlnext-addrlnow)>0x80 )
    return 1;
//  if(@AUTO::Config_Switch == 9 &&  (linelength < 0x20)  && ((addrlnext-addrlnow) > linelength))
//    return 1;
  if(datanext[3]==4 || datanext[3]==5 || datanext[3]==1 || datanext[3]==2)
    return 1;
  else
    return 0;
}

//发送请求并等待响应。如果响应是多帧不要使用此函数，因为p2cmax时间可能不够
void _SendAndWriteReport(diagRequest* obj,dword msgID)
{
  char comment[70];
  byte primitiveRaw[30];
  long size;
  byte i;

  _diagSendMsg(msgID,obj);
  testWaitForDiagRequestSent(obj,1000);
//  testWaitForDiagResponse(obj,p2cmax);
}
//判断收到响应的每个字节
//参数obj: 响应报文
//参数req: 诊断请求
//参数passcondition: {-1:期望收到肯定响应,  >0:期望的否定响应}
int _CheckResp_Byte(message* obj,diagRequest* req,int passcondition)
{
  dword ByteCount;
  dword Temp_Value;
    testStep("passcondition"," %d ",passcondition);
  if(passcondition==-1)//期望收到肯定响应
  {
    if(obj.Byte(1)==req.GetPrimitiveByte(0)+0x40)//收到肯定响应
    {
      //不同的服务
      if(req.GetPrimitiveByte(0)==0x10)//10服务
      {
        if(@AUTO::Config_Switch == 7 && (req.GetPrimitiveByte(1) == 0x03 || req.GetPrimitiveByte(1) == 0x01))
        {
//          if(obj.byte(0)== 6)
          if(obj.byte(0)== 2)
            return 1;
        }
        else
        {
          if(obj.byte(0)==6 && obj.Byte(2)==req.GetPrimitiveByte(1) && obj.Byte(3)<<8|obj.Byte(4)==p2cmax && obj.Byte(5)<<8|obj.Byte(6)==p2exs)
            return 1;
          else
            return -1;
        }
      }
      else if(req.GetPrimitiveByte(0)==0x14)//14服务
      {
        if(obj.byte(0)==1)
        {
          curAppValid = 1;
          return 1;
        }
        else
          return -1;
      }
      else if(req.GetPrimitiveByte(0)==0x11)//11服务
      {
        if(obj.byte(0)==2 && obj.Byte(2)==req.GetPrimitiveByte(1))
          return 1;
        else
          return -1;
      }
      else if(req.GetPrimitiveByte(0)==0x22)//22服务
      {
        if(obj.Byte(2)==req.GetPrimitiveByte(1) && obj.Byte(3)==req.GetPrimitiveByte(2))
          return 1;
        else
          return -1;
      }
      else if(req.GetPrimitiveByte(0)==0x2E)//2E服务
      {
        if(obj.byte(0)==3 && obj.Byte(2)==req.GetPrimitiveByte(1) && obj.Byte(3)==req.GetPrimitiveByte(2))
          return 1;
        else
          return -1;
      }
      else if(req.GetPrimitiveByte(0)==0x27 && req.GetPrimitiveByte(1)==SeedLevel)//27 01服务
      {
        if(obj.byte(1)==0x67 && obj.Byte(2)==req.GetPrimitiveByte(1))
          return 1;
        else
          return -1;
      }
      else if(req.GetPrimitiveByte(0)==0x27 && req.GetPrimitiveByte(1)==SeedLevel+1)//27 02服务
      {
        if(obj.byte(1)==0x67 && obj.Byte(2)==req.GetPrimitiveByte(1))
          return 1;
        else
          return -1;
      }
      else if(req.GetPrimitiveByte(0)==0x31)//31服务
      {
        if(@AUTO::Config_Switch==1 || @AUTO::Config_Switch==3)//BYD || Geely 1.0 
        {
          if(obj.byte(0)==5 && obj.Byte(2)==req.GetPrimitiveByte(1) && obj.Byte(3)==req.GetPrimitiveByte(2) && obj.Byte(4)==req.GetPrimitiveByte(3) && obj.Byte(5)==PassState_31[0])
            return 1;
          else
            return -1;
        }
        else if(@AUTO::Config_Switch==2)//ChangAn
        {
          if(obj.byte(0)==4 && obj.Byte(2)==req.GetPrimitiveByte(1) && obj.Byte(3)==req.GetPrimitiveByte(2) && obj.Byte(4)==req.GetPrimitiveByte(3))
            return 1;
          else
            return -1;
        }
        else if(@AUTO::Config_Switch==4)//Geely3.0
        {
          //31 01 02 12
          if(req.GetPrimitiveByte(2)==0x02 && req.GetPrimitiveByte(3)==0x12)
          {
            testStep("","0x%02X 0x%02X 0x%02X 0x%02X 0x%02X 0x%02X 0x%02X",req.GetPrimitiveByte(0),req.GetPrimitiveByte(1),req.GetPrimitiveByte(2),req.GetPrimitiveByte(03),req.GetPrimitiveByte(4)
            ,req.GetPrimitiveByte(5),req.GetPrimitiveByte(6));
            if(obj.byte(0)==6 && obj.Byte(2)==req.GetPrimitiveByte(1) && obj.Byte(3)==req.GetPrimitiveByte(2) && obj.Byte(4)==req.GetPrimitiveByte(3)
              && obj.Byte(5)==PassState_31[0] && obj.Byte(6)==PassState_31[1])
              return 1;
            else
              return -1;
          }
          //31 01 02 05
          else if(req.GetPrimitiveByte(2)==0x02 && req.GetPrimitiveByte(3)==0x05)
          {
            if(obj.byte(2)==0x71 && obj.Byte(3)==req.GetPrimitiveByte(1) && obj.Byte(4)==req.GetPrimitiveByte(2) && obj.Byte(5)==req.GetPrimitiveByte(3)
              && obj.Byte(6)==PassState_31[0] && obj.Byte(7)==PassState_31[1])
              return 1;
            else
              return -1;
          }
          else
          {
            if(obj.byte(0)==5 && obj.Byte(2)==req.GetPrimitiveByte(1) && obj.Byte(3)==req.GetPrimitiveByte(2) && obj.Byte(4)==req.GetPrimitiveByte(3) 
              && obj.Byte(5)==PassState_31[0])
              return 1;
            else
              return -1;
          }
        }
        else if(@AUTO::Config_Switch==5)//鑫源
        {
          //31 01 FF 00
          if(req.GetPrimitiveByte(2)==0xFF && req.GetPrimitiveByte(3)==0x00)
          {
            if(obj.byte(0)==5 && obj.Byte(2)==req.GetPrimitiveByte(1) && obj.Byte(3)==req.GetPrimitiveByte(2) && obj.Byte(4)==req.GetPrimitiveByte(3))
              return 1;
            else
              return -1;
          }
          else
          {
            if(obj.byte(0)==5 && obj.Byte(2)==req.GetPrimitiveByte(1) && obj.Byte(3)==req.GetPrimitiveByte(2) && obj.Byte(4)==req.GetPrimitiveByte(3) && obj.Byte(5)==PassState_31[0])
              return 1;
            else
              return -1;
          }
        }
        else if(@AUTO::Config_Switch==6)//瑞驰
        {
          //31 01 FF 00
          if(req.GetPrimitiveByte(2)==0xFF && req.GetPrimitiveByte(3)==0x00)
          {
            if(obj.byte(0)==4 && obj.Byte(2)==req.GetPrimitiveByte(1) && obj.Byte(3)==req.GetPrimitiveByte(2) && obj.Byte(4)==req.GetPrimitiveByte(3))
              return 1;
            else
              return -1;
          }
          else
          {
            if(obj.byte(0)==5 && obj.Byte(2)==req.GetPrimitiveByte(1) && obj.Byte(3)==req.GetPrimitiveByte(2) && obj.Byte(4)==req.GetPrimitiveByte(3) && obj.Byte(5)==PassState_31[0])
              return 1;
            else
              return -1;
          }
        }
        else if(@AUTO::Config_Switch==7)//奇瑞
        {
          //31 02 XX XX
          if(req.GetPrimitiveByte(1)==0x02)
          {
            //31 02 FF 00
            if(req.GetPrimitiveByte(2)==0xFF && req.GetPrimitiveByte(3)==0x00)
            {
              if(obj.byte(0)==5 && obj.Byte(2)==req.GetPrimitiveByte(1) && obj.Byte(3)==req.GetPrimitiveByte(2) && obj.Byte(4)==req.GetPrimitiveByte(3) && obj.Byte(5)==PassState_31[2])
                return 1;
              else
                return -1;
            }
            //31 02 FF 01
            if(obj.byte(0)==6 && obj.Byte(2)==req.GetPrimitiveByte(1) && obj.Byte(3)==req.GetPrimitiveByte(2) && obj.Byte(4)==req.GetPrimitiveByte(3) && obj.Byte(5)==0x04 && obj.Byte(6)==PassState_31[0])
              return 1;
            else
              return -1;
          }
          //31 03 XX XX
          else if(req.GetPrimitiveByte(1)==0x03)
          {
            if(obj.byte(0)==5 && obj.Byte(2)==req.GetPrimitiveByte(1) && obj.Byte(3)==req.GetPrimitiveByte(2) && obj.Byte(4)==req.GetPrimitiveByte(3) && obj.Byte(5)==PassState_31[1])
              return 1;
            else
              return -1;
          }
        }
        else if(@AUTO::Config_Switch==11)//奇瑞T1V
        {
//          writeEx(-3,0,"%02X %02X %02X %02X",req.GetPrimitiveByte(0),req.GetPrimitiveByte(1),req.GetPrimitiveByte(2),req.GetPrimitiveByte(3));
          //31 02 XX XX
          if(req.GetPrimitiveByte(1)==0x02)
          {
            //31 02 FF 00
            if(req.GetPrimitiveByte(2)==0xFF && req.GetPrimitiveByte(3)==0x00)
            {
              if(obj.byte(0)==5 && obj.Byte(2)==req.GetPrimitiveByte(1) && obj.Byte(3)==req.GetPrimitiveByte(2) && obj.Byte(4)==req.GetPrimitiveByte(3) && obj.Byte(5)==PassState_31[2])
                return 1;
              else
                return -1;
            }
            //31 02 FF 01
            if(obj.byte(0)==6 && obj.Byte(2)==req.GetPrimitiveByte(1) && obj.Byte(3)==req.GetPrimitiveByte(2) && obj.Byte(4)==req.GetPrimitiveByte(3) && obj.Byte(5)==0x04 && obj.Byte(6)==PassState_31[0])
              return 1;
            else
              return -1;
          }
          //31 03 XX XX
          else if(req.GetPrimitiveByte(1)==0x03)
          {
            if(obj.byte(0)==5 && obj.Byte(2)==req.GetPrimitiveByte(1) && obj.Byte(3)==req.GetPrimitiveByte(2) && obj.Byte(4)==req.GetPrimitiveByte(3) && obj.Byte(5)==PassState_31[1])
              return 1;
            else
              return -1;
          }
          else if(req.GetPrimitiveByte(1)==0x01 && req.GetPrimitiveByte(0)==0x31 && req.GetPrimitiveByte(2)==0x02  && req.GetPrimitiveByte(3)==0x03)/*程序BUG新增，待修复后删除*/
          {
            if(obj.byte(0)==5 && obj.Byte(2)==req.GetPrimitiveByte(1) && obj.Byte(3)==req.GetPrimitiveByte(2) && obj.Byte(4)==req.GetPrimitiveByte(3))
              return 1;
            else
              return -1;
          }
          else
          {
            if(obj.byte(0)==5 && obj.Byte(2)==req.GetPrimitiveByte(1) && obj.Byte(3)==req.GetPrimitiveByte(2) && obj.Byte(4)==req.GetPrimitiveByte(3) && obj.Byte(5)==PassState_31[0])
              return 1;
            else
              return -1;
          }
        }
        else if(@AUTO::Config_Switch==9)//小康
        {
          //31 01 02 02
          if(req.GetPrimitiveByte(1)==0x01 && req.GetPrimitiveByte(2)==0x02 && req.GetPrimitiveByte(3)==0x02)
          {
            if(obj.byte(0)==5 && obj.Byte(2)==req.GetPrimitiveByte(1) && obj.Byte(3)==req.GetPrimitiveByte(2) && obj.Byte(4)==req.GetPrimitiveByte(3) && obj.Byte(5)==PassState_31[0])
              return 1;
            else
              return -1;
          }
          //31 01 FF 01
          else if(req.GetPrimitiveByte(1)==0x01 && req.GetPrimitiveByte(2)==0xFF && req.GetPrimitiveByte(3)==0x01)
          {
            if(obj.byte(0)==5 && obj.Byte(2)==req.GetPrimitiveByte(1) && obj.Byte(3)==req.GetPrimitiveByte(2) && obj.Byte(4)==req.GetPrimitiveByte(3) && obj.Byte(5)==PassState_31[0])
              return 1;
            else
              return -1;
          }
          else
          {
            if(obj.byte(0)==4 && obj.Byte(2)==req.GetPrimitiveByte(1) && obj.Byte(3)==req.GetPrimitiveByte(2) && obj.Byte(4)==req.GetPrimitiveByte(3))
              return 1;
            else
              return -1;
          }
        }
        else if(@AUTO::Config_Switch==12)//广汽
        {
          if(obj.byte(0)==5 && obj.Byte(2)==req.GetPrimitiveByte(1) && obj.Byte(3)==req.GetPrimitiveByte(2) && obj.Byte(4)==req.GetPrimitiveByte(3) && obj.Byte(5)==PassState_31[0])
            return 1;
          else
            return -1;
        }
        else if(@AUTO::Config_Switch==13)//V8
        {
          //31 01 02 02/ 31 01 FF 00/ 31 01 FF 01
          {
            if(obj.byte(0)==4 && obj.Byte(2)==req.GetPrimitiveByte(1) && obj.Byte(3)==req.GetPrimitiveByte(2) && obj.Byte(4)==req.GetPrimitiveByte(3))
              return 1;
            else
              return -1;
          }
        }
        //五菱 || 赛力斯
        else 
        {
          //31 01 FF 00
          if(req.GetPrimitiveByte(2)==0xFF && req.GetPrimitiveByte(3)==0x00)
          {
            if(obj.byte(0)==4 && obj.Byte(2)==req.GetPrimitiveByte(1) && obj.Byte(3)==req.GetPrimitiveByte(2) && obj.Byte(4)==req.GetPrimitiveByte(3))
              return 1;
            else
              return -1;
          }
          else
          {
            if(obj.byte(0)==5 && obj.Byte(2)==req.GetPrimitiveByte(1) && obj.Byte(3)==req.GetPrimitiveByte(2) && obj.Byte(4)==req.GetPrimitiveByte(3) && obj.Byte(5)==PassState_31[0])
              return 1;
            else
              return -1;
          }
        }
      }
      else if(req.GetPrimitiveByte(0)==0x34)//34服务
      {
        if(@AUTO::Config_Switch==11) //奇瑞
        {
          if(obj.byte(0)==6 && obj.byte(2)==0x40 && obj.byte(3)==0 && obj.byte(4)==0 && obj.byte(5)==0x0F && obj.byte(6)==0xFF)
            return 1;
          else
            return -1;
        }
        else
        {
          if(obj.byte(0)==4 && obj.byte(2)==0x20 && obj.byte(3)<<8|obj.byte(4)==DataLengthmax_34)
            return 1;
          else
            return -1;
        }
      }
      else if(req.GetPrimitiveByte(0)==0x36)//36服务
      {
        if(obj.byte(0)==2 && obj.Byte(2)==req.GetPrimitiveByte(1))
          return 1;
        else
          return -1;
      }
      else if(req.GetPrimitiveByte(0)==0x37)//37服务
      {
        if(@AUTO::Config_Switch==2)//ChangAn
        {
          if(obj.byte(0)==3)
            return 1;
          else
            return -1;
        }
        else if(@AUTO::Config_Switch==7)//奇瑞
        {
          if(obj.byte(0)==2)
            return 1;
          else
            return -1;
        }
        else if(@AUTO::Config_Switch==9)//小康
        {
          if(obj.byte(0)==5)
            return 1;
          else
            return -1;
        }
        
        //BYD || Geely 1.0 || 鑫源 || 瑞驰 || 五菱
        else 
        {
          if(obj.byte(0)==1)
            return 1;
          else
            return -1;
        }
      }
      else//其它服务
      {
        if(obj.byte(0)==2 && obj.Byte(2)==req.GetPrimitiveByte(1))
          return 1;
        else
          return -1;
      }
    }
    //收到多帧响应，判断首帧
    else if(obj.Byte(2)==req.GetPrimitiveByte(0)+0x40)
    {
      if(obj.Byte(3)==req.GetPrimitiveByte(1) && obj.Byte(4)==req.GetPrimitiveByte(2))
        return 1;
      else
        return -1;
    }
    //收到否定响应
    else if(obj.Byte(1)==0x7F)
      return -1;
  }
  else if(passcondition > 0)//期望收到否定响应
  {
    if(obj.Byte(1)==0x7F && obj.Byte(2)==req.GetPrimitiveByte(0) && obj.Byte(3)==passcondition)
      return 1;
    else 
      return -1;
  }
  return 0;
}


//根据测试通过条件，在报告上标记结果，判断响应时的各个字节
_TestResult(diagRequest* obj,char stepid[],int passcondition)
{
  char comment[50];
  if(noCheck==1)//不判断响应
  {
    testStepPass(stepid,"不判断诊断的响应");
  }
  else if(passcondition==-1)//期望收到肯定响应
  {
    snprintf(comment,elCount(comment),"期望收到肯定响应");
    //不同的服务
    if(obj.GetPrimitiveByte(0)==0x10)//10服务
    {
      if(diagGetLastResponseCode(obj)==-1)//收到肯定响应
      {
        if(obj.GetRespPrimitiveByte(0)==obj.GetPrimitiveByte(0)+0x40 && obj.GetRespPrimitiveByte(1)==obj.GetPrimitiveByte(1) 
        && obj.GetRespPrimitiveByte(2)<<8|obj.GetRespPrimitiveByte(3)==0x32 && obj.GetRespPrimitiveByte(4)<<8|obj.GetRespPrimitiveByte(5)==p2exs) 
          testStepPass(stepid,"%s，实际收到肯定响应:%02X %02X %02X %02X %02X %02X",comment,obj.GetRespPrimitiveByte(0),obj.GetRespPrimitiveByte(1),obj.GetRespPrimitiveByte(2),obj.GetRespPrimitiveByte(3),obj.GetRespPrimitiveByte(4),obj.GetRespPrimitiveByte(5));
        else
          testStepFail(stepid,"%s，实际收到肯定响应:%02X %02X %02X %02X %02X %02X",comment,obj.GetRespPrimitiveByte(0),obj.GetRespPrimitiveByte(1),obj.GetRespPrimitiveByte(2),obj.GetRespPrimitiveByte(3),obj.GetRespPrimitiveByte(4),obj.GetRespPrimitiveByte(5));
      }
      //没有收到肯定响应
      else if(diagGetLastResponseCode(obj)>0)
        testStepFail(stepid,"%s，实际收到否定响应:%02X %02X %02X",comment,obj.GetRespPrimitiveByte(0),obj.GetRespPrimitiveByte(1),obj.GetRespPrimitiveByte(2));
      else
        testStepFail(stepid,"%s，实际没收到响应",comment);
    }
    else if(obj.GetPrimitiveByte(0)==0x11)//11服务
    {
      if(diagGetLastResponseCode(obj)==-1)//收到肯定响应
      {
        if(obj.GetRespPrimitiveByte(0)==obj.GetPrimitiveByte(0)+0x40 && obj.GetRespPrimitiveByte(1)==obj.GetPrimitiveByte(1)) 
          testStepPass(stepid,"%s，实际收到肯定响应:%02X %02X",comment,obj.GetRespPrimitiveByte(0),obj.GetRespPrimitiveByte(1));
        else
          testStepFail(stepid,"%s，实际收到肯定响应:%02X %02X",comment,obj.GetRespPrimitiveByte(0),obj.GetRespPrimitiveByte(1));
      }
      //没有收到肯定响应
      else if(diagGetLastResponseCode(obj)>0)
        testStepFail(stepid,"%s，实际收到否定响应:%02X %02X %02X",comment,obj.GetRespPrimitiveByte(0),obj.GetRespPrimitiveByte(1),obj.GetRespPrimitiveByte(2));
      else
        testStepFail(stepid,"%s，实际没收到响应",comment);
    }
    else if(obj.GetPrimitiveByte(0)==0x22)//22服务
    {
      if(diagGetLastResponseCode(obj)==-1)//收到肯定响应
      {
        if(obj.GetRespPrimitiveByte(0)==obj.GetPrimitiveByte(0)+0x40 && obj.GetRespPrimitiveByte(1)==obj.GetPrimitiveByte(1) && obj.GetRespPrimitiveByte(2)==obj.GetPrimitiveByte(2)) 
          testStepPass(stepid,"%s，实际收到肯定响应:%02X %02X %02X %02X %02X %02X %02X",comment,obj.GetRespPrimitiveByte(0),obj.GetRespPrimitiveByte(1),obj.GetRespPrimitiveByte(2),
          obj.GetRespPrimitiveByte(3),obj.GetRespPrimitiveByte(4),obj.GetRespPrimitiveByte(5),obj.GetRespPrimitiveByte(6));
        else
          testStepFail(stepid,"%s，实际收到肯定响应:%02X %02X %02X %02X %02X %02X %02X",comment,obj.GetRespPrimitiveByte(0),obj.GetRespPrimitiveByte(1),obj.GetRespPrimitiveByte(2),
          obj.GetRespPrimitiveByte(3),obj.GetRespPrimitiveByte(4),obj.GetRespPrimitiveByte(5),obj.GetRespPrimitiveByte(6));
      }
      //没有收到肯定响应
      else if(diagGetLastResponseCode(obj)>0)
        testStepFail(stepid,"%s，实际收到否定响应:%02X %02X %02X",comment,obj.GetRespPrimitiveByte(0),obj.GetRespPrimitiveByte(1),obj.GetRespPrimitiveByte(2));
      else
        testStepFail(stepid,"%s，实际没收到响应",comment);
    }
    else if(obj.GetPrimitiveByte(0)==0x2E)//2E服务
    {
      if(diagGetLastResponseCode(obj)==-1)//收到肯定响应
      {
        if(obj.GetRespPrimitiveByte(0)==obj.GetPrimitiveByte(0)+0x40 && obj.GetRespPrimitiveByte(1)==obj.GetPrimitiveByte(1) && obj.GetRespPrimitiveByte(2)==obj.GetPrimitiveByte(2)) 
          testStepPass(stepid,"%s，实际收到肯定响应:%02X %02X %02X",comment,obj.GetRespPrimitiveByte(0),obj.GetRespPrimitiveByte(1),obj.GetRespPrimitiveByte(2));
        else
          testStepFail(stepid,"%s，实际收到肯定响应:%02X %02X %02X",comment,obj.GetRespPrimitiveByte(0),obj.GetRespPrimitiveByte(1),obj.GetRespPrimitiveByte(2));
      }
      //没有收到肯定响应
      else if(diagGetLastResponseCode(obj)>0)
        testStepFail(stepid,"%s，实际收到否定响应:%02X %02X %02X",comment,obj.GetRespPrimitiveByte(0),obj.GetRespPrimitiveByte(1),obj.GetRespPrimitiveByte(2));
      else
        testStepFail(stepid,"%s，实际没收到响应",comment);
    }
    else if(obj.GetPrimitiveByte(0)==0x27 && obj.GetPrimitiveByte(1)==0x01)//27 01服务
    {
      if(diagGetLastResponseCode(obj)==-1)//收到肯定响应
      {
        if(obj.GetRespPrimitiveByte(0)==obj.GetPrimitiveByte(0)+0x40 && obj.GetRespPrimitiveByte(1)==obj.GetPrimitiveByte(1)) 
          testStepPass(stepid,"%s，实际收到肯定响应:%02X %02X %02X %02X %02X %02X",comment,
          obj.GetRespPrimitiveByte(0),obj.GetRespPrimitiveByte(1),obj.GetRespPrimitiveByte(2),obj.GetRespPrimitiveByte(3),
          obj.GetRespPrimitiveByte(4),obj.GetRespPrimitiveByte(5));
        else
          testStepFail(stepid,"%s，实际收到肯定响应:%02X %02X %02X %02X %02X %02X",comment,
          obj.GetRespPrimitiveByte(0),obj.GetRespPrimitiveByte(1),obj.GetRespPrimitiveByte(2),obj.GetRespPrimitiveByte(3),
          obj.GetRespPrimitiveByte(4),obj.GetRespPrimitiveByte(5));
      }
      //没有收到肯定响应
      else if(diagGetLastResponseCode(obj)>0)
        testStepFail(stepid,"%s，实际收到否定响应:%02X %02X %02X",comment,obj.GetRespPrimitiveByte(0),obj.GetRespPrimitiveByte(1),obj.GetRespPrimitiveByte(2));
      else
        testStepFail(stepid,"%s，实际没收到响应",comment);
    }
    else if(obj.GetPrimitiveByte(0)==0x27 && obj.GetPrimitiveByte(1)==0x02)//27 02服务
    {
      if(diagGetLastResponseCode(obj)==-1)//收到肯定响应
      {
        if(obj.GetRespPrimitiveByte(0)==obj.GetPrimitiveByte(0)+0x40 && obj.GetRespPrimitiveByte(1)==obj.GetPrimitiveByte(1)) 
          testStepPass(stepid,"%s，实际收到肯定响应:%02X %02X",comment,obj.GetRespPrimitiveByte(0),obj.GetRespPrimitiveByte(1));
        else
          testStepFail(stepid,"%s，实际收到肯定响应:%02X %02X",comment,obj.GetRespPrimitiveByte(0),obj.GetRespPrimitiveByte(1));
      }
      //没有收到肯定响应
      else if(diagGetLastResponseCode(obj)>0)
        testStepFail(stepid,"%s，实际收到否定响应:%02X %02X %02X",comment,obj.GetRespPrimitiveByte(0),obj.GetRespPrimitiveByte(1),obj.GetRespPrimitiveByte(2));
      else
        testStepFail(stepid,"%s，实际没收到响应",comment);
    }
    else if(obj.GetPrimitiveByte(0)==0x28)//28服务
    {
      if(diagGetLastResponseCode(obj)==-1)//收到肯定响应
      {
        if(obj.GetRespPrimitiveByte(0)==obj.GetPrimitiveByte(0)+0x40 && obj.GetRespPrimitiveByte(1)==obj.GetPrimitiveByte(1)) 
          testStepPass(stepid,"%s，实际收到肯定响应:%02X %02X",comment,obj.GetRespPrimitiveByte(0),obj.GetRespPrimitiveByte(1));
        else
          testStepFail(stepid,"%s，实际收到肯定响应:%02X %02X",comment,obj.GetRespPrimitiveByte(0),obj.GetRespPrimitiveByte(1));
      }
      //没有收到肯定响应
      else if(diagGetLastResponseCode(obj)>0)
        testStepFail(stepid,"%s，实际收到否定响应:%02X %02X %02X",comment,obj.GetRespPrimitiveByte(0),obj.GetRespPrimitiveByte(1),obj.GetRespPrimitiveByte(2));
      else
        testStepFail(stepid,"%s，实际没收到响应",comment);
    }
    else if(obj.GetPrimitiveByte(0)==0x3E)//3E服务
    {
      if(diagGetLastResponseCode(obj)==-1)//收到肯定响应
      {
        if(obj.GetRespPrimitiveByte(0)==obj.GetPrimitiveByte(0)+0x40 && obj.GetRespPrimitiveByte(1)==obj.GetPrimitiveByte(1)) 
          testStepPass(stepid,"%s，实际收到肯定响应:%02X %02X",comment,obj.GetRespPrimitiveByte(0),obj.GetRespPrimitiveByte(1));
        else
          testStepFail(stepid,"%s，实际收到肯定响应:%02X %02X",comment,obj.GetRespPrimitiveByte(0),obj.GetRespPrimitiveByte(1));
      }
      //没有收到肯定响应
      else if(diagGetLastResponseCode(obj)>0)
        testStepFail(stepid,"%s，实际收到否定响应:%02X %02X %02X",comment,obj.GetRespPrimitiveByte(0),obj.GetRespPrimitiveByte(1),obj.GetRespPrimitiveByte(2));
      else
        testStepFail(stepid,"%s，实际没收到响应",comment);
    }
    else if(obj.GetPrimitiveByte(0)==0x85)//85服务
    {
      if(diagGetLastResponseCode(obj)==-1)//收到肯定响应
      {
        if(obj.GetRespPrimitiveByte(0)==obj.GetPrimitiveByte(0)+0x40 && obj.GetRespPrimitiveByte(1)==obj.GetPrimitiveByte(1)) 
          testStepPass(stepid,"%s，实际收到肯定响应:%02X %02X",comment,obj.GetRespPrimitiveByte(0),obj.GetRespPrimitiveByte(1));
        else
          testStepFail(stepid,"%s，实际收到肯定响应:%02X %02X",comment,obj.GetRespPrimitiveByte(0),obj.GetRespPrimitiveByte(1));
      }
      //没有收到肯定响应
      else if(diagGetLastResponseCode(obj)>0)
        testStepFail(stepid,"%s，实际收到否定响应:%02X %02X %02X",comment,obj.GetRespPrimitiveByte(0),obj.GetRespPrimitiveByte(1),obj.GetRespPrimitiveByte(2));
      else
        testStepFail(stepid,"%s，实际没收到响应",comment);
    }
    else if(obj.GetPrimitiveByte(0)==0x31)//31服务
    {
      //收到肯定响应
      if(diagGetLastResponseCode(obj)==-1)
      {
        //不同主机厂，响应不同
        if(@AUTO::Config_Switch==1)//BYD
        {
          if(obj.GetRespPrimitiveByte(0)==obj.GetPrimitiveByte(0)+0x40 && obj.GetRespPrimitiveByte(1)==obj.GetPrimitiveByte(1) && obj.GetRespPrimitiveByte(2)==obj.GetPrimitiveByte(2) 
          && obj.GetRespPrimitiveByte(3)==obj.GetPrimitiveByte(3) && obj.GetRespPrimitiveByte(4)==PassState_31[0])
            testStepPass(stepid,"%s，实际收到肯定响应:%02X %02X %02X %02X %02X",comment,obj.GetRespPrimitiveByte(0),obj.GetRespPrimitiveByte(1),obj.GetRespPrimitiveByte(2),obj.GetRespPrimitiveByte(3),obj.GetRespPrimitiveByte(4));
          else
            testStepFail(stepid,"%s，实际收到肯定响应:%02X %02X %02X %02X %02X",comment,obj.GetRespPrimitiveByte(0),obj.GetRespPrimitiveByte(1),obj.GetRespPrimitiveByte(2),obj.GetRespPrimitiveByte(3),obj.GetRespPrimitiveByte(4));
        }
        else if(@AUTO::Config_Switch==2)//ChangAn
        {
          if(obj.GetRespPrimitiveByte(0)==obj.GetPrimitiveByte(0)+0x40 && obj.GetRespPrimitiveByte(1)==obj.GetPrimitiveByte(1) && obj.GetRespPrimitiveByte(2)==obj.GetPrimitiveByte(2) 
          && obj.GetRespPrimitiveByte(3)==obj.GetPrimitiveByte(3))
            testStepPass(stepid,"%s，实际收到肯定响应:%02X %02X %02X %02X",comment,obj.GetRespPrimitiveByte(0),obj.GetRespPrimitiveByte(1),obj.GetRespPrimitiveByte(2),obj.GetRespPrimitiveByte(3));
          else
            testStepFail(stepid,"%s，实际收到肯定响应:%02X %02X %02X %02X",comment,obj.GetRespPrimitiveByte(0),obj.GetRespPrimitiveByte(1),obj.GetRespPrimitiveByte(2),obj.GetRespPrimitiveByte(3));
        }
        else if(@AUTO::Config_Switch==5)//鑫源
        {
          //31 01 FF 00
          if(obj.GetPrimitiveByte(2)==0xFF && obj.GetPrimitiveByte(3)==0x00)
          {
            if(obj.GetRespPrimitiveByte(0)==obj.GetPrimitiveByte(0)+0x40 && obj.GetRespPrimitiveByte(1)==obj.GetPrimitiveByte(1) && obj.GetRespPrimitiveByte(2)==obj.GetPrimitiveByte(2) 
            && obj.GetRespPrimitiveByte(3)==obj.GetPrimitiveByte(3))
              testStepPass(stepid,"%s，实际收到肯定响应:%02X %02X %02X %02X",comment,obj.GetRespPrimitiveByte(0),obj.GetRespPrimitiveByte(1),obj.GetRespPrimitiveByte(2),obj.GetRespPrimitiveByte(3));
            else
              testStepFail(stepid,"%s，实际收到肯定响应:%02X %02X %02X %02X",comment,obj.GetRespPrimitiveByte(0),obj.GetRespPrimitiveByte(1),obj.GetRespPrimitiveByte(2),obj.GetRespPrimitiveByte(3));
          }
          else
          {
            if(obj.GetRespPrimitiveByte(0)==obj.GetPrimitiveByte(0)+0x40 && obj.GetRespPrimitiveByte(1)==obj.GetPrimitiveByte(1) && obj.GetRespPrimitiveByte(2)==obj.GetPrimitiveByte(2) 
            && obj.GetRespPrimitiveByte(3)==obj.GetPrimitiveByte(3) && obj.GetRespPrimitiveByte(4)==PassState_31[0])
              testStepPass(stepid,"%s，实际收到肯定响应:%02X %02X %02X %02X %02X",comment,obj.GetRespPrimitiveByte(0),obj.GetRespPrimitiveByte(1),obj.GetRespPrimitiveByte(2),obj.GetRespPrimitiveByte(3),obj.GetRespPrimitiveByte(4));
            else
              testStepFail(stepid,"%s，实际收到肯定响应:%02X %02X %02X %02X %02X",comment,obj.GetRespPrimitiveByte(0),obj.GetRespPrimitiveByte(1),obj.GetRespPrimitiveByte(2),obj.GetRespPrimitiveByte(3),obj.GetRespPrimitiveByte(4));
          }
        }
        else if(@AUTO::Config_Switch==11)//奇瑞T1V
        {
          if(obj.GetPrimitiveByte(0) == 0x31 && obj.GetPrimitiveByte(1) == 0x01 && obj.GetPrimitiveByte(2) == 0x02 && obj.GetPrimitiveByte(3) == 0x03) /*程序BUG新增，修复后删除*/
          {
            if(obj.GetRespPrimitiveByte(0)==obj.GetPrimitiveByte(0)+0x40 && obj.GetRespPrimitiveByte(1)==obj.GetPrimitiveByte(1) && obj.GetRespPrimitiveByte(2)==obj.GetPrimitiveByte(2) 
            && obj.GetRespPrimitiveByte(3)==obj.GetPrimitiveByte(3) /*&& obj.GetRespPrimitiveByte(4)== PassState_31[0]*/ )
              testStepPass(stepid,"%s，实际收到肯定响应:%02X %02X %02X %02X %02X",comment,obj.GetRespPrimitiveByte(0),obj.GetRespPrimitiveByte(1),obj.GetRespPrimitiveByte(2),obj.GetRespPrimitiveByte(3),obj.GetRespPrimitiveByte(4));
            else
              testStepFail(stepid,"%s，实际收到肯定响应:%02X %02X %02X %02X %02X",comment,obj.GetRespPrimitiveByte(0),obj.GetRespPrimitiveByte(1),obj.GetRespPrimitiveByte(2),obj.GetRespPrimitiveByte(3),obj.GetRespPrimitiveByte(4));
          }
          else
          {
            if(obj.GetRespPrimitiveByte(0)==obj.GetPrimitiveByte(0)+0x40 && obj.GetRespPrimitiveByte(1)==obj.GetPrimitiveByte(1) && obj.GetRespPrimitiveByte(2)==obj.GetPrimitiveByte(2) 
            && obj.GetRespPrimitiveByte(3)==obj.GetPrimitiveByte(3) && obj.GetRespPrimitiveByte(4)== PassState_31[0] )
              testStepPass(stepid,"%s，实际收到肯定响应:%02X %02X %02X %02X %02X",comment,obj.GetRespPrimitiveByte(0),obj.GetRespPrimitiveByte(1),obj.GetRespPrimitiveByte(2),obj.GetRespPrimitiveByte(3),obj.GetRespPrimitiveByte(4));
            else
              testStepFail(stepid,"%s，实际收到肯定响应:%02X %02X %02X %02X %02X",comment,obj.GetRespPrimitiveByte(0),obj.GetRespPrimitiveByte(1),obj.GetRespPrimitiveByte(2),obj.GetRespPrimitiveByte(3),obj.GetRespPrimitiveByte(4));
          }
        }
      }
      //没有收到肯定响应
      else if(diagGetLastResponseCode(obj)>0)
        testStepFail(stepid,"%s，实际收到否定响应:%02X %02X %02X",comment,obj.GetRespPrimitiveByte(0),obj.GetRespPrimitiveByte(1),obj.GetRespPrimitiveByte(2));
      else
        testStepFail(stepid,"%s，实际没收到响应",comment);
    }
    else if(obj.GetPrimitiveByte(0)==0x34)//34服务
    {
      if(diagGetLastResponseCode(obj)==-1)//收到肯定响应
      {
        if(obj.GetRespPrimitiveByte(0)==obj.GetPrimitiveByte(0)+0x40 && obj.GetRespPrimitiveByte(1)==0x20 && obj.GetRespPrimitiveByte(2)<<8|obj.GetRespPrimitiveByte(3)==DataLengthmax_34)
          testStepPass(stepid,"%s，实际收到肯定响应:%02X %02X %02X %02X",comment,obj.GetRespPrimitiveByte(0),obj.GetRespPrimitiveByte(1),obj.GetRespPrimitiveByte(2),obj.GetRespPrimitiveByte(3));
        else
          testStepFail(stepid,"%s，实际收到肯定响应:%02X %02X %02X %02X",comment,obj.GetRespPrimitiveByte(0),obj.GetRespPrimitiveByte(1),obj.GetRespPrimitiveByte(2),obj.GetRespPrimitiveByte(3));
      }
      //没有收到肯定响应
      else if(diagGetLastResponseCode(obj)>0)
        testStepFail(stepid,"%s，实际收到否定响应:%02X %02X %02X",comment,obj.GetRespPrimitiveByte(0),obj.GetRespPrimitiveByte(1),obj.GetRespPrimitiveByte(2));
      else
        testStepFail(stepid,"%s，实际没收到响应",comment);
    }
    else if(obj.GetPrimitiveByte(0)==0x36)//36服务
    {
      if(diagGetLastResponseCode(obj)==-1)//收到肯定响应
      {
        if(obj.GetRespPrimitiveByte(0)==obj.GetPrimitiveByte(0)+0x40 && obj.GetRespPrimitiveByte(1)==obj.GetPrimitiveByte(1))
          testStepPass(stepid,"%s，实际收到肯定响应:%02X %02X",comment,obj.GetRespPrimitiveByte(0),obj.GetRespPrimitiveByte(1));
        else
          testStepFail(stepid,"%s，实际收到肯定响应:%02X %02X",comment,obj.GetRespPrimitiveByte(0),obj.GetRespPrimitiveByte(1));
      }
      //没有收到肯定响应
      else if(diagGetLastResponseCode(obj)>0)
        testStepFail(stepid,"%s，实际收到否定响应:%02X %02X %02X",comment,obj.GetRespPrimitiveByte(0),obj.GetRespPrimitiveByte(1),obj.GetRespPrimitiveByte(2));
      else
        testStepFail(stepid,"%s，实际没收到响应",comment);
    }
    else if(obj.GetPrimitiveByte(0)==0x37)//37服务
    {
      if(diagGetLastResponseCode(obj)==-1)//收到肯定响应
      {
        if(obj.GetRespPrimitiveByte(0)==obj.GetPrimitiveByte(0)+0x40)
          testStepPass(stepid,"%s，实际收到肯定响应:%02X",comment,obj.GetRespPrimitiveByte(0));
        else
          testStepFail(stepid,"%s，实际收到肯定响应:%02X",comment,obj.GetRespPrimitiveByte(0));
      }
      //没有收到肯定响应
      else if(diagGetLastResponseCode(obj)>0)
        testStepFail(stepid,"%s，实际收到否定响应:%02X %02X %02X",comment,obj.GetRespPrimitiveByte(0),obj.GetRespPrimitiveByte(1),obj.GetRespPrimitiveByte(2));
      else
        testStepFail(stepid,"%s，实际没收到响应",comment);
    }
    else //其它服务
    {
      if(diagGetLastResponseCode(obj)==-1)//收到肯定响应
        testStepPass(stepid,"%s，实际收到肯定响应:%02X %02X %02X",comment,obj.GetRespPrimitiveByte(0),obj.GetRespPrimitiveByte(1),obj.GetRespPrimitiveByte(2));
      //没有收到肯定响应
      else if(diagGetLastResponseCode(obj)>0)
        testStepFail(stepid,"%s，实际收到否定响应:%02X %02X %02X",comment,obj.GetRespPrimitiveByte(0),obj.GetRespPrimitiveByte(1),obj.GetRespPrimitiveByte(2));
      else
        testStepFail(stepid,"%s，实际没收到响应",comment);
    }
  }
  //期望不收到响应
  else if(passcondition==0)
  {
    snprintf(comment,elCount(comment),"期望不响应");
    if(diagGetLastResponseCode(obj)==0)
      testStepPass(stepid,"%s，实际未收到响应",comment);
    else
      testStepFail(stepid,"%s，实际收到响应:%02X %02X %02X",comment,obj.GetRespPrimitiveByte(0),obj.GetRespPrimitiveByte(1),obj.GetRespPrimitiveByte(2));
  }
  //期望收到否定响应
  else
  {
    snprintf(comment,elCount(comment),"期望收到否定响应NRC%02X",passcondition);
    
    if(diagGetLastResponseCode(obj)>0)//收到否定响应
    {
      if(obj.GetRespPrimitiveByte(0)==Negative_response && obj.GetRespPrimitiveByte(1)==obj.GetPrimitiveByte(0) && obj.GetRespPrimitiveByte(2)==passcondition)
        testStepPass(stepid,"%s，实际收到否定响应%02X %02X %02X",comment,obj.GetRespPrimitiveByte(0),obj.GetRespPrimitiveByte(1),obj.GetRespPrimitiveByte(2));
      else
        testStepFail(stepid,"%s，实际收到否定响应%02X %02X %02X",comment,obj.GetRespPrimitiveByte(0),obj.GetRespPrimitiveByte(1),obj.GetRespPrimitiveByte(2));
    }
    else//没有收到否定响应
      testStepFail(stepid,"%s，实际没有收到否定响应",comment);
  }
  if(@Test::stoptest==0)
  {
    if(diagGetLastResponseCode(obj)!=passcondition)
    {
      snprintf(comment,elCount(comment),"发生异常中断刷写");
      writeEx(-3,3,comment);
      testStepFail(comment);
      stop();
      testWaitForTimeout(1000);
    }
  }
}
//判断流控帧、NRC78及响应帧;
//参数Passcondition:{-1:期望收到积极响应,0:期望不收到响应,>0:期望收到的NRC}
void  _get_FC(diagrequest* req,dword msgID,char stepid[],int passcondition)
{
  message 0x00 msg;
  message 0x01 msg1;//用于判断流控帧
  message 0x02 msg2;//用于判断响应帧
  double starttime,starttime1,starttime2;
  double endtime,endtime1,endtime2;
  byte result,result1;
  byte sid;
  dword Count_NRC78;
  char comment[50];
  byte Stop_Pos,PassWait;
  Stop_Pos = 0; Count_NRC78 = 0;PassWait = 0;
  if(@Faultinsert::TC_BT_AppValid == 1 && @Faultinsert::TC_Miss_GetFc == 1)
  {
    return;
  }
  /*功能寻址下 部分NRC不响应，可进行补充*/
  if(msgID==funID && (passcondition==0x12 || passcondition==0x13))
  {
    passcondition = 0;
  }
  testWaitForMessage(msgID,1000);
  testGetWaitEventMsgData(msg);
  if(msg.byte(1) == 0x3E)
  {
    testWaitForMessage(msgID,1000);
    testGetWaitEventMsgData(msg);
  }
  if(msg.byte(0)>>4 == 1)
  {
    starttime = (double)timeNow()/100;
    testWaitForMessage(revID,p2cmax);
    testGetWaitEventMsgData(msg1);
    /*判断是否收到流控帧*/
    if(msg1.byte(0) == 0x30)
    {
      endtime = (double)timeNow()/100;
      if(endtime - starttime <= p2cmax)
      {
        testStepPass(stepid,"收到流控帧，流控帧响应时间为:%fms",endtime-starttime);
      }
      else
      {
        testStepFail(stepid,"响应超时，流控帧响应时间为:%fms",endtime-starttime);
        Stop_Pos = 1;
      }
      /*等待诊断请求数据全部发送完*/
      testWaitForDiagRequestSent(req,3000);
    }
    else if(msg1.byte(0) == 0x32)
    {
      endtime = (double)timeNow()/100;
      if(endtime - starttime <= p2cmax)
      {
        testStepPass(stepid,"收到溢出流控帧，响应时间为:%fms",endtime-starttime);
      }
      else
      {
        testStepFail(stepid,"响应超时，流控帧响应时间为:%fms",endtime-starttime);
        Stop_Pos = 1;
      }
    }
    starttime1 = (double)timeNow()/100;
    /*判断流控帧后续的响应*/
    testWaitForMessage(revID,1000); 
    testGetWaitEventMsgData(msg2);
    /*收到积极响应*/
    if(msg2.byte(1)==req.GetPrimitiveByte(0)+0x40)
    {
      endtime1 = (double)timeNow()/100;
      if(endtime1 - starttime1 <= p2cmax)
      {
        if(_CheckResp_Byte(msg2,req,passcondition)==1)
          testStepPass(stepid,"与预期相符，实际收到肯定响应:%02X %02X %02X %02X %02X %02X %02X，响应时间为:%fms",
          msg2.byte(1),msg2.byte(2),msg2.byte(3),msg2.byte(4),msg2.byte(5),msg2.byte(6),msg2.byte(7),endtime1-starttime1);
        else
        {
          testStepFail(stepid,"与预期不符，实际收到肯定响应:%02X %02X %02X %02X %02X %02X %02X，响应时间为:%fms",
          msg2.byte(1),msg2.byte(2),msg2.byte(3),msg2.byte(4),msg2.byte(5),msg2.byte(6),msg2.byte(7),endtime1-starttime1);
          Stop_Pos = 1;
        }
      }
      else
      {
        testStepFail(stepid,"响应超时，实际收到肯定响应:%02X %02X %02X %02X %02X %02X %02X，响应时间为:%fms",
        msg2.byte(1),msg2.byte(2),msg2.byte(3),msg2.byte(4),msg2.byte(5),msg2.byte(6),msg2.byte(7),endtime1-starttime1);
        Stop_Pos = 1;
      }
    }
    /*收到非NRC78的消极响应*/
    else if(msg2.byte(1)==0x7F && msg2.byte(3)!=0x78)
    {
      endtime1 = (double)timeNow()/100;
      if(endtime1 - starttime1 <= p2cmax)
      {
        if(_CheckResp_Byte(msg2,req,passcondition)==1)
          testStepPass(stepid,"与预期相符，实际收到否定响应:%02X %02X %02X，响应时间为:%fms",msg2.byte(1),msg2.byte(2),msg2.byte(3),endtime1-starttime1);
        else
        {
          testStepFail(stepid,"与预期不符，实际收到否定响应:%02X %02X %02X，响应时间为:%fms",msg2.byte(1),msg2.byte(2),msg2.byte(3),endtime1-starttime1);
          Stop_Pos = 1;
        }
      }
      else
      {
        testStepFail(stepid,"响应超时，收到否定响应:%02X %02X %02X，响应时间为:%fms",msg2.byte(1),msg2.byte(2),msg2.byte(3),endtime1-starttime1);
        Stop_Pos = 1;
      }
    }
    /*收到NRC78*/
    else if(msg2.byte(3)==0x78)
    {
      endtime1 = (double)timeNow()/100;
      do
      {
        Count_NRC78++;
        starttime2 = (double)timeNow()/100;
        /*第一次收到NRC78*/
        if(Count_NRC78 == 1)
        {
          endtime1 = (double)timeNow()/100;
          if(endtime1 - starttime1 <= p2cmax)
            testStepPass(stepid,"第%d次收到NRC78，响应时间为:%fms",Count_NRC78,endtime1-starttime1);
          else
          {
            testStepFail(stepid,"第%d次收到NRC78，响应时间为:%fms",Count_NRC78,endtime1-starttime1);
            Stop_Pos = 1;
          }
          if(@Faultinsert::TC_Handshake_after_NRC78 == 1) //ECU响应NRC78后马上发2帧功能寻址的3E80
          {
//            timer_3e80_count=2;
//            setTimer(timer_3e80,0);
//            if(req.GetPrimitiveByte(0) != 0x11) // 20260421：防止11服务被干扰
              PassWait = _handshake_times(msg2,funID,2);
            
          }
        }
        else
        {
          endtime2 = (double)timeNow()/100;
          if(endtime2 - endtime1 >= (0.3*NRC78_Cycle))
            testStepPass(stepid,"第%d次收到NRC78，响应时间为:%fms",Count_NRC78,endtime2 - endtime1);
          else
          {
            testStepFail(stepid,"第%d次收到NRC78，响应时间为:%fms ,预期时间为 %fms以上",Count_NRC78,endtime2 - endtime1,0.3*NRC78_Cycle);
            Stop_Pos = 1;
          }
          if(endtime2 - endtime1 <= NRC78_Cycle)
            testStepPass(stepid,"第%d次收到NRC78，响应时间为:%fms",Count_NRC78,endtime2 - endtime1);
          else
          {
            testStepFail(stepid,"第%d次收到NRC78，响应时间为:%fms ,预期时间为 %fms以内",Count_NRC78,endtime2 - endtime1,NRC78_Cycle);
            Stop_Pos = 1;
          }
          endtime1 = (double)timeNow()/100;
        }
        /*判断NRC78后5s内是否收到最终响应*/
        if(PassWait == 0)
        {
          testWaitForMessage(revID,NRC78_RespTime);
          testGetWaitEventMsgData(msg2);
        }
        /*收到肯定响应*/
        if(msg2.byte(1)==req.GetPrimitiveByte(0)+0x40)
        {
          endtime2 = (double)timeNow()/100;
          if(endtime2 - starttime2 <= NRC78_RespTime)
          {
            if(_CheckResp_Byte(msg2,req,passcondition)==1)
              testStepPass(stepid,"与预期相符，最终收到肯定响应:%02X %02X %02X %02X %02X %02X %02X，响应时间为:%fms",
              msg2.byte(1),msg2.byte(2),msg2.byte(3),msg2.byte(4),msg2.byte(5),msg2.byte(6),msg2.byte(7),endtime2-starttime2);
            else
            {
              testStepFail(stepid,"与预期不符，最终收到肯定响应:%02X %02X %02X %02X %02X %02X %02X，响应时间为:%fms",
              msg2.byte(1),msg2.byte(2),msg2.byte(3),msg2.byte(4),msg2.byte(5),msg2.byte(6),msg2.byte(7),endtime2-starttime2);
              Stop_Pos = 1;
            }
          }
          else
          {
            testStepFail(stepid,"响应超时，最终收到肯定响应:%02X %02X %02X %02X %02X %02X %02X，响应时间为:%fms",
            msg2.byte(1),msg2.byte(2),msg2.byte(3),msg2.byte(4),msg2.byte(5),msg2.byte(6),msg2.byte(7),endtime2-starttime2);
            Stop_Pos = 1;
          }
          break;
        }
        /*收到非NRC78的否定响应*/
        else if(msg2.byte(1)==0x7F && msg2.byte(3)!=0x78)
        {
          endtime2 = (double)timeNow()/100;
          if(endtime2 - starttime2 <= NRC78_RespTime)
          {
            if(_CheckResp_Byte(msg2,req,passcondition)==1)
              testStepPass(stepid,"与预期相符，最终收到否定响应:%02X %02X %02X %02X %02X %02X %02X，响应时间为:%fms",
              msg2.byte(1),msg2.byte(2),msg2.byte(3),msg2.byte(4),msg2.byte(5),msg2.byte(6),msg2.byte(7),endtime2-starttime2);
            else
            {
              testStepFail(stepid,"与预期不符，最终收到否定响应:%02X %02X %02X %02X %02X %02X %02X，响应时间为:%fms",
              msg2.byte(1),msg2.byte(2),msg2.byte(3),msg2.byte(4),msg2.byte(5),msg2.byte(6),msg2.byte(7),endtime2-starttime2);
              Stop_Pos = 1;
            }
          }
          else
          {
            testStepFail(stepid,"响应超时，最终收到否定响应:%02X %02X %02X %02X %02X %02X %02X，响应时间为:%fms",
            msg2.byte(1),msg2.byte(2),msg2.byte(3),msg2.byte(4),msg2.byte(5),msg2.byte(6),msg2.byte(7),endtime2-starttime2);
            Stop_Pos = 1;
          }
          break;
        }
      }while(msg2.byte(3)==0x78);
      /*判断NRC78响应次数*/
      if(Count_NRC78 <= NRC78_max)
        testStepPass(stepid,"连续响应%d次NRC78",Count_NRC78);
      else
      {
        testStepFail(stepid,"连续响应%d次NRC78",Count_NRC78);
        Stop_Pos = 1;
      }
      Count_NRC78 = 0;
    }
  }
  else
  {
    starttime1 = (double)timeNow()/100;
    if(SOS_Flage == 1 && passcondition==0)
      result=0;
    else
      result=testWaitForMessage(revID,1000);
    testGetWaitEventMsgData(msg1);
    if(result==0)
    {
      if(passcondition==0)
        testStepPass(stepid,"预期无响应，实际未收到响应");
      else
      {
        testStepFail(stepid,"响应超时，1s内未收到响应");
        Stop_Pos = 1;
      }
    }
    /*收到多帧，判断首帧*/
    else if(msg1.byte(0)>>4 == 1)
    {
      endtime1 = (double)timeNow()/100;
      if(msg1.byte(2)==req.GetPrimitiveByte(0)+0x40)
      {
        if(endtime1 - starttime1 <= p2cmax)
        {
          if(_CheckResp_Byte(msg1,req,passcondition) == 1)
            testStepPass(stepid,"与预期相符，收到多帧积极响应，首帧响应时间为%fms",endtime1 - starttime1);
          else
          {
            testStepFail(stepid,"与预期不符，收到多帧积极响应，首帧响应时间为%fms",endtime1 - starttime1);
            Stop_Pos = 1;
          }
        }
        else
        {
          testStepFail(stepid,"首帧响应超时，响应时间为%fms",endtime1 - starttime1);
          Stop_Pos = 1;
        }
      }
      testWaitForDiagResponse(req,1000);
    }
    /*CANFD格式单帧响应*/
    else if(msg1.byte(0) == 0 && req.GetPrimitiveByte(0)==0x22)
    {
      endtime1 = (double)timeNow()/100;
      if(msg1.byte(2)==req.GetPrimitiveByte(0)+0x40)
      {
        if(endtime1 - starttime1 <= p2cmax)
        {
          if(_CheckResp_Byte(msg1,req,passcondition) == 1)
            testStepPass(stepid,"与预期相符，收到多帧积极响应，首帧响应时间为%fms",endtime1 - starttime1);
          else
          {
            testStepFail(stepid,"与预期不符，收到多帧积极响应，首帧响应时间为%fms",endtime1 - starttime1);
            Stop_Pos = 1;
          }
        }
        else
        {
          testStepFail(stepid,"首帧响应超时，响应时间为%fms",endtime1 - starttime1);
          Stop_Pos = 1;
        }
      }
      testWaitForDiagResponse(req,1000);
    }
    else
    {
      /*收到积极响应*/
      if(msg1.byte(1)==req.GetPrimitiveByte(0)+0x40)
      {
        endtime1 = (double)timeNow()/100;
        if(endtime1 - starttime1 <= p2cmax)
        {
          if(_CheckResp_Byte(msg1,req,passcondition) == 1)
            testStepPass(stepid,"与预期相符，实际收到肯定响应:%02X %02X %02X %02X %02X %02X %02X，响应时间为:%fms",
            msg1.byte(1),msg1.byte(2),msg1.byte(3),msg1.byte(4),msg1.byte(5),msg1.byte(6),msg1.byte(7),endtime1-starttime1);
          else
          {
            testStepFail(stepid,"与预期不符，实际收到肯定响应:%02X %02X %02X %02X %02X %02X %02X，响应时间为:%fms",
            msg1.byte(1),msg1.byte(2),msg1.byte(3),msg1.byte(4),msg1.byte(5),msg1.byte(6),msg1.byte(7),endtime1-starttime1);
            Stop_Pos = 1;
          }
        }
        else
        {
          testStepFail(stepid,"响应超时，实际收到肯定响应:%02X %02X %02X %02X %02X %02X %02X，响应时间为:%fms",
          msg1.byte(1),msg1.byte(2),msg1.byte(3),msg1.byte(4),msg1.byte(5),msg1.byte(6),msg1.byte(7),endtime1-starttime1);
          Stop_Pos = 1;
        }
      }
      /*收到否定响应*/
      else if(msg1.byte(1)==0x7F && msg1.byte(3)!=0x78)
      {
        endtime1 = (double)timeNow()/100;
        if(endtime1 - starttime1 <= p2cmax)
        {
          if(_CheckResp_Byte(msg1,req,passcondition) == 1)
            testStepPass(stepid,"与预期相符，实际收到否定响应:%02X %02X %02X %02X %02X %02X %02X，响应时间为:%fms",
            msg1.byte(1),msg1.byte(2),msg1.byte(3),msg1.byte(4),msg1.byte(5),msg1.byte(6),msg1.byte(7),endtime1-starttime1);
          else
          {
            testStepFail(stepid,"与预期不符，实际收到否定响应:%02X %02X %02X %02X %02X %02X %02X，响应时间为:%fms",
            msg1.byte(1),msg1.byte(2),msg1.byte(3),msg1.byte(4),msg1.byte(5),msg1.byte(6),msg1.byte(7),endtime1-starttime1);
            Stop_Pos = 1;
          }
        }
        else
        {
          testStepFail(stepid,"响应超时，实际收到否定响应:%02X %02X %02X %02X %02X %02X %02X，响应时间为:%fms",
          msg1.byte(1),msg1.byte(2),msg1.byte(3),msg1.byte(4),msg1.byte(5),msg1.byte(6),msg1.byte(7),endtime1-starttime1);
          Stop_Pos = 1;
        }
      }
      /*收到NRC78*/
      else if(msg1.byte(1)==0x7F && msg1.byte(3)==0x78)
      {
        do
        {
          Count_NRC78++;
          starttime2 = (double)timeNow()/100;
          /*第一次收到NRC78*/
          if(Count_NRC78 == 1)
          {
            endtime1 = (double)timeNow()/100;
            if(endtime1 - starttime1 <= p2cmax)
              testStepPass(stepid,"第%d次收到NRC78，响应时间为:%fms",Count_NRC78,endtime1-starttime1);
            else
            {
              testStepFail(stepid,"第%d次收到NRC78，响应时间为:%fms",Count_NRC78,endtime1-starttime1);
              Stop_Pos = 1;
            }
            if(@Faultinsert::TC_Handshake_after_NRC78 == 1) //ECU响应NRC78后马上发2帧功能寻址的3E80
            {
  //            timer_3e80_count=2;
  //            setTimer(timer_3e80,0);
//              if(req.GetPrimitiveByte(0) != 0x11) // 20260421：防止11服务被干扰
                PassWait = _handshake_times(msg2,funID,2);
            }
          }
          else
          {
            endtime2 = (double)timeNow()/100;
            if(endtime2 - endtime1 >= (0.3*NRC78_Cycle))
              testStepPass(stepid,"第%d次收到NRC78，响应时间为:%fms",Count_NRC78,endtime2 - endtime1);
            else
            {
              testStepFail(stepid,"第%d次收到NRC78，响应时间为:%fms ,预期时间为 %fms以上",Count_NRC78,endtime2 - endtime1,0.3*NRC78_Cycle);
              Stop_Pos = 1;
            }
            if(endtime2 - endtime1 <= NRC78_RespTime)
              testStepPass(stepid,"第%d次收到NRC78，响应时间为:%fms",Count_NRC78,endtime2 - endtime1);
            else
            {
              testStepFail(stepid,"第%d次收到NRC78，响应时间为:%fms ,预期时间为 %fms以内",Count_NRC78,endtime2 - endtime1,NRC78_RespTime);
              Stop_Pos = 1;
            }
            endtime1 = (double)timeNow()/100;
          }
          /*判断NRC78后5s内是否收到最终响应*/
          if(PassWait == 0)
          {
            testWaitForMessage(revID,NRC78_RespTime);
            testGetWaitEventMsgData(msg2);
          }
          if(msg2.byte(1)==req.GetPrimitiveByte(0)+0x40)
          {
            endtime2 = (double)timeNow()/100;
            if(endtime2 - starttime2 <= NRC78_RespTime)
            {
              if(_CheckResp_Byte(msg2,req,passcondition)==1)
                testStepPass(stepid,"与预期相符，最终收到肯定响应:%02X %02X %02X %02X %02X %02X %02X，响应时间为:%fms",
                msg2.byte(1),msg2.byte(2),msg2.byte(3),msg2.byte(4),msg2.byte(5),msg2.byte(6),msg2.byte(7),endtime2-starttime2);
              else
              {
                testStepFail(stepid,"与预期不符，最终收到肯定响应:%02X %02X %02X %02X %02X %02X %02X，响应时间为:%fms",
                msg2.byte(1),msg2.byte(2),msg2.byte(3),msg2.byte(4),msg2.byte(5),msg2.byte(6),msg2.byte(7),endtime2-starttime2);
                Stop_Pos = 1;
              }
            }
            else
            {
              testStepFail(stepid,"响应超时，最终收到肯定响应:%02X %02X %02X %02X %02X %02X %02X，响应时间为:%fms",
              msg2.byte(1),msg2.byte(2),msg2.byte(3),msg2.byte(4),msg2.byte(5),msg2.byte(6),msg2.byte(7),endtime2-starttime2);
              Stop_Pos = 1;
            }
            break;
          }
          else if(msg2.byte(1)==0x7F && msg2.byte(3)!=0x78)
          {
            endtime2 = (double)timeNow()/100;
            if(endtime2 - starttime2 <= NRC78_RespTime)
            {
              if(_CheckResp_Byte(msg2,req,passcondition)==1)
                testStepPass(stepid,"与预期相符，最终收到否定响应:%02X %02X %02X %02X %02X %02X %02X，响应时间为:%fms",
                msg2.byte(1),msg2.byte(2),msg2.byte(3),msg2.byte(4),msg2.byte(5),msg2.byte(6),msg2.byte(7),endtime2-starttime2);
              else
              {
                testStepFail(stepid,"与预期不符，最终收到否定响应:%02X %02X %02X %02X %02X %02X %02X，响应时间为:%fms",
                msg2.byte(1),msg2.byte(2),msg2.byte(3),msg2.byte(4),msg2.byte(5),msg2.byte(6),msg2.byte(7),endtime2-starttime2); 
                Stop_Pos = 1;
              }
            }
            else
            {
              testStepFail(stepid,"响应超时，最终收到否定响应:%02X %02X %02X %02X %02X %02X %02X，响应时间为:%fms",
              msg2.byte(1),msg2.byte(2),msg2.byte(3),msg2.byte(4),msg2.byte(5),msg2.byte(6),msg2.byte(7),endtime2-starttime2);
              Stop_Pos = 1;
            }
            break;
          }
        }while(msg2.byte(3)==0x78);
        /*NRC78响应次数*/
        if(Count_NRC78 <= NRC78_max)
          testStepPass(stepid,"连续响应%d次NRC78",Count_NRC78);
        else
        {
          testStepFail(stepid,"连续响应%d次NRC78",Count_NRC78);
          Stop_Pos = 1;
        }
        Count_NRC78 = 0;
      }
    }
  }
  if(@Test::stoptest==0)
  {
    if(Stop_Pos == 1)
    {
      snprintf(comment,elCount(comment),"发生异常中断刷写");
      writeEx(-3,3,comment);
      testStepFail(comment);
      stop();
      testWaitForTimeout(1000);
    }
  }
}

//获取文件栏的BIN文件地址
//参数FileNum：0为第一个文件栏、1为第二个文件栏
void _getEraseAddrBin(int FileNum)
{
  char filename[400];
  if(Alternate_DownLoad_Flage == 0 || Alternate_DownLoad_Flage == 1)
  {
    if(FileNum==0)
      sysGetVariableString(sysvar::AUTO::openFile_Flash,filename,elCount(filename));
    else if(FileNum==1)
      sysGetVariableString(sysvar::AUTO::openFile_Bin1,filename,elCount(filename));
    else if(FileNum==2)
      sysGetVariableString(sysvar::AUTO::openFile_Bin2,filename,elCount(filename));
  }
  else
  {
    if(FileNum==0)
      sysGetVariableString(sysvar::AUTO::openFile2_Flash,filename,elCount(filename));
    else if(FileNum==1)
      sysGetVariableString(sysvar::AUTO::openFile2_Bin1,filename,elCount(filename));
    else if(FileNum==2)
      sysGetVariableString(sysvar::AUTO::openFile2_Bin2,filename,elCount(filename));
  }
  if(filename[0]==0)//未选择Bin文件
    hexFlage[FileNum] = 1;
  else
  {
    hexFileNum++;
    BinFile_ReadAndSave(filename,BlockBin_Num,FileNum);
  }
}
//获取文件栏的CBF文件地址
//参数FileNum：0为第一个文件栏、1为第二个文件栏
void _getEraseAddrCBF(int FileNum)
{
  char filename[400];
  if(Alternate_DownLoad_Flage == 0 || Alternate_DownLoad_Flage == 1)
  {
    if(FileNum==0)
      sysGetVariableString(sysvar::AUTO::RSA1,filename,elCount(filename));
    else if(FileNum==1)
      sysGetVariableString(sysvar::AUTO::CBF1,filename,elCount(filename));
  }
  else
  {
    if(FileNum==0)
      sysGetVariableString(sysvar::AUTO::RSA2,filename,elCount(filename));
    else if(FileNum==1)
      sysGetVariableString(sysvar::AUTO::CBF2,filename,elCount(filename));
  }
  if(filename[0]==0)//未选择文件
    hexFlage[FileNum] = 1;
  else
  {
    hexFlage[FileNum] = 0;
    hexFileNum++;
    CBF_Flage = 1;
    if(FileNum == 1) CBFFile_ReadAndSave(filename);
    else if(FileNum == 0) RSA_LoadFromSysvar(filename);
  }
}
//获取文件栏的HEX文件地址
//参数FileNum：0为第一个文件栏、1为第二个文件栏
void _getEraseAddr(int FileNum)
{
  char filename[400];
  byte datanow[60];
  byte datanext[60];
  word addrh;
  word addrl;
  word addrnexth;
  word addrnextl;
  word addrlnext;
  dword addrstart;
  dword addrend;
  dword addrnextst;
  byte alignment;
  byte now_Len;
  word addrl_jud;
  int i;
  eraseadd=0;

  if(FileNum==0)
    sysGetVariableString(sysvar::Test::openhex,filename,elCount(filename));
  else if(FileNum==1)
    sysGetVariableString(sysvar::Test::openhex1,filename,elCount(filename));
  else if(FileNum==2)
    sysGetVariableString(sysvar::Test::openhex2,filename,elCount(filename));
 
  if(filename[0]==0)//未选择hex文件
  {
    hexFlage[FileNum] = 1;
  }
  else
  {
    hexFlage[FileNum] = 0;
    hexFileNum++;
    glbHandle = OpenFileRead(filename,0);
    _readhex(datanow); //行读取操作
    addrh=((word)datanow[4]<<8)|datanow[5]; //文件首行为基地址
    
    addrstart=(dword)addrh<<(1<<datanow[3]);//先获取地址的高16位
    addrend=(dword)addrh<<(1<<datanow[3]);
    _readhex(datanow);
    alignment = datanow[0];
    addrl=((word)datanow[1]<<8)|datanow[2];
    addrstart=addrstart|addrl;
    while(1)
    {
      hextype=datanow[3];
      if((hextype==4 || hextype==5 || hextype==1 || hextype==2))
      {
        addrend=addrend|addrl;
        write("第%d块地址：0x%08X-0x%08X",eraseadd,addrstart,addrend);
        eraseaddr[FileNum][eraseadd]=addrstart;
        eraselength[FileNum][eraseadd]=addrend-addrstart+1;
        eraseadd++;
        if(hextype==4 || hextype==2)
        {
          _readhex(datanext);
          addrnexth = ((word)datanow[4]<<8)|datanow[5];
          addrnextst=(dword)addrnexth<<(1<<hextype);//先获取地址的高16位
          addrnextst = addrnextst|(((word)datanext[1]<<8)|datanext[2]);
          if(addrnextst - addrend == 2 && @AUTO::Config_Switch == 9)
          {
            eraseadd--;
            addrend = addrnextst;
            memcpy(datanow,datanext,elCount(datanext));
            Continueaddr[FileNum][eraseadd] = 1;
            continue;
          }
          /*合并连续地址段开关：开关打开后地址空间连续的逻辑块视为同一逻辑块*/
          if(addrnextst - addrend == 1 && @AUTO::MergeAddr_Switch == 1)
          {
            eraseadd--;
            addrend = addrnextst;
            memcpy(datanow,datanext,elCount(datanext));
            Continueaddr[FileNum][eraseadd] = 1;
            write("合并连续地址段：第%d块扩展至0x%08X",eraseadd,addrnextst);
            continue;
          }
          addrh=((word)datanow[4]<<8)|datanow[5];
          addrstart=(dword)addrh<<(1<<hextype);//先获取地址的高16位
          addrend=(dword)addrh<<(1<<hextype);
          addrl=((word)datanext[1]<<8)|datanext[2];
          if((addrl % alignment != 0)&& @AUTO::Config_Switch != 9)//针对开头就没对齐0x20
            addrl-=(addrl % alignment);
          addrstart=addrstart|addrl;
          memcpy(datanow,datanext,elCount(datanext));
        }
        else
          break;
      }
      else if(hextype==0)
      {
        addrl=(((word)datanow[1]<<8)|datanow[2])+(datanow[0]-1);
        _readhex(datanext);
        memcpy(datanow,datanext,elCount(datanext)); 
        if(datanext[3] == 0) // && (addrend - addrstart)!=
        {
          addrlnext=((word)datanext[1]<<8)|datanext[2];
          if( (addrlnext-addrl)>0x80 )
          {
            addrend=addrend|addrl;
            write("第%d块地址：0x%08X-0x%08X",eraseadd,addrstart,addrend);
            eraseaddr[FileNum][eraseadd]=addrstart;
            eraselength[FileNum][eraseadd]=addrend-addrstart+1;
            addrend=addrend&0xFFFF0000;
            addrstart=addrstart&0xFFFF0000;
            if((addrlnext % alignment != 0) && @AUTO::Config_Switch != 9)//针对开头就没对齐0x20
              addrlnext-=(addrlnext%alignment);
            addrstart=addrstart|addrlnext;
            eraseadd++;
          }
        }
      }
    }
    if(@AUTO::FlashDriver_Switch == 0xFF ) //外部输入Flash
    {
      dword Data,Siz;
//      @AUTO::DriverSize = eraselength[0][0];
      DriverSize = eraselength[0][0];
      DriverAddr = eraseaddr[0][0];
      if(FileNum == 0) //装载Flash数据
      {
        fileClose(glbHandle);
        glbHandle = OpenFileRead(filename,0);
        _readhex(datanow); //行读取操作
        _readhex(datanow);//先获取一次00数据类型的数据
        _loadpage(BlockBin_Flash,datanow,Data,Siz);//装载数据到data36，并返回地址、长度和下一段04、05数据类型
      }
    }
  }
  eraseadd=0;
  fileClose(glbHandle);
}
void Set_Battery_DownLoad()
{
  if(@Faultinsert::TC_ErrorVolt != 0) //电压相关操作
  {
    if(@Faultinsert::TC_ErrorVolt == 1)
      @Prog_power::K30Volt = 6;
    else if(@Faultinsert::TC_ErrorVolt == 2)
      @Prog_power::K30Volt = Low_Volt - 0.2;
    else if(@Faultinsert::TC_ErrorVolt == 3)
      @Prog_power::K30Volt = High_Volt + 0.2;
    else if(@Faultinsert::TC_ErrorVolt == 4)
      @Prog_power::K30Volt = 18;
    else if(@Faultinsert::TC_ErrorVolt == 5)
      @Prog_power::K30Volt = 6;
    else if(@Faultinsert::TC_ErrorVolt == 12)
      @Prog_power::K30Volt = Low_Volt + 0.2;
    else if(@Faultinsert::TC_ErrorVolt == 13)
      @Prog_power::K30Volt = High_Volt - 0.2;
    testWaitForTimeout(Volt_Time);
  }
  if(@Faultinsert::TC_ErrorHighVolt_App == 1) 
  {
    @Prog_power::K30Volt = High_Volt + 0.2;
    testWaitForTimeout(Volt_Time);
    HighVolt_Resp(curAppValid);
  }
  if( @Faultinsert::TC_ErrorLowVolt_App == 1) 
  {
    @Prog_power::K30Volt = Low_Volt - 0.2;
    testWaitForTimeout(Volt_Time);
    LowVolt_Resp(curAppValid);
  }
}
/// <DownLoad>
//刷写流程函数
byte MainTest_f()
{
  dword hexaddr[3][2];              /*每一行装填一个HEX文件的起始地址、地址大小*/
  word i,j;
  char appname[200];
  int FileNum;
  i = 0;
  j = 0;
  hexFileNum = 0;
  calcrc16 = 0xFFFF;                /*CRC16 校验值初始化*/
  
  if(@AUTO::Config_Switch==4)       /*Geely3.0*/
    readFile_SBT();
  else if(@AUTO::Config_Switch==12) /*广汽*/
  {
    for(i=0;i<3;i++)
      _getEraseAddrBin(i);          /*获取每个文件栏中的地址段*/
    if(BlockBin_Flage == 0)
    {
      for(i=0;i<3;i++)
        _getEraseAddr(i);          /*获取每个HEX文件栏中的地址段*/
    }
    if(hexFlage[0]==1 && hexFlage[1]==1 && hexFlage[2]==1)
    {
      writeEx(-3,1,"--------------刷写失败，未选择Bin文件！！！--------------");
      stop();
      testWaitForTimeout(1000);
    }
    if(@AUTO::FlashDriver_Switch == 0xFF && hexFlage[0]==1)
    {
      writeEx(-3,1,"--------------刷写失败，未输入Flash文件！！！--------------");
      stop();
      testWaitForTimeout(200);
    }
  }
  else if(@AUTO::Config_Switch==11) /*T1V*/
  {
    CBF_Flage = 0;
    for(i=0;i<3;i++)
      _getEraseAddr(i);            /*获取每个HEX文件栏中的地址段*/
    if(hexFlage[0]==1 && hexFlage[1]==1 && hexFlage[2]==1)
    {
      for(i=0;i<2;i++)
        _getEraseAddrCBF(i);
      if(hexFlage[0]==1 && hexFlage[1]==1)
      {
        writeEx(-3,1,"--------------刷写失败，未选择文件！！！--------------");
        stop();
        testWaitForTimeout(1000);
      }
    }
  }
  else                             /*其它主机厂*/
  {
    for(i=0;i<3;i++)
      _getEraseAddr(i);            /*获取每个HEX文件栏中的地址段*/
    if(hexFlage[0]==1 && hexFlage[1]==1 && hexFlage[2]==1)
    {
      writeEx(-3,1,"--------------刷写失败，未选择hex文件！！！--------------");
      stop();
      testWaitForTimeout(1000);
    }
  } 
  testWaitForTimeout(500);
  /*判断当前是否APP有效*/
  curAppValid = Check_AppValid();
  testWaitForTimeout(1000);
  /*预编程阶段*/
  Pre_Programme();
  
  testWaitForTimeout(1000);
  if(Exit_Pre_Prog==1)
    return 0;
  /*重编程阶段*/
  Re_Programme();
  
  testWaitForTimeout(1000);
  if(Exit_Re_Prog==1)
    return 0;
  Down_f_a = 1; // App开始下载
  
  /*Geely3.0*/
  if(@AUTO::Config_Switch==4)
  {
    for(FileNum=1;FileNum<=4;FileNum++)
    {
      writeEx(-3,0,"第 %d 个文件",FileNum);
      if(Alternate_DownLoad_Flage == 0 || Alternate_DownLoad_Flage == 1)
      {
        if(FileNum==1)
          sysGetVariableString(sysvar::AUTO::openFile_VBF1,appname,elcount(appname));
        else if(FileNum==2)
          sysGetVariableString(sysvar::AUTO::openFile_VBF2,appname,elcount(appname));
        else if(FileNum==3)
          sysGetVariableString(sysvar::AUTO::openFile_VBF3,appname,elcount(appname));
        else if(FileNum==4)
          sysGetVariableString(sysvar::AUTO::openFile_VBF4,appname,elcount(appname));
      }
      else
      {
        if(FileNum==1)
          sysGetVariableString(sysvar::AUTO::openFile2_VBF1,appname,elcount(appname));
        else if(FileNum==2)
          sysGetVariableString(sysvar::AUTO::openFile2_VBF2,appname,elcount(appname));
        else if(FileNum==3)
          sysGetVariableString(sysvar::AUTO::openFile2_VBF3,appname,elcount(appname));
        else if(FileNum==4)
          sysGetVariableString(sysvar::AUTO::openFile2_VBF4,appname,elcount(appname));
      }
      if(strlen(appname)>0)
      {
        readFile_APP(FileNum);
        Data_Download(FileNum);
      }
      testwaitfortimeout(100);
      if(Break_Download==1)
        break;
    }
    if(Exit_Download==1)
      return 0;
  }
  else if(@AUTO::Config_Switch==12)
  {
    if(BlockBin_Flage == 1)
    {
      if(@AUTO::FlashDriver_Switch == 0xFF)
        hexFileNum = hexFileNum-1;
      for(i=1;i<=hexFileNum;i++) // 每次刷写文件均需重新写入Flash
      {
        dword AddStatr,AddLen,AddEnd;
        AddStatr = 0;AddLen = 0;AddEnd = 0;
        calcrc32 = 0xFFFFFFFF;     /*CRC32 校验值初始化*/
        for(j=0;j<BlockBin_Num;j++)
        { 
          if(hexfile_app[j].FilePos == i && AddStatr == 0)
          {
            AddStatr = hexfile_app[j].BlockStartAddr;
            AddEnd =  hexfile_app[j].BlockEndAddr;
          }
        }
        AddLen = AddEnd - AddStatr + 1;
        Down_BinFlash();
        _Sendff00(AddStatr,AddLen,phyID); //擦除部分
        /*故障注入：31 01 FF 00后31 01 FF 00*/
        if(@Faultinsert::TC_Re_FF00==1)
        {
          eraseadd++;
          Resp_ff00 = 0x24;
          Exit_ff00 = 1;
          @Faultinsert::TC_Re_FF00=0;
          _Sendff00(AddStatr,AddLen,phyID);
        }
        if(Exit_ff00==1)
          return 0;
        for(j=0;j<BlockBin_Num;j++)
        {
          if(hexfile_app[j].FilePos == i)
          {
            _download_5_stream(i,j); //[流式改造-2026-09]原 _download_5 整文件装载,改 _download_5_stream 分页流式
            testWaitForTimeout(500);
          }
          if(Exit_Download==1)
            return 0;
        }
        /*
          广汽 APP 31 01 02 02数据校验
          [流式改造-2026-09]Config_Switch==12 时 _Send0202_a 内部跳过 data36 的 CRC 计算(用累计 calcrc32),
          故此处传 hexfile_app[0].dataBuffer(单页缓冲)与 BlockDataLength 仅为占位,实际不被访问。
          calcrc32 已在 _Send36_App_stream 中逐页累加完成。
        */
        _Send0202_a(hexfile_app[0].dataBuffer,hexfile_app[0].BlockDataLength,phyID,Resp_0202_a);
        if(Exit_0202_a==1)
        {
          Exit_Download = 1;
          return 0;
        }
      }
    }
    else
    {
      int Start_Pos;
      if(@AUTO::FlashDriver_Switch == 0xFF) // 第1个文件栏装载Flash
        Start_Pos = 1;
      else
        Start_Pos = 0;
      /*遍历文件栏进行刷写，直至空文件栏*/
      for(i=Start_Pos;i<elcount(hexFlage);i++)  
      {
        if(hexFlage[i]==1)
          break;
        writeEx(-3,1,"--------------------------开始刷写第%d个文件栏--------------------------",i+1);
        Down_BinFlash();
        if(Exit_36_f==1)
        {
          Exit_Download = 1;
          return 0;
        }
        for(j=0;j<elcount(eraseaddr[i]);j++)
        {
          if(eraseaddr[i][j]==0 && eraselength[i][j]==0)
            break;
        }
        /*获取第i个HEX文件的地址段*/
        hexaddr[i][0] = _gethexaddr(i,eraseaddr,eraselength);
        hexaddr[i][1] = _gethexlength(i,eraseaddr,eraselength);
        /*整段擦除第i个HEX文件地址段*/
        _Sendff00(hexaddr[i][0],hexaddr[i][1],phyID);
        if(Exit_ff00==1)
          return 0;
        /*下载第i个HEX文件，34、36、37循环至数据下载完成*/
        if(@AUTO::EraseMode_Switch == 2)
          _download_2(i);
        else if(@AUTO::EraseMode_Switch == 3)
          _download_3(i);
        if(Exit_Download==1)
          return 0;
        testWaitForTimeout(500);
      }
    }
  }
  else if(CBF_Flage == 1 && @AUTO::Config_Switch==11)
  {
    _Sendff00(hexfile_app[0].BlockStartAddr,hexfile_app[0].BlockDataLength,phyID);
    /*故障注入：31 01 FF 00后31 01 FF 00*/
    if(@Faultinsert::TC_Re_FF00==1)
    {
      eraseadd++;
      Resp_ff00 = 0x24;
      Exit_ff00 = 1;
      @Faultinsert::TC_Re_FF00=0;
      _Sendff00(hexaddr[i][0],hexaddr[i][1],phyID);
    }

    if(Exit_ff00==1)
      return 0;
    _download_CBF_stream();
  }
  /*其它主机厂*/
  else
  {
    /*----------------------------------------------------------------------------------------------------------------*/
    /*选择擦除方式，1为分段擦除：FF00、34、36、37循环至数据下载完成*/
    if(@AUTO::EraseMode_Switch == 1)
    {
      /*遍历文件栏进行刷写，直至空文件栏*/
      for(i=0;i<elcount(hexFlage);i++)
      {
        if(hexFlage[i] == 1)
          break;
        writeEx(-3,1,"--------------------------开始刷写第%d个文件栏--------------------------",i+1);
        
        /*下载第i个HEX文件，FF00、34、36、37循环至数据下载完成*/
        _download_1(i);
        if(Exit_Download==1)
          return 0;
        testWaitForTimeout(500);
      }
    }
    /*----------------------------------------------------------------------------------------------------------------*/
    /*选择擦除方式，2为整段擦除，然后34、36、37循环至数据下载完成*/
    if(@AUTO::EraseMode_Switch == 2)
    {
      /*遍历文件栏进行刷写，直至空文件栏*/
      for(i=0;i<elcount(hexFlage);i++)
      {
        if(hexFlage[i]==1)
          break;
        writeEx(-3,1,"--------------------------开始刷写第%d个文件栏--------------------------",i+1);
        for(j=0;j<elcount(eraseaddr[i]);j++)
        {
          if(eraseaddr[i][j]==0 && eraselength[i][j]==0)
            break;
//          writeEx(-3,1,"-----第%d个地址和长度------0x%08X-----------0x%08X",j,eraseaddr[i][j],eraselength[i][j]);
        }
        /*获取第i个HEX文件的地址段*/
        hexaddr[i][0] = _gethexaddr(i,eraseaddr,eraselength);
        hexaddr[i][1] = _gethexlength(i,eraseaddr,eraselength);
//        writeEx(-3,1,"-----第%d个文件的地址和长度-------0x%08X-----------0x%08X",i+1,hexaddr[i][0],hexaddr[i][1]);
        /*整段擦除第i个HEX文件地址段*/
        _Sendff00(hexaddr[i][0],hexaddr[i][1],phyID);
        if(Exit_ff00==1)
          return 0;
        /*奇瑞特殊流程*/
        if(@AUTO::Config_Switch==7)
        {
          _Send03FF00(phyID,Resp_ff00);
          if(Exit_03ff00==1)
            return 0;
          _Send02FF00(phyID,Resp_ff00);
          if(Exit_02ff00==1)
            return 0;
        }
        /*下载第i个HEX文件，34、36、37循环至数据下载完成*/
        _download_2(i);
        if(Exit_Download==1)
          return 0;
        testWaitForTimeout(500);
      }
    }
    /*----------------------------------------------------------------------------------------------------------------*/
    /*选择擦除方式，3为整段擦除，然后34请求整个地址段，36循环至数据下载完成，最后37*/
    if(@AUTO::EraseMode_Switch == 3)
    {
      /*遍历文件栏进行刷写，直至空文件栏*/
      for(i=0;i<elcount(hexFlage);i++)
      {
        if(hexFlage[i]==1)
          break;
        writeEx(-3,1,"--------------------------开始刷写第%d个文件栏--------------------------",i+1);
        
        /*获取第i个HEX文件的地址段*/
        hexaddr[i][0] = _gethexaddr(i,eraseaddr,eraselength);
        hexaddr[i][1] = _gethexlength(i,eraseaddr,eraselength);
        /*整段擦除第i个HEX文件地址段*/
        _Sendff00(hexaddr[i][0],hexaddr[i][1],phyID);
        /*故障注入：31 01 FF 00后31 01 FF 00*/
        if(@Faultinsert::TC_Re_FF00==1)
        {
          eraseadd++;
          Resp_ff00 = 0x24;
          Exit_ff00 = 1;
          @Faultinsert::TC_Re_FF00=0;
          _Sendff00(hexaddr[i][0],hexaddr[i][1],phyID);
        }

        if(Exit_ff00==1)
          return 0;
        /*下载第i个HEX文件，34请求整个文件地址段，然后36循环下载，最后37*/
        _download_3(i);
        if(Exit_Download==1)
          return 0;
        testWaitForTimeout(500);
      }
    }
    /*----------------------------------------------------------------------------------------------------------------*/
    /*选择擦除方式，4为分段擦除，先FF00循环,然后34,36,37循环*/
    if(@AUTO::EraseMode_Switch == 4)
    {
      /*遍历文件栏进行刷写，直至空文件栏*/
      for(i=0;i<elcount(hexFlage);i++)
      {
        if(hexFlage[i]==1)
          break;
        writeEx(-3,1,"--------------------------开始刷写第%d个文件栏--------------------------",i+1);
        
        _download_4(i);
        if(Exit_Download==1)
          return 0;
        testWaitForTimeout(500);
      }
    }
  }
  /*----------------------------------------------------------------------------------------------------------------*/
  /*后编程阶段*/
  Post_Programme();
  TestWaitForTimeout(1000);
  if(Exit_Post_Prog==1)
    return 0;
  return 1;
} 

/*
  将填写的256位解析为数组
  type：
      0：驱动
      1：APP1
      2：APP2
      3：APP3
      4：APP4
*/
void digitalSignature(word toInt[],int type)
{
  long bufferSize;
  int i,length;
  char CheckMerroryArray[514]; 
  word left,right,toInt_inx;
  if(type == 0)
  {
    getCheckMerrory_SBT_Fun();
    strncpy(CheckMerroryArray,getCheckMemory_sbt,strlen(getCheckMemory_sbt)+1);
  }
  else
  {
    getCheckMerrory_Fun(type);
    strncpy(CheckMerroryArray,getCheckMemory,strlen(getCheckMemory)+1);
  }
  length = strlen(CheckMerroryArray);
  for(i = 0; i < length; i++)
  {
    if(i % 2 == 0)
    {
      if(CheckMerroryArray[i] >= '0' && CheckMerroryArray[i] <= '9')
      {
        left = (CheckMerroryArray[i] - 48)<<4;
      }
      else
      {
        left = (CheckMerroryArray[i] - 55)<<4;
      }
    }
    else
    {
      if(CheckMerroryArray[i] >= '0' && CheckMerroryArray[i] <= '9')
      {
        right = (CheckMerroryArray[i] - 48);
      }
      else
      {
        right = (CheckMerroryArray[i] - 55);
      }
      toInt[toInt_inx++] = left|right;
    }
  }
  length = 0;
  left = 0;
  right = 0;
  toInt_inx = 0;
  getCheckMemory[0] = '\0';
  getCheckMemory_sbt[0] = '\0';
}
void getCheckMerrory_Fun(byte num)
{
  int flag;
  char filePathOut[4][200]/* ={ "sign1.VBF","sign2.VBF","sign3.VBF","sign4.VBF"}*/;
  char papername[200];
  char filenameCopy[200];
  char buffer_char[1000];
  char CheckMerrory[1000];
  dword i,j;
  i = 0;
  j = 0;

  testWaitForTimeout(1500);
  switch(num)
  {
    case 1:
      sysGetVariableString(sysvar::AUTO::openFile_VBF1,filePathOut[0],elCount(filePathOut[0]));
      for(i=0;i<strlen(filePathOut[0]);i++)
      {
        if(filePathOut[0][i]=='\\')
        {
          j=i;
        }
      }
      substr_cpy(papername,filePathOut[0],j+1,strlen(filePathOut[0])-j,elCount(papername));
      strncpy (filenameCopy,filePathOut[0],j+1);
      setFilePath(filenameCopy,2);
      glbHandle = openFileRead(papername,0);
      break;
    case 2:
      sysGetVariableString(sysvar::AUTO::openFile_VBF2,filePathOut[1],elCount(filePathOut[1]));
      for(i=0;i<strlen(filePathOut[1]);i++)
      {
        if(filePathOut[1][i]=='\\')
        {
          j=i;
        }
      }
      substr_cpy(papername,filePathOut[1],j+1,strlen(filePathOut[1])-j,elCount(papername));
      strncpy (filenameCopy,filePathOut[1],j+1);
      setFilePath(filenameCopy,2);
      glbHandle = openFileRead(papername,0);
      break;
    case 3:
      sysGetVariableString(sysvar::AUTO::openFile_VBF3,filePathOut[2],elCount(filePathOut[2]));
      for(i=0;i<strlen(filePathOut[2]);i++)
      {
        if(filePathOut[2][i]=='\\')
        {
          j=i;
        }
      }
      substr_cpy(papername,filePathOut[2],j+1,strlen(filePathOut[2])-j,elCount(papername));
      strncpy (filenameCopy,filePathOut[2],j+1);
      setFilePath(filenameCopy,2);
      glbHandle = openFileRead(papername,0);
      break;
    case 4:
      sysGetVariableString(sysvar::AUTO::openFile_VBF4,filePathOut[3],elCount(filePathOut[3]));
      for(i=0;i<strlen(filePathOut[3]);i++)
      {
        if(filePathOut[3][i]=='\\')
        {
          j=i;
        }
      }
      substr_cpy(papername,filePathOut[3],j+1,strlen(filePathOut[3])-j,elCount(papername));
      strncpy (filenameCopy,filePathOut[3],j+1);
      setFilePath(filenameCopy,2);
      glbHandle = openFileRead(papername,0);
      break;
  }
  if(glbHandle != 0)
  {
    j = 0;
    while(fileGetStringSZ(buffer_char,elCount(buffer_char),glbHandle) != 0)
    {
      if(strlen(buffer_char) > 500) //某行长度大于500对应 sw_signature_dev，后续可优化识别该变量
      {
        mbsubstr_cpy_off(CheckMerrory,0,buffer_char,22,-1); //从索引第22位开始读取，即0x后
        break;
      }
      j++;
    }
  }
  fileClose(glbHandle);
  strncpy(getCheckMemory,CheckMerrory,513);
}
void getCheckMerrory_SBT_Fun()
{
  int flag;
  char filePathOut[256];
  char buffer_char[1000];
  char CheckMerrory[1000];
  char papername[200];
  char filenameCopy[200];
  dword i,j;
  i = 0;
  j = 0;
  
  sysGetVariableString(sysvar::AUTO::openFile_SBT,filePathOut,elCount(filePathOut));
  for(i=0;i<strlen(filePathOut);i++)
  {
    if(filePathOut[i]=='\\')
    {j=i;}
  }
  substr_cpy(papername,filePathOut,j+1,strlen(filePathOut)-j,elCount(papername));
  strncpy (filenameCopy,filePathOut,j+1);
  setFilePath(filenameCopy,2);
  glbHandle = openFileRead(papername,0);
  if(glbHandle != 0)
  {
    j = 0;
    while(fileGetStringSZ(buffer_char,elCount(buffer_char),glbHandle) != 0)
    {
      if(strlen(buffer_char) > 500)
      {
        mbsubstr_cpy_off(CheckMerrory,0,buffer_char,22,-1);
        break;
      }
      j++;
    }
  }
  fileClose(glbHandle);
  strncpy(getCheckMemory_sbt,CheckMerrory,513);
}

//读取SBT文件栏内容
void readFile_SBT()
{
  char filename[200];
  int fileInx;
  int i;
  //获取打开文件字节，将其复制到filename中
  if(Alternate_DownLoad_Flage == 0 || Alternate_DownLoad_Flage == 1)
    sysGetVariableString(sysvar::AUTO::openFile_SBT,filename,elCount(filename));
  else
    sysGetVariableString(sysvar::AUTO::openFile2_SBT,filename,elCount(filename));
  fileInx = strlen(filename);
  //判断选择文件类型为 hex or vbf
  if(filename[fileInx-3] == 'h' && filename[fileInx-2] == 'e' && filename[fileInx-1] == 'x')
  {
    Read_hexFile(filename,hexfile_sbt,0);
  }
  else
  {
    Flash_DataFormatId = 0x00;
    Read_vbfFile(filename,hexfile_sbt,0);
    vbfToHexFile(hexfile_sbt,HexBlockTotalNumber_sbt,VbtBlockTotalNumber_sbt,loadhexLength,vbtLength,0);
    testWaitForTimeout(1000);
  }
}

//读取APP文件栏内容
void readFile_APP(int File_num)
{
  char filename[200];
  int fileInx;
  //获取打开文件字节，将其复制到filename中
  if(File_num==1)
    sysGetVariableString(sysvar::AUTO::openFile_VBF1,filename,elCount(filename));
  else if(File_num==2)
    sysGetVariableString(sysvar::AUTO::openFile_VBF2,filename,elCount(filename));
  else if(File_num==3)
    sysGetVariableString(sysvar::AUTO::openFile_VBF3,filename,elCount(filename));
  else if(File_num==4)
    sysGetVariableString(sysvar::AUTO::openFile_VBF4,filename,elCount(filename));
  
  fileInx = strlen(filename);
  if(filename[fileInx-3] == 'h' && filename[fileInx-2] == 'e' && filename[fileInx-1] == 'x')
  {
    Read_hexFile(filename,hexfile_app,1);
  }
  else
  {
    App_DataFormatId=0x00;
    Read_vbfFile(filename,hexfile_app,1);
    vbfToHexFile(hexfile_app,HexBlockTotalNumber_app,VbtBlockTotalNumber_app,loadhexLength,vbtLength,1);
    testWaitForTimeout(1000);
  }
}

/*********************************************************************************
  *Function:      //char -> byte
  *Description：  //把单个字符转换为Byte的函数
  *Input:         //ch：ASCII编码字符，取值为0到F
  *Return:        //val，为byte类型
**********************************************************************************/
byte char2byte(char ch)
{
   byte  val;
   val = 0;
   if ( ch >= '0' && ch <= '9')
   {
      val = ch - '0';      
   }
   if ( ch >= 'a' && ch <= 'f')
   {
      val = (ch - 'a') + 10;      
   }
   if ( ch >= 'A' && ch <= 'F')
   {
      val = (ch - 'A') + 10;       
   }
   return val;
}

/*********************************************************************************
  *Function:      //Read_hexFile
  *Description：  //解码HEX文件，只支持0x00，0x04，0x01，0x02，0x05类型
  *Input:         //Filename：需要解码的文件名
  *Output:        //hexfile
  *Return:        //void
**********************************************************************************/
//读取HEXFILE
void Read_hexFile(char Filename[],struct Block hexfile[],int hexType)
{
  
  long file_handle;
  char RowData[128];                        //逐行读取,每行数据缓存，当每行数据大于128时，需要将其调整
	dword   i;
	dword   RowDataByte;											//单块数据块字节数
	qword   OffsetAddress;										//扩展线性地址 	
	qword   ReAddr;												    //上一数据行起始地址 
	dword   Len;													    //HEX每行有效数据字节数
	dword   ReLen;												    //HEX前一次数据长度
	dword   Addr;													    //HEX每行起始地址
	dword   Type;		                          //HEX每行类型，有00，01，04，05四种类型
  dword   isFirstLine;                      //是否为第一行
  dword   HexBlockTotalNumber;
  RowDataByte = 0;i = 0;Len = 0;ReLen = 0;Addr=0;Type = 0;ReAddr = 0;isFirstLine = 0;
  file_handle = OpenFileRead(Filename,0);
  HexBlockTotalNumber = 0;
  if(file_handle!=0)
  { 
    // Read all lines
    while( fileGetStringSZ(RowData,elcount(RowData),file_handle)!=0 )
    {
      //判断首字符是否为:号
      if(RowData[0] == ':')
      {
        Len = (char2byte(RowData[1])*0x10+char2byte(RowData[2]));
        Addr = char2byte(RowData[3])*0x1000+char2byte(RowData[4])*0x100+char2byte(RowData[5])*0x10+char2byte(RowData[6]);
        Addr |= (OffsetAddress << 16);
        Type = char2byte(RowData[7])*0x10+char2byte(RowData[8]);
        switch(Type)
        {
          case 0x00:											  //数据
            if(Addr > ReAddr)
            {  
              //判断为新数据块
              if(RowDataByte == 0)			  //是否为首行数据字节数
              {
                hexfile[HexBlockTotalNumber].BlockStartAddr = Addr;         //记录新数据块的起始地址
              }
              else										    //不是首行
              {
                hexfile[HexBlockTotalNumber].BlockDataLength = RowDataByte; //数据长度
              }
            }
            for(i=0;i<Len;i++)
            {
              //储存buffer，注意没有对crc进行校验。
              hexfile[HexBlockTotalNumber].dataBuffer[RowDataByte++]=(char2byte(RowData[2*i+9])*0x10+char2byte(RowData[2*i+10]));
            }
            ReAddr = Addr;									  //保存当前地址,下一次使用
            //ReLen  = Len;									  //保存当前长度,下一次使用
            break;
          case 0x04:										   	  //扩展线性地址记录
            if(isFirstLine != 0)
            {
              hexfile[HexBlockTotalNumber].BlockDataLength = RowDataByte;        //数据长度
              RowDataByte = 0;
              HexBlockTotalNumber++;
            }
            isFirstLine++;
						OffsetAddress =  char2byte(RowData[9])*0x1000+char2byte(RowData[10])*0x100+char2byte(RowData[11])*0x10+char2byte(RowData[12]);		//偏移地址
            break;
          case 0x02:										   	//扩展段地址记录
            if(isFirstLine != 0)
            {
              hexfile[HexBlockTotalNumber].BlockDataLength = RowDataByte;        //数据长度
              RowDataByte = 0;
              HexBlockTotalNumber++;
            }
            isFirstLine++;
						OffsetAddress =  char2byte(RowData[9])*0x1000+char2byte(RowData[10])*0x100+char2byte(RowData[11])*0x10+char2byte(RowData[12]);		//偏移地址
            break;
          case 0x01:										   	//地址,结束
            hexfile[HexBlockTotalNumber].BlockDataLength = RowDataByte;        //数据长度
            RowDataByte = 0;
            HexBlockTotalNumber++;
            break;
          case 0x05:										   	//地址,结束
            hexfile[HexBlockTotalNumber].BlockDataLength = RowDataByte;        //数据长度
            RowDataByte = 0;
            HexBlockTotalNumber++;
            break; 
        }        
      }
    }
    write("Hex文件读取成功, 数据分块:%d",HexBlockTotalNumber);
    for(i = 0; i < HexBlockTotalNumber; i++)
  	{
      write("起始地址:0x%X",hexfile[i].BlockStartAddr);
      write("结束地址:0x%X",hexfile[i].BlockStartAddr + hexfile[i].BlockDataLength - 1);
      write("数据长度:%6d字节",hexfile[i].BlockDataLength);
      //write("最后一个字节:%x",hexfile[i].dataBuffer[0xFFE0]);
  	}
    if(hexType == 0)//统计hex地址块总数
    {
      HexBlockTotalNumber_sbt = HexBlockTotalNumber;
    }
    else
    {
      HexBlockTotalNumber_app = HexBlockTotalNumber;
    }
    fileClose(file_handle);
  }
  else{
     writeEx(-3,1,"文件打开失败");
  }
}

/*********************************************************************************
  *Function:      //Read_hexFile
  *Description：  //解码HEX文件，只支持0x00，0x04，0x01类型
  *Input:         //Filename：需要解码的文件名
  *Output:        //hexfile
  *Return:        //void
**********************************************************************************/
//读取HEXFILE
void Read_vbfFile(char Filename[],struct Block hexfile[],int hexType)
{
  long file_handle;
  /*[VBF流式改造-2026-09]原 RowData[0x200000] 2MB 整文件读取+拷贝到 ReadData[1MB]。
    现仅用于解析 VBF 文本头部(元数据 + } 标记),取 0x10000(64KB)覆盖大头部,
    数据段由 vbfToHexFile 按 64KB 块从文件流式读入 dataBuffer。栈占用 2MB→64KB。*/
  byte RowData[0x10000];                    //逐行读取,每行数据缓存，当每行数据大于128时，需要将其调整
  dword   i,j;
	dword   RowDataByte;											//单块数据块字节数
	qword   OffsetAddress;										//扩展线性地址 	
	qword   ReAddr;												    //上一数据行起始地址 
	dword   Len;													    //HEX每行有效数据字节数
	dword   ReLen;												    //HEX前一次数据长度
	dword   Addr;												      //HEX每行起始地址
	dword   Type;		                          //HEX每行类型，有00，01，04，05四种类型
  dword   isFirstLine;                      //是否为第一行
  word    flag;                             //第一个7D标识
  dword   HexBlockTotalNumber;
  char papername[200];
  char filenameCopy[200];
  for(i=0;i<strlen(Filename);i++)
  {
    if(Filename[i]=='\\')
    {
      j=i;
    }
  };
  substr_cpy(papername,Filename,j+1,strlen(Filename)-j,elCount(papername));
  strncpy(filenameCopy,Filename,j+1);
  setFilePath(filenameCopy, 2);
  RowDataByte = 0;i = 0;Len = 0;ReLen = 0;Addr=0;Type = 0;ReAddr = 0;isFirstLine = 0;
  file_handle = OpenFileRead(papername,1);
  HexBlockTotalNumber = 0;
  bytesLength = 0;
  if(file_handle!=0)
  {
    // Read all lines
    qword length;
    length = fileGetBinaryBlock(RowData,elCount(RowData),file_handle);
    vbfLength = length;
    {
      word inx,i;
      hexStartAddr=0;
      inx=Hexandchar_strstr(RowData,0,"data_format_identifier = 0x10");
      if(inx>0)
      {
        Flash_DataFormatId=0x10;
      }
      else
      {
        inx=Hexandchar_strstr(RowData,0,"data_format_identifier = 0x00");
        if(inx>0)
        {
          Flash_DataFormatId=0x00;
        }
      }
      inx=Hexandchar_strstr(RowData,0,"call = 0x");
      if(inx>0)
      {
        for(i=0 ; i < 8; i++)
        {
          hexStartAddr = hexStartAddr << 4 | char2byte(RowData[inx+i]);
        }        
        write("hexStartAddr %x",hexStartAddr);
      }
      else
      {
        inx=Hexandchar_strstr(RowData,0,"erase = {{0x");
        for(i=0 ; i < 8; i++)
        {
          hexStartAddr = hexStartAddr << 4 | char2byte(RowData[inx+i]);
        }        
        write("hexStartAddr %x",hexStartAddr);
      }
      vbtStartAddr = 0;
      inx=Hexandchar_strstr(RowData,0,"verification_block_start = 0x");
      if(inx>0)
      {
        for(i=0 ; i < 8; i++)
        {
          vbtStartAddr = vbtStartAddr << 4 | char2byte(RowData[inx+i]);
        }     
        write("vbtStartAddr %x",vbtStartAddr);
      }
      vbtLength = 0;
      inx=Hexandchar_strstr(RowData,0,"verification_block_length = 0x");
      if(inx>0)
      {
        for(i=0 ; i < 8; i++)
        {
          vbtLength = vbtLength << 4 | char2byte(RowData[inx+i]);
        }     
        write("vbtLength %x",vbtLength);
      }
      hexLength = vbtStartAddr-hexStartAddr;
      bytesLength = hexLength+vbtLength;
//      writeEx(-3,1,"inx=%d",inx); 
      inx_7D=Hexandchar_strstr(RowData,inx,"}")-1;
    }
    loadhexLength=0;
    loadhexStartAddr=0;

    /*[VBF流式改造-2026-09]原将整个数据段拷贝到 ReadData[0x100000] 1MB 全局缓冲。
      现仅解析数据段前 8 字节(loadhexStartAddr/loadhexLength),不拷贝整段。
      数据段由 vbfToHexFile 按 64KB 块从文件流式读取。原拷贝循环已屏蔽:
      for(i = 0; i < vbfLength - inx_7D - 9; i++)
        ReadData[i] = RowData[i+inx_7D+9];*/
    for(i = 0; i < 9; i++)
    {
      if(0<i&&i<5)
      loadhexStartAddr = RowData[i+inx_7D]|loadhexStartAddr<<8;
      if(4<i&&i<9)
      loadhexLength = RowData[i+inx_7D]|loadhexLength<<8;
    }
    /*保存当前 VBF 路径与数据段起始偏移(inx_7D+9),供 vbfToHexFile 流式读取
      同时保存裸文件名 g_vbfFileName,配合 Read_vbfFile 已 setFilePath 的目录打开*/
    strncpy(g_vbfFilePath, Filename, elCount(g_vbfFilePath));
    strncpy(g_vbfFileName, papername, elCount(g_vbfFileName));
    g_vbfDataOffset = inx_7D + 9;
    loadvbtLength=0;
    loadvbtStartAddr=0;
//    for(i = 0; i < 4; i++)
//    {
//      loadvbtLength = ReadData[i+loadhexLength+6]|loadvbtLength<<8;
//      loadvbtStartAddr = ReadData[i+loadhexLength+2]|loadvbtStartAddr<<8;
//    }    

    write("vbf文件读取成功, vbf大小为：%d",vbfLength);
    write("=====================================================");
    write("hex域地址:DATAStartAddr:  {0x%X}",hexStartAddr);
    write("hex域长度:DATALength:     {0x%X}",hexLength);
    write("vbt域地址:VBTStartAddr:   {0x%X}",vbtStartAddr);
    write("vbt域长度:VBTLengt:       {0x%X}",vbtLength);
    write("下载地址:DATAStartAddr:   {0x%X}",loadhexStartAddr);
    write("下载地址:DATALength:      {0x%X}",loadhexLength);
    write("下载地址:VBTStartAddr:    {0x%X}",loadvbtStartAddr);
    write("下载地址:VBTLengt:        {0x%X}",loadvbtLength);    
//    writeEx(-3,0,"vbf文件读取成功, vbf大小为：%d",vbfLength);
//    writeEx(-3,0,"=====================================================");
//    writeEx(-3,0,"hex域地址:DATAStartAddr:  {0x%X}",hexStartAddr);
//    writeEx(-3,0,"hex域长度:DATALength:     {0x%X}",hexLength);
//    writeEx(-3,0,"vbt域地址:VBTStartAddr:   {0x%X}",vbtStartAddr);
//    writeEx(-3,0,"vbt域长度:VBTLengt:       {0x%X}",vbtLength);
//    writeEx(-3,0,"下载地址:DATAStartAddr:   {0x%X}",loadhexStartAddr);
//    writeEx(-3,0,"下载地址:DATALength:      {0x%X}",loadhexLength);
//    writeEx(-3,0,"下载地址:VBTStartAddr:    {0x%X}",loadvbtStartAddr);
//    writeEx(-3,0,"下载地址:VBTLengt:        {0x%X}",loadvbtLength);
    flag = 0;
    fileClose(file_handle);
  }
  else
  {
     writeEx(-3,1,"文件打开失败");
  }
}

void vbfToHexFile(struct Block hexfile[],dword HexBlockTotalNumber,dword VbtBlockTotalNumber,qword Hexlen,qword Vbtlen,int hexType)
{
  dword i,j;
  long vbfHandle;
  byte skipBuf[0x200];
  dword skipRead;
  dword hexBytesRead;      /*[VBF流式]累计 hex 数据段已读字节数,用于定位 vbt 段起始*/
  long  vbtSkipLen;        /*[VBF流式]hex 段末到 vbt 段起始需跳过的字节数(Hexlen+10-hexBytesRead)*/
  /*[VBF流式改造-2026-09]打开 VBF 文件并跳过头部到数据段起始,后续按 64KB 块读取
    到 hexfile[i].dataBuffer/dataVbtBuffer。替代原从 ReadData[1MB] 全局拷贝的方式。
    Read_vbfFile 中已 setFilePath 设置目录,此处用裸文件名 g_vbfFileName 打开,
    与 Read_vbfFile 自身打开方式完全一致,避免完整路径与 setFilePath 冲突。*/
  vbfHandle = OpenFileRead(g_vbfFileName,1);
  if(vbfHandle==0)
  {
    writeEx(-3,1,"[VBF流式]打开文件失败: %s (完整路径: %s)",g_vbfFileName,g_vbfFilePath);
    return;
  }
  {
    dword remaining, thisSkip;
    remaining = g_vbfDataOffset;
    while(remaining > 0)
    {
      if(remaining > elCount(skipBuf))
        thisSkip = elCount(skipBuf);
      else
        thisSkip = remaining;
      skipRead = fileGetBinaryBlock(skipBuf,thisSkip,vbfHandle);
      if((long)skipRead != (long)thisSkip)
      {
        writeEx(-3,1,"[VBF流式]跳过头部失败,剩余%d 实际读了%d",remaining,skipRead);
        fileClose(vbfHandle);
        return;
      }
      remaining -= thisSkip;
    }
  }
  if((Hexlen / 65535) < ((float)Hexlen / 65535.0) || Hexlen <= 65535)
  {
    HexBlockTotalNumber = (Hexlen / 65535) + 1;
  }
  else
  {
    HexBlockTotalNumber = (Hexlen / 65535);
  }
  if((Vbtlen / 65535) < ((float)Vbtlen / 65535.0) || Vbtlen <= 65535)
  {
    VbtBlockTotalNumber = (Vbtlen / 65535) + 1;
  }
  else
  {
    VbtBlockTotalNumber = (Vbtlen / 65535);
  }
  //统计hex地址块总数
  if(hexType == 0)
  {
    HexBlockTotalNumber_sbt = HexBlockTotalNumber;
    write("HexBlockTotalNumber_sbt=%X  ",HexBlockTotalNumber_sbt);
    VbtBlockTotalNumber_sbt=VbtBlockTotalNumber;
    write("VbtBlockTotalNumber_sbt=%X  ",VbtBlockTotalNumber_sbt);
    HexLength_sbt = Hexlen;
    VbtLength_sbt=Vbtlen;   
  }
  else
  {
    HexBlockTotalNumber_app = HexBlockTotalNumber;
    write("HexBlockTotalNumber_app=%X  ",HexBlockTotalNumber_app);
    VbtBlockTotalNumber_app=VbtBlockTotalNumber;
    write("VbtBlockTotalNumber_app=%X  ",VbtBlockTotalNumber_app);
    HexLength_app = Hexlen;
    VbtLength_app=Vbtlen;
  }
  hexBytesRead = 0;
  /*[VBF流式改造-2026-09]hex 数据段:按 64KB 块顺序从 VBF 文件读入 dataBuffer。
    CAPL File I/O 无 fileSeek,依赖 fileGetBinaryBlock 顺序前进特性。
    替代原 for 循环逐字节从 ReadData[0x100000] 拷贝的方式。*/
  for(i=0;i<HexBlockTotalNumber;i++)
  {
    hexfile[i].BlockStartAddr = hexStartAddr + (0x10000 * i)  ;
    if(i == HexBlockTotalNumber - 1)
    {
      qword lastLenth;//最后一段数据长度
      word inx;//角标偏移
      inx = 0;
      hexfile[i].BlockDataLength = Hexlen - 0x10000 * i;
      if(Hexlen <= 65535)
      {
        lastLenth = Hexlen;
      }
      else
      {
        lastLenth = Hexlen - 0x10000 * i;
      }
//      write("lastLenth = 0x%X",lastLenth);
      hexBytesRead += fileGetBinaryBlock(hexfile[i].dataBuffer,(long)(lastLenth-inx),vbfHandle);
    }
    else
    {
      hexfile[i].BlockDataLength = 0x10000;
      hexBytesRead += fileGetBinaryBlock(hexfile[i].dataBuffer,0x10000,vbfHandle);
    }
  }
  /*[VBF流式]定位 vbt 数据段起始:原 ReadData 布局为 [hex(Hexlen)][分隔(10)][vbt(Vbtlen)]。
    hex 段已顺序读取 hexBytesRead 字节,需跳过 (Hexlen+10-hexBytesRead) 字节到达 vbt 段。*/
  vbtSkipLen = (long)Hexlen + 10 - (long)hexBytesRead;
  while(vbtSkipLen > 0)
  {
    dword thisSkip;
    if(vbtSkipLen > elCount(skipBuf))
      thisSkip = elCount(skipBuf);
    else
      thisSkip = vbtSkipLen;
    fileGetBinaryBlock(skipBuf,thisSkip,vbfHandle);
    vbtSkipLen -= thisSkip;
  }
  /*[VBF流式改造-2026-09]vbt 数据段:按 64KB 块顺序从 VBF 文件读入 dataVbtBuffer。
    替代原 for 循环逐字节从 ReadData[0x10000*i+j+Hexlen+10] 拷贝的方式。*/
  for(i = 0; i < VbtBlockTotalNumber; i++)
  {
    hexfile[i].BlockVbtStartAddr = vbtStartAddr + (0x10000 * i)  ;
    if(i == VbtBlockTotalNumber - 1)
    {
      qword lastLenth;//最后一段数据长度
      word inx;//角标偏移
      inx = 0;
      hexfile[i].BlockVbtDataLength = Vbtlen - 0x10000 * i;
      if(Vbtlen <= 65535)
      {
        lastLenth = Vbtlen;
      }
      else
      {
        lastLenth = Vbtlen - 0x10000 * i;
      }
      fileGetBinaryBlock(hexfile[i].dataVbtBuffer,(long)lastLenth,vbfHandle);
    }
    else
    {
      hexfile[i].BlockVbtDataLength = 0x10000;
      fileGetBinaryBlock(hexfile[i].dataVbtBuffer,0x10000,vbfHandle);
    }
  }
  fileClose(vbfHandle);
  vbtStartAddr = 0;
  vbtLength = 0;
  hexStartAddr = 0;
  hexLength = 0;
  inx_7D = 0;
  vbfLength = 0;
}

/*
  查找目标字符串chararray在hexarray中的结束位置
  参数hexarray：数据
  参数offset：查找的起始位
  参数chararray：查找的目标字符串
  返回值a：查找到的结束位
*/
long Hexandchar_strstr(byte hexarray[],long offset,char chararray[])
{
  long i,j,a;
  i=0;a=0;
  for(i=offset;i<elcount(hexarray);i++)
  {
    for(j=0;j<strlen(chararray);j++)
    {
      if(hexarray[i+j]!=chararray[j])
      {
        break;
      }
    }
    if(j==strlen(chararray))
    {
      a=i+strlen(chararray);
      for(j=a;j<strlen(chararray);j++)
      {}
      break;
    }
  }
  return a;
}

/*
  获取hex文件的起始地址
  参数Filenum：对应的文件栏序号
*/
dword _gethexaddr(byte Filenum,dword eraseaddr[][],dword eraselength[][])
{
  dword hexaddr,hexaddrend,hexlength;
  
  hexaddr = eraseaddr[Filenum][0];
  /*故障注入：FF 00擦除过程中部分地址未进行擦除*/
  if(@Faultinsert::TC_FF00_Part==1)
  {
    hexaddr = eraseaddr[Filenum][1];
    Resp_34_a = 0x70;
    Exit_34_a = 1;
    @Faultinsert::TC_FF00_Part==0;
  }
  return hexaddr;
}
/*
  获取hex文件的地址大小
  参数Filenum：对应的文件栏序号
*/
dword _gethexlength(byte Filenum,dword eraseaddr[][],dword eraselength[][])
{
  dword hexaddr,hexaddrend,hexlength;
  word i;
  
  hexaddr = eraseaddr[Filenum][0];
  for(i=0;i<elCount(eraseaddr[Filenum]);i++)
  {
    if(eraseaddr[Filenum][i]==0 && eraselength[Filenum][i]==0)
    {
      hexaddrend = eraseaddr[Filenum][i-1] + eraselength[Filenum][i-1] - 1;
      break;
    }
    else
      continue;
  }
  hexlength = hexaddrend - hexaddr + 1;
  return hexlength;
}

/// <DownLoad>
//分段擦除，循环FF00、34、36、37
//参数openhex：0为下载第一个hex文件，1为下载第二个hex文件
void _download_1(dword openhex)
{
  byte datanow[60];
  byte datanext[60];
  char filename[1000];
  dword addrh;
  dword addrl;
  dword addr;
  dword addrlast;
  dword length34;
  dword i;
  byte first_read;
  first_read = 1;
  i = 0;
  eraseadd = 0;
  
  if(openhex==0)
    sysGetVariableString(sysvar::Test::openhex,filename,elCount(filename));
  else if(openhex==1)
    sysGetVariableString(sysvar::Test::openhex1,filename,elCount(filename));
  else
    sysGetVariableString(sysvar::Test::openhex2,filename,elCount(filename));
  
  glbHandle = OpenFileRead(filename,0);
  _readhex(datanow);//第一次获取数据，数据类型应是04
  while(1)
  {
    hextype=datanow[3];
    //判断hex文件这一行的数据类型，00、04继续，05、01表示文件结束
    if(hextype==4 || hextype==2)
    {
      addrh=((word)datanow[4]<<8)|datanow[5];
      addr=(dword)addrh<<16;//先获取地址的高16位
      _readhex(datanow);//先获取一次00数据类型的数据
      _loadpage(data36,datanow,addr,length34);//装载数据到data36，并返回地址、长度和下一段04、05数据类型
      /*合并连续地址段流式36:仅加载首段,后续段在_App_36_merge中逐段加载发送*/
    }
    else if(hextype==0)
    {
      _loadpage(data36,datanow,addr,length34);//装载数据到data36，并返回地址、长度和下一段04、05数据类型
      hextype = datanow[3];
      if(hextype == 4 && Continueaddr[openhex][eraseadd] == 1)
      {
        addrlast = addr; 
        Continueaddr[openhex][eraseadd] ++;
        _readhex(datanow);//先获取一次00数据类型的数据
        _loadpage1(data36,datanow,addr,length34);//装载数据到data36，并返回地址、长度和下一段04、05数据类型
        addr = addrlast;
      }
    }
    else if(hextype==5)
      break;
    else if(hextype==1)
      break;
    else
      break;
//    write("Continueaddr[%d][%d] = %x",openhex,eraseadd,Continueaddr[openhex][eraseadd]);
//    write("addr = %x, length34 = %x",addr,length34);
    /*故障注入：FF 00擦除过程中部分地址未进行擦除*/
    if(@Faultinsert::TC_FF00_Part==1)
    {
      eraseadd = 1;
      Resp_34_a = 0x70;
      Exit_34_a = 1;
      @Faultinsert::TC_FF00_Part==0;
    }
    /*FF00内存擦除服务*/
      _Sendff00(eraseaddr[openhex][eraseadd],eraselength[openhex][eraseadd],phyID);

    /*故障注入：31 01 FF 00后31 01 FF 00*/
    if(@Faultinsert::TC_Re_FF00==1)
    {
      eraseadd++;
      Resp_ff00 = 0x24;
      Exit_ff00 = 1;
      @Faultinsert::TC_Re_FF00=0;
      continue;
    }
    if(Exit_ff00==1)
    {
      Exit_Download = 1;
      return;
    }
    /*奇瑞特殊流程*/
    if(@AUTO::Config_Switch==7)
    {
      _Send03FF00(phyID,Resp_ff00);
      if(Exit_03ff00==1)
      {
        Exit_Download = 1;
        return;
      }
      _Send02FF00(phyID,Resp_ff00);
      if(Exit_02ff00==1)
      {
        Exit_Download = 1;
        return;
      }
    }
    /*分段请求hex文件地址段*/
    if(@AUTO::MergeAddr_Switch == 1 && Continueaddr[openhex][eraseadd] >= 1)
      App_34(addr,eraselength[openhex][eraseadd]);/*合并块:34请求整段长度*/
    else
      App_34(addr,length34);
    if(Exit_34_a==1)
    {
      Exit_Download = 1;
      return;
    }
    /*合并块:流式36发送(含故障注入+CRC增量累积),非合并块走原流程*/
    if(@AUTO::MergeAddr_Switch == 1 && Continueaddr[openhex][eraseadd] >= 1)
    {
      _App_36_merge(openhex,eraseadd,eraselength[openhex][eraseadd],length34,datanow,addr);
    }
    else
    {
      /*故障注入：APP 36下载的数据错误*/
      if(@Faultinsert::TC_Error_36_A==1)
      {
        for(i=0;i<length34;i++)
        {
          data36[i] = 0xFF;
        }
        PassState_31[0] = 0x01;
        Exit_0202_a = 1;
      }
      
      /*APP36 数据传输服务*/
      App_36(addr,data36,length34);
      crc16[eraseadd] = _caculateCrc16(0xFFFF,data36,length34);
      calcrc16 = _caculateCrc16(calcrc16,data36,length34);
      calcrc32=_caculateCrc32(data36,length34);
      calcrc32 = calcrc32^0xFFFFFFFF;
    }
   
    if(Exit_36_a==1)
    {
      Exit_Download = 1;
      return;
    }

    /*APP37 退出服务*/
    App_37();
    
    eraseadd++;
    if(Exit_37_a==1)
    {
      Exit_Download = 1;
      return;
    }
    /*不同主机厂数据校验不同*/
    if(@AUTO::Config_Switch==1 || @AUTO::Config_Switch==3 || @AUTO::Config_Switch==5
    || @AUTO::Config_Switch==6 || @AUTO::Config_Switch==8 || @AUTO::Config_Switch==13)//BYD || Geely1.0 || 鑫源 || 瑞驰 || 五菱 || V8
    {
      /*APP 31 01 02 02数据校验*/
      _Send0202_a(data36,length34,phyID,Resp_0202_a);
    }
    if(Exit_0202_a==1)
    {
      Exit_Download = 1;
      return;
    }
    if(Break_Download==1)
    {
      break;
    }
  }
  /*奇瑞特殊流程*/
  if(@AUTO::Config_Switch==7)
  {
    for(eraseadd=0;eraseadd<elcount(eraseaddr);eraseadd++)
    {
      if(eraseaddr[openhex][eraseadd]==0 && eraselength[openhex][eraseadd]==0)
        break;
      current_crc16 = crc16[eraseadd];
      EraseAddr = eraseaddr[openhex][eraseadd];
      EraseLength = eraselength[openhex][eraseadd];
      _SendFF01(phyID,Resp_ff01);
      /*故障注入：奇瑞 31 01 FF 01后31 01 FF 01*/
      if(@Faultinsert::TC_Re_FF01==1)
      {
        Resp_ff01 = 0x22;
        Exit_ff01 = 1;
        @Faultinsert::TC_Re_FF01=0;
        continue;
      }
      if(Exit_ff01==1)
      {
        Exit_Download = 1;
        return;
      }
      _Send03FF01(phyID,Resp_ff01);
      if(Exit_03ff01==1)
      {
        Exit_Download = 1;
        return;
      }
      _Send02FF01(phyID,Resp_ff01);
      if(Exit_02ff01==1)
      {
        Exit_Download = 1;
        return;
      }
      /*故障注入：FF 01依赖性检查过程中部分地址段未进行检查*/
      if(@Faultinsert::TC_FF01_Part==1)
      {
        Resp_DA04 = 0x22;
        Exit_DA04 = 1;
        break;
      }
    }
  }
//  else if(@AUTO::Config_Switch==11)
//  {
//    _Send01DD02(phyID,Resp_01DD02);
//    Data_Check_Chery();
//  }
  /*赛力斯特殊流程*/
  if(@AUTO::Config_Switch==10)
  {
    /*APP 31 01 02 02数据校验*/
    _Send0202_a(data36,length34,phyID,Resp_0202_a);
    if(Exit_0202_a==1)
    {
      Exit_Download = 1;
      return;
    }
  }
  if(@AUTO::Config_Switch==13) //v8兼容性校验
  {
    /*APP 31 01 FF 01数据校验*/
    _SendFF01(phyID,Resp_ff01);
  }
  fileClose(glbHandle);
}
/// <DownLoad>
/*
  34、36、37循环下载数据，0为下载第一个hex文件，1为下载第二个hex文件
*/
void _download_2(dword openhex)
{
  byte datanow[60];
  byte datanext[60];
  char filename[1000];
  dword addrh;
  dword addrl;
  dword addr;
  dword length34;
  dword i;
  i = 0;
  eraseadd = 0;
  calcrc32 = 0xFFFFFFFF;
  
  if(openhex==0)
  {
    sysGetVariableString(sysvar::Test::openhex,filename,elCount(filename));
  }
  else if(openhex==1)
  {
    sysGetVariableString(sysvar::Test::openhex1,filename,elCount(filename));
  }
  else
  {
    sysGetVariableString(sysvar::Test::openhex2,filename,elCount(filename));
  }
  glbHandle = OpenFileRead(filename,0);
  _readhex(datanow);//第一次获取数据，数据类型应是04
  /*34、36、37开始循环*/
  while(1)
  {
    hextype=datanow[3];
    //判断hex文件这一行的数据类型，00、04继续，05表示文件结束
    if(hextype==4 || hextype==2)
    {
      addrh=((word)datanow[4]<<8)|datanow[5];
      addr=(dword)addrh<<16;//先获取地址的高16位
      _readhex(datanow);//先获取一次00数据类型的数据
      _loadpage(data36,datanow,addr,length34);//装载数据到data36，并返回地址、长度和下一段04、05数据类型
    }
    else if(hextype==0)
    {
      _loadpage(data36,datanow,addr,length34);//装载数据到data36，并返回地址、长度和下一段04、05数据类型
    }
    else if(hextype==5)
      break;
    else if(hextype==1)
      break;
    else
      break;
//    write("addr = %x,length = %x",addr,length34);
    /*APP34 请求下载*/
    App_34(addr,length34);
    if(Exit_34_a==1)
    {
      Exit_Download = 1;
      return;
    }
    /*故障注入：APP 36下载的数据错误*/
    if(@Faultinsert::TC_Error_36_A==1)
    {
      for(i=0;i<length34;i++)
      {
        data36[i] = 0xFF;
      }
      PassState_31[0] = 0x01;
      Exit_0202_a = 1;
    }
    /*APP36 传输数据*/
    
    App_36(addr,data36,length34);
    crc16[eraseadd] = _caculateCrc16(0xFFFF,data36,length34);
    calcrc16 = _caculateCrc16(calcrc16,data36,length34);
    calcrc32 = _caculateCrc32_1(calcrc32,data36,length34);
    eraseadd++;
    if(Exit_36_a==1)
    {
      Exit_Download = 1;
      return;
    }
    /*APP37 请求退出*/
    App_37();
    if(Exit_37_a==1)
    {
      Exit_Download = 1;
      return;
    }
  
    if(Break_Download==1)
    {
      break;
    }
  }
  /*不同主机厂数据校验不同*/
  if(@AUTO::Config_Switch==1 || @AUTO::Config_Switch==3 || @AUTO::Config_Switch==5
  || @AUTO::Config_Switch==6 || @AUTO::Config_Switch==8 || @AUTO::Config_Switch==10 
  || @AUTO::Config_Switch==12)//BYD || Geely1.0 || 鑫源 || 瑞驰 || 五菱 || 赛力斯 || 广汽
  {
    /*APP 31 01 02 02数据校验*/
    _Send0202_a(data36,length34,phyID,Resp_0202_a);
  }
  if(Exit_0202_a==1)
  {
    Exit_Download = 1;
    return;
  }
  /*奇瑞特殊流程*/
  if(@AUTO::Config_Switch==7)
  {
    for(eraseadd=0;eraseadd<elcount(eraseaddr);eraseadd++)
    {
      if(eraseaddr[openhex][eraseadd]==0 && eraselength[openhex][eraseadd]==0)
        break;
      current_crc16 = crc16[eraseadd];
      EraseAddr = eraseaddr[openhex][eraseadd];
      EraseLength = eraselength[openhex][eraseadd];
      _SendFF01(phyID,Resp_ff01);
      /*故障注入：奇瑞 31 01 FF 01后31 01 FF 01*/
      if(@Faultinsert::TC_Re_FF01==1)
      {
        Resp_ff01 = 0x22;
        Exit_ff01 = 1;
        @Faultinsert::TC_Re_FF01=0;
        continue;
      }
      if(Exit_ff01==1)
      {
        Exit_Download = 1;
        return;
      }
      _Send03FF01(phyID,Resp_ff01);
      if(Exit_03ff01==1)
      {
        Exit_Download = 1;
        return;
      }
      _Send02FF01(phyID,Resp_ff01);
      if(Exit_02ff01==1)
      {
        Exit_Download = 1;
        return;
      }
      //故障注入：FF 01依赖性检查过程中部分地址段未进行检查
      if(@Faultinsert::TC_FF01_Part==1)
      {
        Resp_DA04 = 0x22;
        Exit_DA04 = 1;
        break;
      }
    }
  }
//  else if(@AUTO::Config_Switch==11)
//  {
//    _Send01DD02(phyID,Resp_01DD02);
//    Data_Check_Chery();
//  }
  fileClose(glbHandle);
}

/// <DownLoad>
//34请求整段地址，36循环至数据下载完成,然后37
void _download_3(dword openhex)
{
  byte datanow[60];
  byte datanext[60];
  char filename[1000];
  dword addrh;
  dword addrl;
  dword addr,hexaddr,hexlength;
  dword length34;
  dword i;
  i = 0;
  countcnt1 = 1;             /*每次36循坏下载时，块编号置1*/
  calcrc32 = 0xFFFFFFFF;     /*CRC32 校验值初始化*/
  
  if(openhex==0)
  {
    sysGetVariableString(sysvar::Test::openhex,filename,elCount(filename));
  }
  else if(openhex==1)
  {
    sysGetVariableString(sysvar::Test::openhex1,filename,elCount(filename));
  }
  else
  {
    sysGetVariableString(sysvar::Test::openhex2,filename,elCount(filename));
  }
  glbHandle = OpenFileRead(filename,0);
  _readhex(datanow);//第一次获取数据，数据类型应是04
  
  /*APP34 请求HEX文件整个地址段*/
  /*获取HEX文件起始地址*/
  hexaddr = _gethexaddr(openhex,eraseaddr,eraselength);
  /*获取HEX文件地址长度*/
  hexlength = _gethexlength(openhex,eraseaddr,eraselength);
  App_34(hexaddr,hexlength);

  testWaitForTimeout(100);
  if(Exit_34_a==1)
  {
    Exit_Download = 1;
    return;
  }
  /*36循环至数据下载完成*/
  while(1)
  {
    hextype=datanow[3];
    //判断hex文件这一行的数据类型，00、04继续，05表示文件结束
    if(hextype==4 || hextype==2)
    {
      addrh=((word)datanow[4]<<8)|datanow[5];
      addr=(dword)addrh<<16;//先获取地址的高16位
      _readhex(datanow);//先获取一次00数据类型的数据
      _loadpage(data36,datanow,addr,length34);//装载数据到data36，并返回地址、长度和下一段04、05数据类型
    }
    else if(hextype==0)
    {
      _loadpage(data36,datanow,addr,length34);//装载数据到data36，并返回地址、长度和下一段04、05数据类型
    }
    else if(hextype==5)
    {
      if(@Faultinsert::TC_Continue_36_A == 1) 
      {
        write("/*--------------- 读取到最后一行 ---------------*/");
        END_Pos = 2; 
      }
      break;
    }
    else if(hextype==1)
    {
      if(@Faultinsert::TC_Continue_36_A == 1) 
      {
        write("/*--------------- 读取到最后一行 ---------------*/");
        END_Pos = 2; 
      }
      break;
    }
    else
      break;
    /*APP36 传输数据*/
//    write("length34 = %x",length34);
    APP_36(addr,data36,length34);
    crc16[eraseadd] = _caculateCrc16(0xFFFF,data36,length34);
    calcrc16 = _caculateCrc16(calcrc16,data36,length34);
    calcrc32 = _caculateCrc32_1(calcrc32,data36,length34);
    if(Exit_36_a==1)
    {
      Exit_Download = 1;
      return;
    }
    if(Break_Download==1)
    {
      break;
    }
  }
  fileClose(glbHandle);
  /*APP37 请求退出*/
//  _Send37(phyID,Resp_37_a);
  App_37();
  if(Exit_37_a==1)
  {
    Exit_Download = 1;
    return;
  }
  /*
    不同主机厂数据校验不同
    BYD || Geely1.0 || 鑫源 || 瑞驰 || 五菱 || 赛力斯 || 奇瑞T1V || 广汽
  */
  if(@AUTO::Config_Switch==1 || @AUTO::Config_Switch==3 || @AUTO::Config_Switch==5
  || @AUTO::Config_Switch==6 || @AUTO::Config_Switch==8 || @AUTO::Config_Switch==10
  || @AUTO::Config_Switch==11|| @AUTO::Config_Switch==12)
  {
    /*APP 31 01 02 02数据校验*/
    _Send0202_a(data36,length34,phyID,Resp_0202_a);
  }
    /*奇瑞特殊流程2*/
  if(@AUTO::Config_Switch==7)
  {
      EraseLength = hexlength;
      EraseAddr = eraseaddr[openhex][0];
      current_crc16 = calcrc16;
     
      _SendFF01(phyID,Resp_ff01);
      /*故障注入：奇瑞 31 01 FF 01后31 01 FF 01*/
      if(@Faultinsert::TC_Re_FF01==1)
      {
        Resp_ff01 = 0x22;
        Exit_ff01 = 1;
        @Faultinsert::TC_Re_FF01=0;
        _SendFF01(phyID,Resp_ff01);
      }
      if(Exit_ff01==1)
      {
        Exit_Download = 1;
        return;
      }
      _Send03FF01(phyID,Resp_ff01);
      if(Exit_03ff01==1)
      {
        Exit_Download = 1;
        return;
      }
      _Send02FF01(phyID,Resp_ff01);
      if(Exit_02ff01==1)
      {
        Exit_Download = 1;
        return;
      }

  }
  else if(@AUTO::Config_Switch==11)
  {
    Data_Check_Chery();
    if(Exit_ff01==1)
    {
      Exit_Download = 1;
      return;
    }
  }
  if(Exit_0202_a==1)
  {
    Exit_Download = 1;
    return;
  }
  
}

/// <DownLoad>
//分段擦除，先循环FF00，然后34、36、37循环
//参数openhex：0为下载第一个hex文件，1为下载第二个hex文件
void _download_4(dword openhex)
{
  byte datanow[60];
  byte datanext[60];
  byte i;
  char filename[1000];
  dword addrh;
  dword addrl;
  dword addr;
  dword addrlast;
  dword length34;
  i = 0;
  eraseadd = 0;
  
  if(openhex==0)
  {
    sysGetVariableString(sysvar::Test::openhex,filename,elCount(filename));
  }
  else if(openhex==1)
  {
    sysGetVariableString(sysvar::Test::openhex1,filename,elCount(filename));
  }
  else
  {
    sysGetVariableString(sysvar::Test::openhex2,filename,elCount(filename));
  }
  
  /*循环FF00，擦除整个HEX文件地址段*/
  for(eraseadd=0;eraseadd<elcount(eraseaddr);eraseadd++)
  {
    if(eraseaddr[openhex][eraseadd]==0 && eraselength[openhex][eraseadd]==0)
      break;
    _Sendff00(eraseaddr[openhex][eraseadd],eraselength[openhex][eraseadd],phyID);
    //故障注入：FF 01依赖性检查过程中部分地址段未进行检查
    if(@Faultinsert::TC_FF00_Part==1)
    {
      Resp_34_a = 0x70;
      Exit_34_a = 1;
      @Faultinsert::TC_FF00_Part==0;
      break;
    }
    if(Exit_ff00==1)
    {
      Exit_Download = 1;
      return;
    }
  }
  glbHandle = OpenFileRead(filename,0);
  _readhex(datanow);//第一次获取数据，数据类型应是04
  eraseadd = 0;                                 /*重置eraseadd用于数据下载时跟踪逻辑块*/
  while(1)
  {
    hextype=datanow[3];
    //判断hex文件这一行的数据类型，00、04继续，05、01表示文件结束
    if(hextype==4 || hextype==2)
    {
      addrh=((word)datanow[4]<<8)|datanow[5];
      addr=(dword)addrh<<16;//先获取地址的高16位
      /*合并地址段开关打开时，跟踪当前04段所属的逻辑块*/
      if(@AUTO::MergeAddr_Switch == 1)
      {
        while(eraseaddr[openhex][eraseadd]!=0 &&
              addr >= eraseaddr[openhex][eraseadd]+eraselength[openhex][eraseadd])
          eraseadd++;
      }
      _readhex(datanow);//先获取一次00数据类型的数据
      _loadpage(data36,datanow,addr,length34);//装载数据到data36，并返回地址、长度和下一段04、05数据类型
      /*合并连续地址段流式36:仅加载首段,后续段在_App_36_merge中逐段加载发送*/
    }
    else if(hextype==0)
    {
      _loadpage(data36,datanow,addr,length34);//装载数据到data36，并返回地址、长度和下一段04、05数据类型
    }
    else if(hextype==5)
      break;
    else if(hextype==1)
      break;
    else
      break;
    //分段请求hex文件地址段
    if(@AUTO::MergeAddr_Switch == 1 && Continueaddr[openhex][eraseadd] >= 1)
      App_34(addr,eraselength[openhex][eraseadd]);/*合并块:34请求整段长度*/
    else
      App_34(addr,length34);
    if(Exit_34_a==1)
    {
      Exit_Download = 1;
      break;
    }
    /*合并块:流式36发送(含故障注入+CRC增量累积),非合并块走原流程*/
    if(@AUTO::MergeAddr_Switch == 1 && Continueaddr[openhex][eraseadd] >= 1)
    {
      _App_36_merge(openhex,eraseadd,eraselength[openhex][eraseadd],length34,datanow,addr);
      i++;                                        /*合并块只产生一个crc16条目*/
    }
    else
    {
      //APP36数据传输服务
      App_36(addr,data36,length34);
      crc16[i] = _caculateCrc16(0xFFFF,data36,length34);
      i++;
      calcrc16 = _caculateCrc16(calcrc16,data36,length34);
    }
    if(Exit_36_a==1)
    {
      Exit_Download = 1;
      break;
    }
    if(Continue_36_a==1)
    {
      continue;
    }
    //APP37退出服务
    App_37();
    if(Exit_37_a==1)
    {
      Exit_Download = 1;
      break;
    }
    if(@AUTO::Config_Switch==3)//Geely1.0
    {
      /*APP 31 01 02 02数据校验*/
      _Send0202_a(data36,length34,phyID,Resp_0202_a);
      if(Exit_0202_a==1)
      {
        Exit_Download = 1;
        return;
      }
    }
    if(Break_Download==1)
    {
      break;
    }
  }
  /*奇瑞特殊流程*/
  if(@AUTO::Config_Switch==7)
  {
    for(eraseadd=0;eraseadd<elcount(eraseaddr);eraseadd++)
    {
      if(eraseaddr[openhex][eraseadd]==0 && eraselength[openhex][eraseadd]==0)
        break;
      current_crc16 = crc16[eraseadd];
      EraseAddr = eraseaddr[openhex][eraseadd];
      EraseLength = eraselength[openhex][eraseadd];
      _SendFF01(phyID,Resp_ff01);
      /*故障注入：奇瑞 31 01 FF 01后31 01 FF 01*/
      if(@Faultinsert::TC_Re_FF01==1)
      {
        Resp_ff01 = 0x22;
        Exit_ff01 = 1;
        @Faultinsert::TC_Re_FF01=0;
        continue;
      }
      if(Exit_ff01==1)
      {
        Exit_Download = 1;
        return;
      }
      _Send03FF01(phyID,Resp_ff01);
      if(Exit_03ff01==1)
      {
        Exit_Download = 1;
        return;
      }
      _Send02FF01(phyID,Resp_ff01);
      if(Exit_02ff01==1)
      {
        Exit_Download = 1;
        return;
      }
      //故障注入：FF 01依赖性检查过程中部分地址段未进行检查
      if(@Faultinsert::TC_FF01_Part==1)
      {
        Resp_DA04 = 0x22;
        Exit_DA04 = 1;
        break;
      }
    }
  }
  /*不同主机厂数据校验不同*/
  if(@AUTO::Config_Switch==1 || @AUTO::Config_Switch==5
  || @AUTO::Config_Switch==6 || @AUTO::Config_Switch==8)//BYD || 鑫源 || 瑞驰 || 五菱
  {
    /*APP 31 01 02 02数据校验*/
    _Send0202_a(data36,length34,phyID,Resp_0202_a);
    if(Exit_0202_a==1)
    {
      Exit_Download = 1;
      return;
    }
  }
  fileClose(glbHandle);
}

/// <DownLoad>
/*[流式改造-2026-09]_download_5 的流式版本:替代原整段 dataBuffer 装载。
  流程:打开 bin 文件流 → App_34 → _Send36_App_stream(按页读取发送+逐页CRC) → App_37 → 关闭流。
  内存占用:仅 hexfile_app[0].dataBuffer[0x1000] 单页缓冲(4KB),不再常驻整文件。*/
void _download_5_stream(dword openhex,int Pos_Struct)
{
  dword fileHandle_;
  countcnt1 = 1;             /*每次36循环下载时，块编号置1*/
  countcnt3 = 0;
  App_34(hexfile_app[Pos_Struct].BlockStartAddr,hexfile_app[Pos_Struct].BlockDataLength);
  testWaitForTimeout(100);
  if(Exit_34_a==1)
  {
    Exit_Download = 1;
    return;
  }
  /*打开 bin 文件流,跳过头部到数据段起始*/
  fileHandle_ = BinFile_OpenStream(openhex);
  if(fileHandle_==0)
  {
    writeEx(-3,1,"[流式]打开 bin 文件失败,文件栏%d",openhex);
    Exit_Download = 1;
    return;
  }
  /*APP36 流式传输数据(按页从文件读取)+ 逐页累加 CRC32*/
  _Send36_App_stream(fileHandle_,hexfile_app[Pos_Struct].BlockDataLength,countcnt3,0);
  BinFile_CloseStream(openhex);
  if(Exit_36_a==1)
  {
    Exit_Download = 1;
    return;
  }
  /*APP37 请求退出*/
  App_37();
  if(Exit_37_a==1)
  {
    Exit_Download = 1;
    return;
  }
}

/// <DownLoad>
/*
    [CBF流式]奇瑞 T1V(Config_Switch==11) 整段下载(EraseMode_Switch==3)。
    流程:App_34(整段地址) -> 36 流式逐页发送(从 CBF 文件纯数据段读取) -> App_37 -> 0202 校验。
    复用 _Send36_App_stream 分页读取与 CRC32 累加;calcrc32 在本函数内初始化为 0xFFFFFFFF,
    与 _download_3 的 EraseMode==3 分支一致,0202 校验取 calcrc32^0xFFFFFFFF。
    前置:CBFFile_ReadAndSave 已填充 hexfile_app[0].BlockStartAddr/BlockDataLength/BlockEndAddr
         并计算 cbfDataOffset。
*/
void _download_CBF_stream()
{
  dword fileHandle_;
  countcnt1 = 1;             /*每次36循环下载时，块编号置1*/
  countcnt3 = 0;
  calcrc32 = 0xFFFFFFFF;     /*CRC32 校验值初始化(与 _download_3 一致)*/

  /*APP34 请求整个地址段*/
  App_34(hexfile_app[0].BlockStartAddr,hexfile_app[0].BlockDataLength);
  testWaitForTimeout(100);
  if(Exit_34_a==1)
  {
    Exit_Download = 1;
    return;
  }
  /*打开 CBF 文件流,跳过头部到纯数据段起始*/
  fileHandle_ = CBFFile_OpenStream();
  if(fileHandle_==0)
  {
    writeEx(-3,1,"[CBF流式]打开 CBF 文件失败");
    Exit_Download = 1;
    return;
  }
  /*APP36 流式传输数据(按页从 CBF 文件读取)+ 逐页累加 CRC32*/
  _Send36_App_stream(fileHandle_,hexfile_app[0].BlockDataLength,countcnt3,0);
  CBFFile_CloseStream();
  if(Exit_36_a==1)
  {
    Exit_Download = 1;
    return;
  }
  /*APP37 请求退出*/
  App_37();
  if(Exit_37_a==1)
  {
    Exit_Download = 1;
    return;
  }
  /*APP 31 01 02 02 数据校验(EraseMode==3 走 else 分支,使用累计 calcrc32)*/
  _Send0202_a(hexfile_app[0].dataBuffer,hexfile_app[0].BlockDataLength,phyID,Resp_0202_a);
  Data_Check_Chery();
  if(Exit_ff01==1)
  {
    Exit_Download = 1;
    return;
  }
  if(Exit_0202_a==1)
  {
    Exit_Download = 1;
    return;
  }
}


void Data_Check_Chery()
{
  if(@AUTO::Config_Switch==11)
  {
//    //驱动下载数据校验31 01 DD 0F
//    FlashDriver_0202();
//    if(Exit_0202_f==1)
//    {
//      Exit_Re_Prog = 1;
//      return;
//    }
    if(@Faultinsert::TC_Miss_34_F==1)
      PassState_31[0] = 0x01;
    //软硬件一致性检查 31 01 FF 01
    _SendFF01(phyID,Resp_ff01);
    if(Exit_ff01==1)
    {
      Exit_Re_Prog = 1;
      return;
    }
    if(@Faultinsert::TC_Re_FF01==1)
      {
        Resp_ff01 = 0x22;
        Exit_ff01 = 1;
        @Faultinsert::TC_Re_FF01=0;
      }
      if(Exit_ff01==1)
      {
        Exit_Download = 1;
        return;
      }
    {
//     //31 01 DD 03
//      _Send01DD03(phyID,-1);
//    //22 F0 F0
//      ReadIdentify(phyID,0xF0F2,Resp_22);
    }
  }
}

/// <Geely3.0>
//Geely3.0 下载APP数据流程:FF00 34 36 37 0212
void Data_Download(int FileNum)
{
  int VbtFlage;
  
  for(VbtFlage=0;VbtFlage<=1;VbtFlage++)
  {
    //31 01 FF 00
    APP_FF00(VbtFlage);
    if(Exit_ff00==1)
    {
      Exit_Download = 1;
      return;
    }
  }
  //故障注入：FF00擦除后 直接0205
  if(@Faultinsert::TC_FF00_0205)
  {
    //擦除swlm
    if(FileNum==1)
    {
      PassState_31[4] = 0x05;
      _Send0205(phyID,Resp_0205);
    }
    //擦除Swp1
    else if(FileNum==2)
    {
      PassState_31[4] = 0x21;
      _Send0205(phyID,Resp_0205);
    }
    //擦除Swp2
    else if(FileNum==3)
    {
      PassState_31[4] = 0x41;
      _Send0205(phyID,Resp_0205);
    }
    Exit_Download = 1;
    return;
  }
  //故障注入：重复请求已擦除的FF00
  if(@Faultinsert::TC_Re_FF00==1)
  {
    APP_FF00(1);
  }
  for(VbtFlage=0;VbtFlage<=1;VbtFlage++)
  {
    //故障注入：步骤缺失 APP 34 36 37
    if(@Faultinsert::TC_Miss_34_A==1 && @Faultinsert::TC_Miss_36_A==1 && @Faultinsert::TC_Miss_37_A==1)
    {
      PassState_31[1] = 0x06;
      Exit_0202_a = 1;
      if(@AUTO::Geely3_Config == 1) //P162
        Resp_0202_a = 0x24;
      break;
    }
    //APP 34请求数据下载
    App_34(VbtFlage);
    if(Exit_34_a==1)
    {
      Exit_Download = 1;
      return;
    }
    //APP 36传输数据
    App_36(VbtFlage);
    if(Exit_36_a==1)
    {
      Exit_Download = 1;
      Break_Download = 1;
      return;
    }
    //APP 37退出传输
    App_37();
    if(Exit_37_a==1)
    {
      Exit_Download = 1;
      return;
    }
    if(@Faultinsert::TC_Exit_in_36_A == 1) //37直接退出后不进行第二部分刷写
    {
      Break_Download = 1;
      break;
    }
  }
  //31 01 02 12签名校验
  _Send0212_A(phyID,FileNum,Resp_0202_a);
  if(Exit_0202_a==1)
  {
    Exit_Download = 1;
    return;
  }
}

/// <Geely3.0>
//Geely3.0 APP FF00擦除数据
void APP_FF00(int type)
{
  dword EraseAddr;
  dword EraseLength;
  dword i;
  i = 0;
  if(type == 0)
  {
    EraseAddr = hexfile_app[0].BlockStartAddr;
    EraseLength = 0;
    for(i=0;i<HexBlockTotalNumber_app;i++)
    {
      EraseLength += hexfile_app[i].BlockDataLength;
    }
  }
  else
  {
    EraseAddr = hexfile_app[0].BlockVbtStartAddr;
    EraseLength = 0;
    for(i=0;i<VbtBlockTotalNumber_app;i++)
    {
      EraseLength += hexfile_app[i].BlockVbtDataLength;
    }
  }
  _Sendff00(EraseAddr,EraseLength,phyID);  
  //故障注入：FF00后 物理寻址复位11 01
  if(@Faultinsert::TC_Restart_after_FF00==1 && type==1)
  {
    _Startreset(phyID,0x01,Resp_11);
    Resp_34_a = 0x33;
    Resp_ff00 = 0x31;
    Exit_34_a = 1;
  }
  //故障注入：FF00后 功能寻址切换默认会话10 01
  else if(@Faultinsert::TC_DefaultSession_after_FF00==1 && type==1)
  {
    enterDefault(funID,0,Resp_1001);
    Resp_34_a = 0x7F;
    Resp_ff00 = 0x31;
    Exit_34_a = 1;
  }
}
/// <Geely3.0>
//Geely3.0 APP 34请求数据
void APP_34(int type)
{
  dword EraseAddr;
  dword EraseLength;
  dword i;
  i = 0;
  
  //故障注入：步骤缺失 APP 34请求下载
  if(@Faultinsert::TC_Miss_34_A==1)
  {
    Resp_36_a = 0x24;
    Resp_37_a = 0x24;
    PassState_31[1] = 0x06;
    Exit_0202_a = 1;
    if(@AUTO::Geely3_Config == 1)
      Resp_0202_a = 0x24;
    return;
  }
  if(type==0)
  {
    EraseAddr = hexfile_app[0].BlockStartAddr;
    EraseLength = 0;
    for(i=0;i<HexBlockTotalNumber_app;i++)
    {
      EraseLength += hexfile_app[i].BlockDataLength;
    }
    if(App_DataFormatId==0x10)
      _Send34_App(vbtStartAddr,vbtLength,phyID,Resp_34_a);
    else
      _Send34_App(EraseAddr,EraseLength,phyID,Resp_34_a);
  }
  else if(type==1)
  {
    EraseAddr = hexfile_app[0].BlockVbtStartAddr;
    EraseLength = 0;
    for(i=0;i<HexBlockTotalNumber_app;i++)
    {
      EraseLength += hexfile_app[i].BlockVbtDataLength;
    }
    if(App_DataFormatId==0x10)
      _Send34_App(vbtStartAddr,vbtLength,phyID,Resp_34_a);
    else
      _Send34_App(EraseAddr,EraseLength,phyID,Resp_34_a);
  }
}

/// <Geely3.0>
//Geely3.0 APP 36传输数据
void APP_36(int type)
{
  dword i;
  i = 0;
  snprintf(stepid,elCount(stepid),"步骤%02d",stepnum);
  testStep(stepid,"开始测试写数据之36");
  countcnt3 = 0;
  AddrNum = 0;
  
  //故障注入：APP 36传输数据时低压
  if(@Faultinsert::TC_LowVolt_36_A==1)
  {
    @Prog_power::K30Volt = 8;
    testWaitForTimeout(Volt_Time);
    Resp_36_a = 0x93;
    Exit_36_a = 1;
  }
  //故障注入：APP 36传输数据时高压
  else if(@Faultinsert::TC_HighVolt_36_A==1)
  {
    @Prog_power::K30Volt = 19;
    testWaitForTimeout(Volt_Time);
    Resp_36_a = 0x93;
    Exit_36_a = 1;
  }
  
  //发送所有地址块
  for(i=0;i<HexBlockTotalNumber_app && type == 0;i++)
  {
    AddrNum++;
    _Send36_App(hexfile_app[i],countcnt3,0);
    //故障注入：36传输过程中直接37退出
    if(Geely3_36_Status == 0)
      break;
  }
  if(Geely3_36_Status == 0) //异常退出
    return;
  for(i=0;i<VbtBlockTotalNumber_app && type == 1;i++)
  {
    AddrNum++;
    if(Geely3_36_Status == 0)
      break;
    _Send36_App(hexfile_app[i],countcnt3,1);
  }
  //故障注入：36传输数据后 发送0205
  if(@Faultinsert::TC_36A_0205==1)
  {
    PassState_31[4] = 0x41;
    _Send0205(phyID,Resp_0205);
  }
}
//判断是否有外发报文
//参数Passcondition:{0:预期无外发报文;1:预期有外发报文}
int Check_Tx(int Passcondition)
{
  int result;
//  result = testWaitForMessage(TxMessage_ID,TxMessage_Time);
  result = Check_APPValid();
  if(Passcondition == 1)
  {
    if(result == Passcondition)
      testStepPass("App有效","");
    else
      testStepFail("App有效","");
  }
  else
  {
    if(result == Passcondition)
      testStepPass("App无效","");
    else
      testStepFail("App无效","");
  }
  return result;
}

void _saveMsg(int time)
{
  byte i,j;
  int flag_getMsg;
  flag_getMsg = _getMsg(responseMsgs[0],p2cmax*4);
  if(flag_getMsg == 1)
  {
    for(i = 1; i < 10; i++)
    {
      _getMsg(responseMsgs[i],200);
      if(responseMsgs[i].dlc == 0)
        break;
    }
  }
}

/**
  获取报文，判断报文响应时间是否在目标时间time内
**/
int _getMsg(message 0x00 msg,int time)
{
  char comment[50];
  byte i;
  int re;
  int resave;
  int flag_getMsg;//判断有没有获取到报文
  TestJoinMessageEvent(revID);
  re = testWaitForMessage(revID,time);
  if(re)
  {
    testGetWaitEventMsgData(msg);
    snprintf(comment,elCount(comment),"已收到报文");
    for(i=0;i<8;i++)
    {
      snprintf(comment,elCount(comment),"%s %02X",comment,msg.byte(i));
    }
    resave++;
    flag_getMsg = 1;
  }
  else
  {
    flag_getMsg = 0;
  }
  if(re == 0 && resave == 0)
  {
    TestStepFail("报文响应超时");
  }
  return flag_getMsg;
}

/// <Unlock>
int _CheckCode(int passcondition,int checkLength)
{
  int resNum,i,j,allRes_i;
  int checkResult,StartLen;
  word allRes[100];
  word dlc,allRes_length;
  dlc = (@sysvar::AUTO::CANFD_Switch==0)?8:16;
  StartLen = (@sysvar::AUTO::CANFD_Switch==0)?0:4;
  checkResult = 0;
  for(i = 0; i< 10; i++)//获取当前响应码序列长度
  {
    if(responseMsgs[i].dlc == 0)
    {
      break;
    }
    else if(responseMsgs[i].byte(0) == 0x03 && responseMsgs[i].byte(1) == 0x7f && responseMsgs[i].byte(3) == 0x78 && NRC78_flag == 0)//响应78不存入验证数组
    {
      allRes_i++;
      resNum--;
    }
    else if(responseMsgs[i].byte(0) == 0x30)  //流控帧不计入数组
    {
      allRes_i++;
      resNum--;
    }
    else
    {
      for(j = 0; j < dlc+StartLen ; j++)
      {
        allRes[((i-allRes_i)*dlc)+j] = responseMsgs[i].byte(j);
      }
    }  
    resNum++;
  }
  allRes_length = resNum * dlc;
  if(@sysvar::AUTO::Security_Switch == 2 && allRes_length > 0)//Geely 3.0 将响应的种子存入seed    需注意区分CAN与CANFD
  {
    word inx;
    inx = 4;
    if(@sysvar::AUTO::CANFD_Switch==0)
    {
      for(j = 0; j < 16; j++)
      {
        Seed_AES[j] = allRes[j+inx];
        if(j == 3)
          inx = 5;
        if(j == 10)
          inx = 6;
      }
    }
    else
    {
      for(j = 0; j < 16; j++)
        Seed_AES[j] = allRes[j+inx];
    }
    inx = 4;
  }
  if(passcondition == -1)
    testStepPass("收到肯定响应");
  else if(passcondition == 0)
    testStepfail("无响应");
  else
    testStepfail("收到否定响应");
  resNum = 0;
  allRes_i = 0;
  NRC78_flag = 0;
  for(i = 0; i < 100 ; i++)
    allRes[i] = 0;
  _initMsg(responseMsgs);
  return checkResult;
}

/* 操作完后将responseMsgs重置*/
void _initMsg(message 0x00 msg[])
{
  message 0x00 init_msg;
  word i,j;
  for(i = 0; i < elCount(msg); i++)
    msg[i] = init_msg;
}
/// <Unlock>
/*2702密钥填充：type:0:正确密钥  1:错误密钥*/
void _padding2702(int type,diagRequest* sendkey)
{
  word corresKey[16];
  word key_i;
//  byte Seed_Test[16] = {0x66,0xb0,0xcf,0x31,0xf5,0x6a,0xc1,0x6a,0xbf,0x46,0x10,0xdf,0x87,0xa1,0xae,0x20};
  if(type == 0)
  {
    if(@AUTO::Config_Switch == 4)
      if(curAppValid == 1)
        _SecurityAccess_AES(Seed_AES,fixByte_,corresKey);
      else
        _SecurityAccess_AES(Seed_AES,fixByte_Bt,corresKey);
    else if(@AUTO::Config_Switch == 6)
      _SecurityAccess_AES(Seed_AES,fixByte_2,corresKey);
    else if(@AUTO::Config_Switch == 2)
      _SecurityAccess_AES(Seed_AES,fixByte_CCAG_APP,corresKey);
    else if(@AUTO::Config_Switch == 11)
    {
//      if(curAppValid == 1)
//        _SecurityAccess_AES(Seed_AES,fixByte_Chery_APP,corresKey);
//      else
        _SecurityAccess_AES(Seed_AES,fixByte_Chery_BT,corresKey);
    }
    else if(@AUTO::Config_Switch == 13)
      _SecurityAccess_AES(Seed_AES,fixByte_V8,corresKey);
    for(key_i = 0; key_i < 16; key_i++)
    {
      DiagSetPrimitiveByte(sendkey,key_i+2,corresKey[key_i]);
//      writeEx(-3,0,"Key[%d] = 0x%02X",key_i,corresKey[key_i]);
    }
  }
  else
  {
    for(key_i = 0; key_i < 16; key_i++)
      DiagSetPrimitiveByte(sendkey,key_i+2,0x00);
  }
}
/// <Unlock>
void _SecurityAccess_AES(byte seed[], word Byte_[],word corresKey[])
{
  char M[16],mic[16];
  int i;
  char fixByte[16];
  word gHandle;
  for(i=0;i<16;i++)
  {
    fixByte[i] = Byte_[i];
  }
  gHandle = registerCAPLDLL();
  for(i = 0; i < 16; i++)
  {
    M[i] = seed[i];
  }
  aes_128_cmac(M,fixByte,mic);
  for(i = 0; i < 16; i++)
  {
    corresKey[i] = mic[i] & 0xFF;
  }
  fileClose(gHandle);
}
/*低电压刷写预期结果*/
void LowVolt_Resp(byte AppValid)
{
  /*APP有效情况下*/
  if(AppValid==1)
  {
    /*Geely 1.0*/
    if(@AUTO::Config_Switch==3)
    {
      Resp_1002 = 0x22;
      Exit_1002 = 1;
    }
    else
    {
      Resp_36_f = 0x93;
      Exit_36_f = 1;
    }
  }
  /*APP无效情况下*/
  else
  {
    Resp_36_f = 0x93;
    Exit_36_f = 1;
  }
}
/*高电压刷写预期结果*/
void HighVolt_Resp(byte AppValid)
{
  /*APP有效情况下*/
  if(AppValid==1)
  {
    /*Geely 1.0*/
    if(@AUTO::Config_Switch==3)
    {
      Resp_1002 = 0x22;
      Exit_1002 = 1;
    }
    else
    {
      Resp_36_f = 0x92;
      Exit_36_f = 1;
    }
  }
  /*APP无效情况下*/
  else
  {
    Resp_36_f = 0x92;
    Exit_36_f = 1;
  }
}


