/*@!Encoding:936*/
includes
{
  #if X64
    #pragma library("..\UDS_configuration\AES_128.dll")
    #pragma library("..\UDS_configuration\AES_CBC.dll")
  #else
    #pragma library("..\UDS_configuration\AES_128.dll")
    #pragma library("..\UDS_configuration\AES_CBC.dll")
  
  #endif
  #include "..\Struct.can"
  
}

variables
{
  message 0x11 IGON = {dlc=8};               /*用于控制旧老化板*/
  message *Relaymsg = {dlc=8};               /*用于控制新老化板*/
  byte Burn_in_Board;                        /*老化板类型*/
  byte LHB_State = 0;                        /*老化板状态值*/
  byte LHB_State_New = 0x03;                        /*新老化板状态值*/
  byte InitConfig = 0;                       /*初始化配置，通过此处实现仅在第一次运行时初始化*/
  dword ID_From_Title;
  byte Serve_Form_Title;
  byte Session_From_Title;
  

  /*ini文件路径及相关变量*/
  byte glbHandle1;
  char ECU_project[50];
  char file_path_1[100] = ".\\Testmodule\\Test_UDS";
  char file_name_1[100] = ".\\Testmodule\\Test_UDS\\BT_UDS_Main_info.ini";
  char Cdd_Name[50] = "ABS_ESP";
  char Error_File[50] = ".\\Testmodule\\Test_UDS\\";
  char Error_FileName[50] = "异常数据记录.txt";
  
  byte filler;                            /*未使用填充位：0x30;0x20;0x00*/
  byte BT_Double_Backup;                  /*是否存在回滚功能(BT备份)0:不存在,1:存在*/
  
  qword Seed_Count_List[10100];           /*种子缓存数组*/
  byte Seed_Count_List_AES128[10100][16]; /*16字节种子缓存数组*/
  word Seed_Count;                        /*种子计数*/
  
  char stepid[40];                        /*在报告上标识步骤*/
  word stepnum=0;                         /*步骤每进行一次加一*/
  word phyreq_ID;                         /*诊断物理寻址ID*/
  word funreq_ID;                         /*诊断功能寻址ID*/
  word Response_ID;                       /*诊断响应ID*/

  dword Car_Spd_ID;                       /*车速信号所在消息ID，例：0x121*/
  dword Ready_ID;                         /*发动机信号所在消息ID，例：0x341*/
  char CarSpd_Sig[50];                    /*车速信号(DBC中信号名) 例：Vehicle_speed*/
  char CarSpdInvalid_Sig[50];             /*车速有效性信号(DBC中信号名) 例：VehicleSpeed_Status*/
  byte Car_Spd_Invalid;                   /*车速有效性信号的无效值，例：VehicleSpeed_Status为1时车速无效则填1*/
  word Lost_CarSpd_Time = 500;            /*车速丢失故障成熟时间*/
  
  char Ready_Sig[50];                     /*发动机信号(DBC中信号名)*/
  byte Ready_Active;                      /*发动机开启时的值*/
  byte Set_Battery_RS232;                 /*设置电压的方式  0:手动设置，1：RS232设置*/  
  char ReadyInvalid_Sig[50];              /*发动机有效性信号(DBC中信号名) 例：EMS_EngineSpeedRPMInvalid*/
  byte Ready_Invalid;                     /*发动机有效性信号的无效值，例：EMS_EngineSpeedRPMInvalid为1时发动机无效则填1*/
  word ReadyInvalid_Time = 500;                  /*发动机丢失故障成熟时间*/
  
  word p2cmax;                            /*客户端等待单帧响应的最大等待时长ms，响应是多帧不要使用此参数*/
  word p2exs;                             /*服务器发送NRC78到下一响应的最长时间10ms*/
  dword P2can_server;
  dword P2_can_server;
  word NRC78_Cycle=2000;                  /*消极应答扩展（NRC78）的周期时间ms*/
  word NRC78_RespTime=5000;               /*消极应答扩展（NRC78）后收到响应的时间ms*/
  
  byte NRC78_max;                         /*NRC78连续响应的最大次数*/
  
  byte defsession=1;                      /*默认会话*/
  byte prosession=2;                      /*编程会话*/
  byte exsession=3;                       /*扩展会话*/
  byte Session_BIN;                       /*二进制下会话表示：bit0表示默认会话、bit1表示编程会话、bit2表示扩展会话*/
  byte cursession;                        /*当前编程会话*/
  byte NRC78_flag;
  byte noFail;                            /*是否需要进行判断*/

  dword Seed_Count_Rept[10100][2];        //用于所有种子统计非AES128型
  word  Seed_Count_AES_Rept[10100][17];   //用于所有种子统计AES128型
  
  /*--------------------10H-----------------------*/
  byte Pre_Programmed_UnlockECU;          /*预编程是否需要过安全访问，0：不需要，1：需要*/
  byte Pre_Programmed_1002;               /*进入10 02是否需要预编程条件，0：无，1：有预编程条件*/
  byte Other_1002;                        /*进入10 02的前置条件开关，若为0：无其它条件，为1：有其它前置条件*/
  byte Sub_1082_NRC78;
  byte Sub_1002_NRC78;
  dword Sub_1002_Time_Flage;
  dword Sub_1002_Time;
  byte Factory_1060;                      /*是否检测工厂模式的10 60子功能，仅当为1时，在遍历10子功能时跳过*/
  char Resp_10_len[50];                    /*10服务子功能对应的响应长度Resp_10_len[0]对应10 01，Resp_10_len[1]对应10 02，Resp_10_len[2]对应10 03*/
  int sts_resp10;
  
  byte Send_filler;                       /*发送数据默认填充值*/
  byte Fun_NRC12;                         /*功能寻址方式下,NRC12是否无响应,默认为不响应,0:无响应，1:响应*/
  byte Fun_NRC13;                         /*功能寻址方式下,NRC13是否无响应,默认为不响应,0:无响应，1:响应*/
  /*--------------------11H-----------------------*/

  /*--------------------27H-----------------------*/
  byte RequestSeed_27;                    /*安全访问-请求种子等级*/
  byte SendKey_27;                        /*安全访问-发送秘钥等级*/
  byte SendKey_Len;                       /*安全访问-发送密钥长度*/
  
  byte Get_Seed_Flage;
  dword Seed_AES[16];                     /*AES安全算法*/
  word Error_Count;                       /*安全访问错误计数*/
  word fixByte_Geely_APP[16] = {0x40,0x21,0x07,0x49,0x10,0xD0,0x27,0x15,0x2A,0x19,0x0F,0x1F,0xAC,0x3E,0xFD,0x75};
  word fixByte_Geely_Bt[16] = {0xff,0xff,0xff,0xff,0xff,0xff,0xff,0xff,0xff,0xff,0xff,0xff,0xff,0xff,0xff,0xff};
  word fixByte_RC_BT[16] = {0x2b,0x7e,0x15,0x16,0x28,0xae,0xd2,0xa6,0xab,0xf7,0x15,0x88,0x09,0xcf,0x4f,0x3c};
  word fixByte_Chery_BT[16] = {0xA6,0xD4,0x0C,0x53,0xD1,0xC1,0x69,0x41,0xD6,0x80,0xF1,0xE4,0x93,0x45,0x61,0x96}; //T1V_BT
  word fixByte_Chery_APP[16] = {0x6C,0xA7,0xEB,0xBA,0xD8,0xE2,0x8B,0xFA,0x03,0x58,0x8F,0x35,0x3F,0xD7,0x14,0x02}; //T1V_APP
  word fixByte_CCAG_APP[16] = {0x58,0x94,0x93,0x03,0x62,0xEB,0x75,0x94,0xCD,0x10,0x16,0x50,0x25,0x0D,0x4C,0xD2}; //长安_APP
  word corresKey[16];
  byte AES_128;                           /*AES算法标志位*/
  
  byte Error_Count_Power = 0;             /*下电对错误计数影响测试标志位*/
  byte Error_Count_Reset = 0;             /*重启对错误计数影响测试标志位*/
  word Error_Count_Delay;
  word Error_Count_Change;
  word Restoration_Error_Count;
  word Request_Seed_Consistency;
  word Error_Count_Delay_Tolerance;
  word Error_Count_Delay_Reset;
  byte Request_Error_Count;
  dword Request_Seed_Count;
  int Serve_11_Unlock_Count;
  byte ReqSeed_Count;
//  word Request_Error_Count;
  
  /*************AES_CBC***********************/
  byte Iv[16] = {0x11,0x22,0x33,0x44,0x55,0x66,0x77,0x88,0x99,0x00,0x66,0x55,0x44,0x33,0x22,0x11};
  byte ECU_Key[16] ={0x64,0x1d,0xa0,0x0d,0x7f,0xb1,0x4b,0x51,0x8d,0xa4,0x2b,0xf4,0xef,0x0c,0x24,0xf4} ;
  byte ECU_Key2[16] ={0x7d,0x0b,0xa5,0xb6,0xb5,0x7c,0x49,0x05,0x8d,0xf3,0xf9,0xad,0x2f,0x31,0x92,0xfb};
  byte Secret_KEY[16];
  byte Serial_number[16];
  byte KEY_Len = 16;
  byte RA[16];
  byte ra[16];
  byte R[16];
  byte r[16];
  byte Seed_CBC[16];
  
  /*--------------------34H-----------------------*/
  byte Len_34_Addr;
  byte Len_34_Length;
  
  /*--------------------22H-----------------------*/
  byte Ergodic_22H;
  byte Fun_DID22;                         /*功能寻址下是否支持22服务 0：不支持 1：支持*/
  
  byte DID_22_Support;                    /*22服务支持一次性读取的DID数*/
  
  char DID_Data_str[500];                 /*字符串格式，取值于DID的第四组数据*/
  byte DID_Data[500];                     /*22服务预期返回数据，取值于DID的第四组数据*/
  byte DID_byte1;                         /*22服务中第1个DID字节*/
  byte DID_byte2;                         /*22服务中第2个DID字节*/
  byte Analysis;                          /*22服务对应的解析方式，取值于DID的第一组数据*/
  dword DID_len_Ex;                       /*22服务预期返回长度，取值于DID的第二组数据*/
  dword Len_Input = 0;                    /*输入的长度*/
  byte Write_Flage; /*是否可写*/
  byte UnUse_Byte;
  
  char Traversal_DID[200][20];            /*获取遍历的字符串*/
  dword Traversal_Count;
  
  
  struct DID_Read_Input //用于读取多组DID
  {
    byte DID_byte[2];   //DID[]
    dword DID;          //DID
    dword LenExResp;    //预期数据长度
    int Analysis_Read;  //解析方式
    byte Padding;       //填充值
    char ExResp[200];   //预期结果
    byte ExResp_byte[300];   //预期结果
  };
  struct DID_Read_Input DID_Read[15];
  dword DID_Read_Count;
  char Plural_DID[20][100];     /*装载多组DID读取*/
  int Plural_DID_Count;       /*装载多组DID读取个数*/
  
  /*--------------------2EH-----------------------*/
  byte Ergodic_2EH;
  byte DID_2E_SendData_1_Len;             /*第一次2E发送数据总长度*/
  byte DID_2E_SendData_1[400];            /*第一次2E发送数据*/
  int  DID_2E_SendData_1_Response;
  byte DID_2E_SendData_2_Len;             /*第一次2E发送数据总长度*/
  byte DID_2E_SendData_2[400];            /*第二次2E发送数据*/
  int  DID_2E_SendData_2_Response;
  byte DID_2E_TxFiller;                   /*2E发送默认填充值*/
  byte Read_2E_DID[20];                  /*用于检测是否写入成功*/
  byte Read_2E_DID_Len;
  int  Support_Read_2E_DID;
  byte DID_2E_Len;                        
  byte DID_2E_TxLen;                      /*2E预期发送长度*/
  
  
  
  char Data_Rev[500];                     /*获取返回的数据,除NRC78及流控帧*/
  byte Right_13;
  byte Len_13_min;  /*13(min)*/
  byte Len_13_total; /*13(total)*/
  byte NRC_Support_DID[10];
  word NRC_Support_DID_Len;
  byte NRC_NotSupport_DID[10];
  word NRC_NotSupport_DID_Len;
  
  dword x,i,j;
  dword Len;
  message 0x00 responseMsgs[10];          /*用于接收发送诊断后的所有响应码*/
  diagRequest *Session_Start;
  diagRequest *SendData;
  diagRequest ABS_ESP.SeedLevel1_Request reqseed;
  diagRequest ABS_ESP.KeyLevel1_Send sendkey;
  
  /*-------------------TP层-----------------------*/
  byte TP_filler;
  byte BS;
  byte STmin;
  dword N_Bs_Time;
  dword N_Bs_Time_Tolerance;
  dword N_Cr_Time;
  dword N_Cr_Time_Tolerance;
  dword N_Cs_Time;
  dword N_Cs_Time_Tolerance;
  byte MF_Phy_SF_RxDisturb;
  byte MF_Fun_SF_RxDisturb;
  byte MF_Phy_MF_RxDisturb;
  byte MF_Fun_MF_RxDisturb;
  byte MF_Phy_SF_TxDisturb;
  byte MF_Fun_SF_TxDisturb;
  byte MF_Phy_MF_TxDisturb;
  byte MF_Fun_MF_TxDisturb;
  byte H_Disturb;
  byte Response_CanFD;
  int TP_LastCFLen;
  dword FF_DL_Max;
  dword N_Br_Time;
  dword N_Br_Time_Tolerance;
  /*----------------------------------------------*/
  /*--------------------34H-----------------------*/
  byte BT_34_Len;
  
  byte App_DataFormatId=0x00;                 /*App的指定数据格式标识*/
  byte Flash_AddrAndLenId=0x44;               /*FlashDriver的指定地址和长度格式标识*/
  byte App_AddrAndLenId=0x44;                 /*App的指定地址和长度格式标识*/
  /*----------------------------------------------*/
  
  /*--------------------NRC22-----------------------*/
  dword NRC22_CarSpd; /*回NRC22的车速*/
  float NRC22_Battery_Hight; /*回NRC22的电压高值*/
  float NRC22_Battery_Low; /*回NRC22的电压低值*/
  dword H_Battery_Time;   /*高压故障成熟时间*/
  dword L_Battery_Time;   /*低压故障成熟时间*/
  float NRC22_TasTorque;   /*回NRC22的力矩值*/
  byte NRC_22_Gears_Normal;    /*NRC22_档位_正常档位*/
  dword NRC_22_Gears_Range[2];   /*NRC_22_档位范围*/
  char Gears_Signal[50];        /*档位信号*/
  dword Gears_ID;        /*档位ID*/
  /*----------------------------------------------------*/
  
  /*--------------------NRC优先级-----------------------*/  
  dword Len_31H;
  dword Serve31_NRC_Case;
  int BT_0203_Pro;
  byte Fun_NRC[10];   //用于NRC优先级测试
  byte Fun_NRC_Count; //用于NRC优先级测试
  byte Fun_NRC_Send_Len; //用于NRC优先级测试
  byte NRC31_total,NRC13_total,NRC34_31total;
  int NRC13_Count,NRC31_Count,NRC34_31Count;
  byte NRC33_Pos; //用于NRC优先级测试
  /*----------------------------------------------------*/
  
  char Fault_Data_Report[2000];  /*用于当数据过大时记录错误部分数据，打印输出到Report与Trace界面*/
  char Fault_Data_Write[2000];   /*用于当数据过大时记录错误部分数据，打印输出到Write界面*/
  char Fault_Data_Send[2000];    /*用于当数据过大时装载发送数据，用于后续打印*/
  byte BUS_loader_H = 95;
  byte BUS_loader_L = 90;
  
  
  int Support_ReadSession;
  byte Read_Now_Session[5];
  byte Arry_Data[100];
  int Arry_Len;
  int NRC_For34_FlashDrv;
  int NRC_For34_APP;
  int Board_Channel;
  
}


/*****************新老化板******************/
//RelayON(端口X) ：端口X 黑色接口-黄色接口
//RelayOFF(端口X)：端口X 黑色接口-绿色接口
void RelayON(byte Ctr_state)
{
  Relaymsg.can = Board_Channel;
  Relaymsg.id=0x101;
  if(Burn_in_Board==2)
    LHB_State = LHB_State_New;
  switch(Ctr_state)
  {//置为0
    case 1:LHB_State &=0xFE;break;
    case 2:LHB_State &=0xFD;break;
    case 3:LHB_State &=0xFB;break;
    case 4:LHB_State &=0xF7;break;
  }
  LHB_State_New = LHB_State;
  Relaymsg.byte(0) = LHB_State;
  output(Relaymsg);
}
void RelayOFF(byte Ctr_state)
{ 
  Relaymsg.can = Board_Channel;
  Relaymsg.id=0x101;
  if(Burn_in_Board==2)
    LHB_State = LHB_State_New;
  switch(Ctr_state)
  {//置为1
    case 1:LHB_State |=1;break;
    case 2:LHB_State |=2;break;
    case 3:LHB_State |=4;break;
    case 4:LHB_State |=8;break;
  }
  LHB_State_New = LHB_State;
  Relaymsg.byte(0) = LHB_State;
  output(Relaymsg);
}
void _K15_ON()
{
  if(Burn_in_Board==2)
    RelayOFF(2);
  else if(Burn_in_Board==1 || @Test::Burn_Board_Type == 1)
    RelayON(2);
  else 
  {
    IGON.can = Board_Channel;
    IGON.byte(0)=0x02;
    IGON.byte(1)=0x01;
    IGON.byte(2)=0x01;
    output (IGON);
  } 
  testWaitForTimeout(200);
  _WriteEx_and_Report("上点火","K15->ON,维持200ms");
}
void _K15_OFF()
{
  if(Burn_in_Board==2)
    RelayON(2);
  else if(Burn_in_Board==1 || @Test::Burn_Board_Type == 1)
    RelayOFF(2);
  else 
  {
    IGON.can = Board_Channel;
    IGON.byte(0)=0x02;
    IGON.byte(1)=0x01;
    IGON.byte(2)=0x00;
    output (IGON);
  } 
  testWaitForTimeout(200);
  _WriteEx_and_Report("下点火","K15->OFF,维持200ms");
}
void _K30_ON()
{
  if(Burn_in_Board==2)
    RelayOFF(1);
  else if(Burn_in_Board==1 || @Test::Burn_Board_Type == 1)
    RelayON(1);
  else 
  {
    IGON.can = Board_Channel;
    IGON.byte(0)=0x02;
    IGON.byte(1)=0x27;
    IGON.byte(2)=0x01;
    output (IGON);
  } 
  testWaitForTimeout(200);
  _WriteEx_and_Report("上总电","K30->ON,维持200ms");
}
void _K30_OFF()
{
  if(Burn_in_Board==2)
    RelayON(1);
  else if(Burn_in_Board==1 || @Test::Burn_Board_Type == 1)
    RelayOFF(1);
  else 
  {
    IGON.can = Board_Channel;
    IGON.byte(0)=0x02;
    IGON.byte(1)=0x27;
    IGON.byte(2)=0x00;
    output (IGON);
  } 
  testWaitForTimeout(200);
  _WriteEx_and_Report("下总电","K30->OFF,维持200ms");
}

/*从ini文件中初始化变量*/
void Get_value()
{
  char id_string[5000] = ""; 
  char Temp_Value[500];
  char Temp_2[500];
  byte Temp_data[5];
  snprintf(id_string,elCount(id_string),"%s","");
  snprintf(Temp_Value,elCount(Temp_Value),"%s","");
  glbHandle1 = OpenFileRead(file_name_1,0);
  getProfileString("Project_Information", "ECU_project","Null",ECU_project, 1000, file_name_1); 
  
  p2cmax = getProfileInt(ECU_project,"p2cmax",p2cmax,file_name_1);
  Send_filler = getProfileInt(ECU_project,"Send_filler",Send_filler,file_name_1);
  filler = getProfileInt(ECU_project,"filler",filler,file_name_1);
  Fun_NRC13 = getProfileInt(ECU_project,"Fun_NRC13",Fun_NRC13,file_name_1);
  P2can_server = getProfileInt(ECU_project,"P2can_server",P2can_server,file_name_1);
  P2_can_server = getProfileInt(ECU_project,"P2_can_server",P2_can_server,file_name_1);
  
  /*10服务*/
  Sub_1002_Time_Flage = getProfileInt(ECU_project,"Sub_1002_Time_Flage",Sub_1002_Time_Flage,file_name_1);
  Sub_1002_Time = getProfileInt(ECU_project,"Sub_1002_Time",Sub_1002_Time,file_name_1);
  Pre_Programmed_UnlockECU =  getProfileInt(ECU_project,"Pre_Programmed_UnlockECU",Pre_Programmed_UnlockECU,file_name_1);
  Pre_Programmed_1002 = getProfileInt(ECU_project,"Pre_Programmed_1002",Pre_Programmed_1002,file_name_1);
  Sub_1002_NRC78 = getProfileInt(ECU_project,"Sub_1002_NRC78",Sub_1002_NRC78,file_name_1);
  Sub_1082_NRC78 = getProfileInt(ECU_project,"Sub_1082_NRC78",Sub_1082_NRC78,file_name_1);
  Factory_1060 = getProfileInt(ECU_project,"Factory_1060",Factory_1060,file_name_1);
  sts_resp10 = getProfileArray(ECU_project,"Resp_10_len",Resp_10_len,elcount(Resp_10_len),file_name_1);

  /*其他*/
  BT_Double_Backup = getProfileInt(ECU_project,"BT_Double_Backup",BT_Double_Backup,file_name_1);
  Set_Battery_RS232 = getProfileInt(ECU_project,"Set_Battery_RS232",Set_Battery_RS232,file_name_1);
  Burn_in_Board = getProfileInt(ECU_project,"Burn_in_Board",Burn_in_Board,file_name_1);
  Board_Channel = getProfileInt(ECU_project,"Board_Channel",Board_Channel,file_name_1);
  
  Car_Spd_ID = getProfileInt(ECU_project,"Car_Spd_ID",Car_Spd_ID,file_name_1);
  getProfileString(ECU_project, "CarSpd_Sig","Null",CarSpd_Sig, 50, file_name_1);
  getProfileString(ECU_project, "CarSpdInvalid_Sig","Null",CarSpdInvalid_Sig, 50, file_name_1);
  Car_Spd_Invalid =  getProfileInt(ECU_project,"Car_Spd_Invalid",Car_Spd_Invalid,file_name_1);
  Lost_CarSpd_Time =  getProfileInt(ECU_project,"Lost_CarSpd_Time",Lost_CarSpd_Time,file_name_1);
  
  Ready_ID = getProfileInt(ECU_project,"Ready_ID",Ready_ID,file_name_1);
  getProfileString(ECU_project, "Ready_Sig","Null",Ready_Sig, 50, file_name_1);
  Ready_Active = getProfileInt(ECU_project,"Ready_Active",Ready_Active,file_name_1);
  getProfileString(ECU_project, "ReadyInvalid_Sig","Null",ReadyInvalid_Sig, 50, file_name_1);
  Ready_Invalid =  getProfileInt(ECU_project,"Ready_Invalid",Ready_Invalid,file_name_1);
  ReadyInvalid_Time =  getProfileInt(ECU_project,"ReadyInvalid_Time",ReadyInvalid_Time,file_name_1);
  
  /*-----------------------------------NRC22--------------------------*/
  NRC22_CarSpd = getProfileInt(ECU_project,"NRC22_CarSpd",NRC22_CarSpd,file_name_1);
  NRC22_Battery_Hight =  getProfileFloat(ECU_project,"NRC22_Battery_Hight",NRC22_Battery_Hight,file_name_1);
  NRC22_Battery_Low =  getProfileFloat(ECU_project,"NRC22_Battery_Low",NRC22_Battery_Low,file_name_1);
  H_Battery_Time = getProfileInt(ECU_project,"H_Battery_Time",H_Battery_Time,file_name_1);
  L_Battery_Time = getProfileInt(ECU_project,"L_Battery_Time",L_Battery_Time,file_name_1);
  NRC22_TasTorque =  getProfileFloat(ECU_project,"NRC22_TasTorque",NRC22_TasTorque,file_name_1);
  NRC_22_Gears_Normal = getProfileInt(ECU_project,"NRC_22_Gears_Normal",NRC_22_Gears_Normal,file_name_1);
  Gears_ID = getProfileInt(ECU_project,"Gears_ID",Gears_ID,file_name_1);
  getProfileString(ECU_project, "Gears_Signal","Null",Gears_Signal, 50, file_name_1);
  /*-----------------------------------------------------------------*/
  
  /*27服务*/
  AES_128 = getProfileInt(ECU_project,"AES_128",AES_128,file_name_1);
  Error_Count = getProfileInt(ECU_project,"Error_Count",Error_Count,file_name_1);
  RequestSeed_27 = getProfileInt(ECU_project,"RequestSeed_27",RequestSeed_27,file_name_1);
  SendKey_27 = getProfileInt(ECU_project,"SendKey_27",SendKey_27,file_name_1);
  DiagSetPrimitiveByte(reqseed,1,RequestSeed_27);
  DiagSetPrimitiveByte(sendkey,1,SendKey_27);
  SendKey_Len = getProfileInt(ECU_project,"SendKey_Len",SendKey_Len,file_name_1);
  Error_Count_Delay = getProfileInt(ECU_project,"Error_Count_Delay",Error_Count_Delay,file_name_1);
  Error_Count_Change = getProfileInt(ECU_project,"Error_Count_Change",Error_Count_Change,file_name_1);
  Restoration_Error_Count = getProfileInt(ECU_project,"Restoration_Error_Count",Restoration_Error_Count,file_name_1);
  Request_Seed_Consistency = getProfileInt(ECU_project,"Request_Seed_Consistency",Request_Seed_Consistency,file_name_1);
  Error_Count_Delay_Tolerance = getProfileInt(ECU_project,"Error_Count_Delay_Tolerance",Error_Count_Delay_Tolerance,file_name_1);
  Error_Count_Delay_Reset = getProfileInt(ECU_project,"Error_Count_Delay_Reset",Error_Count_Delay_Reset,file_name_1);
  Request_Error_Count = getProfileInt(ECU_project,"Request_Error_Count",Request_Error_Count,file_name_1);
  Request_Seed_Count = getProfileInt(ECU_project,"Request_Seed_Count",Request_Seed_Count,file_name_1);
  Serve_11_Unlock_Count = getProfileInt(ECU_project,"Serve_11_Unlock_Count",Serve_11_Unlock_Count,file_name_1);
  ReqSeed_Count = getProfileInt(ECU_project,"ReqSeed_Count",ReqSeed_Count,file_name_1);
  
  /*31服务*/
  BT_0203_Pro = getProfileInt(ECU_project,"BT_0203_Pro",BT_0203_Pro,file_name_1);
  Serve31_NRC_Case = getProfileInt(ECU_project,"Serve31_NRC_Case",Serve31_NRC_Case,file_name_1);
  /*34服务*/
  Len_34_Addr = getProfileInt(ECU_project,"Len_34_Addr",Len_34_Addr,file_name_1);
  Len_34_Length = getProfileInt(ECU_project,"Len_34_Length",Len_34_Length,file_name_1);
  /*22服务*/
  Ergodic_22H = getProfileInt(ECU_project,"Ergodic_22H",Ergodic_22H,file_name_1);
  Fun_DID22 = getProfileInt(ECU_project,"Fun_DID22",Fun_DID22,file_name_1);
  DID_22_Support = getProfileInt(ECU_project,"DID_22_Support",DID_22_Support,file_name_1);
  /*2E服务*/
  Ergodic_2EH = getProfileInt(ECU_project,"Ergodic_2EH",Ergodic_2EH,file_name_1);
  
  /*TP层*/
  TP_filler = getProfileInt(ECU_project,"TP_filler",TP_filler,file_name_1);
  BS = getProfileInt(ECU_project,"BS",BS,file_name_1);
  STmin = getProfileInt(ECU_project,"STmin",STmin,file_name_1);
  N_Bs_Time = getProfileInt(ECU_project,"N_Bs_Time",N_Bs_Time,file_name_1);
  N_Bs_Time_Tolerance = getProfileInt(ECU_project,"N_Bs_Time_Tolerance",N_Bs_Time_Tolerance,file_name_1);
  N_Cr_Time = getProfileInt(ECU_project,"N_Cr_Time",N_Cr_Time,file_name_1);
  N_Cr_Time_Tolerance = getProfileInt(ECU_project,"N_Cr_Time_Tolerance",N_Cr_Time_Tolerance,file_name_1);
  N_Cs_Time = getProfileInt(ECU_project,"N_Cs_Time",N_Cs_Time,file_name_1);
  N_Cs_Time_Tolerance = getProfileInt(ECU_project,"N_Cs_Time_Tolerance",N_Cs_Time_Tolerance,file_name_1);
  
  MF_Phy_SF_RxDisturb = getProfileInt(ECU_project,"MF_Phy_SF_RxDisturb",MF_Phy_SF_RxDisturb,file_name_1);
  MF_Fun_SF_RxDisturb = getProfileInt(ECU_project,"MF_Fun_SF_RxDisturb",MF_Fun_SF_RxDisturb,file_name_1);
  MF_Phy_MF_RxDisturb = getProfileInt(ECU_project,"MF_Phy_MF_RxDisturb",MF_Phy_MF_RxDisturb,file_name_1);
  MF_Fun_MF_RxDisturb = getProfileInt(ECU_project,"MF_Fun_MF_RxDisturb",MF_Fun_MF_RxDisturb,file_name_1);
  MF_Phy_SF_TxDisturb = getProfileInt(ECU_project,"MF_Phy_SF_TxDisturb",MF_Phy_SF_TxDisturb,file_name_1);
  MF_Fun_SF_TxDisturb = getProfileInt(ECU_project,"MF_Fun_SF_TxDisturb",MF_Fun_SF_TxDisturb,file_name_1);
  MF_Phy_MF_TxDisturb = getProfileInt(ECU_project,"MF_Phy_MF_TxDisturb",MF_Phy_MF_TxDisturb,file_name_1);
  MF_Fun_MF_TxDisturb = getProfileInt(ECU_project,"MF_Fun_MF_TxDisturb",MF_Fun_MF_TxDisturb,file_name_1);
  H_Disturb = getProfileInt(ECU_project,"H_Disturb",H_Disturb,file_name_1);
  Response_CanFD = getProfileInt(ECU_project,"Response_CanFD",Response_CanFD,file_name_1);
  TP_LastCFLen = getProfileInt(ECU_project,"TP_LastCFLen",TP_LastCFLen,file_name_1);
  FF_DL_Max = getProfileInt(ECU_project,"FF_DL_Max",FF_DL_Max,file_name_1);
  N_Br_Time = getProfileInt(ECU_project,"N_Br_Time",N_Br_Time,file_name_1);
  N_Br_Time_Tolerance = getProfileInt(ECU_project,"N_Br_Time_Tolerance",N_Br_Time_Tolerance,file_name_1);

  funreq_ID = getProfileInt(ECU_project,"funreq_ID",funreq_ID,file_name_1);
  phyreq_ID = getProfileInt(ECU_project,"phyreq_ID",phyreq_ID,file_name_1);
  Response_ID = getProfileInt(ECU_project,"Response_ID",Response_ID,file_name_1);
  
  @sysvar::DID::funreq_ID=getProfileInt (ECU_project, "funreq_ID",0,file_name_1);
  funreq_ID = @sysvar::DID::funreq_ID;
  @sysvar::DID::phyreq_ID=getProfileInt (ECU_project, "phyreq_ID",0,file_name_1);
  phyreq_ID = @sysvar::DID::phyreq_ID;
  @sysvar::DID::Response_ID=getProfileInt (ECU_project, "Response_ID",0,file_name_1);
  Response_ID = @sysvar::DID::Response_ID;
  if(InitConfig == 0)
  {
    InitConfig = 1;//标志位置位，取消下一次初始化过程
    if(strncmp(ECU_project,"BYD",strlen(ECU_project)) == 0 && strlen(ECU_project) == strlen("BYD"))
      @AUTO::Config_Switch = 1;
    else if(strncmp(ECU_project,"ChangAn",strlen(ECU_project)) == 0 && strlen(ECU_project) == strlen("ChangAn"))
      @AUTO::Config_Switch = 2;
    else if(strncmp(ECU_project,"Geely1.0",strlen(ECU_project)) == 0 && strlen(ECU_project) == strlen("Geely1.0"))
      @AUTO::Config_Switch = 3;
    else if(strncmp(ECU_project,"Geely3.0",strlen(ECU_project)) == 0 && strlen(ECU_project) == strlen("Geely3.0"))
      @AUTO::Config_Switch = 4;
    else if(strncmp(ECU_project,"SRM",strlen(ECU_project)) == 0 && strlen(ECU_project) == strlen("SRM"))
      @AUTO::Config_Switch = 5;
    else if(strncmp(ECU_project,"RC",strlen(ECU_project)) == 0 && strlen(ECU_project) == strlen("RC"))
      @AUTO::Config_Switch = 6;
    else if(strncmp(ECU_project,"Chery",strlen(ECU_project)) == 0 && strlen(ECU_project) == strlen("Chery"))
      @AUTO::Config_Switch = 7;
    else if(strncmp(ECU_project,"SGMW",strlen(ECU_project)) == 0 && strlen(ECU_project) == strlen("SGMW"))
      @AUTO::Config_Switch = 8;
    else if(strncmp(ECU_project,"Seres",strlen(ECU_project)) == 0 && strlen(ECU_project) == strlen("Seres"))
      @AUTO::Config_Switch = 10;
    else if(strncmp(ECU_project,"Chery5.0",strlen(ECU_project)) == 0 && strlen(ECU_project) == strlen("Chery5.0"))
      @AUTO::Config_Switch = 11;
    else if(strncmp(ECU_project,"GAC",strlen(ECU_project)) == 0 && strlen(ECU_project) == strlen("GAC"))
      @AUTO::Config_Switch = 12;
    
    if(AES_128 == 0)
      @AUTO::Security_Switch=0;
    else if(AES_128 == 1)
      @AUTO::Security_Switch=2;
    else if(AES_128 == 2)
      @AUTO::Security_Switch=1;
  }
  fileClose(glbHandle1);
  testWaitForTimeout(200);
  
}
_Set_Sig(char Sig[],int Vaule)
{
  char _str[80];
  snprintf(_str,elCount(_str),"%s","");
  snprintf(_str,elCount(_str),"EV_%s",Sig);
  
  setSignal(Sig,Vaule);                   /*信号赋值*/
  putValue(Sig,Vaule);                          /*非系统变量赋值*/
  putValue(_str,Vaule);                          /*非系统变量赋值*/
  writeEx(-3,0,"设置信号 %s 值为 %d",Sig,Vaule);
  testStep("","设置信号 %s 值为 %d",Sig,Vaule);
  testWaitForTimeout(200);
}
_Set_CarSpd(dword Spd)
{
  char _str[80];
  snprintf(_str,elCount(_str),"%s","");
  snprintf(_str,elCount(_str),"EV_%s",CarSpd_Sig);
  
  setSignal(CarSpd_Sig,Spd);                   /*信号赋值*/
  putValue(_str,Spd);                          /*非系统变量赋值*/
  _WriteEx_and_Report("","设置车速为 %d",Spd);
  testWaitForTimeout(500);
}
_Set_CarSpd_Invalid(byte State)
{
  char _str[80];
  snprintf(_str,elCount(_str),"%s","");
  snprintf(_str,elCount(_str),"EV_%s",CarSpdInvalid_Sig);
  setSignal(CarSpdInvalid_Sig,State);
  putValue(_str,State);
  _WriteEx_and_Report("","设置车速有效位状态为 %d",State);
//  testWaitForTimeout(Invalid_CarSpd_Time*1.2);
  testWaitForTimeout(Lost_CarSpd_Time*1.2);
}
_Reset_CarSpd_Invalid()
{
  char _str[80];
  byte State;
  snprintf(_str,elCount(_str),"%s","");
  snprintf(_str,elCount(_str),"EV_%s",CarSpdInvalid_Sig);
  if(strncmp(ECU_project,"Geely3.0",strlen("Geely3.0")) == 0 || @AUTO::Config_Switch == 4)
    State=3;
  else
    State=0;
  setSignal(CarSpdInvalid_Sig,State);
  putValue(_str,State);
  _WriteEx_and_Report("","恢复车速有效位状态为 %d",State);
  testWaitForTimeout(500);
}
_Set_Ready(byte Ready)
{
  char _str[80];
  snprintf(_str,elCount(_str),"%s","");
  snprintf(_str,elCount(_str),"EV_%s",Ready_Sig);
  setSignal(Ready_Sig,Ready);
  putValue(_str,Ready);
  _WriteEx_and_Report("","设置发动机状态为 %d",Ready);
  testWaitForTimeout(500);
}
_Set_Battery(double Value)
{
  char str[100];
  diagStartTesterPresent(Cdd_Name);
//  diagStartTesterPresent(Cdd_Name);
  snprintf(str,elCount(str),"%s","");
  snprintf(str,elCount(str),"设置电压为 %.2f V",Value);
  if(Value>35)
  {
    testStep("Battery","设置电压值较大,后续测试时间较长会损坏控制器,建议人为测试精确时间");
  }
  else
  {
    if(Set_Battery_RS232==0)
      testWaitForTesterConfirmation(str,30000);
    else if(Set_Battery_RS232==1)
    {
      @sysvar::Prog_power::K30Volt = Value;
      _WriteEx_and_Report("电压",str);
    }
    if(Value > NRC22_Battery_Hight)
      testWaitForTimeout(H_Battery_Time*1.1);
    else if(Value < NRC22_Battery_Low)
      testWaitForTimeout(L_Battery_Time*1.1);
    else
      testWaitForTimeout(1000);
  }
  diagStopTesterPresent(Cdd_Name);
}
_Set_Gears(byte Value)
{
  char _str[80];
  snprintf(_str,elCount(_str),"%s","");
  snprintf(_str,elCount(_str),"EV_%s",Gears_Signal);
  setSignal(Gears_Signal,Value);
  putValue(_str,Value);
  _WriteEx_and_Report("","设置档位状态为 %d",Value);
  testWaitForTimeout(500);
}
void _Get_0x34(char Add[], char Len[])
{
  char Temp_Value_1[500];
  char Temp_Value_2[500];
  char Temp_Value_3[500];
  qword BT_34_Address[2];
  qword BT_34_Length[2];
  int i,j,k;

  snprintf(Temp_Value_1,elCount(Temp_Value_1),"%s","");
  snprintf(Temp_Value_2,elCount(Temp_Value_2),"%s","");
  snprintf(Temp_Value_3,elCount(Temp_Value_3),"%s","");
  glbHandle1 = OpenFileRead (file_name_1,0);
  getProfileString(ECU_project,Add,"Null",Temp_Value_2, 500, file_name_1);
  getProfileString(ECU_project,Len,"Null",Temp_Value_3, 500, file_name_1);
  fileClose(glbHandle1);
  /***************************获取地址范围*************************/
  j=0;
  for(i=1;i<50;i++)
  {
    if(Temp_Value_2[i]== 44 || Temp_Value_2[i]==125)
    {
//      BT_34_Address[j] = atol(Temp_Value_1);
      strtoull(Temp_Value_1,BT_34_Address[j]);
//      writeEx(-3,1,"BT_34_Add_End[%d] = %x",j,BT_34_Address[j]);
      snprintf(Temp_Value_1,elCount(Temp_Value_1),"%s","");
      j++;
      if(Temp_Value_2[i]==125)
        break;
    }
    else
      snprintf(Temp_Value_1,elCount(Temp_Value_1),"%s%c",Temp_Value_1,Temp_Value_2[i]);
  }
  /****************************************************************/
  /***************************获取长度范围*************************/
  j=0;
 for(i=1;i<50;i++)
  {
    if(Temp_Value_3[i]== 44 || Temp_Value_3[i]==125)
    {
//      BT_34_Address[j] = atol(Temp_Value_1);
      strtoull(Temp_Value_1,BT_34_Length[j]);
//      writeEx(-3,1,"BT_34_Length[%d] = %x",j,BT_34_Length[j]);
      snprintf(Temp_Value_1,elCount(Temp_Value_1),"%s","");
      j++;
      if(Temp_Value_3[i]==125)
        break;
    }
    else
      snprintf(Temp_Value_1,elCount(Temp_Value_1),"%s%c",Temp_Value_1,Temp_Value_3[i]);
  }
  @Test::BT_34_Add_Start = BT_34_Address[0];
  @Test::BT_34_Add_End = BT_34_Address[1];
  @Test::BT_34_Len_Start = BT_34_Length[0];
  @Test::BT_34_Len_End = BT_34_Length[1];
  /****************************************************************/
}
/*
    Type == 0:APP取正常范围数据  
    Type == 1:APP仅地址范围异常  
    Type == 2:APP仅长度范围异常  
    Type == 3:APP地址及长度范围异常  
    Type == 4:Flash取正常范围数据  
    Type == 5:Flash仅地址范围异常  
    Type == 6:Flash仅长度范围异常  
    Type == 7:Flash地址及长度范围异常 
*/
_Get_Serve_INI(byte Send_Data[],byte Serve,byte Serve_Address,byte Type) 
{
  char Temp_Value[500];
  char Temp_Value_1[500];
  char Temp_Value_2[500];
  char Temp_Value_3[500];
  char Temp_Value_4[500];
  char Temp_Value_5[500];
  byte Temp_data[5];
  int i,j;
  int Address_Len,Length_Len,Fun_Len;
  dword Temp_Address_Set,Temp_Address_Set_L;
  dword Temp_Length_Set;
//  dword BT_34_Address[2];
  dword BT_34_Length[2];
//  dword BT_Flash_Address[2];
  dword BT_Flash_Length[2];
  
  
  snprintf(Temp_Value,elCount(Temp_Value),"%s","");
  snprintf(Temp_Value_1,elCount(Temp_Value_1),"%s","");
  snprintf(Temp_Value_2,elCount(Temp_Value_2),"%s","");
  snprintf(Temp_Value_3,elCount(Temp_Value_3),"%s","");
  snprintf(Temp_Value_4,elCount(Temp_Value_4),"%s","");
  snprintf(Temp_Value_5,elCount(Temp_Value_5),"%s","");
  glbHandle1 = OpenFileRead(file_name_1,0);
  getProfileString("Project_Information", "ECU_project","Null",ECU_project, 100, file_name_1);
  getProfileString(ECU_project,"BT_34_Address","Null",Temp_Value_2, 500, file_name_1);
  getProfileString(ECU_project,"BT_34_Length","Null",Temp_Value_3, 500, file_name_1);
  getProfileString(ECU_project,"BT_Flash_Address","Null",Temp_Value_4, 500, file_name_1);
  getProfileString(ECU_project,"BT_Flash_Length","Null",Temp_Value_5, 500, file_name_1);
  fileClose(glbHandle1);
  Send_Data[0] = Serve;
  /***************************获取参数******************************/
  if(Type != 3 && Type != 7)
  {
    for(i=0;i<Serve_Data[Serve_Address].Serve_Para_Count[0];i++)
      Send_Data[i+1] = Serve_Data[Serve_Address].Serve_Para[0][i];
  }
  BT_34_Len = 3 + Len_34_Addr + Len_34_Length;
  /****************************************************************/
  /***************************获取地址范围*************************/
  if(Type == 0 || Type == 1 || Type == 2 || Type == 3)
  {
    _Get_0x34("BT_34_Address","BT_34_Length");
//    BT_34_Address[0] = @Test::BT_34_Add_Start;
//    BT_34_Address[1] = @Test::BT_34_Add_End;
    
    BT_34_Length[0] = @Test::BT_34_Len_Start;
    BT_34_Length[1] = @Test::BT_34_Len_End;
  }
  if(Type == 4 || Type == 5 || Type == 6 || Type == 7)
  {
    _Get_0x34("BT_Flash_Address","BT_Flash_Length");
//    BT_Flash_Address[0] = @Test::BT_34_Add_Start;
//    BT_Flash_Address[1] = @Test::BT_34_Add_End;
    BT_Flash_Length[0] = @Test::BT_34_Len_Start;
    BT_Flash_Length[1] = @Test::BT_34_Len_End;
  }
//  writeEx(-3,1,"@Test::BT_34_Add_Start = 0x%X, @Test::BT_34_Add_End = 0x%X",@Test::BT_34_Add_Start,@Test::BT_34_Add_End);
//  writeEx(-3,1,"BT_34_Address[0] = 0x%X, BT_34_Address[1] = 0x%X",BT_34_Address[0],BT_34_Address[1]);
//  writeEx(-3,1,"BT_34_Length[0] = 0x%X, BT_34_Length[1] = 0x%X",BT_34_Length[0],BT_34_Length[1] );
//  writeEx(-3,1,"BT_Flash_Address[0] = 0x%X, BT_Flash_Address[1] = 0x%X",BT_Flash_Address[0],BT_Flash_Address[1] );
//  writeEx(-3,1,"BT_Flash_Length[0] = 0x%X, BT_Flash_Length[1] = 0x%X",BT_Flash_Length[0],BT_Flash_Length[1] );
  /****************************************************************/
  /***************************取地址及长度*************************/
  Address_Len = Len_34_Addr;
  Length_Len = Len_34_Length;
  Fun_Len = 3;
  if(Type == 0) //正常范围
  {
//    do{
//      Temp_Address_Set = random(BT_34_Address[1]);
//    }while(Temp_Address_Set<=BT_34_Address[0] || Temp_Address_Set>=BT_34_Address[1]);
    do{
      Temp_Length_Set = random(BT_34_Length[1]);
    }while(Temp_Length_Set<=BT_34_Length[0] || Temp_Length_Set>=BT_34_Length[1]);
    
    Temp_Address_Set = ((@Test::BT_34_Add_Start + Temp_Length_Set)>>16);
    Temp_Address_Set_L = ((@Test::BT_34_Add_Start + Temp_Length_Set)&0xFFFF);
  }
  else if(Type==1)  //APP地址范围异常
  {
//    Temp_Address_Set = 0xFFFFFFFF;
    Temp_Address_Set = 0xFFFF;
    Temp_Address_Set_L = 0xFFFF;
    do{
      Temp_Length_Set = random(BT_34_Length[1]);
    }while(Temp_Length_Set<=BT_34_Length[0] || Temp_Length_Set>=BT_34_Length[1]);
  }  
  else if(Type==2) //APP长度范围异常
  {
//    do{
//      Temp_Address_Set = random(BT_34_Address[1]);
//    }while(Temp_Address_Set<=BT_34_Address[0] || Temp_Address_Set>=BT_34_Address[1]);
    Temp_Address_Set = (@Test::BT_34_Add_Start>>16);
    Temp_Address_Set_L = (@Test::BT_34_Add_Start&0xFFFF);
    Temp_Length_Set = 0xFFFFFFFF;
  }  
  else if(Type==3) //APP均异常
  {
//    Temp_Address_Set = 0xFFFFFFFF;
    Temp_Address_Set = 0xFFFF;
    Temp_Address_Set_L = 0xFFFF;
    Temp_Length_Set = 0xFFFFFFFF;
  }  
  else if(Type==4)  //Flash正常范围
  {
//    Temp_Address_Set = BT_Flash_Address[0];
    Temp_Address_Set = (@Test::BT_34_Add_Start>>16);
    Temp_Address_Set_L = (@Test::BT_34_Add_Start&0xFFFF);
    Temp_Length_Set = BT_Flash_Length[0];
  }  
  else if(Type==5)  //Flash地址范围异常
  {
//    Temp_Address_Set = 0xFFFFFFFF;
    Temp_Address_Set = 0xFFFF;
    Temp_Address_Set_L = 0xFFFF;
    do{
      Temp_Length_Set = random(BT_Flash_Length[1]);
    }while(Temp_Length_Set<=BT_Flash_Length[0] || Temp_Length_Set>=BT_Flash_Length[1]);
  }  
  else if(Type==6) //Flash长度范围异常
  {
//    do{
//      Temp_Address_Set = random(BT_Flash_Address[1]);
//    }while(Temp_Address_Set<=BT_Flash_Address[0] || Temp_Address_Set>=BT_Flash_Address[1]);
    Temp_Address_Set = (@Test::BT_34_Add_Start>>16);
    Temp_Address_Set_L = (@Test::BT_34_Add_Start&0xFFFF);
    Temp_Length_Set = 0xFFFFFFFF;
  }  
  else if(Type==7) //Flash均异常
  {
//    Temp_Address_Set = 0xFFFFFFFF;
    Temp_Address_Set = 0xFFFF;
    Temp_Address_Set_L = 0xFFFF;
    Temp_Length_Set = 0xFFFFFFFF;
  }  
  
  for(i = Fun_Len; i < Fun_Len + Address_Len/2; i++)
    Send_Data[i] = (Temp_Address_Set>>((Fun_Len + (Address_Len/2)-1-i)*8))&0xFF;
  for(i = Fun_Len + Address_Len/2; i < Fun_Len + Address_Len; i++)
    Send_Data[i] = (Temp_Address_Set_L>>((Fun_Len + Address_Len-1-i)*8))&0xFF;
  
  for(i = Fun_Len+Address_Len; i < BT_34_Len; i++)
    Send_Data[i] = (Temp_Length_Set>>((BT_34_Len-1-i)*8))&0xFF;
  /****************************************************************/ 
}

/*重置为默认会话或扩展会话*/
_SetSession(byte Session)
{
  if(Session==defsession)
  {
    _Switch_To_Def();
    Session_BIN = 0x01;
  }
  else if(Session==prosession)
  {
    _Switch_To_Pro();
    Session_BIN = 0x02;
  }
  else if(Session==exsession)
  {
    _Switch_To_Ex();
    Session_BIN = 0x04;
  }
}
/*请求重置为默认会话*/
void _Switch_To_Def()
{
  testCaseComment("请求重置为默认会话");
//  diagSetTarget(Cdd_Name);
  diagResize(Session_Start,2);
  DiagSetPrimitiveByte(Session_Start,0,0x10);
  DiagSetPrimitiveByte(Session_Start,1,defsession);
  diagSendRequest(Session_Start);
  testWaitForDiagRequestSent(Session_Start,500);
  testWaitForDiagResponse(Session_Start,p2cmax);
  testReportWriteDiagResponse(Session_Start);
  testWaitForTimeout(100); //防止复位导致后续无响应
  /*判断重置默认会话是否成功并体现在报告里*/
  if(diagGetLastResponseCode(Session_Start)==-1)
    testStepPass("重置默认会话成功");
  else
    testStepFail("重置默认会话失败");
}
/*请求重置为扩展会话*/
void _Switch_To_Ex()
{
  testCaseComment("请求重置为扩展会话");
//  diagSetTarget(Cdd_Name);
  _Switch_To_Def();
  testWaitForTimeout(500);
  diagResize(Session_Start,2);
  DiagSetPrimitiveByte(Session_Start,0,0x10);
  DiagSetPrimitiveByte(Session_Start,1,exsession);
  diagSendRequest(Session_Start);
  testWaitForDiagRequestSent(Session_Start,500);
  testWaitForDiagResponse(Session_Start,p2cmax);
  testReportWriteDiagResponse(Session_Start);
  testWaitForTimeout(100); //防止复位导致后续无响应
  /*判断重置扩展会话是否成功并体现在报告里*/
  if(diagGetLastResponseCode(Session_Start)==-1)
    testStepPass("重置扩展会话成功");
  else
    testStepFail("重置扩展会话失败");
}
/*请求重置为编程会话*/
void _Switch_To_Pro()
{
  testCaseComment("请求重置为编程会话");
  if(_Check_Serve(0x10,0x03,4) >= 0)  //20260409出现BT下不支持1003故修改
    _Switch_To_Ex();
  else
    _Switch_To_Def();
    
  testWaitForTimeout(500);
  if(Pre_Programmed_1002==1)
    _Pre_Programmed();
  if((_Check_Serve(0x10,0x02,5)==1) && (Pre_Programmed_UnlockECU==0) && (Pre_Programmed_1002==1))
    _unlockECU();
  diagResize(Session_Start,2);
  DiagSetPrimitiveByte(Session_Start,0,0x10);
  DiagSetPrimitiveByte(Session_Start,1,0x02);
  diagSendRequest(Session_Start);
  diagSetP2Extended(-1);
  testWaitForDiagRequestSent(Session_Start,500);
  testWaitForDiagResponse(Session_Start,p2cmax);
  if(diagGetLastResponseCode(Session_Start)==0x78)
    testWaitForDiagResponse(Session_Start,p2cmax*100);
  testReportWriteDiagResponse(Session_Start);
  if(diagGetLastResponseCode(Session_Start)==-1)
    testStepPass("重置编程会话成功");
  else
    testStepFail("重置编程会话失败");
  testWaitForTimeout(500);
}
_Other_1002()
{
  if(Pre_Programmed_1002 == 1)
    _Pre_Programmed();
  else if((Pre_Programmed_1002 == 1) && (Pre_Programmed_UnlockECU == 0) && (_Check_Serve(0x10,0x02,5)==1))
    _unlockECU();
  else if((_Check_Serve(0x10,0x02,5)==1) && (Pre_Programmed_1002 == 0))
    _unlockECU();
  else
  {
    _WriteEx_and_Report("","无其余条件，即10 02可直接响应");
  }
}
//用于创建Log,根据TestCase标题命名
void creat_log(char function[])
{
  //用于创造Log
  char log_name[400] = "./Logging";
  char testCaseTitle[400];
  char order[400];  
  long Time[9];
  char timeBuffer[400];
  
  snprintf(timeBuffer,elCount(timeBuffer),"%s","");
  getLocalTime(Time);
  snprintf(timeBuffer,400,"%s%s",timeBuffer,"___");
  snprintf(timeBuffer,400,"%s%d",timeBuffer,Time[5]+1900);
  snprintf(timeBuffer,400,"%s%s",timeBuffer,"-");
  snprintf(timeBuffer,400,"%s%d",timeBuffer,Time[4]+1);
  snprintf(timeBuffer,400,"%s%s",timeBuffer,"-");
  snprintf(timeBuffer,400,"%s%d",timeBuffer,Time[3]);
  snprintf(timeBuffer,400,"%s%s",timeBuffer,"_");
  if(Time[2]<10)
  {
    snprintf(timeBuffer,400,"%s%02X",timeBuffer,Time[2]);
  }
  if(Time[2]>=10)
  {
    snprintf(timeBuffer,400,"%s%d",timeBuffer,Time[2]);
  }
  snprintf(timeBuffer,400,"%s%s",timeBuffer,"-");
  if(Time[1]<10)
  {
    snprintf(timeBuffer,400,"%s%02X",timeBuffer,Time[1]);
  }
  if(Time[1]>=10)
  {
    snprintf(timeBuffer,400,"%s%d",timeBuffer,Time[1]);
  }
  snprintf(timeBuffer,400,"%s%s",timeBuffer,"-");
  if(Time[0]<10)
  {
    snprintf(timeBuffer,400,"%s%02X",timeBuffer,Time[0]);
  }
  if(Time[0]>=10)
  {
    snprintf(timeBuffer,400,"%s%d",timeBuffer,Time[0]);
  }
  x++;
  if(x < 10){
    order[0] = x+48;
    order[1] = '.';
  }
  else if(x < 100){
    order[0] = (x/10)+48;
    order[1] = (x%10)+48;
    order[2] = '.';
  }
  else if(x < 1000){
    order[0] = (x/100)+48;
    order[1] = (x/10%10)+48;
    order[2] = (x%10)+48;
    order[3] = '.';
  }
  testGetCurrentTestCaseTitle(testCaseTitle,400);
  log_name[0] = 92;
//  log_name[8] = 92;
  strncat(log_name,function,399-strlen(log_name));
  strncat(log_name,order,399-strlen(log_name));
  strncat(log_name,testCaseTitle,399-strlen(log_name));
  strncat(log_name,timeBuffer,399-strlen(log_name));
  strncat(log_name,".asc",399-strlen(log_name));
  setLogFileName(log_name);
  for(i = 9; log_name[i] !='\0'; i++ )
    log_name[i] = '\0';
}

void UDS_start_log()
{
  creat_log("//UDS_Logging//");
  startLogging();
}

void UDS_end_log()
{
  stopLogging();
  testWaitForTimeout(500);
}
/*初始化操作：让APP无效并进入相应的会话模式*/
void MainInit(byte session)
{
  _WriteEx_and_Report("","初始化");
  Get_value();
  _Init_Struct();
  diagSetTarget(Cdd_Name);
  UDS_start_log();
  _SetSession(session);

}
void End_Main()
{
  char TempStr[50];
  snprintf(TempStr,elCount(TempStr),"%s","");
  snprintf(TempStr,elCount(TempStr),"%s_Functional",Cdd_Name);
  diagStopTesterPresent(TempStr);
  diagStopTesterPresent(Cdd_Name);
  UDS_end_log();
  _Clear_Seed();
  Get_Seed_Flage = 0;
  Fun_NRC_Count = 0;
  writeEx(-3,1,"/*--------------- 测 试 结 束 --------------*/");
  testWaitForTimeout(1000);
}
/*
  发送诊断请求等待响应，并将请求和响应写进报告。
  如果响应是多帧不要使用此函数，因为p2cmax时间可能不够
*/
void _SendAndWriteReport(diagRequest* obj,dword msgID)
{
  char comment[300];
  byte primitiveRaw[300];
  long size;
  dword i;
  
  size=DiagGetPrimitiveData(obj,primitiveRaw,elCount(primitiveRaw));
  if(msgID==@sysvar::DID::phyreq_ID)
    snprintf(comment,elCount(comment),"已发送物理寻址请求:[%02X]",size);
  else
    snprintf(comment,elCount(comment),"已发送功能寻址请求:[%02X]",size);
  for(i=0;i<size;i++)
  {
    snprintf(comment,elCount(comment),"%s %02X",comment,primitiveRaw[i]);
  }
  if(msgID==@sysvar::DID::phyreq_ID)
  {
    diagSendRequest(obj);
  }
  else if(msgID==@sysvar::DID::funreq_ID)
  {
    diagSendFunctional(obj);
  }
  testWaitForDiagRequestSent(obj,1000);
  testCaseComment(comment);
  writeEx(-3,0,comment);
  testReportWriteDiagObject(obj);
  diagSetP2Extended(-1);
  testWaitForDiagResponse(obj,p2cmax);
  if(diagGetLastResponseCode(obj)==0x78)
    testWaitForDiagResponse(obj,p2cmax*100);
  testReportWriteDiagResponse(obj);
}
void _SendNoWrite(diagRequest* obj,dword msgID)
{
  char comment[300];
  byte primitiveRaw[300];
  long size;
  dword i;
  
  size=DiagGetPrimitiveData(obj,primitiveRaw,elCount(primitiveRaw));
  if(msgID==@sysvar::DID::phyreq_ID)
    snprintf(comment,elCount(comment),"已发送物理寻址请求:[%02X]",size);
  else
    snprintf(comment,elCount(comment),"已发送功能寻址请求:[%02X]",size);
  for(i=0;i<size;i++)
  {
    snprintf(comment,elCount(comment),"%s %02X",comment,primitiveRaw[i]);
  }
  if(msgID==@sysvar::DID::phyreq_ID)
  {
    diagSendRequest(obj);
  }
  else if(msgID==@sysvar::DID::funreq_ID)
  {
    diagSendFunctional(obj);
  }
  testWaitForDiagRequestSent(obj,1000);
  testCaseComment(comment);
  writeEx(-3,0,comment);
  testReportWriteDiagObject(obj);
}
void _SendAndWriteReport(diagRequest* obj,dword msgID ,dword Time)
{
  char comment[300];
  byte primitiveRaw[300];
  long size;
  dword i;
  
  size=DiagGetPrimitiveData(obj,primitiveRaw,elCount(primitiveRaw));
  if(msgID==@sysvar::DID::phyreq_ID)
    snprintf(comment,elCount(comment),"已发送物理寻址请求:[%02X]",size);
  else
    snprintf(comment,elCount(comment),"已发送功能寻址请求:[%02X]",size);
  for(i=0;i<size;i++)
  {
    snprintf(comment,elCount(comment),"%s %02X",comment,primitiveRaw[i]);
  }
  if(msgID==@sysvar::DID::phyreq_ID)
  {
    diagSendRequest(obj);
  }
  else if(msgID==@sysvar::DID::funreq_ID)
  {
    diagSendFunctional(obj);
  }
  testWaitForDiagRequestSent(obj,1000);
  testCaseComment(comment);
  writeEx(-3,0,comment);
  testReportWriteDiagObject(obj);
  diagSetP2Extended(-1);
  testWaitForDiagResponse(obj,Time);
  if(diagGetLastResponseCode(obj)==0x78)
    testWaitForDiagResponse(obj,p2cmax*100);
  testReportWriteDiagResponse(obj);
}
//发送请求等待响应，并将请求和响应写进报告。如果响应是多帧不要使用此函数，因为p2cmax时间可能不够
_SendAndWriteReport_NoTime(diagRequest* obj,dword msgID)
{
  char comment[70];
  byte primitiveRaw[300];
  long size;
  dword i;
  
  size=DiagGetPrimitiveData(obj,primitiveRaw,elCount(primitiveRaw));
  if(DiagGetPrimitiveByte(obj,0) == 0x10 || DiagGetPrimitiveByte(obj,0) == 0x11 || DiagGetPrimitiveByte(obj,0) == 0x27 || DiagGetPrimitiveByte(obj,0) == 0x3E)
  {
    NRC78_flag = 1;
  }
  if(msgID==@sysvar::DID::phyreq_ID)
    snprintf(comment,elCount(comment),"已发送物理寻址请求:[%02X]",size);
  else
    snprintf(comment,elCount(comment),"已发送功能寻址请求:[%02X]",size);
  for(i=0;i<size;i++)
  {
    snprintf(comment,elCount(comment),"%s %02X",comment,primitiveRaw[i]);
  }
  if(msgID==@sysvar::DID::phyreq_ID)
    diagSendRequest(obj);
  else if(msgID==@sysvar::DID::funreq_ID)
    diagSendFunctional(obj);
  
  diagSetP2Extended(-1);
  testWaitForDiagRequestSent(obj,1000);
  testCaseComment(comment);
  writeEx(-3,0,comment);
  testReportWriteDiagObject(obj);
}
/*
  使用物理寻址或功能寻址发送请求
  参数msgID:{phyreq_ID:物理寻址,funreq_ID:功能寻址}
  参数obj:诊断请求
*/
void _Send_Diag(int size,dword ID,byte Send_Data[])
{
  int i;
  dword LenSend;
  i=0;
  LenSend = elCount(Send_Data);
  diagResize(SendData,size);
  if(size<=LenSend)
  {
    for(i=0;i<size;i++)
      DiagSetPrimitiveByte(SendData,i,Send_Data[i]);
  }
  else if(size>LenSend)
  {
    for(i=0;i<LenSend;i++)
      DiagSetPrimitiveByte(SendData,i,Send_Data[i]);
    for(i=LenSend;i<size;i++)
      DiagSetPrimitiveByte(SendData,i,Send_filler);
  }
  _SendAndWriteReport(SendData,ID);
}

void _Send_Diag(int size,dword ID,byte Send_Data[],dword Time)
{
  int i;
  dword LenSend;
  i=0;
  LenSend = elCount(Send_Data);
  diagResize(SendData,size);
  if(size<=LenSend)
  {
    for(i=0;i<size;i++)
      DiagSetPrimitiveByte(SendData,i,Send_Data[i]);
  }
  else if(size>LenSend)
  {
    for(i=0;i<LenSend;i++)
      DiagSetPrimitiveByte(SendData,i,Send_Data[i]);
    for(i=LenSend;i<size;i++)
      DiagSetPrimitiveByte(SendData,i,Send_filler);
  }
  _SendAndWriteReport(SendData,ID,Time);
}
void _Send_Diag_NoTime(byte size,dword ID,byte Send_Data[])
{
  int i;
  dword LenSend;
  i=0;
  LenSend = elCount(Send_Data);
  diagResize(SendData,size);
  if(size<=LenSend)
  {
    for(i=0;i<size;i++)
      DiagSetPrimitiveByte(SendData,i,Send_Data[i]);
  }
  else if(size>LenSend)
  {
    for(i=0;i<LenSend;i++)
      DiagSetPrimitiveByte(SendData,i,Send_Data[i]);
    for(i=LenSend;i<size;i++)
      DiagSetPrimitiveByte(SendData,i,Send_filler);
  }
  _SendAndWriteReport_NoTime(SendData,ID);
}
void _Send_Diag_And_Get_CF(byte size,dword ID,byte Send_Data[])
{
  _Send_Diag(size,ID,Send_Data);
//  testWaitForDiagResponseStart(SendData,p2cmax);
  if(diagGetLastResponseCode(SendData) == 0)
    testWaitForDiagResponse(SendData,P2_can_server);
}
//根据测试通过条件，在报告上标记结果，功能寻址不响应NRC11、12、13、31、7E、7F
int _TestResult(diagRequest* obj,dword msgID,char stepid[],int passcondition)
{
  char comment[50];
  int Return_Value,RxLen;
  Return_Value = 0;
//  if(obj.GetPrimitiveByte(0) == 0x27 ) //&& ((obj.GetPrimitiveByte(1) & 0x80) == 0x80)
//  {
//    if(passcondition == -1)
//      writeEx(-3,1,"0x%X %X，期望正响应",obj.GetPrimitiveByte(0),obj.GetPrimitiveByte(1));
//    else if(passcondition == 0)
//      writeEx(-3,1,"0x%X %X，期望不响应",obj.GetPrimitiveByte(0),obj.GetPrimitiveByte(1));
//    else
//      writeEx(-3,1,"0x%X %X，期望响应NRC%X",obj.GetPrimitiveByte(0),obj.GetPrimitiveByte(1),passcondition);
//  }
  
  if(passcondition==-1)
    snprintf(comment,elCount(comment),"期望收到肯定响应");
  else if(passcondition==0)
    snprintf(comment,elCount(comment),"期望不响应");
  else
  {
    if(msgID==funreq_ID&& @AUTO::Config_Switch != 2 && (passcondition==0X11||passcondition==0X12||(passcondition==0X13 && Fun_NRC13==0)||passcondition==0X31||passcondition==0X7E||passcondition==0X7F))
      snprintf(comment,elCount(comment),"期望不响应");
    else
      snprintf(comment,elCount(comment),"期望收到否定响应NRC%02X",passcondition);
  }
  if(diagGetLastResponseCode(obj)==-1)
  {
    if(passcondition == -1)
    {
      byte Serve_Send;
      Serve_Send = DiagGetPrimitiveByte(obj,0);
      RxLen = DiagGetRespPrimitiveSize(obj);
      if(Serve_Send == 0x11 || Serve_Send == 0x85 || Serve_Send == 0x28)
      {
        if(RxLen != 2)
          testStepFail("","0x%02X服务，响应长度异常，当前为%d",Serve_Send,RxLen);
      }
      else if(Serve_Send == 0x2E)
      {
        if(RxLen != 3)
          testStepFail("","0x%02X服务，响应长度异常，当前为%d",Serve_Send,RxLen);
      }
      else if(Serve_Send == 0x27 && DiagGetPrimitiveByte(obj,1) == SendKey_27)
      {
        if(RxLen != 2)
          testStepFail("","0x%02X服务，响应长度异常，当前为%d",Serve_Send,RxLen);
      }
    }
    if(passcondition==-1)
      testStepPass(stepid,"%s，实际收到肯定响应",comment);
    else
    {
      Return_Value = -1;
      testStepFail(stepid,"%s，实际收到肯定响应",comment);
    }
  }
  else if(diagGetLastResponseCode(obj)==0)
  { 
    if((passcondition==0)||(msgID==funreq_ID&&(passcondition==0X11||passcondition==0X12||(passcondition==0X13 && Fun_NRC13==0)||passcondition==0X31||passcondition==0X7E||passcondition==0X7F)))
    {
      testStepPass(stepid,"%s，实际未收到响应",comment);
      return 1;
    }  
    if(passcondition==-1)
    {
      testWaitForDiagResponse(obj,200);
      if(diagGetLastResponseCode(obj)==0)
      {
        Return_Value = -1;
        testStepFail(stepid,"%s，实际未收到响应",comment);
      }
      else if(diagGetLastResponseCode(obj)==-1)
        testStepPass(stepid,"%s，实际收到肯定响应",comment);
      else
      {
        Return_Value = -1;
        testStepFail(stepid,"%s，实际收到否定响应",comment);
      }
    }
    else
    {
      Return_Value = -1;
      testStepFail(stepid,"%s，实际未收到响应",comment);
    }
  }
  else if(diagGetLastResponseCode(obj)==0X10)
  {
    if((passcondition==0X10)&&(msgID==phyreq_ID))
      testStepPass(stepid,"%s，实际收到否定响应NRC10",comment);
    else
    {
      Return_Value = -1;
      testStepFail(stepid,"%s，实际收到否定响应NRC10",comment);
    }
  }
  else if(diagGetLastResponseCode(obj)==0X11)
  {
    if((passcondition==0X11)&&(msgID==phyreq_ID))
      testStepPass(stepid,"%s，实际收到否定响应NRC11",comment);
    else
    {
      Return_Value = -1;
      testStepFail(stepid,"%s，实际收到否定响应NRC11",comment);
    }
  }
  else if(diagGetLastResponseCode(obj)==0X12)
  {
    if((passcondition==0X12)&&(msgID==phyreq_ID))
      testStepPass(stepid,"%s，实际收到否定响应NRC12",comment);
    else
    {
      Return_Value = -1;
      testStepFail(stepid,"%s，实际收到否定响应NRC12",comment);
    }
  }
  else if(diagGetLastResponseCode(obj)==0X13)
  {
    if((passcondition==0X13)&&(msgID==phyreq_ID))
      testStepPass(stepid,"%s，实际收到否定响应NRC13",comment);
    else if((passcondition==0X13)&&(msgID==funreq_ID && Fun_NRC13==1))
      testStepPass(stepid,"%s，实际收到否定响应NRC13",comment);
    else if((passcondition==0X13)&&(msgID==funreq_ID && @AUTO::Config_Switch == 2))
      testStepPass(stepid,"%s，实际收到否定响应NRC13",comment);
    else
    {
      Return_Value = -1;
      testStepFail(stepid,"%s，实际收到否定响应NRC13",comment);
    }
  }
  else if(diagGetLastResponseCode(obj)==0X22)
  {
    if(passcondition==0X22)
      testStepPass(stepid,"%s，实际收到否定响应NRC22",comment);
    else
    {
      Return_Value = -1;
      testStepFail(stepid,"%s，实际收到否定响应NRC22",comment);
    }
  }
  else if(diagGetLastResponseCode(obj)==0X24)
  {
    if(passcondition==0X24)
      testStepPass(stepid,"%s，实际收到否定响应NRC24",comment);
    else
    {
      Return_Value = -1;
      testStepFail(stepid,"%s，实际收到否定响应NRC24",comment);
    }
  }
  else if(diagGetLastResponseCode(obj)==0X31)
  {
    if((passcondition==0X31)&&(msgID==phyreq_ID))
      testStepPass(stepid,"%s，实际收到否定响应NRC31",comment);
    else
    {
      Return_Value = -1;
      testStepFail(stepid,"%s，实际收到否定响应NRC31",comment);
    }
  }
  else if(diagGetLastResponseCode(obj)==0X33)
  {
    if(passcondition==0X33)
      testStepPass(stepid,"%s，实际收到否定响应NRC33",comment);
    else
    {
      Return_Value = -1;
      testStepFail(stepid,"%s，实际收到否定响应NRC33",comment);
    }
  }
  else if(diagGetLastResponseCode(obj)==0X7E)
  {
    if((passcondition==0X7E)&&(msgID==phyreq_ID))
      testStepPass(stepid,"%s，实际收到否定响应NRC7E",comment);
    else
    {
      Return_Value = -1;
      testStepFail(stepid,"%s，实际收到否定响应NRC7E",comment);
    }
  }
  else if(diagGetLastResponseCode(obj)==0X7F)
  {
    if((passcondition==0X7F)&&(msgID==phyreq_ID))
      testStepPass(stepid,"%s，实际收到否定响应NRC7F",comment);
    else
    {
      Return_Value = -1;
      testStepFail(stepid,"%s，实际收到否定响应NRC7F",comment);
    }
  }
  else if(diagGetLastResponseCode(obj)==0X78)
  {
    if((passcondition==0X78) && (passcondition!=0))
      testStepPass(stepid,"%s，实际收到否定响应NRC78",comment);
    else
    {
      Return_Value = -1;
      testStepFail(stepid,"%s，实际收到否定响应NRC78",comment);
    }
  }
  else if(diagGetLastResponseCode(obj)==0X35)
  {
    if((passcondition==0X35))
      testStepPass(stepid,"%s，实际收到否定响应NRC35",comment);
    else
    {
      Return_Value = -1;
      testStepFail(stepid,"%s，实际收到否定响应NRC35",comment);
    }
  }
  else if(diagGetLastResponseCode(obj)==0X36)
  {
    if((passcondition==0X36))
      testStepPass(stepid,"%s，实际收到否定响应NRC36",comment);
    else
    {
      Return_Value = -1;
      testStepFail(stepid,"%s，实际收到否定响应NRC36",comment);
    }
  }
  else if(diagGetLastResponseCode(obj)==0X37)
  {
    if((passcondition==0X37))
      testStepPass(stepid,"%s，实际收到否定响应NRC37",comment);
    else
    {
      Return_Value = -1;
      testStepFail(stepid,"%s，实际收到否定响应NRC37",comment);
    }
  }
  else if(diagGetLastResponseCode(obj)==0X72)
  {
    if((passcondition==0X72))
      testStepPass(stepid,"%s，实际收到否定响应NRC72",comment);
    else
    {
      Return_Value = -1;
      testStepFail(stepid,"%s，实际收到否定响应NRC72",comment);
    }
  }
  else
  {
    Return_Value = -1;
    testStepFail(stepid,"%s，实际收到否定响应NRC%02X",comment,diagGetLastResponseCode(obj));
  }
  return Return_Value;
}


/*
  判断2E服务的响应
*/
void _Check_Response_2E(diagRequest *Diag,byte Tx_Data[])
{
  dword ReSize,i;
  dword LenEx;
  byte Temp_Flage_1;
  LenEx = 0;i = 0;
  Temp_Flage_1=0;
  if(diagGetLastResponseCode(Diag) == 0)
    testWaitForDiagResponse(Diag,200);
  ReSize = DiagGetRespPrimitiveSize(Diag);
  if(diagGetLastResponseCode(Diag) == 0)
  {
    testStepFail("未收到响应");
    writeEx(-3,0,"未收到响应");
  }
  else if(diagGetLastResponseCode(Diag) > 0)
  {
    testStepFail("收到消极应答");
    writeEx(-3,0,"收到消极应答");
  }
  else if(diagGetLastResponseCode(Diag) == -1)
  {
    if(ReSize == DID_2E_TxLen)
      testStepPass("","反馈长度与预期一致");
    else
      testStepFail("","反馈长度与预期不一致,预期为：%d，实际为：%d",DID_2E_TxLen,ReSize);
    if(DiagGetRespPrimitiveByte(SendData,0)!=0x62)
      testStepFail("","反馈值与预期不一致,预期为0x%2X,实际为0x%2X",0x62,DiagGetRespPrimitiveByte(SendData,0));
    if(strncmp(ECU_project,"BYD",strlen(ECU_project)) == 0 && strlen(ECU_project) == strlen("BYD"))
    {
      if(Tx_Data[0]==0x2E && Tx_Data[1] == 0xf1 && Tx_Data[2] == 0xa1)
      {
        for(i=3;i<DID_2E_TxLen-1;i++)
        {
          if(Tx_Data[i]!=0x00 && Tx_Data[i]!=0xFF)
            Temp_Flage_1 = 1;
        }
        if(Temp_Flage_1==0)
        {
          
          for(i=1;i<ReSize-1;i++)
          {
            if(DiagGetRespPrimitiveByte(SendData,i)!=Tx_Data[i])
              testStepFail("","第 %d 位,反馈值与预期不一致,预期为0x%2X,实际为0x%2X",i+1,Tx_Data[i],DiagGetRespPrimitiveByte(SendData,i));
            else
              testStepPass("","反馈值与预期一致");
          } 
          if(DiagGetRespPrimitiveByte(SendData,ReSize-1)!=0x00)
            testStepFail("","第 %d 位,反馈值与预期不一致,预期为0x%X,实际为0x%X",ReSize,0x00,DiagGetRespPrimitiveByte(SendData,ReSize-1));
          else
            testStepPass("","反馈值与预期一致");
        }
      }
    }
    else
    {
      for(i=1;i<ReSize;i++)
      {
        if(DiagGetRespPrimitiveByte(SendData,i)!=Tx_Data[i])
          testStepFail("","第 %d 位,反馈值与预期不一致,预期为0x%2X,实际为0x%2X",i+1,Tx_Data[i],DiagGetRespPrimitiveByte(SendData,i));
        else
          testStepPass("","反馈值与预期一致");
      }
    }
  }
}
byte Check_APPValid()
{
  char comment[50];
  diagRequest ABS_ESP.FaultMemory_ReadAllIdentified req19;
  
  diagResize(req19,3);
  DiagSetPrimitiveByte(req19,0,0x19);
  DiagSetPrimitiveByte(req19,1,0x02);
  DiagSetPrimitiveByte(req19,2,0x01);
  _SendNoWrite(req19,phyreq_ID);
  
  testWaitForDiagResponse(req19,1000);
  if(diagGetLastResponseCode(req19) == -1)
  {
    snprintf(comment,elCount(comment),"/*----------当前APP有效---------*/");
    writeEx(-3,1,comment);
    testCaseComment(comment);
    return 1;
  }
  else
  {
    snprintf(comment,elCount(comment),"/*----------当前APP无效---------*/");
    writeEx(-3,1,comment);
    testCaseComment(comment);
    return 0;
  }
}

void _Pre_Programmed()
{
  if(Pre_Programmed_UnlockECU==1)
    _unlockECU();
  _WriteEx_and_Report("","发送预编程报文");
  UpdateCheck(phyreq_ID,-1);
}
/*清空种子*/
void _Clear_Seed()
{
  qword i,j;
//  for(j=0;j<10000;j++)
//    Seed_Count_List[j]=0; //清空之前存储的种子
//  for(i=0;i<10000;i++)
//  {
//    for(j=0;j<16;j++)
//      Seed_Count_List_AES128[i][j]=0;//清空之前存储的种子
//  }
  Seed_Count = 0;    //清空种子计数
}
/*请求解锁ECU*/
_unlockECU()
{
//  if(AES_128 != 2 && Session_BIN != 2)
//  {
//    _SetSession(exsession);
//    testWaitForTimeout(1000);
//  }
  diagResize(reqseed,2);
  diagResize(sendkey,SendKey_Len);
  DiagSetPrimitiveByte(reqseed,0,0x27);
  DiagSetPrimitiveByte(sendkey,0,0x27);
  DiagSetPrimitiveByte(reqseed,1,RequestSeed_27);
  DiagSetPrimitiveByte(sendkey,1,SendKey_27);
  if(AES_128==0 || @AUTO::Security_Switch == 0)
  {
    dword seed;
    dword skey;
    byte Send_Seed[2];
    byte Send_Key[20];
    Send_Seed[0] = 0x27;
    Send_Seed[1] = RequestSeed_27;
    Send_Key[0] = 0x27;
    Send_Key[1] = SendKey_27;
    
    testCaseComment("请求解锁ECU");
    _Send_Diag(2,phyreq_ID,Send_Seed);
    if(diagGetLastResponseCode(SendData)==-1)
    {
      int Seed_Pos,Seed_Len,Key_Loop;
      Seed_Len = DiagGetRespPrimitiveSize(SendData);
      seed = 0;skey = 0;
      for(Seed_Pos = 2 ;Seed_Pos < Seed_Len;Seed_Pos++)
        seed = seed | (DiagGetRespPrimitiveByte(SendData,Seed_Pos) << ((Seed_Len -3 -(Seed_Pos-2))*8));
      /*安全算法函数*/
      testStep("种子","种子为0x%08X",seed);
      SecurityAccess(seed,skey);
      testStep("密钥","计算出密钥为0x%08X",skey);
      DiagSetPrimitiveByte(sendkey,0,0x27);
      for(Key_Loop = 2;Key_Loop < SendKey_Len;Key_Loop++)
        Send_Key[Key_Loop] = (skey>>((SendKey_Len-1-Key_Loop)*8))&0xFF;
      _Send_Diag(SendKey_Len,phyreq_ID,Send_Key);

      /*判断是否解锁成功*/
      if(diagGetLastResponseCode(SendData)==-1)
        testStepPass("ECU解锁成功");
      else
        testStepFail("ECU解锁失败");
    }
    else
      testStepFail("ECU解锁,获取种子失败");
    testWaitForTimeout(500);
  }
  else if(AES_128==1 || @AUTO::Security_Switch==2) /*AES_CMAC*/
  {
    testWaitForTimeout(500);    //排除10 03的反馈干扰,会影响到获取种子
    testCaseComment("请求解锁ECU");
    _SendAndWriteReport_NoTime(reqseed,phyreq_ID);
    _saveMsg(p2cmax);
    _CheckCode(-1,4);
    testWaitForTimeout(200);
    diagResize(sendkey,SendKey_Len);
    _padding2702(0,sendkey);
    _SendAndWriteReport_NoTime(sendkey,phyreq_ID);
    _saveMsg(p2cmax);
    testWaitForTimeout(150);
  }
  else if(AES_128==2 || @AUTO::Security_Switch==1) /*AES_CBC*/
  {
    byte data[3]={0x22,0xF1,0x8C};
    int m;
    memcpy(ECU_Key,ECU_Key2,elCount(ECU_Key2));
    diagResize(reqseed,2);
    diagResize(sendkey,SendKey_Len);
    DiagSetPrimitiveByte(reqseed,0,0x27);
    DiagSetPrimitiveByte(sendkey,0,0x27);
    DiagSetPrimitiveByte(reqseed,1,RequestSeed_27);
    DiagSetPrimitiveByte(sendkey,1,SendKey_27);
    testCaseComment("获取序列号");
    _Send_Diag_And_Get_CF(3,phyreq_ID,data);
    if(diagGetLastResponseCode(SendData) == -1)
    {
      if(DiagGetRespPrimitiveSize(SendData) == 22)
      {
        for(m=0;m<16;m++)
          Serial_number[m] = DiagGetRespPrimitiveByte(SendData,m+6);
        /*序列号移位*/
        LeftMove(Serial_number,3);
//        for(m=0;m<16;m++)
//          writeEx(-3,0,"----------移位后序列号-------0x%2x",Serial_number[m]);
        /*用ECU KEY加密移位后的序列号 获取密钥KEY*/
        AES128_CBC_encrypt_buffer(Secret_KEY,Serial_number,KEY_Len,ECU_Key,Iv); 
//        if(@AUTO::Config_Switch != 1)
//          _SetSession(exsession);
        testWaitForTimeout(150);
        testCaseComment("请求解锁ECU");
        _SendAndWriteReport(reqseed,phyreq_ID,500);
        if(diagGetLastResponseCode(reqseed) == -1)
        {
          for(m=0;m<16;m++)
            RA[m]=DiagGetRespPrimitiveByte(reqseed,m+2);
          /*用密钥KEY解密RA 得到ra`*/
          AES128_CBC_decrypt_buffer(ra,RA,KEY_Len,Secret_KEY,Iv);
          /*ra逆向*/
          reverseNum(ra,16);
          testWaitForTimeout(100);
          /*用密钥KEY加密r得到R*/
          AES128_CBC_encrypt_buffer(R,ra,KEY_Len,Secret_KEY,Iv);
          diagResize(sendkey,18);
          for(m=0;m<16;m++)
            DiagSetPrimitiveByte(sendkey,m+2,R[m]);
          diagSendRequest(sendkey);
          testWaitForDiagRequestSent(sendkey,50);
          testReportWriteDiagObject(sendkey);
          testWaitForDiagResponse(sendkey,1000);
          testReportWriteDiagResponse(sendkey); 
          if(diagGetLastResponseCode(sendkey)==-1)
            testStepPass("ECU解锁成功");
          else
            testStepFail("ECU解锁失败");
        }
        else
          testStepFail("","请求种子失败");
      }
      else
        testStepFail("","返回序列号长度错误,导致秘钥Key不可信");
    }
    else
      testStepFail("","未收到正确序列号,无法进行安全访问");
  }
}
/*
  各主机厂安全算法函数
  参数SaccSeed：请求种子
  参数SaccKey：安全访问密钥
*/
void SecurityAccess(dword SaccSeed,dword& SaccKey)
{
  if(@AUTO::Config_Switch==1)//BYD
  {
    dword KeyK;
    dword KeyResult;
    KeyK=0X00000137;
    KeyResult = ((((SaccSeed >> 1) ^ SaccSeed) <<3) ^ (SaccSeed >>2));
    SaccKey = KeyResult ^ KeyK;
  }
  else if(@AUTO::Config_Switch==2)//CA
  {
    dword seed;
    dword key1;
    dword key2;
    byte i;
    seed = 0;
    for(i=0;i<16;i++)
      seed=seed|(SaccSeed>>(31-i*2)&(1<<i));
    for(i=0;i<16;i++)
      seed=seed|(SaccSeed<<(31-i*2)&(0X80000000>>i));
    key1=SaccSeed^0X70F77302;
    key2=seed^0X70F77302;
    SaccKey=key1+key2;
  }
  else if(@AUTO::Config_Switch==3)//Geely 1.0
  {
    byte i;
    byte XorArray[4];
    byte calData[4];
    byte skeybyte[4];
    XorArray[0]=0xC1;
    XorArray[1]=0x1C;
    XorArray[2]=0x12;
    XorArray[3]=0x81;
    calData[0]=0;
    calData[1]=0;
    calData[2]=0;
    calData[3]=0;
    for (i = 0;i < 4;i++)
      calData[i] = ((SaccSeed>>(24-8*i))&0xFF)^ XorArray[i];/*修改秘钥传入方式为MSB*/
    skeybyte[0] = ((calData[2] & 0x03) << 6)|((calData[3]&0xFC)>>2);
    skeybyte[1] = ((calData[3] & 0x03) << 6 )|(calData[0]&0x3F);
    skeybyte[2] = (calData[0] & 0xFC)|((calData[1] & 0xC0) >> 6);
    skeybyte[3] = (calData[1] & 0xFC)|(calData[2] & 0x03);
    SaccKey=skeybyte[0];
    SaccKey=(SaccKey<<8)|skeybyte[1];
    SaccKey=(SaccKey<<8)|skeybyte[2];
    SaccKey=(SaccKey<<8)|skeybyte[3];
  }
  else if(@AUTO::Config_Switch==5)//鑫源
  {
    byte Seed[4];
    byte Skey[4];
    byte Xor[4]={0xA1,0x59,0xD4,0x30};
    byte Cal[4];
    byte i;
    Seed[0]=SaccSeed>>24;
    Seed[1]=SaccSeed>>16;
    Seed[2]=SaccSeed>>8;
    Seed[3]=SaccSeed; 
    for(i=0;i<4;i++)
      Cal[i]=Seed[i]^Xor[i];
    Skey[0]=((Cal[3]&0xF5)>>2) | ((Cal[0]&0x0F)<<6);
    Skey[1]=((Cal[2]&0x0F)<<4) | ((Cal[3]&0xC0)>>6);
    Skey[2]=((Cal[1]&0xFC)) | ((Cal[0]&0x3D));
    Skey[3]=((Cal[3]&0xE0)) | ((Cal[1]&0xF0)>>4);
    SaccKey=Skey[0];
    SaccKey=(SaccKey<<8)|Skey[1];
    SaccKey=(SaccKey<<8)|Skey[2];
    SaccKey=(SaccKey<<8)|Skey[3];
  }
  else if(@AUTO::Config_Switch==6)//瑞驰
  {
    byte i;
    dword tmpSaccSeed;
    dword mask = 0x5FD62190;//掩码5FD62190
    tmpSaccSeed = SaccSeed;
		for(i=0; i<32; i++)
		{
			if(tmpSaccSeed & 0x80000000)
			{
				tmpSaccSeed = tmpSaccSeed << 1;
				tmpSaccSeed = tmpSaccSeed ^ mask;
			}
			else
				tmpSaccSeed = tmpSaccSeed << 1;
		}
    SaccKey = tmpSaccSeed;
  }
  else if(@AUTO::Config_Switch==7)//奇瑞
  {
    byte Seed[2];
    dword remainder;
    byte n;
    byte i;
    Seed[0] = SaccSeed >> 8;
    Seed[1] = SaccSeed & 0xFF; 
    remainder =0xFFFE;
    for (n = 0; n < 2; n++)
    {
      remainder ^= ((Seed[n]) << 8);
      for (i = 0; i < 8; i++)
      {
        if (remainder & 0x8000)
        {
          if(remainder & 0x0080)
            remainder = (remainder << 1) ^ 0x8408;
          else
            remainder = (remainder << 1) ^ 0x8025;
        }
        else
          remainder = (remainder << 1);
      }
    }
    remainder = remainder & 0xFFFF;
    SaccKey = remainder;
  }
  else if(@AUTO::Config_Switch==8)//五菱
  {
    word uds_key_mul[32] = 
    {
      0x7678, 0x9130, 0xd753, 0x750f, 0x72cb, 0x55f7, 0x13da, 0x786b, 
      0x372a, 0x4932, 0x0e7c, 0x3687, 0x3261, 0xa82c, 0x8935, 0xd00c, 
      0x1995, 0x4311, 0xb854, 0x0d8d, 0x9863, 0x1a21, 0xf753, 0xd6d3,
      0xb15d, 0x7f3d, 0x6821, 0x791c, 0x26c5, 0x2e37, 0x0e69, 0x64a0 
    };
    dword temp;
  	word index;
  	word mult1;
  	word mult2;
    dword NC_DEFAULT_SEED;
    dword NC_UDS_KEYMASK;
    NC_DEFAULT_SEED=0xA548FD85;
    NC_UDS_KEYMASK=0x5C7D4EF3;
    index = 0x5D39;
  	if(SaccSeed == 0) 
  		SaccSeed = NC_DEFAULT_SEED;
  	for(temp=0x80000000;temp!=0;temp>>=1)
  	{
  		if(temp & SaccSeed) 
      {
  			index = croshortright(index,1);
  			if (temp & NC_UDS_KEYMASK) 
  				index ^= 0x74c9;
  		}
  	}
  	mult1 = (uds_key_mul[(index >> 2) & ((1 << 5) - 1)] ^ index);
  	mult2 = (uds_key_mul[(index >> 8) &((1 << 5) - 1)] ^ index);
  	temp = (((dword) mult1) << 16) | ((dword) mult2);
  	temp = mulu32(SaccSeed,temp);
  	SaccKey = temp;
  }
  else if(@AUTO::Config_Switch==9 || @AUTO::Config_Switch==10)//东风小康 || 赛力斯
  {
    byte Seed[4];
    byte Skey[4];
    byte Xor[4]={0xD1,0x31,0x54,0x07};
    byte Cal[4];
    byte i;
    Seed[0]=(SaccSeed>>24)&0xFF;
    Seed[1]=(SaccSeed>>16)&0xFF;
    Seed[2]=(SaccSeed>>8)&0xFF;
    Seed[3]=SaccSeed&0xFF;
    
    for(i=0;i<4;i++)
      Cal[i]=Seed[i]^Xor[i];
    
    Skey[0]=((Cal[0]&0x0f)<<4)|(Cal[1]&0x0f);
    Skey[1]=((Cal[1]&0xf0)>>4)|((Cal[2]&0x0f)<<4);
    Skey[2]=((Cal[2]&0xf0)>>4)|(Cal[3]&0xf0);
    Skey[3]=(Cal[3]&0x0f)|((Cal[0]&0xf0)>>4);
    
    SaccKey=Skey[0];
    SaccKey=(SaccKey<<8)|Skey[1];
    SaccKey=(SaccKey<<8)|Skey[2];
    SaccKey=(SaccKey<<8)|Skey[3];
  }
  else if(@AUTO::Config_Switch== 12)
  {
    dword AppKeyConst = 0x19870413;
    SaccKey = ((SaccSeed + 0x19870424)|AppKeyConst)&0xFFFFFFFF;
  }
}
/**/
void _SecurityAccess_AES(dword seed[], word Byte_[],word corresKey[])
{
  char M[16],mic[16];
  int i;
  char fixByte[16];
  word gHandle;
  for(i=0;i<16;i++)
  {
    fixByte[i] = Byte_[i];
  }
  gHandle = registerCAPLDLL();
  for(i = 0; i < 16; i++)
  {
    M[i] = seed[i];
  }
  aes_128_cmac(M,fixByte,mic);
  for(i = 0; i < 16; i++)
  {
    corresKey[i] = mic[i] & 0xFF;
  }
  fileClose(gHandle);
}
/*用于五菱安全算法*/
word croshortright(word c, word b)
{
	word right;
	word left;
	word crorightvalue;
  right = c >> b;
  left = c << (16 - b);
  crorightvalue = left | right;
	return crorightvalue;
}
/*用于五菱安全算法*/
dword croleft(dword c, word b)
{
	dword left;
	dword right;
	dword croleftvalue;
  left = c << b;
  right = c >> (32 - b);
  croleftvalue = left | right;
	return croleftvalue;
}
/*/用于五菱安全算法*/
dword mulu32(dword val1, dword val2)
{
	dword x, y, z, p;
  dword NC_UDS_KEYMASK=0x5c7d4ef3;
	x = (val1 & NC_UDS_KEYMASK) | ((~val1) & val2);
	y = ((croleft(val1, 1)) & (croleft(val2, 14)))
	        | ((croleft(NC_UDS_KEYMASK, 21)) & (~(croleft(val1, 30))));
	z = (croleft(val1, 17)) ^ (croleft(val2, 4))
	        ^ (croleft(NC_UDS_KEYMASK, 11));
	p = x ^ y ^ z;
	return p;
}

void _WriteEx_and_Report(char str1[],char str2[])
{
  char str[500];
  
  snprintf(str,elCount(str),"%s","");
  
  TestStep(str1,str2);
  strncpy(str,str1,elCount(str));
  strncat(str,"   ",elCount(str));
  strncat(str,str2,elCount(str));
  writeEx(-3,0,str);
}
void _WriteEx_and_Report(char str1[],char str2[],dword Da)
{
  char str[500];
  
  snprintf(str,elCount(str),"%s","");
  
  TestStep(str1,str2,Da);
  strncpy(str,str1,elCount(str));
  strncat(str,"   ",elCount(str));
  strncat(str,str2,elCount(str));
  writeEx(-3,0,str,Da);
}
//更新条件查询31 01 02 03
//参数msgID:{phyreq_ID:物理寻址,funreq_ID:功能寻址}
//参数Passcondition:{-1:期望收到积极响应,0:期望不收到响应,>0:期望收到的NRC}
void UpdateCheck(dword msgID,int Passcondition)
{
  diagRequest ABS_ESP.Check_Memory_Start req0203;
  snprintf(stepid,elCount(stepid),"");
  testStep(stepid,"开始更新条件查询");
  
  //瑞驰
  if(@AUTO::Config_Switch==6)
  {
    diagResize(req0203,0x04);
    DiagSetPrimitiveByte(req0203,0,0x31);
    DiagSetPrimitiveByte(req0203,1,0x01);
    DiagSetPrimitiveByte(req0203,2,0xF0);
    DiagSetPrimitiveByte(req0203,3,0x02);
  }
  else
  {
    diagResize(req0203,0x04);
    DiagSetPrimitiveByte(req0203,0,0x31);
    DiagSetPrimitiveByte(req0203,1,0x01);
    DiagSetPrimitiveByte(req0203,2,0x02);
    DiagSetPrimitiveByte(req0203,3,0x03);
  }
  _SendAndWriteReport(req0203,msgID);
  _TestResult(req0203,msgID,stepid,Passcondition); 
}

dword _Check_CANFD_Flage()
{
  dword data = 0;
  if(@AUTO::CANFD_Switch == 0)
  {
    _WriteEx_and_Report("","当前为CAN报文数据");
    data = 7;   
  }
  if(@AUTO::CANFD_Switch == 1)
  {
    _WriteEx_and_Report("","当前为CANFD报文数据");
    data = 0x3E;   
  }
  return data;
}
void _Check_10_01(dword size,byte Sub_Function,dword Time_1,dword Time_2)
{
  dword Temp_Time_1;
  dword Temp_Time_2;
  int i=0;
  char Buffer_Temp[100];
  byte result;
  message 0x00 msg;
  Temp_Time_1 = 0;Temp_Time_2 = 0;
  snprintf(Buffer_Temp,elCount(Buffer_Temp),"%s","");
  Buffer_Temp[0] = 0x50;
  Buffer_Temp[1] = Sub_Function;
  if(diagGetLastResponseCode(SendData) == 0)
    testWaitForDiagResponse(SendData,p2cmax);
  if(Sub_Function ==0x02 && Sub_1002_NRC78==1 && diagGetLastResponseCode(SendData) == 0x78)
  {
//    if((msg.byte(0)==0x03)&&(msg.byte(1)==0x7F)&&(msg.byte(3)==0x78))
      testStepFail("","收到否定响应NRC78");
//    else
//      testStepPass("","未收到否定响应NRC78");
  }
  if(diagGetLastResponseCode(SendData) == 0x78)
    testWaitForDiagResponse(SendData,p2cmax*10);
  testReportWriteDiagResponse(SendData);
  if(size==DiagGetRespPrimitiveSize(SendData))
  {
    testStepPass("","反馈长度与预期长度一致");
    writeEx(-3,0,"反馈长度与预期长度一致");
  }
  else
  {
    testStepFail("","预期长度%d，实际长度：%d",size,DiagGetRespPrimitiveSize(SendData));
    writeEx(-3,0,"预期长度%d，实际长度：%d",size,DiagGetRespPrimitiveSize(SendData));
  }
  for(i=0;i<2;i++)
  {
    if(DiagGetRespPrimitiveByte(SendData,i) != Buffer_Temp[i])
      testStepFail("","正响应部分异常，与期望不一致");
    else
      testStepPass("","响应与期望一致");
  }
  if(size == 2)
    return;
  if(Sub_Function==0x02 && Sub_1002_Time_Flage==0)
  {
    Temp_Time_1 = DiagGetRespPrimitiveByte(SendData,2)*256+DiagGetRespPrimitiveByte(SendData,3);
    if(Temp_Time_1 == Sub_1002_Time)
      testStepPass("","P2can_server时间与期望一致为%d",Time_1);
    else
      testStepFail("","P2can_server期望为%d,实际为%d",Sub_1002_Time,Temp_Time_1);
  }
  else
  {
    Temp_Time_1 = DiagGetRespPrimitiveByte(SendData,2)*256+DiagGetRespPrimitiveByte(SendData,3);
    Temp_Time_2 = DiagGetRespPrimitiveByte(SendData,4)*256+DiagGetRespPrimitiveByte(SendData,5);
    if(Temp_Time_1 == Time_1)
      testStepPass("","P2can_server时间与期望一致为%d",Time_1);
    else
      testStepFail("","P2can_server期望为%d,实际为%d",Time_1,Temp_Time_1);
    if(Temp_Time_2*10 == Time_2)
      testStepPass("","P2*can_server时间与期望一致为%d",Time_2);
    else
      testStepFail("","P2*can_server期望为%d,实际为%d",Time_2,Temp_Time_2*10);
  }
}

_Set_11_Restoration()
{
  byte Temp[2]={0x11,0x01};
  byte flage;
  int k,Fun_Pos,Serve_Pos;
  flage=0;
  Serve_Pos = _Check_Serve(0x11,0,0);
  if(Serve_Pos == -1)
  {
    _WriteEx_and_Report("","未查询到支持11服务");
    return;
  }
  if(Serve_Data[Serve_Pos].Security_Access[Fun_Pos]==1)
    _unlockECU();
  Temp[1] = Serve_Data[Serve_Pos].Serve_Fun[Fun_Pos];
  _Send_Diag(2,phyreq_ID,Temp);
  _TestResult(SendData,phyreq_ID,"",-1);
  testWaitForTimeout(2000); /*11复位后增加延时时间防止后续出错*/
}

/*遍历选中字符串的数据*/
void _get_Str_Traversal(char Str[])
{
  char Temp_Value1[2000];
  char Temp_Value2[20];
  int i,m=0,j=0;
  snprintf(Temp_Value1,elCount(Temp_Value1),"%s","");
  snprintf(Temp_Value2,elCount(Temp_Value2),"%s","");
  
  glbHandle1 = OpenFileRead (file_name_1,0);
  getProfileString(ECU_project, Str,"Null",Temp_Value1, 2000, file_name_1);
  fileClose(glbHandle1);
  for(j=0;j<strlen(Temp_Value1);j++)
  {
    if(Temp_Value1[j]==91)
    {
      for(i=j+1;i<strlen(Temp_Value1);i++)
      {
        if(Temp_Value1[i]==93)
        {
          Traversal_Count = atol(Temp_Value2);
          break;
        }
        else
          snprintf(Temp_Value2,elCount(Temp_Value2),"%s%c",Temp_Value2,Temp_Value1[i]);
      }
    }
    if(Temp_Value1[j]==123)
    {
      for(i=j+1;i<strlen(Temp_Value1);i++)
      {
        if(Temp_Value1[i]==44 || Temp_Value1[i]==125)
        {
          m++;
          if(Temp_Value1[i]==125)
            break;
        }
        else
          snprintf(Traversal_DID[m],elCount(Traversal_DID[m]),"%s%c",Traversal_DID[m],Temp_Value1[i]);
      }
    }
  }
  testWaitForTimeout(1000);
}

/*获取DID为"Str"中的数据*/
_Get_DID(char Str[])
{
  char Temp_Value1[500];
  char Temp_Value2[100];
  char Temp_Value3[5000];
  char Temp_Value4[50];
  char Temp_Value5[50];
  
  char Temp_byte1[50];
  char Temp_byte2[50];
  char Temp_Str[1000];
  
  int j,m,Count;
  j=0;m=0;
  snprintf(Temp_Value3,elCount(Temp_Value3),"%s","");
  glbHandle1 = OpenFileRead (file_name_1,0);
  getProfileString(ECU_project, Str,"Null",Temp_Value3, 5000, file_name_1);
  fileClose (glbHandle1);
  Count = 1;
  for(i = 0;i<strlen(Temp_Value3);i++)                  //查找INI文件中数组值并返回10进制
  {
    if(Temp_Value3[i] == 91 && Count == 1)/*取解析方式*/
    {
      snprintf(Temp_Value5,elCount(Temp_Value5),"%s","");
      for(j=i+1;j<=strlen(Temp_Value3);j++)
      {
        if(Temp_Value3[j]==93)
        {
          Analysis = atol(Temp_Value5);
          Count++;
          i=j;
          break;
        }
        else
          snprintf(Temp_Value5,elCount(Temp_Value5),"%s%c",Temp_Value5,Temp_Value3[j]);
      }
    }
    if(Temp_Value3[i] == 91 && Count == 2)/*取预期长度*/
    {
      snprintf(Temp_Value4,elCount(Temp_Value4),"%s","");
      for(j = i+1;j<strlen(Temp_Value3);j++)
      {
        if(Temp_Value3[j] == 93)
        {
          Count++;
          i=j;
          break;
        }
        snprintf(Temp_Value4,elCount(Temp_Value4),"%s%c",Temp_Value4,HexToAsc(Temp_Value3[j]));
      }
    }
    if(Temp_Value3[i] == 91 && Count == 3)/*取子服务DID*/
    {
      snprintf(Temp_Value2,elCount(Temp_Value2),"%s","");
      for(j = i;j<strlen(Temp_Value3);j++)
      {
        snprintf(Temp_Value2,elCount(Temp_Value2),"%s%c",Temp_Value2,HexToAsc(Temp_Value3[j]));
        if(Temp_Value3[j] == 93)/*取间隔符 */
        {
          Count++;
          i=j;
          break;
        }
      }
    }
    if(Temp_Value3[i] == 91  && Analysis == 1 && Count == 4)/*以16进制HEX格式获取数据*/
    {
      snprintf(Temp_Value1,elCount(Temp_Value1),"%s","");
      for(j=i+1;j<strlen(Temp_Value3);j++)
      {
        if(Temp_Value3[j]== 44)  /*取间隔符  */
        {
          DID_Data[m] = atol(Temp_Str);   /*取预期结果byte */
          snprintf(Temp_Str,elCount(Temp_Str),"%s","");
          m++;
        }
        else if(Temp_Value3[j]== 93 ) /*(最后一个byte终止) */
        {
          DID_Data[m] = atol(Temp_Str);
          if(strlen(Temp_Str) != 0) //防止输入为空时进行输入数据个数计数
            m++;  
          snprintf(Temp_Str,elCount(Temp_Str),"%s","");
          Count++;
          i=j;
          break;
        }
        else
          snprintf(Temp_Str,elCount(Temp_Str),"%s%c",Temp_Str,Temp_Value3[j]);
      }
    }
    else if(Temp_Value3[i] == 91  && Analysis == 2 && Count == 4)/*以ASCII码格式获取数据*/
    {
      snprintf(Temp_Value1,elCount(Temp_Value1),"%s","");
      snprintf(DID_Data_str,elCount(DID_Data_str),"%s","");
      for(j=i+1;j<strlen(Temp_Value3);j++)
      {
        if(Temp_Value3[j] == 93)
        {
          Count++;
          i=j;
          break;
        }
        snprintf(DID_Data_str,elCount(DID_Data_str),"%s%c",DID_Data_str,HexToAsc(Temp_Value3[j]));
      }
    }
    else if(Temp_Value3[i] == 91  && (Analysis == 3 ||Analysis == 4||Analysis == 5||Analysis == 6) && Count == 4)/*以字符串获取数据,3:整体转换为10进制判断,4:每个Byte分别转换10进制后拼接,5:原码拼接判断,6:混合判断*/
    {
      snprintf(Temp_Value1,elCount(Temp_Value1),"%s","");
      snprintf(DID_Data_str,elCount(DID_Data_str),"%s","");
      for(j=i+1;j<strlen(Temp_Value3);j++)
      {
        if(Temp_Value3[j] == 93)
        {
          Count++;
          i=j;
          break;
        }
        else
          snprintf(DID_Data_str,elCount(DID_Data_str),"%s%c",DID_Data_str,HexToAsc(Temp_Value3[j]));
      }
    }  
    if(Temp_Value3[i] == 91 && Count == 5) /*取可写性*/
    {
      snprintf(Temp_Value5,elCount(Temp_Value5),"%s","");
      for(j=i+1;j<=strlen(Temp_Value3);j++)
      {
        if(Temp_Value3[j]==93)
        {
          Write_Flage = atol(Temp_Value5);
          Count++;
          i=j;
          break;
        }
        else
          snprintf(Temp_Value5,elCount(Temp_Value5),"%s%c",Temp_Value5,Temp_Value3[j]);
      }
    }
    if(Temp_Value3[i] == 91 && Count == 6) /*取填充值*/
    {
      snprintf(Temp_Value5,elCount(Temp_Value5),"%s","");
      for(j=i+1;j<=strlen(Temp_Value3);j++)
      {
        if(Temp_Value3[j]==93)
        {
          UnUse_Byte = atol(Temp_Value5);
          Count++;
          i=j;
          break;
        }
        else
          snprintf(Temp_Value5,elCount(Temp_Value5),"%s%c",Temp_Value5,Temp_Value3[j]);
      }
    }
  }
  DID_len_Ex = atol(Temp_Value4)+3;
  for(i=0;i<strlen(Temp_Value2);i++)
  {
    if(Temp_Value2[i] == 91)
    {
      snprintf(Temp_byte1,elCount(Temp_byte1),"%s","");
      for(j = i+1;j<strlen(Temp_Value2);j++)
      {
        if(Temp_Value2[j] == 44)
          break;
        snprintf(Temp_byte1,elCount(Temp_byte1),"%s%c",Temp_byte1,Temp_Value2[j]);
      }
      DID_byte1 = atol(Temp_byte1);
    }
    if(Temp_Value2[i] == 44 )
    {
      snprintf(Temp_byte2,elCount(Temp_byte2),"%s","");
      for(j = i+1;j<strlen(Temp_Value2);j++)
      {
        if(Temp_Value2[j] == 93)
          break;
        snprintf(Temp_byte2,elCount(Temp_byte2),"%s%c",Temp_byte2,Temp_Value2[j]);
      }
      DID_byte2 = atol(Temp_byte2);
    } 
  }
  Len_Input = m;
}

_get_2E_DID(char Str[])
{
  char Temp_Value1[1000];  /*装载获取到的字符串对应的全部数据*/
  char Temp_Value2[500];  /*装载获取到的分段数据*/
  
  char Temp_Str[500];
  int i,n,j;
  int Send_1_Input,Send_2_Input;
  
  snprintf(Temp_Value1,elCount(Temp_Value1),"%s","");
  snprintf(Temp_Value2,elCount(Temp_Value2),"%s","");
  n = 0;
  DID_2E_SendData_1[0] = 0x2E;
  DID_2E_SendData_2[0] = 0x2E;
  Read_2E_DID[0] = 0x22;
  Send_1_Input = 0;
  Send_2_Input = 0;
  
  writeEx(-3,0,"获取数据 %s",Str);
  glbHandle1 = OpenFileRead (file_name_1,0);
  getProfileString(ECU_project,Str,"Null",Temp_Value1, 1000, file_name_1);
  fileClose (glbHandle1);
  DID_2E_TxFiller = Send_filler;
  for(i=0;i<strlen(Temp_Value1);i++) 
  {
    if(Temp_Value1[i]== 91 && n==0) //装载预期发送DID，ASCII 44 = ‘,’ 91 = '[', 93 = ']'
    {
      DID_2E_Len = 1;
      for(j=i+1;j<strlen(Temp_Value1);j++)
      {
        if(Temp_Value1[j]==44 || Temp_Value1[j]==93)
        {
          DID_2E_SendData_1[DID_2E_Len]=atol(Temp_Value2);
          DID_2E_SendData_2[DID_2E_Len]=atol(Temp_Value2);
          snprintf(Temp_Value2,elCount(Temp_Value2),"%s","");
          DID_2E_Len++;
          if(Temp_Value1[j]==93)
          {
            n++; i = j;
            break;
          }
        }
        else
          snprintf(Temp_Value2,elCount(Temp_Value2),"%s%c",Temp_Value2,Temp_Value1[j]);
      }
    }
    if(Temp_Value1[i]== 91 && n==1) //装载预期发送数据1长度
    {
      for(j=i+1;j<strlen(Temp_Value1);j++)
      {
        if(Temp_Value1[j]==44 || Temp_Value1[j]==93)
        {
          DID_2E_SendData_1_Len = atol(Temp_Value2);
          snprintf(Temp_Value2,elCount(Temp_Value2),"%s","");
          if(Temp_Value1[j]==93)
          {
            n++; i = j;
            break;
          }
        }
        else
          snprintf(Temp_Value2,elCount(Temp_Value2),"%s%c",Temp_Value2,Temp_Value1[j]);
      }
    }
    if(Temp_Value1[i]== 91 && n==2) //装载第一次预期发送数据
    {
      Send_1_Input = 0;
      for(j=i+1;j<strlen(Temp_Value1);j++)
      {
        if(Temp_Value1[j]==44 || Temp_Value1[j]==93)
        {
          DID_2E_SendData_1[3 + Send_1_Input]=atol(Temp_Value2);
          snprintf(Temp_Value2,elCount(Temp_Value2),"%s","");
          Send_1_Input++;
          if(Temp_Value1[j]==93)
          {
            n++; i = j;
            break;
          }
        }
        else
          snprintf(Temp_Value2,elCount(Temp_Value2),"%s%c",Temp_Value2,Temp_Value1[j]);
      }
    }
    if(Temp_Value1[i]== 91 && n==3) //装载第一次预期发送数据预期响应
    {
      for(j=i+1;j<strlen(Temp_Value1);j++)
      {
        if(Temp_Value1[j]==44 || Temp_Value1[j]==93)
        {
          DID_2E_SendData_1_Response=atol(Temp_Value2);
          snprintf(Temp_Value2,elCount(Temp_Value2),"%s","");
          if(Temp_Value1[j]==93)
          {
            n++; i = j;
            break;
          }
        }
        else
          snprintf(Temp_Value2,elCount(Temp_Value2),"%s%c",Temp_Value2,Temp_Value1[j]);
      }
    }
    if(Temp_Value1[i]== 91 && n==4) //装载预期发送数据2长度
    {
      for(j=i+1;j<strlen(Temp_Value1);j++)
      {
        if(Temp_Value1[j]==44 || Temp_Value1[j]==93)
        {
          DID_2E_SendData_2_Len = atol(Temp_Value2);
          snprintf(Temp_Value2,elCount(Temp_Value2),"%s","");
          if(Temp_Value1[j]==93)
          {
            n++; i = j;
            break;
          }
        }
        else
          snprintf(Temp_Value2,elCount(Temp_Value2),"%s%c",Temp_Value2,Temp_Value1[j]);
      }
    }
    if(Temp_Value1[i]== 91 && n==5) //装载第二次预期发送数据
    {
      Send_2_Input = 0;
      for(j=i+1;j<strlen(Temp_Value1);j++)
      {
        if(Temp_Value1[j]==44 || Temp_Value1[j]==93)
        {
          DID_2E_SendData_2[3 + Send_2_Input]=atol(Temp_Value2);
          snprintf(Temp_Value2,elCount(Temp_Value2),"%s","");
          Send_2_Input++;
          if(Temp_Value1[j]==93)
          {
            n++; i = j;
            break;
          }
        }
        else
          snprintf(Temp_Value2,elCount(Temp_Value2),"%s%c",Temp_Value2,Temp_Value1[j]);
      }
    }
    if(Temp_Value1[i]== 91 && n==6) //装载第二次预期发送数据预期响应
    {
      for(j=i+1;j<strlen(Temp_Value1);j++)
      {
        if(Temp_Value1[j]==44 || Temp_Value1[j]==93)
        {
          DID_2E_SendData_2_Response=atol(Temp_Value2);
          snprintf(Temp_Value2,elCount(Temp_Value2),"%s","");
          if(Temp_Value1[j]==93)
          {
            n++; i = j;
            break;
          }
        }
        else
          snprintf(Temp_Value2,elCount(Temp_Value2),"%s%c",Temp_Value2,Temp_Value1[j]);
      }
    }
    if(Temp_Value1[i]== 91 && n==7) //装载发送填充值
    {
      for(j=i+1;j<strlen(Temp_Value1);j++)
      {
        if(Temp_Value1[j]==44 || Temp_Value1[j]==93)
        {
          DID_2E_TxFiller = atol(Temp_Value2);
          snprintf(Temp_Value2,elCount(Temp_Value2),"%s","");
          if(Temp_Value1[j]==93)
          {
            n++; i = j;
            break;
          }
        }
        else
          snprintf(Temp_Value2,elCount(Temp_Value2),"%s%c",Temp_Value2,Temp_Value1[j]);
      }
    }
    if(Temp_Value1[i]== 91 && n==8) //获取读取数据DID
    {
      Read_2E_DID_Len = 1;
      for(j=i+1;j<strlen(Temp_Value1);j++)
      {
        if(Temp_Value1[j]==44 || Temp_Value1[j]==93)
        {
          Read_2E_DID[Read_2E_DID_Len] = atol(Temp_Value2);
          snprintf(Temp_Value2,elCount(Temp_Value2),"%s","");
          Read_2E_DID_Len++;
          if(Temp_Value1[j]==93)
          {
            n++; i = j;
            break;
          }
        }
        else
          snprintf(Temp_Value2,elCount(Temp_Value2),"%s%c",Temp_Value2,Temp_Value1[j]);
      }
    }
  }

  /*----------------判断是否需要填充值------------------*/
  if(Send_1_Input+3 < DID_2E_SendData_1_Len)
  {
    for(i=Send_1_Input+3;i<DID_2E_SendData_1_Len;i++)
      DID_2E_SendData_1[i] = DID_2E_TxFiller;
  }
  if(Send_2_Input+3 < DID_2E_SendData_2_Len)
  {
    for(i=Send_2_Input+3;i<DID_2E_SendData_2_Len;i++)
      DID_2E_SendData_2[i] = DID_2E_TxFiller;
  }
  
  if(Read_2E_DID_Len <= 2)
    Support_Read_2E_DID = -1;
  else
    Support_Read_2E_DID = 1;
}
/*请求种子*/
int _reqseed()
{
  diagSetTarget(Cdd_Name);
  _WriteEx_and_Report("","请求种子");
  diagResize(SendData,2);
  DiagSetPrimitiveByte(SendData,0,0x27);
  DiagSetPrimitiveByte(SendData,1,RequestSeed_27);
  diagSendRequest(SendData);
  testWaitForDiagRequestSent(SendData,500);
  testWaitForDiagResponse(SendData,p2cmax);
  return diagGetLastResponseCode(SendData);
}
/*获取种子*/
qword _get_seed(dword msgID)
{
  byte Temp[2] = {0x27,0x01};
  byte Serial_Num_Req[3] = {0x22,0xF1,0x8C};
  qword seed_Temp;
  byte Len,i,Falge_AES_CBC;
  byte m;
  Len = 0;
  m = 0;
  seed_Temp = 0;
  Falge_AES_CBC = 0;
  Temp[1] = RequestSeed_27;
  if(AES_128==2 && Get_Seed_Flage==0)/*重复请求种子时跳过发送此部分*/
  {
    _WriteEx_and_Report(ECU_project,"当前采用AES-CBC算法");
    _WriteEx_and_Report("","获取序列号");
    _Send_Diag_And_Get_CF(3,phyreq_ID,Serial_Num_Req);
    if(diagGetLastResponseCode(SendData) == -1)
    {
      if(DiagGetRespPrimitiveSize(SendData) == 22)
      {
        for(m=0;m<16;m++)
          Serial_number[m] = DiagGetRespPrimitiveByte(SendData,m+6);
        /*序列号移位*/
        LeftMove(Serial_number,3);
        /*用ECU KEY加密移位后的序列号 获取密钥KEY*/
        AES128_CBC_encrypt_buffer(Secret_KEY,Serial_number,KEY_Len,ECU_Key,Iv);
      }
      else
      {
        testStepFail("序列号长度错误");
        Falge_AES_CBC =1;
      }
    }
    else
    {
      testStepFail("获取序列号失败");
      Falge_AES_CBC =1;
    }
  }
  _Send_Diag_And_Get_CF(2,msgID,Temp);
  if(diagGetLastResponseCode(SendData)==-1)
  {
    Len = DiagGetRespPrimitiveSize(SendData);
    if(AES_128==0)
    {
      for(i=2;i<Len;i++)
        seed_Temp = seed_Temp | (DiagGetRespPrimitiveByte(SendData,i)<<((Len-i-1)*8));
      testStep("种子","获取到种子为0x%2X",seed_Temp);
      Seed_Count_List[Seed_Count] = seed_Temp;
      Seed_Count++;
      return seed_Temp;
    }
    else if(AES_128==1)
    {
      _WriteEx_and_Report(ECU_project,"当前采用AES-128算法");
      for(i=2;i<Len;i++)
      {
        Seed_AES[i-2] = DiagGetRespPrimitiveByte(SendData,i);
        Seed_Count_List_AES128[Seed_Count][i-2] = DiagGetRespPrimitiveByte(SendData,i);
      }
      Seed_Count++;
      return 0;
    }
    else if(AES_128==2 && Falge_AES_CBC == 0)
    {
      for(i=2;i<Len;i++)
      {
        Seed_CBC[i-2] = DiagGetRespPrimitiveByte(SendData,i);
        Seed_Count_List_AES128[Seed_Count][i-2] = DiagGetRespPrimitiveByte(SendData,i);
      }
      Seed_Count++;
      return 0;
    }
    else if(AES_128==2 && Falge_AES_CBC == 1)
    {
      _WriteEx_and_Report(ECU_project,"序列号错误导致计算的秘钥不可信");
      return -1;
    }
    else
    {
      _WriteEx_and_Report(ECU_project,"安全访问算法选择异常");
      return -1;
    }
  }
  else
  {
    testStep("","获取种子失败");
    return -1;
  }
}
/*通过种子计算出密钥并发送,type:0:正确密钥  1:错误密钥*/
void _Send_Key(byte len, dword msgID,qword Temp_seed,dword type)   
{
  byte Key_Data[18];
  dword m=0;
  dword Skey;
  word key_i;
  Key_Data[0] = 0x27;
  Key_Data[1] = SendKey_27;
  if(AES_128 == 0)
  {
    SecurityAccess(Temp_seed,Skey);
    testStep("密钥","计算出密钥为0x%2X",Skey);
    if(type == 1)
    {
      for(m=2;m<len;m++)
        Key_Data[m] = 0x00;
    }
    else
    {
      for(m=2;m<len;m++)
        Key_Data[m] = (Skey>>(abs(m+1-len)*8))&0xFF;
    }
    _Send_Diag(len,msgID,Key_Data);   
  }
  else if(AES_128 == 1 || @sysvar::AUTO::Security_Switch == 2)
  {
    _WriteEx_and_Report(ECU_project,"当前采用AES-128算法");
    if(type == 0)
    {
//      if(@AUTO::Config_Switch == 4)
//        _SecurityAccess_AES(Seed_AES,fixByte_Geely_APP,corresKey);
//      else if(@AUTO::Config_Switch == 6)
//        _SecurityAccess_AES(Seed_AES,fixByte_RC_BT,corresKey);
//      else if(@AUTO::Config_Switch == 11)
//        _SecurityAccess_AES(Seed_AES,fixByte_Chery_BT,corresKey);
//      else if(@AUTO::Config_Switch == 2)//长安掩码
//        _SecurityAccess_AES(Seed_AES,fixByte_CCAG_APP,corresKey);
      _Key_Count();
      for(key_i = 0; key_i < 16; key_i++)
        Key_Data[key_i+2] = corresKey[key_i];
    }
    else
    {
      for(key_i = 0; key_i < 16; key_i++)
        Key_Data[key_i+2] = 0x00;
    }
    _Send_Diag(len,msgID,Key_Data);
  }
  else if(AES_128 == 2)
  {
    _WriteEx_and_Report(ECU_project,"当前采用AES-CBC算法");
    if(type == 0)
    {
      for(m=0;m<16;m++)
        RA[m]=Seed_CBC[m];
      /*用密钥KEY解密RA 得到ra`*/
      AES128_CBC_decrypt_buffer(ra,RA,KEY_Len,Secret_KEY,Iv);
      /*ra`逆向*/
      reverseNum(ra,16);
      testWaitForTimeout(50);
      /*用密钥KEY加密r得到R*/
      AES128_CBC_encrypt_buffer(R,ra,KEY_Len,Secret_KEY,Iv);
      for(key_i = 0; key_i < 16; key_i++)
        Key_Data[key_i+2] = R[key_i];
    }
    else
    {
      for(key_i = 0; key_i < 16; key_i++)
        Key_Data[key_i+2] = 0x00;
    }
    _Send_Diag(len,msgID,Key_Data);
  }
  else
    _WriteEx_and_Report(ECU_project,"安全访问算法选择异常");
}
dword _Check_Repeat(dword Len)   
{
  dword Repeat_Count;
  dword Repeat_Count_0,Repeat_Count_;
  dword count;
  dword i,j,k;
  int Same_Flage;
  char comment[500];
  char comment_2[500];
  char comment_3[500];
  Repeat_Count = 0;
  Repeat_Count_0 = 0;
  count = 0;
  {
    if(AES_128==0)
    {      
      for(i=0;i<Len;i++)
      {
        Seed_Count_Rept[i][0] = Seed_Count_List[i];
        Same_Flage = _Seed_Repeat( Seed_Count_List[i],i,0);
        if(Same_Flage == 1)
          Repeat_Count++;
      }
      for(i=0;i<Len;i++)
      {
        Seed_Count_Rept[i][1]++; //初始值为1,出现次数在原基础上加上本身
        if(Seed_Count_List[i]==0)
          Repeat_Count_0++;
      }
      if(Repeat_Count_0==Len)   //若获取到的全部为0,则未收到种子，无重复
        Repeat_Count =0;
    }
    else
    {
      for(i=0;i<Len;i++)
      {
        Repeat_Count_ = 0;
        for(k=0;k<16;k++)
        {
          Seed_Count_AES_Rept[i][k] = Seed_Count_List_AES128[i][k];
          if(Seed_Count_List_AES128[i][k] == 0)
            Repeat_Count_++;
          if(Repeat_Count_ == 16)
            Repeat_Count_0++;
        }
        Same_Flage = _Seed_Repeat(Seed_Count_List_AES128[i],i);
        if(Same_Flage == 1)
          Repeat_Count++;
        Seed_Count_AES_Rept[i][16]++; //初始值为1,出现次数在原基础上加上本身
        testWaitForTimeout(10);
      }
    }
    
    {
      snprintf(comment,elCount(comment),"验证 %d 次,当前重复次数为 %d 次",Len,Repeat_Count);
      snprintf(comment_2,elCount(comment_2),"验证 %d 次,全0种子出现 %d 次",Len,Repeat_Count_0);
      _WriteEx_and_Report("",comment);
      _WriteEx_and_Report("",comment_2);
      if(AES_128 == 0)
      {
        for(i=0;i<Seed_Count;i++)
        {
          if(Seed_Count_Rept[i][1]>1)
          {
            snprintf(comment_3,elCount(comment_3),"种子 0x%08X ,出现次数 %d ",Seed_Count_Rept[i][0],Seed_Count_Rept[i][1]);
            _WriteEx_and_Report("",comment_3);
          }
        }
      }
      else
      {
        for(i=0;i<Seed_Count;i++)
        {
          if(Seed_Count_AES_Rept[i][16]>1)
          {
            char Temp_Str[200];
            snprintf(comment_3,elCount(comment_3),"");
            snprintf(Temp_Str,elCount(Temp_Str),"种子0x");
            for(k=0;k<16;k++)
              snprintf(Temp_Str,elCount(Temp_Str),"%s%02X",Temp_Str,Seed_Count_AES_Rept[i][k]);
            snprintf(comment_3,elCount(comment_3),"%s,出现次数 %d ",Temp_Str,Seed_Count_AES_Rept[i][16]);
            _WriteEx_and_Report("",comment_3);
          }
        }
      }
      if(Request_Seed_Consistency==1)
      {
        Repeat_Count++; //自加一次
        if(Repeat_Count!=Len )
          testStepFail("","重复次数与请求次数不等，重复次数为%d",Repeat_Count);
        else
          testStepPass("","重复次数与请求次数相等");
      }
    }
  }
  _Clear_Seed();
  return Repeat_Count;
}
dword _Check_Repeat(int Len,byte Type)   
{
  dword Repeat_Count;
  dword Repeat_Count_0,Repeat_Count_;
  dword count;
  dword i,j,k;
  char comment[500];
  char comment_2[500];
  char comment_3[500];
  int Same_Flage;
  Repeat_Count = 0;
  Repeat_Count_0 = 0;
  count = 0;
  if(Type==0)
    _Check_Repeat(Len);
  else
  {
    if(AES_128==0)
    {
      for(i=0;i<Len;i++)
      {
        Seed_Count_Rept[i][0] = Seed_Count_List[i];
        Same_Flage = _Seed_Repeat( Seed_Count_List[i],i,0);
        if(Same_Flage == 1)
          Repeat_Count++;
      }
      for(i=0;i<Len;i++)
      {
        Seed_Count_Rept[i][1]++; //初始值为1,出现次数在原基础上加上本身
        if(Seed_Count_List[i]==0)
          Repeat_Count_0++;
      }
      if(Repeat_Count_0==Len)   //若获取到的全部为0,则未收到种子，无重复
        Repeat_Count =0;
    }
    else
    {
      for(i=0;i<Len;i++)
      {
        Repeat_Count_ = 0;
        for(k=0;k<16;k++)
        {
          Seed_Count_AES_Rept[i][k] = Seed_Count_List_AES128[i][k];
          if(Seed_Count_List_AES128[i][k] == 0)
            Repeat_Count_++;
          if(Repeat_Count_ == 16)
            Repeat_Count_0++;
        }
        Same_Flage = _Seed_Repeat(Seed_Count_List_AES128[i],i);
        if(Same_Flage == 1)
          Repeat_Count++;
        Seed_Count_AES_Rept[i][16]++; //初始值为1,出现次数在原基础上加上本身
        testWaitForTimeout(10);
      }
    }
    snprintf(comment,elCount(comment),"验证 %d 次,当前重复次数为 %d 次",Len,Repeat_Count);
    snprintf(comment_2,elCount(comment_2),"验证 %d 次,全0种子出现 %d 次",Len,Repeat_Count_0);
    _WriteEx_and_Report("",comment);
    _WriteEx_and_Report("",comment_2);
    if(AES_128 == 0)
    {
      for(i=0;i<Seed_Count;i++)
      {
        if(Seed_Count_Rept[i][1]>1)
        {
          snprintf(comment_3,elCount(comment_3),"种子 0x%08X ,出现次数 %d ",Seed_Count_Rept[i][0],Seed_Count_Rept[i][1]);
          _WriteEx_and_Report("",comment_3);
        }
      }
    }
    else
    {
      for(i=0;i<Seed_Count;i++)
      {
        if(Seed_Count_AES_Rept[i][16]>1)
        {
          char Temp_Str[200];
          snprintf(comment_3,elCount(comment_3),"");
          snprintf(Temp_Str,elCount(Temp_Str),"种子0x");
          for(k=0;k<16;k++)
            snprintf(Temp_Str,elCount(Temp_Str),"%s%02X",Temp_Str,Seed_Count_AES_Rept[i][k]);
          snprintf(comment_3,elCount(comment_3),"%s,出现次数 %d ",Temp_Str,Seed_Count_AES_Rept[i][16]);
          _WriteEx_and_Report("",comment_3);
        }
      }
    }
    if(Len>=10000 && Repeat_Count >=5)
      testStepFail("","");
    else
      testStepPass("","");
  }
  testWaitForTimeout(2000);
  _Clear_Seed();
  return Repeat_Count;
}
/*
  检测种子是否已经出现过重复
  Seed_ 待检测种子
  _Repeat_Count:已重复种子列表个数
  Type = 0：非AES128类算法,种子长度在4byte以内
*/
int _Seed_Repeat(qword Seed_,dword _Repeat_Count,byte Type)
{
  int Return_Value;
  int k;
  Return_Value = 0;
  for(k=0;k<_Repeat_Count;k++)
  {
    if(Type == 0)
    {
      if(Seed_ == Seed_Count_Rept[k][0])
      {
        Seed_Count_Rept[k][1]++;
        Return_Value = 1;
        break;
      }
    }
  }
  return  Return_Value;
}
/*
  检测种子是否已经出现过重复
  AES 128型
  Seed_ 待检测种子
  _Repeat_Count:列表个数
*/
int _Seed_Repeat(byte Seed_[],dword _Repeat_Count)
{
  int Return_Value;
  int k,m;
  Return_Value = 0;
  for(k=0;k<_Repeat_Count;k++)
  {
    for(m=0;m<16;m++)
    {
      if(Seed_[m] != Seed_Count_AES_Rept[k][m])
        break;
    }
    if(m == 16)
    {
      Seed_Count_AES_Rept[k][16]++;
      Return_Value = 1;
      break;
    }
  }
  return  Return_Value;
}

int _Get_Read_Plural(char str[])
{
  char Temp_Value_0[1000];
  char Temp_Value_1[100];
  int i,j,k,Count,Count_Group,Flage;
  
  snprintf(Temp_Value_0,elCount(Temp_Value_0),"%s","");
  snprintf(Temp_Value_1,elCount(Temp_Value_1),"%s","");
  DID_Read_Count = 0;
  Count_Group = 0;
  glbHandle1 = OpenFileRead (file_name_1,0);
  getProfileString(ECU_project,str,"Null",Temp_Value_0, 1000, file_name_1);
  fileClose(glbHandle1);
  if(strlen(Temp_Value_0)<= 5)
    return -1;
  else
  {
    for(i=0;i<strlen(Temp_Value_0);i++)
    {
      if(Temp_Value_0[i] == 91)
      {
        Count = 0;
        for(j=i+1;j<strlen(Temp_Value_0);j++)
        {
          if(Temp_Value_0[j] == 44 || Temp_Value_0[j] == 93)
          {
            DID_Read[DID_Read_Count].DID_byte[Count] = atol(Temp_Value_1);
            Count++;
            snprintf(Temp_Value_1,elCount(Temp_Value_1),"%s","");
            if(Temp_Value_0[j] == 93)
            {
              i = j;
              DID_Read_Count++;
              Count_Group++;
              break;
            }
          }
          else
            snprintf(Temp_Value_1,elCount(Temp_Value_1),"%s%c",Temp_Value_1,Temp_Value_0[j]);
        }
      }
    }
    for(i=0;i<DID_Read_Count;i++)
      DID_Read[i].DID = ((DID_Read[i].DID_byte[0]<<8) + (DID_Read[i].DID_byte[1]));
    _get_Str_Traversal("DID_22_Traversal");
    
    for(i=0;i<DID_Read_Count;i++)
    {
      snprintf(Temp_Value_1,elCount(Temp_Value_1),"%s","");
      snprintf(Temp_Value_1,elCount(Temp_Value_1),"DID_%04X",DID_Read[i].DID);
      Flage = 0;
      for(j=0;j<Traversal_Count;j++)
      {
        if(strncmp(Traversal_DID[j],Temp_Value_1,strlen(Traversal_DID[j])) == 0 && strlen(Traversal_DID[j]) == strlen(Temp_Value_1))
        {
          Flage = 1;
          _Get_DID(Traversal_DID[j]);
          DID_Read[i].LenExResp = DID_len_Ex - 3; 
          DID_Read[i].Analysis_Read = Analysis;
          DID_Read[i].Padding = UnUse_Byte;
          if(Analysis == 1)
          {
            for(k=0;k<Len_Input;k++)
              DID_Read[i].ExResp_byte[k] = DID_Data[k];
            if(Len_Input < DID_len_Ex)
            {
              for(k=Len_Input;k<DID_len_Ex-3;k++)  /*减去 22 + DID长度*/
                DID_Read[i].ExResp_byte[k] = DID_Read[i].Padding;
            }
          }
          else
          {
            snprintf(DID_Read[i].ExResp,elCount(DID_Read[i].ExResp),"%s",DID_Data_str);
            if(Analysis == 2 && Len_Input < DID_len_Ex)
            {
              Len_Input = strlen(DID_Read[i].ExResp);
              for(k=Len_Input;k<DID_len_Ex-3;k++)   /*减去 22 + DID长度*/
                snprintf(DID_Read[i].ExResp,elCount(DID_Read[i].ExResp),"%s%c",DID_Read[i].ExResp,UnUse_Byte);
            }
          }
          break;
        }
      }
      if(Flage == 0)
      {
        DID_Read[i].LenExResp = 0;
        snprintf(DID_Read[i].ExResp,elCount(DID_Read[i].ExResp),"");
      }
    }
    return 1;
  }
}
_Get_ReadPlural()
{
  char Temp_Value_0[1000];
  char Temp_Value_1[500];
  int i,j;
  glbHandle1 = OpenFileRead (file_name_1,0);
  getProfileString(ECU_project,"Other_Plural_DID","Null",Temp_Value_0, 1000, file_name_1);
  fileClose(glbHandle1);
  Plural_DID_Count = 0;
  for(i=0;i<strlen(Temp_Value_0);i++)
  {
    if(Temp_Value_0[i]==91)
    {
      for(j=i+1;j<strlen(Temp_Value_0);j++)
      {
        if(Temp_Value_0[j]==44 || Temp_Value_0[j]==93)
        {
          snprintf(Plural_DID[Plural_DID_Count],elCount(Plural_DID[Plural_DID_Count]),"%s",Temp_Value_1);
          Plural_DID_Count++;
          snprintf(Temp_Value_1,elCount(Temp_Value_1),"");
          if(Temp_Value_0[j]==93)
          {
            i = j; break;
          }
        }
        else
          snprintf(Temp_Value_1,elCount(Temp_Value_1),"%s%c",Temp_Value_1,Temp_Value_0[j]);
      }
    }
  }
  if(Plural_DID_Count == 1 && strlen(Plural_DID[0])==0)
    Plural_DID_Count = 0;
}

/*
  将输入的数组按照输入格式进行转换并输出
  List_Input：输入数组
  Len_Input :输入长度
  List_Output：输出数据
  Type ：转换格式
  Type = 2：ASCII码格式转换
  Type = 3：整体转换至10进制 
  Type = 4：每个Byte分别转换至10进制后拼接
  Type = 5：16进制拼接
*/
void Array_Change(byte List_Input[],int Len_Input,char List_Output[],byte Type)
{
  int Count_Size;
  char Temp_Buffer[20];
  snprintf(List_Output,elCount(List_Output),"%s","");
  snprintf(Temp_Buffer,elCount(Temp_Buffer),"%s","");
  if(Type == 2)
  {
    for(Count_Size=0;Count_Size<Len_Input;Count_Size++)
      snprintf(List_Output,elCount(List_Output),"%s%c",List_Output,HexToAsc(List_Input[Count_Size])); //ASCII码查表切换
  }
  else if(Type == 3)
  {
    qword Data_Temp ;
    Data_Temp = 0;
    snprintf(List_Output,elCount(List_Output),"0x%s");
    for(Count_Size=0;Count_Size<Len_Input;Count_Size++)
      snprintf(List_Output,elCount(List_Output),"%s%02X",List_Output,List_Input[Count_Size]);
    strtoull(List_Output,Data_Temp);
    snprintf(List_Output,elCount(List_Output),"%s","");
    snprintf(List_Output,elCount(List_Output),"%s%I64u",List_Output,Data_Temp);
  }
  else if(Type == 4)
  {
    for(Count_Size=0;Count_Size<Len_Input;Count_Size++)
    {
      ltoa(List_Input[Count_Size],Temp_Buffer,10);
      if(strlen(Temp_Buffer) == 1)
        snprintf(List_Output,300,"%s%s",List_Output,"0");
      snprintf(List_Output,300,"%s%s",List_Output,Temp_Buffer);
    }
  }
  else if(Type == 5)
  {
    for(Count_Size=0;Count_Size<Len_Input;Count_Size++)
    {
      ltoa(List_Input[Count_Size],Temp_Buffer,16);
      if(strlen(Temp_Buffer) == 1)
        snprintf(List_Output,300,"%s%s",List_Output,"0");
      snprintf(List_Output,300,"%s%s",List_Output,Temp_Buffer);
    }
  }
  else
    _WriteEx_and_Report("","无对应解析,待完善");
}

void DID_Read_Some(dword ID,byte Session,char Str[])
{
  int Return_Va,n,Flage_Error;
  int Len_Rx,Len_Ex,Len_Start,Len_End;
  byte Send_Data[100],Temp_RxData[100],Temp_RxData_2[100];
  char DID[20];
  int i;
  Return_Va = _Check_Serve_IDAndSess(0x22,ID,Session);
  
  if(DID_22_Support==1)
    _WriteEx_and_Report("","该项目一次性只支持一个DID读取");
  else
  {
    Return_Va = _Check_Serve_IDAndSess(0x22,ID,Session);
    if(Return_Va == 1)
    {
      Send_Data[0] = 0x22;
      _Get_Read_Plural(Str);
      n = 1;
      for(i=0;i<DID_Read_Count;i++)
      {
        Send_Data[n++] = DID_Read[i].DID_byte[0];
        Send_Data[n++] = DID_Read[i].DID_byte[1];
      }
      _Send_Diag(1+DID_Read_Count*2,ID,Send_Data);
      if(diagGetLastResponseCode(SendData) == 0)
        testWaitForDiagResponse(SendData,2000);
      if(diagGetLastResponseCode(SendData) == -1)
      {
        Len_Ex = 0;
        Len_Rx = DiagGetRespPrimitiveSize(SendData);
        for(i=0;i<DID_Read_Count;i++)
        {
          if(DID_Read[i].LenExResp != 0)
            Len_Ex = Len_Ex + DID_Read[i].LenExResp + 2;
        }
        Len_Ex = Len_Ex + 1;
        if(Len_Rx != Len_Ex)
          testStepFail("读取多组DID","返回长度与预期长度不符,返回长度为 %d, 期望长度为 %d",Len_Rx,Len_Ex);
        else
        {
          /* 分组进行判断 */
          Len_Start = 0;
          Len_End = 0;
          for(i=0;i<DID_Read_Count;i++)
          {
            if( DID_Read[i].LenExResp != 0)
            {
              Flage_Error = 0;
              snprintf(DID,elCount(DID),"%s","");
              snprintf(DID,elCount(DID),"0x%02X 0x%02X",DID_Read[i].DID_byte[0],DID_Read[i].DID_byte[1]);
              Len_Start =  Len_End ;
              if(Len_End == 0)
                Len_Start = Len_Start +1;
              Len_End = Len_Start + DID_Read[i].LenExResp+2;
              for(n = 0; n< DID_Read[i].LenExResp+2 ; n++)
              {
                if((Len_Start+n) > Len_Rx)
                {
                  testStepFail("","出现异常长度导致无法获取到后续字节");
                  return;
                }
                Temp_RxData[n] = DiagGetRespPrimitiveByte(SendData,Len_Start+n);
              }
              if((Temp_RxData[0] != DID_Read[i].DID_byte[0]) || (Temp_RxData[1] != DID_Read[i].DID_byte[1]))
                testStepFail(DID,"DID与预期无法对应,接收到DID为: 0x%02X 0x%02X ,预期DID为: 0x%02X 0x%02X ",Temp_RxData[0],Temp_RxData[1],DID_Read[i].DID_byte[0],DID_Read[i].DID_byte[1]);
              else
                testStepPass(DID,"DID与预期一致");
              for(n=0;n<DID_Read[i].LenExResp;n++)
                Temp_RxData_2[n] = DiagGetRespPrimitiveByte(SendData,Len_Start+2+n); //全数据数组(剔除DID)
              if(DID_Read[i].Analysis_Read == 1)
              {
                char Temp_Rx[200];
                char Temp_Ex[200];
                snprintf(Temp_Rx,elCount(Temp_Rx),"%s","实际接收为: ");
                snprintf(Temp_Ex,elCount(Temp_Ex),"%s","期望接收为: ");
                for(n=0;n<DID_Read[i].LenExResp;n++)
                {
                  snprintf(Temp_Rx,elCount(Temp_Rx),"%s%02X",Temp_Rx,Temp_RxData_2[n]);
                  snprintf(Temp_Ex,elCount(Temp_Ex),"%s%02X",Temp_Ex,DID_Read[i].ExResp_Byte[n]);
                  if(Temp_RxData_2[n] != DID_Read[i].ExResp_Byte[n])
                    Flage_Error = 1;
                }
                if(Flage_Error == 1)
                {
                  _WriteEx_and_Report(DID,Temp_Rx);
                  _WriteEx_and_Report(DID,Temp_Ex);
                  testStepFail(DID,"接收到的数据与预期不符");
                }
                else
                  testStepPass(DID,"接收到的数据与预期一致");
              }
              else
              {
                char Buffer_Check[500];
                Array_Change(Temp_RxData_2,DID_Read[i].LenExResp,Buffer_Check,DID_Read[i].Analysis_Read);
                Check_information_(Buffer_Check,DID_Read[i].ExResp,DID);
              }
            }
          }
        }
      }
      else
        testStepFail("","未收到响应或收到消极应答");
    }
    else if(Return_Va == -1)
      _WriteEx_and_Report("","当前寻址不支持该服务");
    else if(Return_Va == 0)
      _WriteEx_and_Report("","当前会话不支持该服务");
  }
}
int _Check_22DID(dword ID,byte Temp_0[],byte Session)
{
  int Flage_;
  Flage_ = _Check_BT_Double_Backup(ID,Temp_0,Session);
  if( Flage_ == -1)
  {
    _WriteEx_and_Report("","特殊处理");
    return 0;
  }
  else
  {
    Flage_ = 0;
    if(ID == funreq_ID && Fun_DID22 == 0)
    {
      Flage_ = Analysis_Select(Analysis,ID,Temp_0,0);
    }
    else
    {
      Flage_ = Analysis_Select(Analysis,ID,Temp_0,-1);
    }
    return Flage_;
  }
}

int Analysis_Select(int Type,dword ID,byte DID_Send[],int Res)
{
  int Return_Value;
  switch(Analysis)
  {
    case 2:
      Return_Value = _Check_22DID_ASCII(ID,DID_len_Ex,DID_Send,DID_Data_str,Res);break;
    case 3:
      Return_Value = _Check_22DID_DecAll(ID,DID_len_Ex,DID_Send,DID_Data_str,Res);break;
    case 4:
      Return_Value = _Check_22DID_DecByte(ID,DID_len_Ex,DID_Send,DID_Data_str,Res);break;
    case 5:
      Return_Value = _Check_22DID_HexSplicing(ID,DID_len_Ex,DID_Send,DID_Data_str,Res);break;
    case 6:
      Return_Value = _Check_22DID_Mixed_DecALL_DecByte(ID,DID_len_Ex,DID_Send,DID_Data_str,Res);break;
    default:
      Return_Value = _Check_22DID_Hex(ID,DID_len_Ex,DID_Send,DID_Data,Res);break;
  }
  return Return_Value;
}

/*
  解析方式：输入16进制直接进行对比
  msgID：寻址方式{phyreq_ID:物理寻址，funreq_ID:功能寻址}
  LenEx：预期响应长度
  Tx_Data：发送的数据
  Rx_Data：接收的数据
  passcondition：预期响应{-1:正响应,0:无响应,>0:消极响应码}
*/
int _Check_22DID_Hex(dword msgID,dword LenEx,byte Tx_Data[],byte Rx_Data[],int passcondition)
{
  diagRequest * req1; 
  char str[500];
  int i = 0, Len_Rx = 0;
  int Return_Value;
  int flage_0 = 0;
  int flage = 0;
  Return_Value = 0;
  snprintf(str,elCount(str),"%s","");
  if(Tx_Data[1]<=0xF)
    snprintf(str,elCount(str),"%s%s",str,"0");
  snprintf(str,elCount(str),"%s%X",str,Tx_Data[1]);
  snprintf(str,elCount(str),"%s%s",str,"  ");
  if(Tx_Data[2]<=0xF)
    snprintf(str,elCount(str),"%s%s",str,"0");
  snprintf(str,elCount(str),"%s%X",str,Tx_Data[2]);
  diagResize(req1,3);
  for(i=0;i<3;i++)
    DiagSetPrimitiveByte(req1,i,Tx_Data[i]);
  _SendAndWriteReport(req1,msgID,1000);
  Len_Rx = diagGetRespPrimitiveSize(req1);
  if((diagGetLastResponseCode(req1) == passcondition) && (diagGetLastResponseCode(req1) == 0))
    testStepPass(str,"与期望一致无应答"); 
  if((diagGetLastResponseCode(req1) == passcondition) && (diagGetLastResponseCode(req1) != 0))
  {
    if(Len_Rx != LenEx)
    {
      Return_Value = -1;
      testStepFail(str,"长度异常,预期长度为%d，实际长度为%d",LenEx,Len_Rx);
    }
    else if((Len_Rx == LenEx))
      testStepPass(str,"长度与预期一致"); 
    if(Len_Input<=Len_Rx)
    {
      if((DiagGetRespPrimitiveByte(req1,0) != (DiagGetPrimitiveByte(req1,0)^0x40)) ||DiagGetRespPrimitiveByte(req1,1)!=Tx_Data[1] ||DiagGetRespPrimitiveByte(req1,2)!=Tx_Data[2] )
      {
        Return_Value = -1;
        testStepFail(str,"前三字符存在异常,实际反馈为 0x%2X  0x%2X  0x%2X ",DiagGetRespPrimitiveByte(req1,0),DiagGetRespPrimitiveByte(req1,1),DiagGetRespPrimitiveByte(req1,2));
      }
      else
        testStepPass(str,"前三字符与预期一致");
      if(Len_Input==0)
        _WriteEx_and_Report(str,"未输入预期值，跳过内容检测");
      else if(Len_Input>0)
      {
        for(i=0;i<Len_Input;i++)
        {
          if(Rx_Data[i]!= DiagGetRespPrimitiveByte(req1,i+3))
          {
            flage_0 = 1;Return_Value = -1;
            testStepFail(str,"反馈值异常，预期为；0x%2X,第%d 位实际反馈值为:0x%2X",Rx_Data[i],i+4,DiagGetRespPrimitiveByte(req1,i+3));
          }
        }
        if(flage_0 == 0)
          testStepPass(str,"反馈与预期一致");
       if(Len_Input<Len_Rx-3)
        {
          _WriteEx_and_Report("","存在未使用的填充位");
          for(i=Len_Input+3;i<Len_Rx;i++)
          {
            if(DiagGetRespPrimitiveByte(req1,i) != UnUse_Byte)
            {
              flage = 1;Return_Value = -1;
              testStepFail(str,"未使用位填充值存在非预期情况，默认填充值为；0x%2X,第%d 位实际反馈值为:0x%2X",UnUse_Byte,i+1,DiagGetRespPrimitiveByte(req1,i));
            }
          }
          if(flage == 0)
            testStepPass(str,"未使用填充位为默认值0x%2X",UnUse_Byte);
        } 
      }
    }
    else if(Len_Input>Len_Rx)
    {
      Return_Value = -1;
      testStepFail(str,"长度异常,收到的长度小于期望长度");
    }
  }
  else if(diagGetLastResponseCode(req1) != passcondition)
  {
    Return_Value = -1;
    testStepFail(str,"收到响应异常");
  }
  return Return_Value;
}
/*
  解析方式：ASCII码
  msgID：寻址方式{phyreq_ID:物理寻址，funreq_ID:功能寻址}
  LenEx：预期响应长度
  Tx_Data：发送的数据
  Rx_Data：接收的数据
  passcondition：预期响应{-1:正响应,0:无响应,>0:消极响应码}
*/
int _Check_22DID_ASCII(dword msgID,dword LenEx,byte Tx_Data[],char Rx_Data[],int passcondition)
{
  diagRequest * req1; 
  int Return_Value;
  char str[500];
  int i = 0, Len_Rx = 0;
  int flage = 0;
  char Buffer[500];
  Return_Value = 0;
  snprintf(Buffer,elCount(Buffer),"%s","");
  snprintf(str,elCount(str),"%s","");
  if(Tx_Data[1]<=0xF)
    snprintf(str,elCount(str),"%s%s",str,"0");
  snprintf(str,elCount(str),"%s%X",str,Tx_Data[1]);
  snprintf(str,elCount(str),"%s%s",str,"  ");
  if(Tx_Data[2]<=0xF)
    snprintf(str,elCount(str),"%s%s",str,"0");
  snprintf(str,elCount(str),"%s%X",str,Tx_Data[2]);
  diagResize(req1,3);
  for(i=0;i<3;i++)
    DiagSetPrimitiveByte(req1,i,Tx_Data[i]);
  _SendAndWriteReport(req1,msgID,1000);
  Len_Rx = diagGetRespPrimitiveSize(req1);
  if((diagGetLastResponseCode(req1) == passcondition) && (diagGetLastResponseCode(req1) == 0))
    testStepPass(str,"与期望一致无应答"); 
  if((diagGetLastResponseCode(req1) == passcondition) && (diagGetLastResponseCode(req1) != 0))
  {
    if(Len_Rx != LenEx)
    {
      Return_Value = -1;
      testStepFail(str,"长度异常,预期长度为%d，实际长度为%d",LenEx,Len_Rx);
    }
    else if((Len_Rx == LenEx))
      testStepPass(str,"长度与预期一致"); 
    if(strlen(Rx_Data)<=Len_Rx)
    {      
      if((DiagGetRespPrimitiveByte(req1,0) != (DiagGetPrimitiveByte(req1,0)^0x40)) ||DiagGetRespPrimitiveByte(req1,1)!=Tx_Data[1] ||DiagGetRespPrimitiveByte(req1,2)!=Tx_Data[2] )
      {
        Return_Value = -1;
        testStepFail(str,"前三字符存在异常,实际反馈为 0x%2X  0x%2X  0x%2X ",DiagGetRespPrimitiveByte(req1,0),DiagGetRespPrimitiveByte(req1,1),DiagGetRespPrimitiveByte(req1,2));
      }
      else
        testStepPass(str,"前三字符与预期一致");
      if(strlen(Rx_Data)!=0)
      {
        for(i=3;i<strlen(Rx_Data)+3;i++)
        {
          snprintf(Buffer,elCount(Buffer),"%s%c",Buffer,HexToAsc(DiagGetRespPrimitiveByte(req1,i))); //ASCII码查表切换
        }
        Check_information_(Buffer,Rx_Data,str);
        if(strlen(Rx_Data)<Len_Rx-3)
        {
          _WriteEx_and_Report("","存在未使用的填充位");
          for(i=strlen(Rx_Data)+3;i<Len_Rx;i++)
          {
            if(DiagGetRespPrimitiveByte(req1,i) != UnUse_Byte)
            {
              flage = 1;
              Return_Value = -1;
              testStepFail(str,"未使用位填充值存在非预期情况，默认填充值为；0x%2X,第%d 位实际反馈值为:0x%2X",UnUse_Byte,i+1,DiagGetRespPrimitiveByte(req1,i));
            }
          }
          if(flage == 0)
            testStepPass(str,"未使用填充位为默认值0x%2X",UnUse_Byte);
        }
      }
      if(strlen(Rx_Data)==0)
        _WriteEx_and_Report(str,"未输入预期值，跳过内容检测");
    }
    else if(strlen(Rx_Data)>Len_Rx)
    {
      Return_Value = -1;
      testStepFail(str,"长度异常,收到的长度小于期望长度");
    }
  }
  else if(diagGetLastResponseCode(req1) != passcondition)
  {
    Return_Value = -1;
    testStepFail(str,"收到响应异常");
  }
  return Return_Value;
}

/*
  解析方式：将16进制整体转换为10进制
  msgID：寻址方式{phyreq_ID:物理寻址，funreq_ID:功能寻址}
  LenEx：预期响应长度
  Tx_Data：发送的数据
  Rx_Data：接收的数据
  passcondition：预期响应{-1:正响应,0:无响应,>0:消极响应码}
*/
int _Check_22DID_DecAll(dword msgID,dword LenEx,byte Tx_Data[],char Rx_Data[],int passcondition)/*整体转换*/
{
  diagRequest * req1; 
  char str[500];
  int i = 0, Len_Rx = 0;
  int Return_Value,Temp_Return_Value;
  qword Data_Temp = 0;
  char Buffer[500];
  char Buffer_Check[500];
  Return_Value = 0;
  snprintf(str,elCount(str),"%s","");
  snprintf(Buffer,elCount(Buffer),"%s","");
  snprintf(Buffer_Check,elCount(Buffer_Check),"%s","");
  if(Tx_Data[1]<=0xF)
    snprintf(str,elCount(str),"%s%s",str,"0");
  snprintf(str,elCount(str),"%s%X",str,Tx_Data[1]);
  snprintf(str,elCount(str),"%s%s",str,"  ");
  if(Tx_Data[2]<=0xF)
    snprintf(str,elCount(str),"%s%s",str,"0");
  snprintf(str,elCount(str),"%s%X",str,Tx_Data[2]);
  diagResize(req1,3);
  for(i=0;i<3;i++)
    DiagSetPrimitiveByte(req1,i,Tx_Data[i]);
  _SendAndWriteReport(req1,msgID,1000);
  Len_Rx = diagGetRespPrimitiveSize(req1);
  if((diagGetLastResponseCode(req1) == passcondition) && (diagGetLastResponseCode(req1) == 0))
    testStepPass(str,"与期望一致无应答"); 
  if((diagGetLastResponseCode(req1) == passcondition) && (diagGetLastResponseCode(req1) != 0))
  {
    if(Len_Rx != LenEx)
    {
      Return_Value = -1;
      testStepFail(str,"长度异常,预期长度为%d，实际长度为%d",LenEx,Len_Rx);
    }
    else if((Len_Rx == LenEx))
      testStepPass(str,"长度与预期一致"); 
    if((DiagGetRespPrimitiveByte(req1,0) != (DiagGetPrimitiveByte(req1,0)^0x40)) ||DiagGetRespPrimitiveByte(req1,1)!=Tx_Data[1] ||DiagGetRespPrimitiveByte(req1,2)!=Tx_Data[2] )
    {
      Return_Value = -1;
      testStepFail(str,"前三字符存在异常,实际反馈为 0x%2X  0x%2X  0x%2X ",DiagGetRespPrimitiveByte(req1,0),DiagGetRespPrimitiveByte(req1,1),DiagGetRespPrimitiveByte(req1,2));
    }
    else
      testStepPass(str,"前三字符与预期一致");
    snprintf(Buffer,elCount(Buffer),"%s%s",Buffer,"0x");
    if(strlen(Rx_Data)!=0)
    {
      for(i=3;i<Len_Rx;i++)
      {
        if(DiagGetRespPrimitiveByte(req1,i)>0x0F)
          snprintf(Buffer,elCount(Buffer),"%s%2X",Buffer,DiagGetRespPrimitiveByte(req1,i));
        else
        {
          snprintf(Buffer,elCount(Buffer),"%s%s",Buffer,"0");
          snprintf(Buffer,elCount(Buffer),"%s%X",Buffer,DiagGetRespPrimitiveByte(req1,i));
        }
      }
      strtoull(Buffer,Data_Temp);
      snprintf(Buffer_Check,elCount(Buffer_Check),"%s%I64u",Buffer_Check,Data_Temp);
      Temp_Return_Value = Check_information_(Buffer_Check,Rx_Data,str);
      if(Temp_Return_Value == -1)
        Return_Value = -1;
    }
    if(strlen(Rx_Data)==0)
      _WriteEx_and_Report(str,"未输入预期值，跳过内容检测");
  }
  else if(diagGetLastResponseCode(req1) != passcondition)
  {
    Return_Value = -1;
    testStepFail(str,"收到响应异常");
  }
  return Return_Value;
}

/*
  解析方式：将16进制每个字节转换为10进制
  msgID：寻址方式{phyreq_ID:物理寻址，funreq_ID:功能寻址}
  LenEx：预期响应长度
  Tx_Data：发送的数据
  Rx_Data：接收的数据
  passcondition：预期响应{-1:正响应,0:无响应,>0:消极响应码}
*/

int _Check_22DID_DecByte(dword msgID,dword LenEx,byte Tx_Data[],char Rx_Data[],int passcondition)/*每个Byte分别转换*/
{
  diagRequest * req1; 
  char str[500];
  int i = 0, Len_Rx = 0;
  int Return_Value,Temp_Return_Value;
  char Buffer[500];
  char Buffer_Check[500];
  Return_Value = 0;
  snprintf(str,elCount(str),"%s","");
  snprintf(Buffer,elCount(Buffer),"%s","");
  snprintf(Buffer_Check,elCount(Buffer_Check),"%s","");
  if(Tx_Data[1]<=0xF)
    snprintf(str,elCount(str),"%s%s",str,"0");
  snprintf(str,elCount(str),"%s%X",str,Tx_Data[1]);
  snprintf(str,elCount(str),"%s%s",str,"  ");
  if(Tx_Data[2]<=0xF)
    snprintf(str,elCount(str),"%s%s",str,"0");
  snprintf(str,elCount(str),"%s%X",str,Tx_Data[2]);
  diagResize(req1,3);
  for(i=0;i<3;i++)
    DiagSetPrimitiveByte(req1,i,Tx_Data[i]);
  _SendAndWriteReport(req1,msgID,1000);
  Len_Rx = diagGetRespPrimitiveSize(req1);
  if((diagGetLastResponseCode(req1) == passcondition) && (diagGetLastResponseCode(req1) == 0))
    testStepPass(str,"与期望一致无应答"); 
  if((diagGetLastResponseCode(req1) == passcondition) && (diagGetLastResponseCode(req1) != 0))
  {
    if(Len_Rx != LenEx)
    {
      Return_Value = -1;
      testStepFail(str,"长度异常,预期长度为%d，实际长度为%d",LenEx,Len_Rx);
    }
    else if((Len_Rx == LenEx))
      testStepPass(str,"长度与预期一致"); 
    if((DiagGetRespPrimitiveByte(req1,0) != (DiagGetPrimitiveByte(req1,0)^0x40)) ||DiagGetRespPrimitiveByte(req1,1)!=Tx_Data[1] ||DiagGetRespPrimitiveByte(req1,2)!=Tx_Data[2] )
    {
      Return_Value = -1;
      testStepFail(str,"前三字符存在异常,实际反馈为 0x%2X  0x%2X  0x%2X ",DiagGetRespPrimitiveByte(req1,0),DiagGetRespPrimitiveByte(req1,1),DiagGetRespPrimitiveByte(req1,2));
    }
    else
      testStepPass(str,"前三字符与预期一致");
    snprintf(Buffer,elCount(Buffer),"%s%s",Buffer,"0x");
    if(strlen(Rx_Data)!=0)
    {
      for(i=3;i<Len_Rx;i++)
      {
        ltoa(DiagGetRespPrimitiveByte(req1,i),Buffer,10);
        if(strlen(Buffer) == 1)
        {
          snprintf(Buffer_Check,200,"%s%s",Buffer_Check,"0");
        }
        snprintf(Buffer_Check,200,"%s%s",Buffer_Check,Buffer);
      }
      Temp_Return_Value = Check_information_(Buffer_Check,Rx_Data,str);
      if(Temp_Return_Value == -1)
        Return_Value = -1;
    }
    if(strlen(Rx_Data)==0)
      _WriteEx_and_Report(str,"未输入预期值，跳过内容检测");
  }
  else if(diagGetLastResponseCode(req1) != passcondition)
  {
    Return_Value = -1;
    testStepFail(str,"收到响应异常");
  }
  return Return_Value;
}
/*
  解析方式：将16进制整体转换为10进制
  msgID：寻址方式{phyreq_ID:物理寻址，funreq_ID:功能寻址}
  LenEx：预期响应长度
  Tx_Data：发送的数据
  Rx_Data：接收的数据
  passcondition：预期响应{-1:正响应,0:无响应,>0:消极响应码}
*/
int _Check_22DID_HexSplicing(dword msgID,dword LenEx,byte Tx_Data[],char Rx_Data[],int passcondition)/*16进制拼接*/
{
  diagRequest * req1; 
  char str[500];
  int i = 0, Len_Rx = 0;
  int flage = 0;
  qword Data_Temp = 0;
  int Return_Value,Temp_Return_Value;
  char Buffer[500];
  char Buffer_Check[500];
  Return_Value = 0;
  snprintf(str,elCount(str),"%s","");
  snprintf(Buffer,elCount(Buffer),"%s","");
  snprintf(Buffer_Check,elCount(Buffer_Check),"%s","");
  if(Tx_Data[1]<=0xF)
    snprintf(str,elCount(str),"%s%s",str,"0");
  snprintf(str,elCount(str),"%s%X",str,Tx_Data[1]);
  snprintf(str,elCount(str),"%s%s",str,"  ");
  if(Tx_Data[2]<=0xF)
    snprintf(str,elCount(str),"%s%s",str,"0");
  snprintf(str,elCount(str),"%s%X",str,Tx_Data[2]);
  diagResize(req1,3);
  for(i=0;i<3;i++)
    DiagSetPrimitiveByte(req1,i,Tx_Data[i]);
  _SendAndWriteReport(req1,msgID,1000);
  Len_Rx = diagGetRespPrimitiveSize(req1);
  if((diagGetLastResponseCode(req1) == passcondition) && (diagGetLastResponseCode(req1) == 0))
    testStepPass(str,"与期望一致无应答"); 
  if((diagGetLastResponseCode(req1) == passcondition) && (diagGetLastResponseCode(req1) != 0))
  {
    if(Len_Rx != LenEx)
    {
      Return_Value = -1;
      testStepFail(str,"长度异常,预期长度为%d，实际长度为%d",LenEx,Len_Rx);
    }
    else if((Len_Rx == LenEx))
      testStepPass(str,"长度与预期一致"); 
    if(strlen(Rx_Data)/2<=Len_Rx)
    {      
      if((DiagGetRespPrimitiveByte(req1,0) != (DiagGetPrimitiveByte(req1,0)^0x40)) ||DiagGetRespPrimitiveByte(req1,1)!=Tx_Data[1] ||DiagGetRespPrimitiveByte(req1,2)!=Tx_Data[2] )
      {
        Return_Value = -1;
        testStepFail(str,"前三字符存在异常,实际反馈为 0x%2X  0x%2X  0x%2X ",DiagGetRespPrimitiveByte(req1,0),DiagGetRespPrimitiveByte(req1,1),DiagGetRespPrimitiveByte(req1,2));
      }
      else
        testStepPass(str,"前三字符与预期一致");
      snprintf(Buffer,elCount(Buffer),"%s%s",Buffer,"0x");
      if(strlen(Rx_Data)!=0)
      {
        for(i=3;i<strlen(Rx_Data)/2+3;i++)
        {
          ltoa(DiagGetRespPrimitiveByte(req1,i),Buffer,16);
          if(strlen(Buffer) == 1)
          {
            snprintf(Buffer_Check,200,"%s%s",Buffer_Check,"0");
          }
          snprintf(Buffer_Check,200,"%s%s",Buffer_Check,Buffer);
        }
        toUpper(Buffer_Check, Buffer_Check, elcount(Buffer_Check));
        Temp_Return_Value = Check_information_(Buffer_Check,Rx_Data,str);
        if(Temp_Return_Value == -1)
          Return_Value = -1;
        if(strlen(Rx_Data)/2<Len_Rx-3)
        {
          _WriteEx_and_Report("","存在未使用的填充位");
          for(i=strlen(Rx_Data)/2+3;i<Len_Rx;i++)
          {
            if(DiagGetRespPrimitiveByte(req1,i) != UnUse_Byte)
            {
              flage = 1;Return_Value = -1;
              testStepFail(str,"未使用位填充值存在非预期情况，默认填充值为；0x%2X,第%d 位实际反馈值为:0x%2X",UnUse_Byte,i+1,DiagGetRespPrimitiveByte(req1,i));
            }
          }
          if(flage == 0)
            testStepPass(str,"未使用填充位为默认值0x%2X",UnUse_Byte);
        }
      }
      if(strlen(Rx_Data)==0)
        _WriteEx_and_Report(str,"未输入预期值，跳过内容检测");
    }
    else if(strlen(Rx_Data)/2>Len_Rx)
    {
      testStepFail(str,"长度异常");
      Return_Value = -1;
    }
  }
  else if(diagGetLastResponseCode(req1) != passcondition)
  {
    Return_Value = -1;
    testStepFail(str,"收到响应异常");
  }
  return Return_Value;
}
/*
  解析方式：前两字节为整体转换为10进制，后面为每个Byte分别转换为10进制
  msgID：寻址方式{phyreq_ID:物理寻址，funreq_ID:功能寻址}
  LenEx：预期响应长度
  Tx_Data：发送的数据
  Rx_Data：接收的数据
  passcondition：预期响应{-1:正响应,0:无响应,>0:消极响应码}
*/
int _Check_22DID_Mixed_DecALL_DecByte(dword msgID,dword LenEx,byte Tx_Data[],char Rx_Data[],int passcondition)/*混合解析BYD: F1 95*/
{
  diagRequest * req1; 
  char str[500];
  int i = 0, Len_Rx = 0;
  qword Data_Temp = 0;
  int Return_Value,Temp_Return_Value;
  char Buffer[500];
  char Buffer_1[500];
  char Buffer_Check[500];
  char Buffer_Check_1[500];
  Return_Value = 0;
  snprintf(str,elCount(str),"%s","");
  snprintf(Buffer,elCount(Buffer),"%s","");
  snprintf(Buffer_1,elCount(Buffer_1),"%s","");
  snprintf(Buffer_Check,elCount(Buffer_Check),"%s","");
  snprintf(Buffer_Check_1,elCount(Buffer_Check_1),"%s","");
  if(Tx_Data[1]<=0xF)
    snprintf(str,elCount(str),"%s%s",str,"0");
  snprintf(str,elCount(str),"%s%X",str,Tx_Data[1]);
  snprintf(str,elCount(str),"%s%s",str,"  ");
  if(Tx_Data[2]<=0xF)
    snprintf(str,elCount(str),"%s%s",str,"0");
  snprintf(str,elCount(str),"%s%X",str,Tx_Data[2]);
  diagResize(req1,3);
  for(i=0;i<3;i++)
    DiagSetPrimitiveByte(req1,i,Tx_Data[i]);
  _SendAndWriteReport(req1,msgID,1000);
  Len_Rx = diagGetRespPrimitiveSize(req1);
  if((diagGetLastResponseCode(req1) == passcondition) && (diagGetLastResponseCode(req1) == 0))
    testStepPass(str,"与期望一致无应答"); 
  if((diagGetLastResponseCode(req1) == passcondition) && (diagGetLastResponseCode(req1) != 0))
  {
    if(Len_Rx != LenEx)
    {
      Return_Value = -1;
      testStepFail(str,"长度异常,预期长度为%d，实际长度为%d",LenEx,Len_Rx);
    }
    else if((Len_Rx == LenEx))
      testStepPass(str,"长度与预期一致"); 
    if((DiagGetRespPrimitiveByte(req1,0) != (DiagGetPrimitiveByte(req1,0)^0x40)) ||DiagGetRespPrimitiveByte(req1,1)!=Tx_Data[1] ||DiagGetRespPrimitiveByte(req1,2)!=Tx_Data[2] )
    {
      Return_Value = -1;
      testStepFail(str,"前三字符存在异常,实际反馈为 0x%2X  0x%2X  0x%2X ",DiagGetRespPrimitiveByte(req1,0),DiagGetRespPrimitiveByte(req1,1),DiagGetRespPrimitiveByte(req1,2));
    }
    else
      testStepPass(str,"前三字符与预期一致");
    snprintf(Buffer,elCount(Buffer),"%s%s",Buffer,"0x");
    if(strlen(Rx_Data)!=0)
    {
      for(i=3;i<5;i++)
      {
        if(DiagGetRespPrimitiveByte(req1,i)>0x0F)
          snprintf(Buffer,elCount(Buffer),"%s%2X",Buffer,DiagGetRespPrimitiveByte(req1,i));
        else
        {
          snprintf(Buffer,elCount(Buffer),"%s%s",Buffer,"0");
          snprintf(Buffer,elCount(Buffer),"%s%X",Buffer,DiagGetRespPrimitiveByte(req1,i));
        }
      }
      strtoull(Buffer,Data_Temp);
      snprintf(Buffer_Check,elCount(Buffer_Check),"%s%I64u",Buffer_Check,Data_Temp);
      if(strstr(Rx_Data,",") != -1)
      { 
        snprintf(Buffer_Check_1,200,"%s%s",Buffer_Check_1,",");
        for(i=5;i<Len_Rx;i++)
        {
          ltoa(DiagGetRespPrimitiveByte(req1,i),Buffer_1,10);
          if(strlen(Buffer_1) == 1)
          {
           snprintf(Buffer_Check_1,200,"%s%s",Buffer_Check_1,"0");
          }
         snprintf(Buffer_Check_1,200,"%s%s",Buffer_Check_1,Buffer_1);
        }
      }
      else if(strstr(Rx_Data,",") == -1)
      {
        _WriteEx_and_Report("","未填充第二部分，跳过第二部分检测");
      }
      snprintf(Buffer_Check,300,"%s%s",Buffer_Check,Buffer_Check_1);
      Temp_Return_Value = Check_information_(Buffer_Check,Rx_Data,str);
      if(Temp_Return_Value == -1)
        Return_Value = -1;
    }
    if(strlen(Rx_Data)==0)
      _WriteEx_and_Report(str,"未输入预期值，跳过所有内容检测");
  }
  else if(diagGetLastResponseCode(req1) != passcondition)
  {
    Return_Value = -1;
    testStepFail(str,"收到响应异常");
  }
  return Return_Value;
}
/*
  是否需要进行特殊处理
  特殊处理返回 -1
  正常处理返回 1
*/
int _Check_BT_Double_Backup(dword ID,byte Temp_0[],byte Session)
{
  int Return_Value;
  int Len_Rx,Flage;
  char Temp_Str_0[300];
  
  Flage = 0;
  snprintf(Temp_Str_0,elCount(Temp_Str_0),"收到反馈值%s","");
  Return_Value = 1;
  
  if((strncmp(ECU_project,"BYD",strlen(ECU_project)) == 0) || @AUTO::Config_Switch == 1)
  {
    if(ID == phyreq_ID)
    {
      if( ((Session == prosession) && (BT_Double_Backup == 1)) && ((Temp_0[1]==0xF1 ) && Temp_0[2] == 0x95)) // BT下 F1/F2 95返回全0xFF
      {
        Return_Value = -1;
        _Send_Diag(3,ID,Temp_0,1000);
        Len_Rx = diagGetRespPrimitiveSize(SendData);
        _TestResult(SendData,ID,"",-1);
        for(i=0;i<Len_Rx;i++)
          snprintf(Temp_Str_0,elCount(Temp_Str_0),"%s %02X",Temp_Str_0,DiagGetRespPrimitiveByte(SendData,i));
        for(i=3;i<Len_Rx;i++)
        {
          if(DiagGetRespPrimitiveByte(SendData,i) != 0xFF)
          {
            Flage = 1;
            break;
          }
        }
        _WriteEx_and_Report("",Temp_Str_0);
        if(Flage==0)
          testStepPass("","反馈与预期一致为全0xFF");
        else
          testStepFail("","反馈与预期不一致存在非0xFF值");
      }
      if( ((Session == prosession) && (BT_Double_Backup == 1)) && ((Temp_0[2]==0x94 || Temp_0[2] == 0x95) && Temp_0[1] == 0xF2)) // BT下 F2 94/95存在不支持现象
      {
        Return_Value = -1;
        _Send_Diag(3,ID,Temp_0,1000);
        _TestResult(SendData,ID,"",0x31);
      }
    }
  }
  
  return Return_Value;
}
void _Check_DID_2E(dword ID,dword Session,dword Count)
{
  char str1[200];
  int n,flage;
  byte Temp_Data[100];
  word Read_DID;
  byte suprt_Read_DID;
  
  Read_DID = Read_2E_DID[1] <<8 | Read_2E_DID[2];
//  suprt_Read_DID = _Check_Fun_IDAndSess(0x22,Read_DID,ID,Session); //判断该DID是否在该会话可读
  
  flage = 0;
  snprintf(str1,elCount(str1),"%s","");
  snprintf(str1,elCount(str1),"%s","获取第一次发送数据: ");
  if(Count != 0)
    _SetSession(Session);
  for(n=0;n<DID_2E_SendData_1_Len;n++)
  {
    snprintf(str1,elCount(str1),"%s 0x%02X",str1,DID_2E_SendData_1[n]);
    Temp_Data[n] = DID_2E_SendData_1[n];
  }
  _WriteEx_and_Report("",str1);
  
  _unlockECU();
  
  testWaitForTimeout(500);
  _Send_Diag(DID_2E_SendData_1_Len,ID,DID_2E_SendData_1);
  _TestResult(SendData,ID,"",DID_2E_SendData_1_Response);
  if(DID_2E_SendData_1_Response == -1)
  {
    if(diagGetLastResponseCode(SendData) == -1)
    {
      if(Support_Read_2E_DID == 1)
      {
        if(@AUTO::Config_Switch == 5 || (strncmp(ECU_project,"SRM",strlen("SRM")) == 0 ))
        {
          _SetSession(defsession);
          testWaitForTimeout(200);
        }
        _Send_Diag(Read_2E_DID_Len,phyreq_ID,Read_2E_DID);
        _TestResult(SendData,ID,"",-1);
        for(n=1 ; n< DiagGetRespPrimitiveSize(SendData); n++)
        {
          if(DiagGetRespPrimitiveByte(SendData,n) != Temp_Data[n])
          {
            testStepFail("","第 %d 位,预期为 0x%02X , 实际为 0x%02X",n,Temp_Data[n],DiagGetRespPrimitiveByte(SendData,n));
            flage = 1;
          }
        }
        if(flage == 0)
          testStepPass("","反馈值与写入值一致");
      }
    }
    else
      _WriteEx_and_Report("","未收到正响应");
    
  }
  flage = 0;
  snprintf(str1,elCount(str1),"%s","");
  snprintf(str1,elCount(str1),"%s","获取第二次发送数据: ");
  
  _SetSession(Session);
  _unlockECU();
  
  for(n=0;n<DID_2E_SendData_2_Len;n++)
  {
    snprintf(str1,elCount(str1),"%s 0x%02X",str1,DID_2E_SendData_2[n]);
    Temp_Data[n] = DID_2E_SendData_2[n];
  }
  _WriteEx_and_Report("",str1);
  _Send_Diag(DID_2E_SendData_2_Len,ID,DID_2E_SendData_2);
  _TestResult(SendData,ID,"",DID_2E_SendData_2_Response);
  if(DID_2E_SendData_2_Response == -1)
  {
    if(diagGetLastResponseCode(SendData) == -1)
    {
      if(Support_Read_2E_DID == 1)
      {
        if(@AUTO::Config_Switch == 5 || (strncmp(ECU_project,"SRM",strlen("SRM")) == 0 ))
        {
          _SetSession(defsession);
          testWaitForTimeout(200);
        }
        _Send_Diag(Read_2E_DID_Len,phyreq_ID,Read_2E_DID);
        _TestResult(SendData,ID,"",-1);
        for(n=1 ; n< DiagGetRespPrimitiveSize(SendData); n++)
        {
          if(DiagGetRespPrimitiveByte(SendData,n) != Temp_Data[n])
          {
            testStepFail("","第 %d 位,预期为 0x%02X , 实际为 0x%02X",n,Temp_Data[n],DiagGetRespPrimitiveByte(SendData,n));
            flage = 1;
          }
        }
        if(flage == 0)
          testStepPass("","反馈值与写入值一致");
        _SetSession(Session);
      }
    }
    else
      _WriteEx_and_Report("","未收到正响应");
  }
}

_Check_Response_2E(diagRequest *Diag,dword LenInput,byte Tx_Data[])
{
  dword ReSize,i;
  byte Temp_Flage_1;
  i = 0;
  Temp_Flage_1=0;
  if(diagGetLastResponseCode(Diag) == 0)
    testWaitForDiagResponse(Diag,200);
  ReSize = DiagGetRespPrimitiveSize(Diag);
  if(diagGetLastResponseCode(Diag) == 0)
  {
    testStepFail("未收到响应");
    writeEx(-3,0,"未收到响应");
  }
  else if(diagGetLastResponseCode(Diag) > 0)
  {
    testStepFail("收到消极应答");
    writeEx(-3,0,"收到消极应答");
  }
  else if(diagGetLastResponseCode(Diag) == -1)
  {
    if(ReSize == LenInput)
      testStepPass("","反馈长度与预期一致");
    else
      testStepFail("","反馈长度与预期不一致,预期为：%d，实际为：%d",LenInput,ReSize);
    if(DiagGetRespPrimitiveByte(SendData,0)!=0x62)
      testStepFail("","反馈值与预期不一致,预期为0x%2X,实际为0x%2X",0x62,DiagGetRespPrimitiveByte(SendData,0));
    if((strncmp(ECU_project,"BYD",strlen(ECU_project)) == 0 && strlen(ECU_project) == strlen("BYD")) || @AUTO::Config_Switch == 1)
    {
      if(Tx_Data[0]==0x2E && Tx_Data[1] == 0xf1 && Tx_Data[2] == 0xa1)
      {
        for(i=3;i<LenInput-1;i++)
        {
          if(Tx_Data[i]!=0x00 && Tx_Data[i]!=0xFF)
            Temp_Flage_1 = 1;
        }
        if(Temp_Flage_1==1)
        {
          for(i=1;i<ReSize-1;i++)
          {
            if(DiagGetRespPrimitiveByte(SendData,i)!=Tx_Data[i])
              testStepFail("","第 %d 位,反馈值与预期不一致,预期为0x%2X,实际为0x%2X",i+1,Tx_Data[i],DiagGetRespPrimitiveByte(SendData,i));
            else
              testStepPass("","反馈值与预期一致");
          } 
        }
        else
        {
          if(DiagGetRespPrimitiveByte(SendData,ReSize-1)!=0x00)
            testStepFail("","第 %d 位,反馈值与预期不一致,预期为0x%X,实际为0x%X",ReSize,0x00,DiagGetRespPrimitiveByte(SendData,ReSize-1));
          else
            testStepPass("","反馈值与预期一致");
        }
      }
      else
      {
        for(i=1;i<ReSize;i++)
        {
          if(DiagGetRespPrimitiveByte(SendData,i)!=Tx_Data[i])
            testStepFail("","第 %d 位,反馈值与预期不一致,预期为0x%2X,实际为0x%2X",i+1,Tx_Data[i],DiagGetRespPrimitiveByte(SendData,i));
          else
            testStepPass("","反馈值与预期一致");
        }
      }
    }
    else
    {
      for(i=1;i<ReSize;i++)
      {
        if(DiagGetRespPrimitiveByte(SendData,i)!=Tx_Data[i])
          testStepFail("","第 %d 位,反馈值与预期不一致,预期为0x%2X,实际为0x%2X",i+1,Tx_Data[i],DiagGetRespPrimitiveByte(SendData,i));
        else
          testStepPass("","反馈值与预期一致");
      }
    }
  }
}
//_Check_Error_Count(dword ID)
//{
//  int i;
//  dword seed;
//  
//  _WriteEx_and_Report("","进行错误密钥计数");
//  for(i=1;i<=Error_Count;i++)
//  {
//    if(i==Error_Count)
//    {
//      _Send_Key(SendKey_Len,ID,_get_seed(ID),1);
//      _TestResult(SendData,ID,"",0x36);
//    }
//    else
//    {
//      _Send_Key(SendKey_Len,ID,_get_seed(ID),1);
//      _TestResult(SendData,ID,"",0x35);
//    }
//    Get_Seed_Flage = 1;
//  }
//}
/*
  检查错误计数
  Type = 0:请求错误种子直到0x36
  Type = 1:请求错误种子直到错误计数器满 -1
*/
void _Check_Error_Count(dword ID,byte Type)
{
  int i,count;
  _WriteEx_and_Report("","进行错误密钥计数");
  if(Type == 0)
    count = Error_Count;
  else if(Type == 1)
    count = Error_Count-1;
  for(i=1;i<=count;i++)
  {
    if(i==Error_Count)
    {
      _Send_Key(SendKey_Len,ID,_get_seed(ID),1);
      _TestResult(SendData,ID,"",0x36);
    }
    else
    {
      _Send_Key(SendKey_Len,ID,_get_seed(ID),1);
      _TestResult(SendData,ID,"",0x35);
    }
    Get_Seed_Flage = 1;
  }
}
_Set_Error_Count(dword ID,int Pose,byte session)
{
  int i;
  dword seed;
  int half_Count;
  half_Count = Pose;
  
  _WriteEx_and_Report("","进行错误密钥计数");
  for(i=1;i<=Error_Count;i++)
  {
    if(i==Error_Count)
    {
      _Send_Key(SendKey_Len,ID,_get_seed(ID),1);
      _TestResult(SendData,ID,"",0x36);
    }
    else
    {
      _Send_Key(SendKey_Len,ID,_get_seed(ID),1);
      _TestResult(SendData,ID,"",0x35);
    }
    if(Error_Count_Power == 1 && i == half_Count) //错误计数为half_Count时：下电
    {
      testWaitForTimeout(Error_Count_Delay*0.3);
      _K15_OFF();
      testWaitForTimeout(2000);
      _K15_ON();
      testWaitForTimeout(1000);
      _SetSession(session);
      if(Restoration_Error_Count == 1)
        i = 1;
      Error_Count_Power = 0;
      continue;
    }
    else if(Error_Count_Reset == 1 && i == half_Count) //错误计数为half_Count时：重启
    {
      byte Temp[2] ={0x11,0x01};
      int Serve_Pos;
      Serve_Pos = _Check_Serve(0x11,0,0);
      Temp[1] = Serve_Data[Serve_Pos].Serve_Fun[0];
      testWaitForTimeout(Error_Count_Delay*0.3);
      _Send_Diag(2,phyreq_ID,Temp);
      _TestResult(SendData,ID,"",-1);
      testWaitForTimeout(2000);
      _SetSession(session);
      if(Restoration_Error_Count == 1)
        i = 1;
      Error_Count_Reset = 0;
      continue;
    }
    Get_Seed_Flage = 1;
  }
}
int Check_information_(char Rev[],char Ex[],char str[])  //实测结果，预期结果，输出信息
{
  int Return_Value;
  if(strncmp(Ex,Rev,strlen(Rev)) == 0 && strlen(Ex) == strlen(Rev))
  {
    writeEx(-3,0,"%s",str);
    writeEx(-3,0,"/---------------Pass------------------/");
    writeEx(-3,0,"        预期版本 = %s",Ex);
    writeEx(-3,0,"        实测版本 = %s",Rev);
    writeEx(-3,0,"/------------------------------------/");
    testStepPass(str,"预期结果=%s \n 实际结果=%s",Ex,Rev);
//    write("%s",Rev);
    Return_Value = 0;
  }
  else
  {
    writeEx(-3,0,"%s",str);
    writeEx(-3,0,"/--------------Error-----------------/");
    writeEx(-3,0,"        预期版本 = %s",Ex);
    writeEx(-3,0,"        实测版本 = %s",Rev);
    writeEx(-3,0,"/------------------------------------/");
    testStepFail(str,"预期结果=%s \n 实际结果=%s",Ex,Rev);
//    write("%s",Rev);
    Return_Value = -1;
  } 
  return Return_Value;
}
char HexToAsc(char data)
{
  int i;
  char ASCII_0[26]={'A','B','C','D','E','F','G','H','I','J','K','L','M','N','O','P','Q','R','S','T','U','V','W','X','Y','Z'};
  char ASCII_1[26]={'a','b','c','d','e','f','g','h','i','j','k','l','m','n','o','p','q','r','s','t','u','v','w','x','y','z'};
  char ASCII_2[10]={'0','1','2','3','4','5','6','7','8','9'};
  char ASCII_3[6]={':',';','<','=','>','?'};
  char ASCII_4[15]={'!','"','#','$','%','&','`','(',')','*','+',',','-','.','/'};
  char ASCII_5[3]={']','^','_'};
  
  
  if(data>=0x21 && data<=0x2f)
  {
    for(i=0;i<15;i++)
    {
      if(data == i+33) { data = ASCII_4[i];}
    }
  }  
  else if(data>=0x30 && data<=0x39)
  {
    for(i=0;i<10;i++)
    {
      if(data == i+48) {data = ASCII_2[i];}
    }
  }
  else if(data>=0x3a && data<=0x3f)
  {
    for(i=0;i<6;i++)
    {
      if(data == i+58){data = ASCII_3[i];}
    }
  }
  else if(data>=0x41 && data<=0x5A)
  {
    for(i=0;i<26;i++)
     {
       if(data == i+65) {data = ASCII_0[i];}
     }
  }
  else if(data>=0x5D && data<=0x5f)
  {
    for(i=0;i<3;i++)
    {
      if(data == i+93) { data = ASCII_5[i];}
    }
  }
  else if(data>=0x61 && data<=0x7A)
  {
    for(i=0;i<26;i++)
    {
      if(data == i+97) {data = ASCII_1[i];}
    }
  }
  else if(data == 0x20)
    data = 0x20;
  else if(data == 0x00)
    data = 0x00;
  else if(data == 0x5B)
    data = '[';
  else if(data == 0x7B)
    data = '{';
  else if(data == 0x7D)
    data = '}';
  return data;
}
byte _MsgSave_To_Value(int passcondition)
{
  int resNum,i,j,allRes_i;
  int checkResult;
  word allRes[500];
  word dlc,allRes_length;
  byte NRC;
  int SF_Flage;
  byte Byte0_H;
  byte Byte0_L;
  dlc =8;
  _saveMsg(p2cmax);
  checkResult = 0;
  for(i = 0; i< 10; i++)//获取当前响应码序列长度
  {
    if(responseMsgs[i].dlc == 0)
      break;
    else if(responseMsgs[i].byte(0) == 0x03 && responseMsgs[i].byte(1) == 0x7f && responseMsgs[i].byte(3) == 0x78 )//响应78不存入验证数组
    {
      allRes_i++;
      resNum--;
    }
    else if(responseMsgs[i].byte(0) == 0x30 )  //流控帧不计入数组
    {
      allRes_i++;
      resNum--;
    }
    else
    {
      for(j = 0; j < dlc ; j++)
        allRes[((i-allRes_i)*dlc)+j] = responseMsgs[i].byte(j);
    }  
    resNum++;
  }
  allRes_length = resNum * dlc;
  if( allRes_length > 0)// 需注意区分单帧和首帧
  {
    int Len_Rx;
    int jump;
    jump = 0;
    Byte0_H = allRes[0]>>4;
    Byte0_L = allRes[0]&0xF;
    if(Byte0_H==0)
      SF_Flage = 1;
    else
      SF_Flage =0;
    if(SF_Flage == 1 && Byte0_L==0)
      Len_Rx = allRes[1];
    else if(SF_Flage == 1 &&Byte0_L!=0)
      Len_Rx = Byte0_L;
    else if(SF_Flage == 0 )
      Len_Rx = Byte0_L*256+allRes[1];
    for(i=1;i<Len_Rx;i++)
    {
      if(i%8==0)
      {
        jump++;
        continue;
      }
      Data_Rev[i-jump-1] = allRes[i];
    }
    if(SF_Flage == 1 && Byte0_L!=0)
    {
      if(allRes[1]==0x7F)
        NRC=allRes[3];
    }
    else if(SF_Flage == 1 && Byte0_L==0)
    {
      if(allRes[2]==0x7F)
        NRC=allRes[4];
    }
    else if(SF_Flage == 0)
    {
      if(allRes[2]==0x7F)
        NRC=allRes[4];
    }
    else
      NRC=-1;
  }
  writeEx(-3,0," allRes = 0x%02X",allRes[0]);
  writeEx(-3,0," allRes = 0x%02X",allRes[1]);
  writeEx(-3,0," allRes = 0x%02X",allRes[2]);
  writeEx(-3,0," allRes = 0x%02X",allRes[3]);
  writeEx(-3,0," allRes = 0x%02X",allRes[5]);
  writeEx(-3,0," passcondition = %d",passcondition);
  writeEx(-3,0," NRC = %d",NRC);
  if(passcondition==-1 && NRC ==-1)
    testStepPass("","预期收到正响应,实际收到正响应");
  else if(passcondition==0 && allRes_length==0)
    testStepPass("","预期无响应,实际无响应");
  else if(passcondition == NRC && passcondition!=-1)
    testStepPass("","预期收到NRC 0x%2X,实际收到NRC 0x%2X",passcondition,NRC);
  else
    testStepFail("","预期反馈数据与实际不符");
  resNum = 0;
  allRes_i = 0;
  for(i = 0; i < 500 ; i++)
    allRes[i] = 0;
  for(i = 0; i < 500 ; i++)
    Data_Rev[i] = 0;
  _initMsg(responseMsgs);
  return NRC;
}
/*
  将接受到的所有报文装载到responseMsgs中
  且第一帧在50ms，后续帧通过参数time来控制
*/
void _saveMsg(int time)
{
  byte i,j;
  int flag_getMsg;
  flag_getMsg = _getMsg(responseMsgs[0],time);
  if(flag_getMsg == 1)
  {
    for(i = 1; i < 10; i++)
    {
      _getMsg(responseMsgs[i],200);
      if(responseMsgs[i].dlc == 0)
        break;
    }
  }
}
/*
  获取报文，判断报文响应时间是否在目标时间time内
*/
int _getMsg(message 0x00 msg,int time)
{
  char comment[50];
  byte i;
  int re;
  int resave;
  int flag_getMsg;//判断有没有获取到报文
  TestJoinMessageEvent(Response_ID);
  re = testWaitForMessage(Response_ID,time);
  if(re)
  {
    testGetWaitEventMsgData(msg);
    snprintf(comment,elCount(comment),"已收到报文");
    for(i=0;i<8;i++)
    {
      snprintf(comment,elCount(comment),"%s %02X",comment,msg.byte(i));
    }
    resave++;
    flag_getMsg = 1;
  }
  else
  {
    flag_getMsg = 0;
  }
  if(re == 0 && resave == 0)
  {
    if(noFail == 0)
      TestStepFail("报文响应超时");
  }
  return flag_getMsg;
}


int _CheckCode(int passcondition,int checkLength)
{
  int resNum,i,j,allRes_i;
  int checkResult;
  word allRes[100];
  word dlc = 8,allRes_length;
  checkResult = 0;
  for(i = 0; i< 10; i++)//获取当前响应码序列长度
  {
    if(responseMsgs[i].dlc == 0)
    {
      break;
    }
    else if(responseMsgs[i].byte(0) == 0x03 && responseMsgs[i].byte(1) == 0x7f && responseMsgs[i].byte(3) == 0x78 && NRC78_flag == 0)//响应78不存入验证数组
    {
      allRes_i++;
      resNum--;
    }
    else if(responseMsgs[i].byte(0) == 0x30)  //流控帧不计入数组
    {
      allRes_i++;
      resNum--;
    }
    else
    {
      for(j = 0; j < dlc ; j++)
      {
        allRes[((i-allRes_i)*dlc)+j] = responseMsgs[i].byte(j);
      }
    }  
    resNum++;
  }
  allRes_length = resNum * dlc;
  if((AES_128==1 || @AUTO::Security_Switch==2) && allRes_length > 0)//Geely 3.0 将响应的种子存入seed    需注意区分CAN与CANFD
  {
    word inx;
    inx = 4;
    if(@sysvar::AUTO::CANFD_Switch==0)
    {
      for(j = 0; j < 16; j++)
      {
        Seed_AES[j] = allRes[j+inx];
        if(j == 3)
          inx = 5;
        if(j == 10)
          inx = 6;
      }
    }
    else
    {
      for(j = 0; j < 16; j++)
        Seed_AES[j] = allRes[j+inx];
    }
    inx = 4;
  }
  if(passcondition == -1)
    testStepPass("收到肯定响应");
  else if(passcondition == 0)
    testStepfail("无响应");
  else
    testStepfail("收到否定响应");
  resNum = 0;
  allRes_i = 0;
  NRC78_flag = 0;
  for(i = 0; i < 100 ; i++)
    allRes[i] = 0;
  _initMsg(responseMsgs);
  return checkResult;
}

/*2702密钥填充：type:0:正确密钥  1:错误密钥*/
void _padding2702(int type,diagRequest* sendkey)
{
//  word fixByte_[16] = {0x40,0x21,0x07,0x49,0x10,0xD0,0x27,0x15,0x2A,0x19,0x0F,0x1F,0xAC,0x3E,0xFD,0x75};
  word key_i;
//  int App_Sts = -1;
//  App_Sts = Check_APPValid();
  
  if(type == 0)
  {
//    if(@AUTO::Config_Switch == 4)//吉利3.0掩码
//       if(Session_BIN == 2)
//        _SecurityAccess_AES(Seed_AES,fixByte_Geely_Bt,corresKey);
//      else
//        _SecurityAccess_AES(Seed_AES,fixByte_Geely_APP,corresKey);
//    else if(@AUTO::Config_Switch == 6)//瑞驰掩码
//      _SecurityAccess_AES(Seed_AES,fixByte_RC_BT,corresKey);
//    else if(@AUTO::Config_Switch == 11)
//      _SecurityAccess_AES(Seed_AES,fixByte_Chery_BT,corresKey);
//    else if(@AUTO::Config_Switch == 2)//长安掩码
//      _SecurityAccess_AES(Seed_AES,fixByte_CCAG_APP,corresKey);
    _Key_Count();
    for(key_i = 0; key_i < 16; key_i++)
      DiagSetPrimitiveByte(sendkey,key_i+2,corresKey[key_i]);
  }
  else
  {
    for(key_i = 0; key_i < 16; key_i++)
      DiagSetPrimitiveByte(sendkey,key_i+2,0x00);
  }
}


/* 
  操作完后将responseMsgs重置
*/
void _initMsg(message 0x00 msg[])
{
  message 0x00 init_msg;
  word i,j;
  for(i = 0; i < elCount(msg); i++)
    msg[i] = init_msg;
}

/*数组左移*/
void LeftMove(byte Serial_Num[],byte bit)
{
  dword i;
  byte carry;
  byte nextcarry;
  carry = 0;
  nextcarry = 0;
  for(i=15;i>=0;i--)
  {
    nextcarry = Serial_Num[i] >> (8 - bit);
    Serial_Num[i] = (Serial_Num[i] << bit) | carry;
    carry = nextcarry;
  }
}
/*数组逆向*/
void reverseNum(byte num[],dword size)
{
  dword startnum;
  dword temp;
  dword endnum;
  
  startnum = 0;
  endnum = size - 1;
  while(startnum < endnum)
  {
    temp = num[startnum];
    num[startnum] = num[endnum];
    num[endnum] = temp;
    startnum++;
    endnum--;
  }
}
_Clear_SendData(byte Send_Data[])
{
  int k;
  for(k=0;k<elcount(Send_Data);k++)
    Send_Data[k] = Send_filler;
}
_Get_31_ServeData(dword Serve_Poss,byte Send_Data[],byte type,byte Ctrl_Type_Pos) //
{
  byte Init_len;
  Init_len = 4;
  _Clear_SendData(Send_Data);
  Send_Data[0] = 0x31;
  if(type != 1)
  {
    Send_Data[1] = Serve_31_Hex[Serve_Poss].Control_Type[Ctrl_Type_Pos];
    Send_Data[2] = Serve_31_Hex[Serve_Poss].Routine[0];
    Send_Data[3] = Serve_31_Hex[Serve_Poss].Routine[1];
  }
  Len_31H = Serve_31_Hex[Serve_Poss].Control_Type_TxLen[Ctrl_Type_Pos];
 
  if(Serve_31_Hex[Serve_Poss].Control_Option_Count[0] != 0)
  {
    Init_len = 5;
    Send_Data[4] = Serve_31_Hex[Serve_Poss].Control_Option[0][0];
  }
  if(Len_31H == 4)
    return;
  else if(Len_31H == 6)
  {
    int n;
    word Temp_crc16;
    Temp_crc16 = random(0xFFFF);
    Send_Data[4] = (Temp_crc16 >> 8) & 0xFF;
    Send_Data[5] = Temp_crc16 & 0xFF;
    
  }
  else if(Len_31H == 8)
  {
    int n;
    word Temp_crc16_H;
    word Temp_crc16_L;
    Temp_crc16_H = random(0xFFFF);
    Temp_crc16_L = random(0xFFFF);
    Send_Data[4] = (Temp_crc16_H >> 8) & 0xFF;
    Send_Data[5] = Temp_crc16_H & 0xFF;
    Send_Data[6] = (Temp_crc16_L >> 8) & 0xFF;
    Send_Data[7] = Temp_crc16_L & 0xFF; 
  }
  
  if(Send_Data[2] == 0xFF && (Send_Data[3] == 0x00 || Send_Data[3] == 0x01))
  {
    int n;
    byte Address_Len,Length_Len;
    dword Temp_Address_Set,Temp_Length_Set;
    word Temp_crc16;
	  Address_Len = 4;Length_Len = 4;
    if(Send_Data[1] != 0x01)
    {
      Len_31H = Serve_31_Hex[Serve_Poss].Control_Type_TxLen[Ctrl_Type_Pos];
      return;
    }
    if(Send_Data[3] == 0x01 &&  ((strncmp(ECU_project,"Chery",strlen("Chery")) == 0 )|| @AUTO::Config_Switch == 7))
    {
      Len_31H = Serve_31_Hex[Serve_Poss].Control_Type_TxLen[Ctrl_Type_Pos];
      Temp_crc16 = random(0xFFFF);
      Send_Data[12] = (Temp_crc16 >> 16) & 0xFF;
      Send_Data[13] = Temp_crc16 & 0xFF;
    } 
    _Get_0x34("BT_34_Address","BT_34_Length");
    if(type == 0)
    {
      do{
        Temp_Address_Set = random(@Test::BT_34_Add_End);
      }while(Temp_Address_Set<=@Test::BT_34_Add_Start || Temp_Address_Set>=@Test::BT_34_Add_End);
      do{
        Temp_Length_Set = random(@Test::BT_34_Len_End);
      }while(Temp_Length_Set<=@Test::BT_34_Len_Start || Temp_Length_Set>=@Test::BT_34_Len_End);
    }
    else if(type == 1)
    {
      Temp_Address_Set = 0xFFFFFFFF;
      Temp_Length_Set = 0xFFFFFFFF;
    }
    else if(type == 2)
    {
      Temp_Address_Set = @Test::BT_34_Add_Start;
      Temp_Length_Set = @Test::BT_34_Len_End;
    }
    
    for(n=0;n<Address_Len;n++)
    {
      Send_Data[n+Init_len] = (Temp_Address_Set>>((Address_Len -n-1)*8)) & 0xFF;
    }
    for(n=0;n<Length_Len;n++)
    {
      Send_Data[n+Init_len+Address_Len] = (Temp_Length_Set>>((Length_Len -n-1 )*8))&0xFF;
    }
  
  }
}
/*
  检测输入数据是否在31结构体中
  Send_Data[];输入数组
*/
int _Check_SendData_In_31H(byte Send_Data[])
{
  int Return_Value;
  int m,Routine_Pos,Type_Pos;
  Routine_Pos = -1;
  Type_Pos = -1;
  for(m=0;m<Serve_31_Hex_Count;m++)
  {
    if((Serve_31_Hex[m].Routine[0] == Send_Data[2]) && (Serve_31_Hex[m].Routine[1] == Send_Data[3]))
    {
      Routine_Pos = m;
      break;
    }
  }
  if(m == Serve_31_Hex_Count)
    return -1;
//  for(m=0;m<Serve_31_Hex[Routine_Pos].Control_Type_Count;m++)
//  {
//    if(Serve_31_Hex[Routine_Pos].Control_Type[m] == Send_Data[1])
//    {
//      Type_Pos = m;
//      break;
//    }
//  }
  Return_Value = Routine_Pos;
  return Return_Value;
}
_get_NRC11(dword ID)
{
  message 0x00 msg;
  double starttime;
  double endtime1;
  double endtime2;
  byte result;
  byte sid;
  sid=DiagGetPrimitiveByte(SendData,0);
  starttime=(double)timeNow()/100;
  result=testWaitForMessage(Response_ID,p2cmax);
  if(ID==phyreq_ID)
  {
    if(result==1)
    {
      endtime1=(double)timeNow()/100;
      testGetWaitEventMsgData(msg);
      if((msg.byte(0)==0x03)&&(msg.byte(1)==0x7F)&&(msg.byte(2)==sid)&&(msg.byte(3)==0x11))
      {
        testStepPass("","收到否定响应NRC11");
        if((endtime1-starttime)<=p2cmax)
          testStepPass("","NRC11实际响应时间为%fms",endtime1-starttime);
        else
          testStepFail("","NRC11实际响应时间为%fms",endtime1-starttime);
      }
      else
        testStepFail("","收到非NRC11响应");
    }
    else
    {
      testStepFail("","未在规定时间内收到响应");
      return;
    }
  }
  else if(ID == funreq_ID)
  {
    if(result==1)
    {
      endtime1=(double)timeNow()/100;
      testGetWaitEventMsgData(msg);
      if((msg.byte(0)==0x03)&&(msg.byte(1)==0x7F)&&(msg.byte(2)==sid)&&(msg.byte(3)==0x11))
      {
        testStepFail("","收到否定响应NRC11");
        if((endtime1-starttime)<=p2cmax)
          testStepPass("","NRC11实际响应时间为%fms",endtime1-starttime);
        else
          testStepFail("","NRC11实际响应时间为%fms",endtime1-starttime);
      }
      else
        testStepFail("","收到非NRC11响应");
    }
    else
    {
      testStepPass("","功能寻址下NRC11不响应");
      return;
    }
  }
}
/***************************NRC优先级暂无优化策略**************************/
/*
  type == 0:均无效
  type == 2：均有效
  type == 3：地址无效
  type == 4：长度无效
*/
_Get_Invalid_Data(dword Serve_Poss,byte Send_Data[],byte type)  //Data无效
{
  int n;
  byte Address_Len,Length_Len;
  qword Temp_Address_Set,Temp_Length_Set;
  qword Add_End;
  qword BT_34_Address[2];
  qword BT_34_Length[2];
  byte Init_len;
  Init_len = 4;
  
  _Get_0x34("BT_34_Address","BT_34_Length");
  if(@AUTO::Config_Switch == 12 && (type == 2 || type == 3 || type == 4) && Send_Data[2] == 0xFF && Send_Data[3] == 0x00) //广汽测试Flash段
  {
    _Get_0x34("BT_Flash_Address","BT_Flash_Length");
  }
  Address_Len = Len_34_Addr;
  Length_Len = Len_34_Length;
  
  if(Serve_31_Hex[Serve_Poss].Control_Option_Count[0] != 0)
  {
    Init_len = 5;
  }
  
  if(type == 0)
  {
    Temp_Address_Set =0xFFFFFFFF;
    Temp_Length_Set = 0xFFFFFFFF;
  }
  else if( type == 1)
  {
    do{
       Temp_Address_Set = random(@Test::BT_34_Add_End);
     }while(Temp_Address_Set<=@Test::BT_34_Add_Start || Temp_Address_Set>=@Test::BT_34_Add_End);
    do{
      Temp_Length_Set = random(@Test::BT_34_Len_End);
    }while(Temp_Length_Set<=@Test::BT_34_Len_Start || Temp_Length_Set>= @Test::BT_34_Len_End);
  }
  else if( type == 2)
  {
    Temp_Address_Set = @Test::BT_34_Add_Start;
    Temp_Length_Set = @Test::BT_34_Len_End;
  }
  else if( type == 3)
  {
    Temp_Address_Set = 0xFFFFFFFF;
    Temp_Length_Set = @Test::BT_34_Len_End;
  }
  else if( type == 4)
  {
    Temp_Address_Set = @Test::BT_34_Add_Start;
    Temp_Length_Set = 0xFFFFFFFF;
  }
  
  for(n=0;n<Address_Len;n++)
    Send_Data[n+Init_len] = (Temp_Address_Set>>((Address_Len -n-1)*8))&0xFF;
  for(n=0;n<Length_Len;n++)
    Send_Data[n+Init_len+Address_Len] = (Temp_Length_Set>>((Length_Len -n-1 )*8))&0xFF;
}
word _Get_Invalid_RID(word Pos)   //RID无效
{
  int n,m;
  byte hash[0xFF+1][0xFF+1];
  for(m=0;m<Serve_31_Hex_Count;m++) 
  {
    hash[Serve_31_Hex[m].Routine[0]][Serve_31_Hex[m].Routine[1]] = 1;
  }
  for(n=1;n<=0xFF;n++)
  {
//    for(m=0;m<Serve_31_Hex_Count;m++)
//    {
//      if( n == Serve_31_Hex[m].Routine[1])
//        break;
//    }
//    if(m >= Serve_31_Hex_Count)
//      return n;
    if((hash[(Pos >> 8) & 0xFF][n]) != 1) return n;
  }
   return 0;
}
byte _Get_Invalid_RID_Control_Type(word Pos)   //RID控制类型无效
{
  int n,m,Serve_Pos;
  for(i=0;i<Serve_31_Hex_Count;i++)
  {
    if(Serve_31_Hex[i].Routine[0] == ((Pos >> 8) & 0xFF) && Serve_31_Hex[i].Routine[1] == (Pos & 0xFF))
      break;
  }
  Serve_Pos = i;
  for(n=1;n<=0xFF;n++)
  {
    for(m=0;m<Serve_31_Hex[Serve_Pos].Control_Type_Count;m++)
    {
      if(n==Serve_31_Hex[Serve_Pos].Control_Type[m])
        break;
    }
    if(m>= Serve_31_Hex[Serve_Pos].Control_Type_Count)
      return n;
  }
  return 0;
}
/*
  获取控制选项
 Type = 0:获取无效的控制选项
 Type = 1:获取正常的控制选项
*/
byte _Get_Invalid_RID_Control_Option(byte Serve,word Pos,byte Type)  
{
  int n,m;
  int i,RID_Pos_,Control_Type_Pos;
  byte Data[2];
  Data[0] = (Pos>>8)&0xFF;
  Data[1] = Pos &0xFF;
  for(i=0;i<Serve_31_Hex_Count;i++)
  {
    if((Serve_31_Hex[i].Routine[0] == Data[0]) && (Serve_31_Hex[i].Routine[1] == Data[1]))
    {
      RID_Pos_ = i;
      break;
    }
  }
  Pos = RID_Pos_;
  for(m=0;m<Serve_31_Hex[Pos].Control_Type_Count;m++)
  {
    if(Serve_31_Hex[Pos].Control_Type[m] == Serve)
      break;
  }
  Control_Type_Pos = m;
  if(m>=Serve_31_Hex[Pos].Control_Type_Count)
    Control_Type_Pos = 0;
  if(Type == 0)
  {
    if(Data[0] == 0xFF)
    {
      return Serve_31_Hex[Pos].Control_Option[Control_Type_Pos][0] - 1;
    }
    else
    {
      for(m=0;m<0xFF;m++)
      {
        for(n=0;n<Serve_31_Hex[Pos].Control_Option_Count[Control_Type_Pos];n++)
        {
          if(m==Serve_31_Hex[Pos].Control_Option[Control_Type_Pos][n])
            break;
        }
        if(n >= Serve_31_Hex[Pos].Control_Option_Count[Control_Type_Pos])
          return m;
      }
    }
  }
  else
  {
    return Serve_31_Hex[Pos].Control_Option[Control_Type_Pos][0];
  }
  return 0;
}

/*
  获取NRC22条件并进行设置
  Serve: 服务
  Fun：子功能
  Type = 0：满足NRC22条件
  Type = 1：恢复NRC22条件
  Type = 2：查询NRC22条件
*/
int _Set_NRC22(byte Serve, dword Fun,byte Type)
{
  int Serve_Pos_22,Fun_Pos_22,Loop_22,NRC22_Flage;
  int Temp_NRC22;
  char Str_22[50];
  NRC22_Flage = 0;
  snprintf(Str_22,elCount(Str_22),"%s","");
  Fun_Pos_22 = -1;
  Serve_Pos_22 = -1;
  if(Fun<=0xFF)
    snprintf(Str_22,elCount(Str_22),"%s0x%02X 0x%02X",Str_22,Serve,Fun);
  else
    snprintf(Str_22,elCount(Str_22),"%s0x%02X 0x%02X 0x%02X",Str_22,Serve,(Fun>>8),(Fun & 0xFF));
  if((Serve != 0x01) && (Serve != 0x03))
  {
    Serve_Pos_22 = _Check_Serve(Serve,Fun,0);
    Fun_Pos_22 = _Check_Serve(Serve,Fun,4);
    if(Serve == 0x14)
      Fun_Pos_22 = 0;
    if(Fun_Pos_22 == -1)
    {
      _WriteEx_and_Report(Str_22,"未查询到该子功能");
      return -1;
    }
    else
    {
      for(Loop_22 = 0; Loop_22 < Serve_Data[Serve_Pos_22].Serve_NRC_Count[Fun_Pos_22];Loop_22++)
      {
        if(Serve_Data[Serve_Pos_22].Serve_NRC[Fun_Pos_22][Loop_22] == 0x22) //获取到NRC22在NRC列表中所在位置
        {
          NRC22_Flage = 1;
          break;
        }
      }
      if(NRC22_Flage == 0)
      {
        _WriteEx_and_Report(Str_22,"未查询到NRC22条件");
        return -1;
      }
      else
      {
        Temp_NRC22 = Serve_Data[Serve_Pos_22].Serve_NRC22[Fun_Pos_22];
        if(Type == 2)
        {
          return Temp_NRC22;  //提前结束返回，不进行操作
        }
        if(Type == 0)//满足NRC22
        {
          if((Temp_NRC22 & 0x1) != 0)//车速
          {
            _Set_CarSpd(NRC22_CarSpd+1);
            return 1;
          }
          else if((Temp_NRC22 & 0x20) != 0 ) //发动机
          {
            _Set_Ready(Ready_Active);
            return 0x20;
          }
          else if((Temp_NRC22 & 0x08) != 0 ) //档位
          {
            _Set_Gears(NRC_22_Gears_Normal+1);
            return 8;
          }
          else if((Temp_NRC22 & 0x02) != 0 ) //电压
          {
            _Set_Battery(NRC22_Battery_Hight+1);
            return 2;
          }
          else if((Temp_NRC22 & 0x04) != 0 ) //手力矩
          {
            diagStartTesterPresent(Cdd_Name);
            TestWaitForTesterConfirmation("控制手力矩为",NRC22_TasTorque+1);
            diagStopTesterPresent(Cdd_Name);
            return 4;
          }
          else if(Serve==0x10 && Fun==0x02)
          {
            /*10 02预编程*/
            return 0x80;
          }
          else
            return 0;
        }
        else if(Type == 1)//恢复NRC22
        {
          if((Temp_NRC22 & 0x1) != 0)//车速
          {
            _Set_CarSpd(0);
            return 0;
          }
          else if((Temp_NRC22 & 0x20) != 0 ) //发动机
          {
            _Set_Ready(0);
            return 0;
          }
          else if((Temp_NRC22 & 0x08) != 0 ) //档位
          {
            _Set_Gears(NRC_22_Gears_Normal);
            return 0;
          }
          else if((Temp_NRC22 & 0x02) != 0 )//电压
          {
            _Set_Battery(12);
            return 0;
          }
          else if((Temp_NRC22 & 0x04) != 0 )//手力矩
          {
            TestWaitForTesterConfirmation("松开方向盘",10000);
            return 0;
          }
          else if(Serve==0x10 && Fun==0x02)
          {
            /*10 02预编程*/
            _Pre_Programmed();
            return 0;
          }
        }
      }
    }
  }
  else
  {
    byte Da_1,Da_2;
    Da_1 = (Fun>>8)&0xFF;
    Da_2 = Fun&0xFF;
    for(Loop_22=0;Loop_22<Serve_31_Hex_Count;Loop_22++)
    {
      if((Serve_31_Hex[Loop_22].Routine[0] == Da_1) && (Serve_31_Hex[Loop_22].Routine[1] == Da_2))
      {
        Fun_Pos_22 = Loop_22;
        break;
      }
    }
    if(Fun_Pos_22 == -1)
    {
      _WriteEx_and_Report("","未查询到对应RID");
      return -1;
    }
    for(Loop_22=0;Loop_22<Serve_31_Hex[Fun_Pos_22].Control_Type_Count;Loop_22++)
    {
      if(Serve_31_Hex[Fun_Pos_22].Control_Type[Loop_22] == Serve)
      {
        Serve_Pos_22 = Loop_22;
        break;
      }
    }
    if(Serve_Pos_22 == -1)
    {
      _WriteEx_and_Report("","未查询到对应控制类型");
      return -1;
    }
    NRC22_Flage = _Check_Serve(Serve,Fun,10);
    {
      Temp_NRC22 = NRC22_Flage;
      if(Type == 2)
        return Temp_NRC22;  //提前结束返回，不进行操作
      if(Temp_NRC22 == 0)
      {
        _WriteEx_and_Report("","无NRC22条件");
        return -1;
      }
      if(Type == 0)//满足NRC22
      {
        if((Temp_NRC22 & 0x1) != 0)//车速
        {
          _Set_CarSpd(NRC22_CarSpd+1);
          return 1;
        }
        else if((Temp_NRC22 & 0x20) != 0 ) //发动机
        {
          _Set_Ready(Ready_Active);
          return 0x20;
        }
        else if((Temp_NRC22 & 0x08) != 0 ) //档位
        {
          _Set_Gears(NRC_22_Gears_Normal+1);
          return 8;
        }
        else if((Temp_NRC22 & 0x02) != 0 ) //电压
        {
          _Set_Battery(NRC22_Battery_Hight+1);
          return 2;
        }
        else if((Temp_NRC22 & 0x04) != 0 ) //手力矩
        {
          TestWaitForTesterConfirmation("控制手力矩为",NRC22_TasTorque+1);
          return 4;
        }
        else if((Temp_NRC22 & 0x10) != 0 ) //传感器
        {
          TestWaitForTesterConfirmation("拔掉传感器");
          return 16;
        }
      }
      else if(Type == 1)//恢复NRC22
      {
        if((Temp_NRC22 & 0x1) != 0)//车速
        {
          _Set_CarSpd(0);
          return 0;
        }
        else if((Temp_NRC22 & 0x20) != 0 ) //发动机
        {
          _Set_Ready(0);
          return 0;
        }
        else if((Temp_NRC22 & 0x08) != 0 ) //档位
        {
          _Set_Gears(NRC_22_Gears_Normal);
          return 0;
        }
        else if((Temp_NRC22 & 0x02) != 0 )//电压
        {
          _Set_Battery(12);
          return 0;
        }
        else if((Temp_NRC22 & 0x04) != 0 )//手力矩
        {
          TestWaitForTesterConfirmation("松开方向盘",10000);
          return 0;
        }
        else if((Temp_NRC22 & 0x10) != 0 ) //传感器
        {
          TestWaitForTesterConfirmation("恢复传感器");
          TestWaitForTesterConfirmation("恢复传感器存在上下电及会话问题,此部分会有风险,建议手动测试");
          return 16;
        }
      }
    }
  }
  return 0xFF;
}
/*
Type_ = 0:获取Total 13 长度
Type_ = 1:获取Mini 13 长度
Type_ = 2:获取正常 长度
*/
dword _Get_Serve_13_Len(byte Serve, dword Fun, byte Type_)
{
  dword Return_Len,Temp_Len;
  byte Min_Len,Max_Len;
  int Loop_Get_Max, Serve_Poss_, Fun_Pos_;
  Serve_Poss_ = _Check_Serve(Serve,0,0);
  Fun_Pos_ = _Check_Serve(Serve,Fun,4);
  for(Loop_Get_Max=0;Loop_Get_Max<Serve_Data[Serve_Poss_].Serve_Fun_Count;Loop_Get_Max++)
  {
    Temp_Len = Serve_Data[Serve_Poss_].Serve_Fun_Len[Loop_Get_Max];
    if(Loop_Get_Max == 0)
      Return_Len = Temp_Len;
    if(Type_ == 0)
    {
      if(Temp_Len>=Return_Len)
        Return_Len = Temp_Len;
    }
    else if(Type_ == 1)
    {
      if(Temp_Len<=Return_Len)
        Return_Len = Temp_Len;
    }
    else if(Type_ == 2)
    {
      Return_Len = Serve_Data[Serve_Poss_].Serve_Fun_Len[Fun_Pos_];
      break;
    }
  }
  if(Type_ == 0)
    Return_Len = Return_Len +1;
  else if(Type_ == 1)
    Return_Len = Return_Len -1;
  
  if(Serve == 0x34)
  {
    Return_Len = 3 + Len_34_Addr + Len_34_Length;
    if(Type_ == 0)
      Return_Len = Return_Len +1;
    else if(Type_ == 1)
      Return_Len = Return_Len -1;
    else if(Type_ == 2)
      Return_Len = 3 + Len_34_Addr + Len_34_Length;
    if(@AUTO::Config_Switch==6 && Type_ == 1)
      Return_Len = 2;
  }
  else if(Serve == 0x36)
  {
    if(Type_ == 2)
      Return_Len = 0x0C;
  }
  /* 22 服务 */
  if(Type_ == 0 && Serve == 0x22)
  {
    Return_Len = DID_22_Support*2+2;
  }
  /* 37 服务 */
  if((Type_ == 0 || Type_ == 1) && Serve == 0x37)
    Return_Len = 2;
  else if(Type_ == 2 && Serve == 0x37)
    Return_Len = 1;
  
  /* 2E 服务 */
  if(Serve == 0x2E)
  {
    if(Type_ == 1)
    {
      Return_Len = 3;
      if(@AUTO::Config_Switch == 5 || (strncmp(ECU_project,"SRM",strlen("SRM")) == 0))
        Return_Len = Serve_Data[Serve_Poss_].Serve_Fun_Len[Fun_Pos_]+1;
    }
    else if(Type_ == 0)
      Return_Len = Serve_Data[Serve_Poss_].Serve_Fun_Len[Fun_Pos_]+1;
    else if(Type_ == 2)
      Return_Len = Serve_Data[Serve_Poss_].Serve_Fun_Len[Fun_Pos_];
  }
  return Return_Len;
}
/*
  NRC10
  Type_ = 0：制造NRC10
  Type_ = 1: 恢复
  Len_Ex 数组长度
  Check_Pos：校验位所在位置
  Data数组,装载修改值
*/

void _Get_Serve_NRC10(byte Serve,byte Type_,byte Len_Ex,byte Check_Pos,byte Data[])
{
  int Serve_Pos_;
  int Fun_;
  Serve_Pos_ = _Check_Serve(Serve,0,0);
  if(Type_ == 0)
  {
    Data[Check_Pos] = 0;
  }
  else if(Type_ == 1)
  {
    if((strncmp(ECU_project,"BYD",strlen(ECU_project)) == 0 && strlen(ECU_project) == strlen("BYD"))|| @AUTO::Config_Switch == 1)
    {
      int i;
      dword Temp;
      Temp = 0;
      for(i=3;i<Len_Ex-1;i++)
        Temp = (Temp + Data[i])&0xFF;
      Temp = (Temp^0x55) &0xFF;
      Data[Check_Pos] = Temp;
    }
  }
}
/*
  NRC31操作
  Type_ = 0：制造NRC31
  Type_ = 1: 恢复
  Data数组,装载修改值
*/
void _Get_Serve_NRC31(byte Serve,byte Type_,byte Data[])
{
  int Serve_Pos_;
  int Fun_;
  int n;
  Serve_Pos_ = _Check_Serve(Serve,0,0);
  if(Type_ == 0)
  {
    if(Serve == 0x2E || Serve == 0x22)
    {
      do{
        Fun_ = random(0XFFFF);
      }while(_Check_Serve(Serve,Fun_,4)==1);
      Data[1] = (Fun_>>8);
      Data[2] = (Fun_&0xFF);
    }
    else if(Serve == 0x28)
    {
      for(Fun_=0;Fun_<0xFF;Fun_++)
      {
        for(n=0;n<Serve_Data[Serve_Pos_].Serve_Para_Count[0];n++)
        {
          if(Fun_ == Serve_Data[Serve_Pos_].Serve_Para[0][n])
            break;
        }
        if(n==Serve_Data[Serve_Pos_].Serve_Para_Count[0])
          break;
      }
      Data[2] = Fun_;
    }
    else if(Serve == 0x34)
      _Get_Serve_INI(Data,0x34,Serve_Pos_,3);

  }
  else if(Type_ == 1)
  {
    if(Serve == 0x2E)
    {
      Data[1] = (Serve_Data[Serve_Pos_].Serve_Fun[0]>>8);
      Data[2] = (Serve_Data[Serve_Pos_].Serve_Fun[0]&0xFF);
    }
    else if(Serve == 0x28)
    {
      Data[2] = Serve_Data[Serve_Pos_].Serve_Para[0][0];
    }
    else if(Serve == 0x22)
    {
      Data[1] = (Serve_Data[Serve_Pos_].Serve_Fun[0]>>8);
      Data[2] = (Serve_Data[Serve_Pos_].Serve_Fun[0]&0xFF);
    }
    else if(Serve == 0x34)
    {
      if(NRC_For34_FlashDrv == 1)
        _Get_Serve_INI(Data,0x34,Serve_Pos_,4);
      else
        _Get_Serve_INI(Data,0x34,Serve_Pos_,0);
    }
  }
}
/*
获取子功能
Type_ = 0:无效子功能
Type_ = 1:正常子功能
*/
byte _Get_Invalid_Fun(byte Serve,byte Type_)  
{
  int Loop_Get_Max,Fun_Count;
  int Serve_Poss_;
  byte Return_Fun;
  byte hash[0xff];
  Return_Fun = 0;
  Serve_Poss_ = _Check_Serve(Serve,0,0);
  if(Type_ == 0)
  {
    for(Fun_Count = 0;Fun_Count<Serve_Data[Serve_Poss_].Serve_Fun_Count;Fun_Count++)
    {
      hash[Serve_Data[Serve_Poss_].Serve_Fun[Fun_Count]] = 1;
    }
    for(Loop_Get_Max=1; Loop_Get_Max<=0xFF; Loop_Get_Max++)
    {
      if(hash[Loop_Get_Max]!= 1)
      {
        Return_Fun = Loop_Get_Max;
        break;
      }
    }
  }
  else if(Type_ == 1)
  {
    Return_Fun = Serve_Data[Serve_Poss_].Serve_Fun[0];
  }
  
  return Return_Fun;
}
/*
获取子功能
Type_ = 0:无效DID
Type_ = 1:正常DID
*/
word _Get_Invalid_DID(byte Serve,byte Type_)  
{
  int Loop_Get_Max,Fun_Count;
  int Serve_Poss_;
  word Return_Fun;
//  byte High_hash[0xff];
  byte Low_hash[0xff];
  byte Low_pos;
  
  Return_Fun = 0;
  Serve_Poss_ = _Check_Serve(Serve,0,0);
  if(Type_ == 0)
  {
    for(Fun_Count = 0;Fun_Count<Serve_Data[Serve_Poss_].Serve_Fun_Count;Fun_Count++)
    {
      Low_hash[Serve_Data[Serve_Poss_].Serve_Fun[Fun_Count] & 0xFF] = 1;
    }
    for(Loop_Get_Max=0x10; Loop_Get_Max<=0xFF; Loop_Get_Max++)
    {
      if(Low_hash[Loop_Get_Max]!= 1)
      {
        Low_pos = Loop_Get_Max ;
        Return_Fun = ((Serve_Data[Serve_Poss_].Serve_Fun[0] & 0xFF00) | Low_pos) & 0xFFFF ;
        break;
      }
    }
  }
  else if(Type_ == 1)
  {
    Return_Fun = Serve_Data[Serve_Poss_].Serve_Fun[0];
  }
  
  return Return_Fun;
}

/*---------------------------------------------NRC优先级-------------------------------*/
/*
  NRC优先级测试步骤
  Serve：服务
  Pos：子功能
  Type：获取NRC数据方式
*/
_Set_NRC_Step(byte Serve,dword Pos,byte Type,byte Send_Data[]) 
{
  int k;
  byte Serve_Pos;
  NRC31_Count = 0;
  NRC13_Count = 0;
  NRC34_31Count = 0;
  NRC31_total = 0;
  NRC13_total = 0;
  NRC34_31total = 0;
  Serve_Pos = _Check_Serve(Serve,Pos,Type); //获取NRC列表装载到Fun_NRC中
  
  for(k=Fun_NRC_Count-1;k>=0;k--)  //获取共多少个NRC13或NRC31
  {
    if(Fun_NRC[k]==0x13)
      NRC13_total++;
    else if(Fun_NRC[k]==0x31)
      NRC31_total++;
  }
//  writeEX(-3,1,"NRC13_total = %x,NRC31_total = %x",NRC13_total,NRC31_total);
  for(k=Fun_NRC_Count-1;k>=0;k--)
  {
    if(Send_Data[0] == 0x31)
    {
      /*待31服务时完善*/
      if(Fun_NRC[k]==0x22) //31服务NRC22
      {
        _Set_NRC22(Serve,Pos,0);
      }
      else if(Fun_NRC[k]==0x31 && NRC31_total==1) //RID无效
      {
        Send_Data[3] = _Get_Invalid_RID(Pos);
      }
      else if(Fun_NRC[k]==0x31 && NRC31_Count==0 && NRC31_total==2) //RID无效
      {
        Send_Data[3] = _Get_Invalid_RID(Pos);
        NRC31_Count++;
      }
      else if(Fun_NRC[k]==0x31 && NRC31_Count==1 && NRC31_total==2) //控制选项无效/数据无效
      {
        if(Serve_31_Hex[Serve_Pos].Control_Option_Count[0]  != 0)
          Send_Data[4] = _Get_Invalid_RID_Control_Option(Serve,Pos,0);
        _Get_Invalid_Data(Serve_Pos,Send_Data,0);
        NRC31_Count++;
      }
      else if(Fun_NRC[k]==0x13 && NRC13_Count==0 && NRC13_total==2) //total13
      {
        Fun_NRC_Send_Len = Len_31H +1;
        NRC13_Count++;
      }
      else if(Fun_NRC[k]==0x13 && NRC13_Count==1 && NRC13_total==2) //mini13
      {
        Fun_NRC_Send_Len = 3;
        NRC13_Count++;
      }
      else if(Fun_NRC[k]==0x13 && NRC13_total==1) //mini13
        Fun_NRC_Send_Len = Len_31H + 1;  //3
      else if(Fun_NRC[k]==0x12) //子功能无效
        Send_Data[1] = _Get_Invalid_RID_Control_Type(Pos);
      else if(Fun_NRC[k]==0x33)
        NRC33_Pos = k; //NRC33所在位置
      
//      writeEx(-3,1,"NRC:%02X  Fun_NRC_Send_Len = %d,Send_Data = 31 %02X %02X %02X",Fun_NRC[k],Fun_NRC_Send_Len,Send_Data[1],Send_Data[2],Send_Data[3]);
    }
    else
    {
      if(Fun_NRC[k]==0x13 && NRC13_Count==0 && NRC13_total==2) //total13
      {
        Fun_NRC_Send_Len = _Get_Serve_13_Len(Serve,Pos,0);//遍历该服务下所有支持子功能,并返回最大长度
        NRC13_Count++;
      }
      else if(Fun_NRC[k]==0x13 && NRC13_Count==1 && NRC13_total==2) //mini13
      {
        Fun_NRC_Send_Len = _Get_Serve_13_Len(Serve,Pos,1);//遍历该服务下所有支持子功能,并返回最小长度
        if(Send_Data[0] == 0x27)
          Fun_NRC_Send_Len = 1;
        NRC13_Count++;
      }
      else if(Fun_NRC[k]==0x13 && NRC13_total==1 ) //mini13
      {
//        if(Send_Data[0] == 0x34)
//        {
        Fun_NRC_Send_Len = (Serve == 0x36)? _Get_Serve_13_Len(Serve,Pos,1) : _Get_Serve_13_Len(Serve,Pos,0);
//          Fun_NRC_Send_Len = _Get_Serve_13_Len(Serve,Pos,0);
//        }
//        else
//          Fun_NRC_Send_Len = _Get_Serve_13_Len(Serve,Pos,1);
      }
      else if(Fun_NRC[k]==0x12 ) //子功能无效
        Send_Data[1] = _Get_Invalid_Fun(Serve,0);
      else if(Fun_NRC[k]==0x22 ) //NRC22条件
        _Set_NRC22(Serve,Pos,0);
      /*----------------------------------------------------------------------*/
      else if(Fun_NRC[k]==0x31 && NRC31_total==1) //数据无效 + DFI无效 + ALFID无效
      {
        _Get_Serve_NRC31(Serve,0,Send_Data);
        if(Send_Data[0] == 0x34)
        {
          NRC34_31total = 3;
          Send_Data[1] = Serve_Data[Pos].Serve_Para[0][0] + 1;
          Send_Data[2] = 0x43;
        }
      }
      else if(Fun_NRC[k]==0x31 && NRC31_Count==0 && NRC31_total==2) //DFI无效
      {
        if(Send_Data[0] == 0x34)
        {
          Send_Data[1] = Serve_Data[Pos].Serve_Para[0][0] + 1;
          Send_Data[2] = 0x43;
        }
        NRC31_Count++;
      }
      else if(Fun_NRC[k]==0x31 && NRC31_Count==1 && NRC31_total==2) //数据无效
      {
        if(Send_Data[0] == 0x34)
        {
          _Get_Serve_NRC31(Serve,0,Send_Data);
        }
        NRC31_Count++;
      }
     /*--------------------------------------------------------------------------*/
//      else if(Fun_NRC[k]==0x31 ) //NRC31条件
//      {
//        _Get_Serve_NRC31(Serve,0,Send_Data);
//        if(Send_Data[0] == 0x34)
//        {
//          NRC34_31total = 3;
//          Send_Data[1] = Serve_Data[Pos].Serve_Para[0][0] + 1;
//          Send_Data[2] = 0x43;
//          
//        }
//      }
    }
//     writeEx(-3,1,"Fun_NRC_Send_Len = %d",Fun_NRC_Send_Len);
  }
  /*清除计数防止后续执行恢复操作时报错*/
  NRC31_Count = 0;
  NRC13_Count = 0;
  NRC34_31Count = 0;
}
_Recover_NRC_Step(byte NRC,byte Pos,dword Fun_Pos,byte Send_Data[]) // Pos为所在结构体位置
{
  dword Fun_;
  if(Send_Data[0] != 0x31)
    Fun_ = Serve_Data[Pos].Serve_Fun[Fun_Pos];
  if( NRC == 0x33 )
    _unlockECU();
  /*---------------------------31服务------------------------*/
  else if(NRC != 0x33 && Send_Data[0] == 0x31)
  {
    if( NRC == 0x13 && NRC13_total ==2 && NRC13_Count==0)
    {
      Fun_NRC_Send_Len = Len_31H +1;
      NRC13_Count++;
//      if(Serve_31_Hex[Pos].Routine[0] == 0xFF && Serve_31_Hex[Pos].Routine[1] == 0x00)
//        Send_Data[Len_31H] = 0xFF;
    }
    else if( NRC == 0x13 && NRC13_total ==2 && NRC13_Count==1)
    {
      Fun_NRC_Send_Len = Len_31H;
      NRC13_Count++;
    }
    else if( NRC == 0x13 && NRC13_total ==1)
    {
      Fun_NRC_Send_Len = Len_31H;
    }
    else if( NRC == 0x31 && NRC31_total ==1)
    {
      Send_Data[2] = Serve_31_Hex[Pos].Routine[0];
      Send_Data[3] = Serve_31_Hex[Pos].Routine[1];
    }
    else if( NRC == 0x31 && NRC31_Count==0 && NRC31_total == 2)
    {
      Send_Data[2] = Serve_31_Hex[Pos].Routine[0];
      Send_Data[3] = Serve_31_Hex[Pos].Routine[1];
      NRC31_Count++;
    }
    else if( NRC == 0x31 && NRC31_Count==1 && NRC31_total == 2)
    {
      _Get_Invalid_Data(Pos,Send_Data,2);
      if(Serve_31_Hex[Pos].Control_Option_Count[0]  != 0)
        Send_Data[4] = _Get_Invalid_RID_Control_Option(Fun_Pos,Pos,1);
      NRC31_Count++;
    }
    else if( NRC == 0x12)
    {
      Send_Data[1] = Serve_31_Hex[Pos].Control_Type[0];
    }
    else if( NRC == 0x22)
    {
      _Set_NRC22(Serve_31_Hex[Pos].Control_Type[0],Pos,1);    
    }
  }
  /*---------------------------非31服务------------------------*/
  else if(NRC != 0x33 && Send_Data[0] != 0x31)
  {
    if( NRC == 0x13 && NRC13_total ==2 && NRC13_Count==0)
    {
      Fun_NRC_Send_Len =  _Get_Serve_13_Len(Send_Data[0],Fun_,0);
      NRC13_Count++;
    }
    else if( NRC == 0x13 && NRC13_total ==2 && NRC13_Count==1)
    {
      Fun_NRC_Send_Len =  _Get_Serve_13_Len(Send_Data[0],Fun_,2);
      NRC13_Count++;
    }
    else if( NRC == 0x13 && NRC13_total ==1)
    {
      Fun_NRC_Send_Len =  _Get_Serve_13_Len(Send_Data[0],Fun_,2);
    }
    else if( NRC == 0x12)
    {
      if(Send_Data[0] == 0x22 || Send_Data[0] == 0x2E)
      {
        Send_Data[1] = Serve_Data[Pos].Serve_Fun[Fun_Pos]>> 8 & 0xFF;
        Send_Data[2] = Serve_Data[Pos].Serve_Fun[Fun_Pos] & 0xFF;
      }
      else if(Send_Data[0] == 0x34)
      {
        Send_Data[1] = Serve_Data[Pos].Serve_Para[0][0];
        Send_Data[2] = Serve_Data[Pos].Serve_Para[0][1];
      }
      else
        Send_Data[1] = Serve_Data[Pos].Serve_Fun[Fun_Pos];
    }
    else if( NRC == 0x22)
      _Set_NRC22(Send_Data[0],Send_Data[1],1);
    else if( NRC == 0x10 && Send_Data[0]==0X2E)
      _Get_Serve_NRC10(Send_Data[0],1,Fun_NRC_Send_Len,10,Send_Data);
    else if( NRC == 0x31 && NRC31_total == 1)
    {
      if(Send_Data[0] == 0x34)
      {
        if(NRC34_31Count ==0)
          Send_Data[1] = Serve_Data[Pos].Serve_Para[0][0];
        else if(NRC34_31Count ==1)
          Send_Data[2] = Serve_Data[Pos].Serve_Para[0][1];
        else if(NRC34_31Count ==2)
          _Get_Serve_NRC31(Send_Data[0],1,Send_Data);
        NRC34_31Count++;
      }
      else
        _Get_Serve_NRC31(Send_Data[0],1,Send_Data);
    }
    else if(NRC == 0x31 && NRC31_total == 2 && NRC31_Count == 0)
    {
      if(Send_Data[0] == 0x34)
      {
        Send_Data[1] = Serve_Data[Pos].Serve_Para[0][0];
        Send_Data[2] = 0x44;
      }
      NRC31_Count++;
    }
    else if(NRC == 0x31 && NRC31_total == 2 && NRC31_Count == 1)
    {
      if(Send_Data[0] == 0x34)
      {
        _Get_Serve_NRC31(Send_Data[0],1,Send_Data);
      }
      NRC31_Count++;
    }
    /*--------------------------------------------------------------------------*/
//    else if( NRC == 0x31)
//    {
//      if(Send_Data[0] == 0x34)
//      {
//        if(NRC34_31Count ==0)
//          Send_Data[1] = Serve_Data[Pos].Serve_Para[0][0];
//        else if(NRC34_31Count ==1)
//          Send_Data[2] = Serve_Data[Pos].Serve_Para[0][1];
//        else if(NRC34_31Count ==2)
//          _Get_Serve_NRC31(Send_Data[0],1,Send_Data);
//        NRC34_31Count++;
//      }
//      else
//        _Get_Serve_NRC31(Send_Data[0],1,Send_Data);
//    }
    /*--------------------------------------------------------------------------*/
//    else if( NRC == 0x24)
//    {
//      Send_34(phyreq_ID);
//    }
      
  }
}
/**********************************************************************************/
void _Reset_By_11H() //11复位
{
  int Temp_Pos;
  byte Send[2];
  Temp_Pos = _Check_Serve(0x11,0,0);
  if( Temp_Pos!= -1)
  {
    Send[0] = 0x11;
    Send[1] = Serve_Data[Temp_Pos].Serve_Fun[0];
    if(Serve_Data[Temp_Pos].Security_Access[0] == 1)
    {
      _SetSession(exsession);
      _unlockECU();
    }
    _Send_Diag(2,phyreq_ID,Send);
    _TestResult(SendData,phyreq_ID,"",-1);
  }
  else
    _WriteEx_and_Report("0x11","该服务不支持");
}

int _Check_22H_Support(byte DID[])//检测所输入的参数是否被22服务所支持
{
  int Return_Value,n;
  int Serv_Pos;
  Serv_Pos = _Check_Serve(0x22,0,0);
  for(n=0;n<Serve_Data[Serv_Pos].Serve_Para_Count[0]*2-1;n=n+2)
  {
    if((DID[0]==Serve_Data[Serv_Pos].Serve_Para[0][n]) && (DID[1]==Serve_Data[Serv_Pos].Serve_Para[0][n+1]))
    {
      Return_Value = 1;
      return Return_Value;
    }
  }
  Return_Value = -1;
  return Return_Value;
}
/*
  检测所输入的参数是否被2E服务所支持
  Type = 0：检测所输入的参数是否被2E服务所支持(不使用ID及Session)
  Type = 1：当前寻址方式及会话下,该DID是否支持
*/
int _Check_2EH_Support(byte DID[],dword ID,byte Session,byte Type)//检测所输入的参数是否被2E服务所支持
{
  int Return_Value,n;
  int Serv_Pos;
  dword DID_Temp;
  DID_Temp = 0;
  Serv_Pos = _Check_Serve(0x2E,0,0);
  DID_Temp = ((DID[0]<<8 & 0xFF00) | DID[1]);
  if(Type == 0)
  {
    for(n=0;n<Serve_Data[Serv_Pos].Serve_Fun_Count;n++)
    {
      if(DID_Temp == Serve_Data[Serv_Pos].Serve_Fun[n])
      {
        Return_Value = 1;
        return Return_Value;
      }
    }
  }
  else if(Type == 1)
  {
    Return_Value = _Check_Fun_IDAndSess(0x2E,DID_Temp,ID,Session);
    return Return_Value;
  }
  Return_Value = -1;
  return Return_Value;
}
_Step_Serve_Fun(byte Serve,dword ID,byte session)//肯定响应抑制位测试(服务内的所有子功能均一致)
{
  byte Send_Data[100];
  int i,n,Fun_Poss,len,Serve_Poss;
  byte Size_Para;
  
  Serve_Poss = _Check_Serve(Serve,0,0);
  Send_Data[0] = Serve;
  for(i=0;i<=0xFF;i++)
  {
    Fun_Poss = _Check_Serve(Serve,i,4);
    len = 1+1;//服务+子功能
    if(Fun_Poss != -1)
    {
      Size_Para = Serve_Data[Serve_Poss].Serve_Para_Len[Fun_Poss][0];   //子功能对应的第一个参数长度
      if( Size_Para != 0)
      {
        for(n=0;n<Size_Para;n++)
          Send_Data[len+n] = Serve_Data[Serve_Poss].Serve_Para[Fun_Poss][n];
        len = len + Serve_Data[Serve_Poss].Serve_Para_Len[Fun_Poss][0];
      }
      Send_Data[1] = i;
      _Send_Diag(len,ID,Send_Data);
      _TestResult(SendData,ID,"",-1);
      if(_Check_Serve(Serve,i,3)==1)
      {
        Send_Data[1] = i|0x80;
        _Send_Diag(len,ID,Send_Data);
        _TestResult(SendData,ID,"",0);
      }
      else
        _WriteEx_and_Report("","当前子功能不支持肯定响应抑制位");
    }
  }
}

_Step_Serve_RSP(byte Serve,dword ID,byte session)//肯定响应抑制位测试(根据子功能情况确定响应状态)
{
  byte Send_Data[100];
  int i,n,Fun_Poss,len,Serve_Poss;
  byte Size_Para;
  int Count_;
  Count_ = 0;
  Serve_Poss = _Check_Serve(Serve,0,0);
  Send_Data[0] = Serve;
  for(i=1;i<=0xFF;i++)
  {
    Fun_Poss = _Check_Serve(Serve,i,4);
    len = 1+1;//服务+子功能
    if(Fun_Poss != -1)
    {
      Size_Para = Serve_Data[Serve_Poss].Serve_Para_Len[Fun_Poss][0];   //子功能对应的第一个参数长度
      if( Size_Para != 0)
      {
        for(n=0;n<Size_Para;n++)
          Send_Data[len+n] = Serve_Data[Serve_Poss].Serve_Para[Fun_Poss][n];
        len = len + Serve_Data[Serve_Poss].Serve_Para_Len[Fun_Poss][0];
      }
      Send_Data[1] = i;
      if(_Check_Serve(Serve,i,3)==1)
      {
        if(_Check_Fun_IDAndSess(Serve,i,ID,session) == 0) //寻址支持，但会话不支持
        {
          if(Serve == 0x10 ) //10服务特殊处理
          {
            _WriteEx_and_Report("","开始测试0x%02X肯定响应抑制位",i|0x80);
            if((session != defsession) && (Count_ != 0))
              _SetSession(session);
            testWaitForTimeout(1000);
            Send_Data[1] = i|0x80;
            _Send_Diag(len,ID,Send_Data);
            if(@AUTO::Config_Switch == 7 || (strncmp(ECU_project,"Chery",strlen("Chery")) == 0 ))
              _TestResult(SendData,ID,"",0x12);  
            else
              _TestResult(SendData,ID,"",0x7E);  
            _Send_And_Check_NowSession(ID,session);
            Count_++;
          }
          else
          {
            Send_Data[1] = i|0x80;
            _Send_Diag(len,ID,Send_Data);
            _TestResult(SendData,ID,"",0x7E);
            _Send_And_Check_NowSession(ID,session);
          }
        }
        else if(_Check_Fun_IDAndSess(Serve,i,ID,session) == 1) //寻址和会话都支持
        {
          if(Serve == 0x10 ) //10服务特殊处理
          {
            _WriteEx_and_Report("","开始测试0x%02X肯定响应抑制位",i|0x80);
            if((session != defsession) && (Count_ != 0))
              _SetSession(session);
            testWaitForTimeout(1000);
            if((session == exsession) && (i==0x02)) //10 02特殊处理,加载前提条件
            {
              if(Pre_Programmed_1002 == 1)
              {
                _Pre_Programmed();
                if( (Pre_Programmed_UnlockECU == 0) && (_Check_Serve(Serve,i,5)==1))
                  _unlockECU();
              }
              else
              {
                if(_Check_Serve(Serve,i,5)==1)
                  _unlockECU();  
              }
            }
            Send_Data[1] = i|0x80;
            _Send_Diag_NoTime(len,ID,Send_Data);
            {
              diagSetP2Extended(-1);
              testWaitForDiagResponse(SendData,p2cmax);
              if(diagGetLastResponseCode(SendData)==0x78)
              {
                if((Sub_1082_NRC78 == 0) && (DiagGetPrimitiveByte(SendData,1)==0x82))
                  testStepFail("","0x82收到NRC78反馈,该项目预期0x82不响应NRC78");
                testWaitForDiagResponse(SendData,p2cmax*100);
                testReportWriteDiagResponse(SendData);
                _WriteEx_and_Report("","接收到NRC78响应,后续响应判断是否为正响应");
                _TestResult(SendData,ID,"",-1); 
              }
              else
              {
                testReportWriteDiagResponse(SendData);
                _TestResult(SendData,ID,"",0); 
                testWaitForTimeout(2000); 
                _reqseed();
                if(Send_Data[1] == 0x83)
                {
                  if(_Check_Fun_IDAndSess(0x27,RequestSeed_27,phyreq_ID,exsession)==1)
                    _TestResult(SendData,phyreq_ID,"",-1);  
                  else
                    _TestResult(SendData,phyreq_ID,"",0x7F); 
                  _Send_And_Check_NowSession(ID,exsession);
                }
                else if(Send_Data[1] == 0x81)
                {
                  _TestResult(SendData,phyreq_ID,"",0x7F);  
                  _Send_And_Check_NowSession(ID,defsession);
                }
                else
                {
                  _TestResult(SendData,phyreq_ID,"",-1);  
                  testWaitForTimeout(1000); 
                  _Send_And_Check_NowSession(ID,prosession);
                }
              }
            }
            Count_++;
          }
          else
          {
            Send_Data[1] = i|0x80;
            _Send_Diag(len,ID,Send_Data);
            _TestResult(SendData,ID,"",0);
//            _unlockECU();
            testWaitForTimeout(2000);
            _reqseed();
            _TestResult(SendData,phyreq_ID,"",0x7F);  
            _Send_And_Check_NowSession(ID,defsession);
          }
        }
        testWaitForTimeout(500);
      }
      else
      {
        _WriteEx_and_Report("","当前子功能不支持肯定响应抑制位");
        Send_Data[1] = i|0x80;
        _Send_Diag(len,ID,Send_Data);
        _TestResult(SendData,ID,"",0x12);
        _Send_And_Check_NowSession(ID,session);
      }
    }
  }
}
/*
  检测该服务在当前会话及寻址方式下是否支持
  适用于整个服务支持的寻址及会话一致的情况下
  Serve ： 服务
  ID ： 寻址方式
  session ： 会话
*/
int _Check_Serve_IDAndSess(byte Serve,dword ID,byte session)  
{
  int Temp_Serve_Pos;
  byte Add,Sess;
  char Tem_Fun[20];
  Temp_Serve_Pos = _Check_Serve(Serve,0,0);
  
  snprintf(Tem_Fun,elCount(Tem_Fun),"%s","");
  snprintf(Tem_Fun,elCount(Tem_Fun),"%02X服务",Serve);
  if(Temp_Serve_Pos == -1)
  {
    _WriteEx_and_Report(Tem_Fun,"当前服务不支持");
    return -2;
  }
  if(ID == funreq_ID)
    Add = 2;
  else if(ID == phyreq_ID)
    Add = 1;
  if(session == defsession)
    Sess = 1;
  else if(session == prosession)
    Sess = 2;
  else if(session == exsession)
    Sess = 4;
  if((Serve_Data[Temp_Serve_Pos].Serve_Addres[0] & Add) != 0)
  {
    if((Serve_Data[Temp_Serve_Pos].Serve_Session[0] & Sess) != 0)
      return 1;//该会话及寻址方式下支持该服务
    else
    {
      _WriteEx_and_Report(Tem_Fun,"寻址支持但会话不支持");
      return 0; //寻址支持但会话不支持
    }
  }
  else 
  {
    _WriteEx_and_Report(Tem_Fun,"当前寻址不支持该服务");
    return -1;
  }
}
int _Check_Serve_IDAndSess_(byte Serve,dword ID,byte session)  //检测该服务在当前会话及寻址方式下是否支持
{
  int Return_Value_Serve;
  byte Send_Data[2] = {0x85,0x03};
  int Addres,Addres2;
  int Len;
  Addres = -1;
  Addres2 = -1;
  Addres = _Check_Serve(Serve,0,0);
  Send_Data[0] = Serve;
  Return_Value_Serve = -1;
  if(Addres==-1)
  {
    testStep("","当前不支持%2X服务,验证返回NRC11",Serve);
    _Send_Diag(2,ID,Send_Data);
    _TestResult(SendData,ID,"",0x11);
  }
  else
  {
    Return_Value_Serve = 0;
    Addres2 = _Check_Serve(Serve,0,1);
    Send_Data[1] = Serve_Data[Addres].Serve_Fun[0];
    Len =  Serve_Data[Addres].Serve_Fun_Len[0] + 1;
    if((ID == phyreq_ID && (Addres2 & 1)!=0) || (ID == funreq_ID && (Addres2 & 2)!=0))
    {
      Addres2 = _Check_Serve(Serve,0,2);
      if((session == prosession && (Addres2 & 2)!=0) || (session == exsession && (Addres2 & 4)!=0) || (session == defsession && (Addres2 & 1)!=0))
      {
        Return_Value_Serve = Addres;//当前寻址方式和会话下支持该服务
      }
      else
        testStep("","当前会话不支持%2X服务",Serve);
    }
    else
      testStep("","当前寻址不支持%2X服务",Serve);
  }
  return Return_Value_Serve;
}

int _Check_31Serve_IDAndSess(byte Pos,byte Ctrl_Type,dword ID,byte session)  
{
  int Temp_Serve_Pos;
  byte Add,Sess;
  char Tem_Fun[20];
  
  Temp_Serve_Pos = 0;
  snprintf(Tem_Fun,elCount(Tem_Fun),"%s","");
  snprintf(Tem_Fun,elCount(Tem_Fun),"%02X %02X %02X %02X",0x31,Serve_31_Hex[Pos].Control_Type[Ctrl_Type],Serve_31_Hex[Pos].Routine[0],Serve_31_Hex[Pos].Routine[1]);
  if(Temp_Serve_Pos == -1)
  {
    _WriteEx_and_Report(Tem_Fun,"当前服务不支持");
    return -2;
  }
  if(ID == funreq_ID)
    Add = 2;
  else if(ID == phyreq_ID)
    Add = 1;
  if(session == defsession)
    Sess = 1;
  else if(session == prosession)
    Sess = 2;
  else if(session == exsession)
    Sess = 4;
  if((Serve_31_Hex[Pos].Serve_Addres[Ctrl_Type] & Add) != 0)
  {
    if((Serve_31_Hex[Pos].Serve_Session[Ctrl_Type] & Sess) != 0)
      return 1;//该会话及寻址方式下支持该服务
    else
    {
      _WriteEx_and_Report(Tem_Fun,"寻址支持但会话不支持");
      return 0; //寻址支持但会话不支持
    }
  }
  else 
  {
    _WriteEx_and_Report(Tem_Fun,"当前寻址不支持该服务");
    return -1;
  }
}
/*检测该子功能在当前会话及寻址方式下是否支持*/
int _Check_Fun_IDAndSess(byte Serve,dword Fun,dword ID,byte session)  
{
  int Temp_Serve_Pos,Temp_Fun_Pos;
  byte Add,Sess;
  char Tem_Fun[20];
  Temp_Serve_Pos = _Check_Serve(Serve,Fun,0);
  Temp_Fun_Pos = _Check_Serve(Serve,Fun,4);
  snprintf(Tem_Fun,elCount(Tem_Fun),"%s","");
  if(Fun<=0xFF)
    snprintf(Tem_Fun,elCount(Tem_Fun),"%s0x%02X 0x%02X",Tem_Fun,Serve,Fun);
  else
    snprintf(Tem_Fun,elCount(Tem_Fun),"%s0x%02X 0x%02X 0x%02X",Tem_Fun,Serve,(Fun>>8),(Fun & 0xFF));
  if((Temp_Serve_Pos == -1) || (Temp_Fun_Pos) == -1)
  {
    _WriteEx_and_Report(Tem_Fun,"当前服务不支持或子功能不支持");
    return -2;
  }
  if(ID == funreq_ID)
    Add = 2;
  else if(ID == phyreq_ID)
    Add = 1;
  if(session == defsession)
    Sess = 1;
  else if(session == exsession)
    Sess = 4;
  else if(session == prosession)
    Sess = 2;

  if((Serve_Data[Temp_Serve_Pos].Serve_Addres[Temp_Fun_Pos] & Add) != 0)
  {
    if((Serve_Data[Temp_Serve_Pos].Serve_Session[Temp_Fun_Pos] & Sess) != 0)
      return 1;//该会话及寻址方式下支持该子功能
    else
    {
      _WriteEx_and_Report(Tem_Fun,"寻址支持但会话不支持");
      return 0; 
    }
  }
  else 
  {
    _WriteEx_and_Report(Tem_Fun,"当前寻址不支持该子功能");
    return -1;
  }
}

/*检测对应服务及子功能下对应的该参数是否支持*/
int _Check_Para(byte Serve_Poss ,byte Fun_Poss,byte Para[],byte Para_Len)
{
  int Return_Value,k,flage_dif;
  int Len_,Start_Len;
  Return_Value = -1;
  Start_Len = 0;
  for(k=0;k<Serve_Data[Serve_Poss].Serve_Para_Count[Fun_Poss];k++)  //遍历所有参数组
  {
    flage_dif = 1;
    if((Para_Len-2)!= Serve_Data[Serve_Poss].Serve_Para_Len[Fun_Poss][k])   //长度不匹配则跳过
    {
      flage_dif = -1;
      continue;
    }
    else
    {
      for(Len_=Start_Len;Len_<Start_Len + Serve_Data[Serve_Poss].Serve_Para_Len[Fun_Poss][k];Len_++)
      {
        if(Para[Len_-Start_Len+2] != Serve_Data[Serve_Poss].Serve_Para[Fun_Poss][Len_])
        {
          flage_dif = -1;
          break;
        }
      }
      if(flage_dif==1)
        break;
    }
    Start_Len = Start_Len + Serve_Data[Serve_Poss].Serve_Para_Len[Fun_Poss][k];
  }
  if(flage_dif == 1)
    Return_Value = 1;
  return Return_Value;
}

/*
    检测服务结构体中对应的数据
    Fun ：子功能
    type = 0:检测服务是否支持(未查询到时表明服务不支持,位置为-1返回到外层)
    type = 1:检测服务所支持的寻址方式  (适用与整个服务所有子功能支持寻址方式均一致)
    type = 2:检测服务所支持的会话      (适用与整个服务所有子功能支持寻址方式均一致)
    type = 3:检测服务是否支持肯定响应抑制位      (适用与整个服务所有子功能支持寻址方式均一致)
    type = 4:检测子功能是否支持        (不支持返回-1,支持则返回所在列表位置)
    type = 5:检测子功能是否需要安全访问      (同时需要服务和子功能)
    type = 6:检测子功能对应的NRC列表      (同时需要服务和子功能)
    type = 7:检测子功能对应的NRC22条件      (同时需要服务和子功能)
    type = 8:检测子功能对应的NRC列表      (较为特殊,指定支持31服务,子功能改为31H结构体中RID所在位置)
    type = 9:检测31服务子功能是否支持肯定响应抑制位   
    type = 10:检测31服务对应的RID的控制类型下NRC22条件
    type = 11:检测31服务对应的RID的控制类型下安全访问条件
*/
int _Check_Serve(byte Serve ,dword Fun,byte type)
{
  int Return_Value,Possion_Serve,Possion_Fun;
  int Check_Fun;
  int k;
  char Common[30];
  snprintf(Common,elCount(Common),"%s","");
  snprintf(Common,elCount(Common),"0x%02X服务",Serve);
  snprintf(Common,elCount(Common),"%s0x%02X子功能",Common,Fun);
  Possion_Serve = -1;
  Possion_Fun = -1;
  for(k=0;k<Serve_Data_Count;k++)
  {
    if(Serve_Data[k].Serve==Serve)
    {
      Possion_Serve = k;  //查询服务所在结构体位置
      break;
    }
  }
  if( (type==0) && (Possion_Serve==-1) && (type != 8) && (type != 10)&& (type != 11))
    return -1;//未查询到服务 提前终止
  if(type == 8 || type == 10 || type == 11)
  {
    for(k=0;k<Serve_31_Hex_Count;k++)
    {
      if((Serve_31_Hex[k].Routine[0] == (Fun>>8)) && (Serve_31_Hex[k].Routine[1] == (Fun&0xFF)))
      {
        Possion_Serve = k;
        break;
      }
    }
//    writeEx(-3,0,"Possion_Serve %d ",Possion_Serve);
    if(Possion_Serve == -1)
      return -1;//未查询到RID 提前终止
    for(k=0;k<Serve_31_Hex[Possion_Serve].Control_Type_Count;k++)
    {
      if(Serve == Serve_31_Hex[Possion_Serve].Control_Type[k])
      {
        Possion_Fun = k;
        break;
      }
    }
//    writeEx(-3,0,"Possion_Fun %d ",Possion_Fun);
    if(Possion_Fun == -1)
      return -1;//未查询到控制类型 提前终止
  }
  else
  {
    for(k=0;k<Serve_Data[Possion_Serve].Serve_Fun_Count;k++)
    {
      if(Serve_Data[Possion_Serve].Serve_Fun[k]==Fun)
      {
        Possion_Fun = k;  //查询子功能所在列表位置
        break;
      }
    }
  }
  if(Fun == 0 && type != 4)  //未输入子功能默认选择第0个子功能,当检测子功能是否支持情况时除外
    Check_Fun = 0;
  else if(Fun>0)
    Check_Fun = Possion_Fun;
  if(((type>=5 && type< 8) || type == 9 ) && Possion_Fun == -1)
  {
    _WriteEx_and_Report(Common,"子功能不支持");
    return -1;//未查询到子功能 提前终止
  }
  if(type == 8)
  {
    snprintf(Common,elCount(Common),"%s","");
    snprintf(Common,elCount(Common),"31服务 0x%X RID",Fun);
    _WriteEx_and_Report(Common,"NRC列表");
  }
  if(type==0)
    Return_Value = Possion_Serve;  //返回结构体中所在位置
  else if(type==1)
    Return_Value = Serve_Data[Possion_Serve].Serve_Addres[Check_Fun];   //  Return_Value & 检测值 != 0即表示支持该寻址
  else if(type==2)
    Return_Value = Serve_Data[Possion_Serve].Serve_Session[Check_Fun];
  else if(type==3)
    Return_Value = Serve_Data[Possion_Serve].RSP[Check_Fun];
  else if(type==4)
    Return_Value = Possion_Fun;
  else if(type==5)
    Return_Value = Serve_Data[Possion_Serve].Security_Access[Check_Fun];
  else if(type==6)
  {
    for(k=0;k< Serve_Data[Possion_Serve].Serve_NRC_Count[Check_Fun];k++)
      Fun_NRC[k] = Serve_Data[Possion_Serve].Serve_NRC[Check_Fun][k];
    Fun_NRC_Count = Serve_Data[Possion_Serve].Serve_NRC_Count[Check_Fun];
    Return_Value = 1;
  }
  else if(type==7)
  {
    Return_Value = Serve_Data[Possion_Serve].Serve_NRC22[Check_Fun];
  }
  else if(type==8)
  {
    for(k=0;k< Serve_31_Hex[Possion_Serve].Serve_NRC_Count[Possion_Fun];k++)
    {
      Fun_NRC[k] = Serve_31_Hex[Possion_Serve].Serve_NRC[k];
    }
    Fun_NRC_Count = Serve_31_Hex[Possion_Serve].Serve_NRC_Count[Possion_Fun];
    Return_Value = Possion_Serve;
  }
  else if(type==9)
    Return_Value = Serve_Data[Possion_Serve].RSP[Check_Fun];
  else if(type==10)
    Return_Value = Serve_31_Hex[Possion_Serve].Serve_NRC22[Possion_Fun];
  else if(type==11)
    Return_Value = Serve_31_Hex[Possion_Serve].Security_Access[Possion_Fun];
  
  return Return_Value;
}
_TestDisableMsg(dword Node_ID)
{
  char Tem[20];
  snprintf(Tem,elCount(Tem),"0x%03X",Node_ID);
  _WriteEx_and_Report("丢失节点",Tem);
  testDisableMsg(Node_ID);
}
_TestEnableMsg(dword Node_ID)
{
  char Tem[20];
  snprintf(Tem,elCount(Tem),"0x%03X",Node_ID);
  _WriteEx_and_Report("恢复节点",Tem);
  testEnableMsg(Node_ID);
}
byte _Get_NRC_Input(byte NRC1,byte NRC2,byte Serve ,byte Fun)
{
  byte NRC;
  int Serve_Pos,Fun_Pos,i;
  if(Serve != 0x31)
  {
    Serve_Pos = _Check_Serve(Serve,0,0);
    Fun_Pos = _Check_Serve(Serve,Fun_Pos,4);
    for(i=0;i<Serve_Data[Serve_Pos].Serve_NRC_Count[Fun_Pos];i++)
    {
      if(Serve_Data[Serve_Pos].Serve_NRC[Fun_Pos][i] == NRC2)
      {
        NRC = NRC2;
        break;
      }
      if(Serve_Data[Serve_Pos].Serve_NRC[Fun_Pos][i] == NRC1)
      {
        NRC = NRC1;
        break;
      }
    }
  }
  return NRC;
}

/*
  Serve : 服务
  Fun_Pos : 功能所在位置
  Add : 寻址
  Session : 会话
  Type : 0:自动化测试部分 1:手动测试
*/
_NRC22_Test_Loop(int Serve,dword Fun_Pos,dword ID,byte Session,byte Type)
{
  byte Send_Data[100];
  dword Send_Len;
  byte Tar_NRC22;
  int m,Auto_Loop_22;
  int Serve_Pos,IsNRC22;
  char Step_Write[50];
  int Special;
  Special = 0;
  Send_Data[0] = Serve;
  snprintf(Step_Write,elCount(Step_Write),"0x%02X",Serve);
  {
    if(Serve != 0x31)
    {
      Serve_Pos = _Check_Serve(Serve,0,0);
      Send_Data[1] = Serve_Data[Serve_Pos].Serve_Fun[Fun_Pos]; // 装载子功能
      Send_Len = Serve_Data[Serve_Pos].Serve_Fun_Len[Fun_Pos]; // 装载发送长度
      Tar_NRC22 = Serve_Data[Serve_Pos].Serve_NRC22[Fun_Pos]; // 装载NRC22条件
      
      snprintf(Step_Write,elCount(Step_Write),"%s 0x%02X",Step_Write,Send_Data[1]);
      if(Send_Data[0] == 0x28)
        Send_Data[2] = Serve_Data[Serve_Pos].Serve_Para[Fun_Pos][0];
      else if(Send_Data[0] == 0x22)
      {
        Send_Data[1] = (Serve_Data[Serve_Pos].Serve_Fun[Fun_Pos]>>8);
        Send_Data[2] = (Serve_Data[Serve_Pos].Serve_Fun[Fun_Pos]&0xFF);
        snprintf(Step_Write,elCount(Step_Write),"0x%02X 0x%02X 0x%02X",Serve,Send_Data[1],Send_Data[2]);
      }
      else if(Send_Data[0] == 0x2E)
      {
        dword Fun;
        int Fun_Pos_Ser;
        _get_2E_DID(Traversal_DID[Fun_Pos]);
        Send_Len = DID_2E_SendData_1_Len;
        Send_Data[1] = DID_2E_SendData_1[1];
        Send_Data[2] = DID_2E_SendData_1[2];
        Fun = ((Send_Data[1]<<8) | Send_Data[2]);
        Fun_Pos_Ser = _Check_Serve(Serve,Fun,4);
        Tar_NRC22 = Serve_Data[Serve_Pos].Serve_NRC22[Fun_Pos_Ser];
        snprintf(Step_Write,elCount(Step_Write),"0x%02X 0x%02X 0x%02X",Serve,Send_Data[1],Send_Data[2]);
        for(m=0;m<Send_Len;m++)
          Send_Data[m] = DID_2E_SendData_1[m];
      }
    }
    else
    {
      Send_Data[1] = Serve_31_Hex[Fun_Pos].Control_Type[0];
      Send_Data[2] = Serve_31_Hex[Fun_Pos].Routine[0];
      Send_Data[3] = Serve_31_Hex[Fun_Pos].Routine[1];
      Send_Len = Serve_31_Hex[Fun_Pos].Control_Type_TxLen[0];
      snprintf(Step_Write,elCount(Step_Write),"%s 0x%02X 0x%02X 0x%02X",Step_Write,Send_Data[1],Send_Data[2],Send_Data[3]);
      if(Serve_31_Hex[Fun_Pos].Control_Option_Count[0] != 0)
      {
        Send_Data[4] = Serve_31_Hex[Fun_Pos].Control_Option[0][0];
        snprintf(Step_Write,elCount(Step_Write),"%s 0x%02X",Step_Write,Send_Data[4]);
      }
      Tar_NRC22 = Serve_31_Hex[Fun_Pos].Serve_NRC22[0]; 
    }
    
    if((Send_Data[0] == 0x10) && (Send_Data[1] == 0x02))
      Special = 1;//10 02特殊处理部分
    else if(Send_Data[0] == 0x11)
      Special = 2;
    else if(Send_Data[0] == 0x28 && ((Send_Data[1]==0x02) || (Send_Data[1]==0x03)))
      Special = 3;
    else if(Send_Data[0] == 0x85 && Send_Data[1]==0x02)
      Special = 3;
    if(Type == 0)
    {
      Auto_Loop_22 = 3;
      if(Set_Battery_RS232 == 1)
        Auto_Loop_22 = 4;
      for(m=0;m<Auto_Loop_22;m++)
      {
//        Special_Requirements(exsession);
        if(@AUTO::Config_Switch!= 12)
        {
          _SetSession(defsession);
          if(Session != defsession)
            _SetSession(Session);    /*会话切换防止上一次干扰*/
        }
        if(Serve == 0x31 || Serve == 0x2E)
        {
          _Send_Key(SendKey_Len,phyreq_ID,_get_seed(phyreq_ID),0);
          _TestResult(SendData,phyreq_ID,"",-1);
          Get_Seed_Flage = 1;
        }
        testWaitForTimeout(100);
        if(m==0)//NRC22_车速
        {
          if((Tar_NRC22&0x1)!=0)
            IsNRC22 = 1;
          else
            IsNRC22 = 0;
          _NRC22_CarSpd(Send_Data,Send_Len,ID,Session,Step_Write,IsNRC22,Special);
        }
        if(m==1)//NRC22_档位
        {
          if((Tar_NRC22&0x8)!=0)
            IsNRC22 = 1;
          else
            IsNRC22 = 0;
          _NRC22_Gears(Send_Data,Send_Len,ID,Session,Step_Write,IsNRC22,Special);
        }
        if(m==2)//NRC22_发动机
        {
          if((Tar_NRC22 & 0x20)!=0)
            IsNRC22 = 1;
          else
            IsNRC22 = 0;
          _NRC22_Ready(Send_Data,Send_Len,ID,Session,Step_Write,IsNRC22,Special);
        }
        if(m==3)//NRC22_电压
        {
          if((Tar_NRC22 & 0x02)!=0)
            IsNRC22 = 1;
          else
            IsNRC22 = 0;
          _NRC22_Battery(Send_Data,Send_Len,ID,Session,Step_Write,IsNRC22,Special);
        }
        
      }
    }
    else if(Type == 1)
    {
      Auto_Loop_22 = 2;
      if(Set_Battery_RS232 == 0)
        Auto_Loop_22=3;
      for(m=0;m<Auto_Loop_22;m++)
      {
        _SetSession(defsession);
        if(Session != defsession)
          _SetSession(Session);    /*会话切换防止上一次干扰*/
        if(Serve == 0x31)
        {
          _Send_Key(SendKey_Len,phyreq_ID,_get_seed(phyreq_ID),0);
          _TestResult(SendData,phyreq_ID,"",-1);
          Get_Seed_Flage = 1;
        }
        if(m==2)//NRC22_电压
        {
          if((Tar_NRC22 & 0x02)!=0)
            IsNRC22 = 1;
          else
            IsNRC22 = 0;
          _NRC22_Battery(Send_Data,Send_Len,ID,Session,Step_Write,IsNRC22,Special);
        }
      }
    }
  }
}
/*
    自动化测试NRC22车速条件
    Send_Data：发送数据
    Send_Len：发送长度
    ID：寻址
    Session: 会话
    Step ：打印内容
    Tpye ：0:正常响应,无NRC22条件   1:响应NRC22
*/
_NRC22_CarSpd(byte Send_Data[],dword Send_Len,dword ID,byte Session,char Step[],byte Tpye,int Special)
{
  byte Temp_NRC22_HigCar;
  int Temp_NRC22_InCar;
  dword Fun;
  int Flage_31;
  Temp_NRC22_HigCar = 0x22;
  Temp_NRC22_InCar = -1;
  Flage_31 = 0;
  _WriteEx_and_Report("","-----------------------");
  _WriteEx_and_Report("","NRC22_车速测试");
  _WriteEx_and_Report("","-----------------------");
  if(Send_Data[0] == 0x31 && Tpye == 1)
  {
    Fun = ((Send_Data[2]<<8) | (Send_Data[3]));
    Temp_NRC22_InCar = -1;
    Flage_31 = 1;
  }
  if(Special == 1)
    _Other_1002();
  if(Flage_31 == 0)
  {
    _WriteEx_and_Report("步骤1","设置车速 > NRC22车速");
    _Set_CarSpd(NRC22_CarSpd+1);
    if(Tpye == 0)
    {
      _Send_Diag(Send_Len,ID,Send_Data);
      _TestResult(SendData,ID,Step,-1);
      _Special_Step(diagGetLastResponseCode(SendData),Special,Step,Session);
    }
    else if(Tpye == 1)
    {
      _Send_Diag(Send_Len,ID,Send_Data);
      _TestResult(SendData,ID,Step,Temp_NRC22_HigCar);
      _Special_Step(diagGetLastResponseCode(SendData),Special,Step,Session);
    }
    
    _WriteEx_and_Report("步骤2","设置车速 = NRC22车速");
    _Set_CarSpd(NRC22_CarSpd);
    _Send_Diag(Send_Len,ID,Send_Data);
    _TestResult(SendData,ID,Step,-1);
    _Special_Step(diagGetLastResponseCode(SendData),Special,Step,Session);
    _WriteEx_and_Report("步骤3","设置车速 > NRC22车速，再丢失车速");
    _Set_CarSpd(NRC22_CarSpd+1);
    testWaitForTimeout(300);
    _TestDisableMsg(Car_Spd_ID);
    testWaitForTimeout(Lost_CarSpd_Time*1.1);
    _Send_Diag(Send_Len,ID,Send_Data);
    _TestResult(SendData,ID,Step,-1);
    _Special_Step(diagGetLastResponseCode(SendData),Special,Step,Session);
    _TestEnableMsg(Car_Spd_ID);
    _Set_CarSpd(0);
    testWaitForTimeout(Lost_CarSpd_Time*1.1);
    _WriteEx_and_Report("步骤4","设置车速 > NRC22车速，再无效车速");
    _Set_CarSpd(NRC22_CarSpd+1);
    _Set_CarSpd_Invalid(Car_Spd_Invalid);
    _Send_Diag(Send_Len,ID,Send_Data);
    _TestResult(SendData,ID,Step,Temp_NRC22_InCar);
    _Special_Step(diagGetLastResponseCode(SendData),Special,Step,Session);
    _Reset_CarSpd_Invalid();
    _Set_CarSpd(0);
    testWaitForTimeout(500);
  }
  else
  {
    _WriteEx_and_Report("步骤1","设置车速 > 0车速");
    _Set_CarSpd(1);
    if(Tpye == 0)
    {
      _Send_Diag(Send_Len,ID,Send_Data);
      _TestResult(SendData,ID,Step,-1);
      _Special_Step(diagGetLastResponseCode(SendData),Special,Step,Session);
    }
    else if(Tpye == 1)
    {
      _Send_Diag(Send_Len,ID,Send_Data);
      _TestResult(SendData,ID,Step,Temp_NRC22_HigCar);
      _Special_Step(diagGetLastResponseCode(SendData),Special,Step,Session);
    }
    _WriteEx_and_Report("步骤2","设置车速 = 0车速，再丢失车速");
    _Set_CarSpd(0);
    testWaitForTimeout(100);
    _TestDisableMsg(Car_Spd_ID);
    testWaitForTimeout(Lost_CarSpd_Time*1.1);
    _Send_Diag(Send_Len,ID,Send_Data);
    _TestResult(SendData,ID,Step,Temp_NRC22_InCar);
    _Special_Step(diagGetLastResponseCode(SendData),Special,Step,Session);
    _WriteEx_and_Report("步骤3","设置车速丢失恢复，再无效车速");
    _TestEnableMsg(Car_Spd_ID);
    testWaitForTimeout(Lost_CarSpd_Time*1.1);
    _Set_CarSpd_Invalid(Car_Spd_Invalid);
    _Send_Diag(Send_Len,ID,Send_Data);
    _TestResult(SendData,ID,Step,Temp_NRC22_InCar);
    _Special_Step(diagGetLastResponseCode(SendData),Special,Step,Session);
    _Reset_CarSpd_Invalid();
    _Set_CarSpd(0);
    testWaitForTimeout(500);
  }
}
/*
    自动化测试NRC22档位条件
    Send_Data：发送数据
    Send_Len：发送长度
    ID：寻址
    Session: 会话
    Step ：打印内容
    Tpye ：0:正常响应,无NRC22条件   1:响应NRC22
*/
_NRC22_Gears(byte Send_Data[],dword Send_Len,dword ID,byte Session,char Step[],byte Tpye,int Special)
{
  byte Temp_NRC22;
  byte Temp_27[2] = {0x27,0x01};
  int j;
  Temp_NRC22 = 0x22;
  Temp_27[1] = RequestSeed_27;
  if(Gears_ID != 0 && strncmp(Gears_Signal,"NULL",strlen(Gears_Signal)) != 0)
  {
    _WriteEx_and_Report("","-----------------------");
    _WriteEx_and_Report("","NRC22_档位测试");
    _WriteEx_and_Report("","-----------------------");
    if(Special == 1)
      _Other_1002();
    for(j=NRC_22_Gears_Range[0];j<NRC_22_Gears_Range[1];j++)
    {
      if(j==NRC_22_Gears_Normal)
        continue;
      
      _WriteEx_and_Report("步骤1","设置档位为非正常档位");
      _Set_Gears(j);
      if(Tpye == 0)
      {
        _Send_Diag(Send_Len,ID,Send_Data);
        _TestResult(SendData,phyreq_ID,Step,-1);
       _Special_Step(diagGetLastResponseCode(SendData),Special,Step,Session);
      }
      else if(Tpye == 1)
      {
        _Send_Diag(Send_Len,ID,Send_Data);
        _TestResult(SendData,ID,Step,Temp_NRC22);
        _Special_Step(diagGetLastResponseCode(SendData),Special,Step,Session);
      }
      _WriteEx_and_Report("步骤2","丢失档位");
      _TestDisableMsg(Gears_ID);
      testWaitForTimeout(1000);
      _Send_Diag(Send_Len,ID,Send_Data);
      _TestResult(SendData,ID,Step,-1);
      _Special_Step(diagGetLastResponseCode(SendData),Special,Step,Session);
      _TestEnableMsg(Gears_ID);
      testWaitForTimeout(1000);
      _WriteEx_and_Report("步骤3","设置档位为正常档位");
      _Set_Gears(NRC_22_Gears_Normal);
      _Send_Diag(Send_Len,ID,Send_Data);
      _TestResult(SendData,ID,Step,-1);
      _Special_Step(diagGetLastResponseCode(SendData),Special,Step,Session);
      testWaitForTimeout(500);
    }
  }
  else
    writeEx(-3,0,"未输入档位条件,跳过测试");
}
/*
    自动化测试NRC22发动机条件
    Send_Data：发送数据
    Send_Len：发送长度
    ID：寻址
    Session: 会话
    Step ：打印内容
    Tpye ：0:正常响应,无NRC22条件   1:响应NRC22
*/
_NRC22_Ready(byte Send_Data[],dword Send_Len,dword ID,byte Session,char Step[],byte Tpye,int Special)
{
  byte Temp_NRC22;
  byte Temp_27[2] = {0x27,0x01};
  Temp_NRC22 = 0x22;

  Temp_27[1] = RequestSeed_27;
  _WriteEx_and_Report("","-----------------------");
  _WriteEx_and_Report("","NRC22_发动机测试");
  _WriteEx_and_Report("","-----------------------");
  if(Special == 1)
    _Other_1002();
  _WriteEx_and_Report("步骤1","设置发动机满足NRC22条件");
  _Set_Ready(Ready_Active);
  if(Tpye == 0)
  {
    _Send_Diag(Send_Len,ID,Send_Data);
    _TestResult(SendData,phyreq_ID,Step,-1);
    _Special_Step(diagGetLastResponseCode(SendData),Special,Step,Session);
  }
  else if(Tpye == 1)
  {
    _Send_Diag(Send_Len,ID,Send_Data);
    _TestResult(SendData,ID,Step,Temp_NRC22);
    _Special_Step(diagGetLastResponseCode(SendData),Special,Step,Session);
  }
  
  _WriteEx_and_Report("步骤2","丢失发动机信号");
  _TestDisableMsg(Ready_ID);
  testWaitForTimeout(1000);
  _Send_Diag(Send_Len,ID,Send_Data);
  _TestResult(SendData,ID,Step,-1);
  _Special_Step(diagGetLastResponseCode(SendData),Special,Step,Session);
  _TestEnableMsg(Ready_ID);
  testWaitForTimeout(1000);
  if(strlen(ReadyInvalid_Sig) == 0 || strncmp(ReadyInvalid_Sig,"nan",strlen("nan")) == 0)
  {
    _WriteEx_and_Report("","无发动机无效相关测试");
    return;
  }
  _WriteEx_and_Report("步骤3","设置发动机无效");
  _Set_Sig(ReadyInvalid_Sig,Ready_Invalid);
  testWaitForTimeout(ReadyInvalid_Time*1.2);
  _Send_Diag(Send_Len,ID,Send_Data);
  _TestResult(SendData,ID,Step,-1);
  _Special_Step(diagGetLastResponseCode(SendData),Special,Step,Session);
  _WriteEx_and_Report("步骤4","设置发动机到正常状态");
  _Set_Ready(0);
  _Set_Sig(ReadyInvalid_Sig,0);
  testWaitForTimeout(ReadyInvalid_Time*1.2);
  _Send_Diag(Send_Len,ID,Send_Data);
  _TestResult(SendData,ID,Step,-1);
  _Special_Step(diagGetLastResponseCode(SendData),Special,Step,Session);
  testWaitForTimeout(500);
  _Set_Ready(0);
}
/*
    自动化测试NRC22电压条件
    Send_Data：发送数据
    Send_Len：发送长度
    ID：寻址
    Session: 会话
    Step ：打印内容
    Tpye ：0:正常响应,无NRC22条件   1:响应NRC22
*/
_NRC22_Battery(byte Send_Data[],dword Send_Len,dword ID,byte Session,char Step[],byte Tpye,int Special)
{
  byte Temp_NRC22_Hig,Temp_NRC22_Low;
  byte Temp_27[2] = {0x27,0x01};
  Temp_NRC22_Hig = 0x22;
  Temp_NRC22_Low = 0x22;
  Temp_27[1] = RequestSeed_27;
  _WriteEx_and_Report("","-----------------------");
  _WriteEx_and_Report("","NRC22_电压测试");
  _WriteEx_and_Report("","-----------------------");
  if(Special == 1)
    _Other_1002();
  
  _WriteEx_and_Report("步骤1","设置电压 > NRC22高压");
  _Set_Battery(NRC22_Battery_Hight+0.2);
  if(Tpye == 0)
  {
    _Send_Diag(Send_Len,ID,Send_Data);
    _TestResult(SendData,phyreq_ID,Step,-1);
    _Special_Step(diagGetLastResponseCode(SendData),Special,Step,Session);
  }
  else if(Tpye == 1)
  {
    _Send_Diag(Send_Len,ID,Send_Data);
    _TestResult(SendData,ID,Step,Temp_NRC22_Hig);
    _Special_Step(diagGetLastResponseCode(SendData),Special,Step,Session);
  }
  _WriteEx_and_Report("步骤2","设置电压 < NRC22高压");
  _Set_Battery(NRC22_Battery_Hight-0.2);
  _Send_Diag(Send_Len,ID,Send_Data);
  _TestResult(SendData,ID,Step,-1);
  _Special_Step(diagGetLastResponseCode(SendData),Special,Step,Session);
  _WriteEx_and_Report("步骤3","设置电压 < NRC22低压");
  _Set_Battery(NRC22_Battery_Low-0.2);
  _Send_Diag(Send_Len,ID,Send_Data);
  if(Tpye == 0)
  {
    _TestResult(SendData,phyreq_ID,Step,-1);
    _Special_Step(diagGetLastResponseCode(SendData),Special,Step,Session);
  }
  else if(Tpye == 1)
  {
    _TestResult(SendData,ID,Step,Temp_NRC22_Low);
    _Special_Step(diagGetLastResponseCode(SendData),Special,Step,Session);
  }
  _Special_Step(diagGetLastResponseCode(SendData),Special,Step,Session);
  _WriteEx_and_Report("步骤4","设置电压 > NRC22低压");
  _Set_Battery(NRC22_Battery_Low+0.2);
  _Send_Diag(Send_Len,ID,Send_Data);
  _TestResult(SendData,ID,Step,-1);
  _Special_Step(diagGetLastResponseCode(SendData),Special,Step,Session);
  testWaitForTimeout(500);
  _Set_Battery(12);;
}
void _Special_Step(int Code,byte Special,char St[],byte Session)
{
  int Serve34_Poss;
  byte Temp_34[11];
  byte Temp_27[2] = {0x27,0x01};
   
  Serve34_Poss = _Check_Serve(0x34,0,0);
  _Get_Serve_INI(Temp_34,0x34,Serve34_Poss,0);
  Temp_27[1] = RequestSeed_27;
  if(Code == -1)
  {
    if(Special == 1)
    {
      testWaitForTimeout(1000);
      _Send_Diag(BT_34_Len,phyreq_ID,Temp_34);
      if(@AUTO::Config_Switch == 4)
        _TestResult(SendData,phyreq_ID,St,0x24);
      else
        _TestResult(SendData,phyreq_ID,St,0x22);
      _SetSession(defsession);
      testWaitForTimeout(1000);
      _Other_1002();
//      if(Session_BIN !=4 && Session==exsession)
//        _SetSession(exsession);
      _SetSession(Session);
    }
    else if(Special == 2)
    {
      testWaitForTimeout(2000);
      _Send_Diag(2,phyreq_ID,Temp_27);
      _TestResult(SendData,phyreq_ID,St,0x7F);
      _SetSession(Session);
      testWaitForTimeout(200);
    }
    else if(Special == 3)
    {
      _SetSession(defsession);
      _SetSession(Session);
      testWaitForTimeout(200);
    }
  }
  else if(Code > 0)
  {
    if(Special == 1)
    {
      testWaitForTimeout(1000);
      _Send_Diag(BT_34_Len,phyreq_ID,Temp_34);
      _TestResult(SendData,phyreq_ID,St,0x7F);
    }
    else if(Special == 2)
    {
      testWaitForTimeout(2000);
      _Send_Diag(2,phyreq_ID,Temp_27);
      _TestResult(SendData,phyreq_ID,St,-1);
      _SetSession(defsession);
      _SetSession(Session);
      testWaitForTimeout(200);
    }
    else if(Special == 3)
    {
//      _SetSession(defsession); //上一次消极响应情况下可不在进行重新复位
//      _SetSession(Session);
      testWaitForTimeout(200);
    }
  }
}

//void Special_Requirements(byte Session)
//{
//  if(@AUTO::Config_Switch == 12 && Session == defsession) // 广汽，默认会话下超过300s就休眠
//  {
//    _SetSession(exsession);
//    testWaitForTimeout(200);
//    _SetSession(Session);
//    testWaitForTimeout(200);
//  }
//}



/*
    根据输入的Testcase Title来修改寻址以及会话
*/
void GetInformationFromTitle()
{
  char Title[400];
  char TempForTitle[200];
  char Sevre_Str[10];
  int Title_Index,Count;
  long Offset;
  Count = 0;
  Offset = 0;
  getProfileString("Project_Information", "ECU_project","Null",ECU_project, 200, file_name_1);  
  @sysvar::DID::funreq_ID=getProfileInt(ECU_project, "funreq_ID",0,file_name_1);
  funreq_ID = @sysvar::DID::funreq_ID;
  @sysvar::DID::phyreq_ID=getProfileInt (ECU_project, "phyreq_ID",0,file_name_1);
  phyreq_ID = @sysvar::DID::phyreq_ID;
  @sysvar::DID::Response_ID=getProfileInt (ECU_project, "Response_ID",0,file_name_1);
  Response_ID = @sysvar::DID::Response_ID;
  
  testGetCurrentTestCaseTitle(Title,400);
  snprintf(TempForTitle,elcount(TempForTitle),"");
  snprintf(Sevre_Str,elcount(Sevre_Str),"0x");
  Offset = strstr_off(Title,3,"_");
  snprintf(TempForTitle,Offset+6,"%s",Title); //汉字占用两字节
//  writeEx(-3,0,"%s",TempForTitle);
  if(strstr(TempForTitle,"物理")!= -1)
    ID_From_Title = phyreq_ID;
  else
    ID_From_Title = funreq_ID;
  if(strstr(TempForTitle,"默认")!= -1)
    Session_From_Title = defsession;
  else if(strstr(TempForTitle,"编程")!= -1)
    Session_From_Title = prosession;
  else
    Session_From_Title = exsession;
  for(Count=6;Count<8;Count++)
    snprintf(Sevre_Str,elcount(Sevre_Str),"%s%c",Sevre_Str,TempForTitle[Count]);
  Serve_Form_Title = atol(Sevre_Str);
//  writeEx(-3,0,"%X , %d , %X",ID_From_Title,Session_From_Title,Serve_Form_Title);
}

/*
    发送并判断当前会话
    Session == 0xFF,特殊情况不判断返回值，并返回当前会话
*/
byte _Send_And_Check_NowSession(dword ID,byte Session)
{
  _get_Arry("Read_Now_Session");
  if(Support_ReadSession == 1)
  {
    testWaitForTimeout(10);
    _Send_Diag(3,ID,Read_Now_Session);
    _TestResult(SendData,ID,"读取当前会话模式",-1);
    if(diagGetLastResponseCode(SendData)==-1)
    {
      byte Session_Now;
      Session_Now = DiagGetRespPrimitiveByte(SendData,3);
      if(Session == 0xFF)
        return Session_Now;
      if(Session_Now == Session)
        testStepPass("","当前会话与预期一致为0x%02X",Session_Now);
      else
        testStepFail("","当前会话为0x%02X，预期会话为0x%02X",Session_Now,Session);
      return Session_Now;
    }
  }
  else
  {
//    _WriteEx_and_Report("","不支持读取当前会话");
  }
  return 0;
}

_get_Arry(char srt[])
{
  char Temp_Value_0[500];
  char Temp_Value_2[50];
  int i,j,m;
  m = 0;
  snprintf(Temp_Value_0,elCount(Temp_Value_0),"%s","");
  glbHandle1 = OpenFileRead (file_name_1,0);
  getProfileString(ECU_project,srt,"Null",Temp_Value_0, 1000, file_name_1);
  fileClose(glbHandle1);
  if(strncmp(Temp_Value_0,"Null",strlen(Temp_Value_0)) == 0 && strlen(Temp_Value_0) == strlen("Null"))
  {
    Arry_Len = 0;
    // _WriteEx_and_Report(srt,"未获取到输入数据");
  }
  else
  {
    Arry_Len = (strlen(Temp_Value_0)-1)/5;
    for(i = 0;i<strlen(Temp_Value_0);i++)                  
    {
      snprintf(Temp_Value_2,elCount(Temp_Value_2),"%s","");
      if(Temp_Value_0[i] == 48 && (Temp_Value_0[i+1] == 120 ||Temp_Value_0[i+1] == 88 ))
      {
        for(j=0;j<8;j++)
        {
          if(Temp_Value_0[i+j]==44 || i+j==strlen(Temp_Value_0)-1) 
          {
            m++; break;
          }
          else
            snprintf(Temp_Value_2,elCount(Temp_Value_2),"%s%c",Temp_Value_2,HexToAsc(Temp_Value_0[i+j]));
        }
        Arry_Data[m-1] = atol(Temp_Value_2);
      }
    }
    if(strncmp(srt,"Read_Now_Session",strlen(srt)) == 0 && strlen(srt) == strlen("Read_Now_Session"))
    {
      if(Arry_Len>1)
      {
        Support_ReadSession = 1;
        Read_Now_Session[0] = 0x22;
        Read_Now_Session[1] = Arry_Data[0];
        Read_Now_Session[2] = Arry_Data[1];
      }
    }
  }
}

File_Write(char file_path[],char file_name[],char StrValue[],int state)
{
  char buffer_write[20000];
  long ret;

  setFilePath(file_path, 2);//不可以直接设置C根目录，2表明可以对这个目录下的文件可读可写
  glbHandle1 = openFileWrite (file_name,state); //以ASCII打开，并且覆盖文件原有内容
  if ( glbHandle1!=0 )
  {
    ret = filePutString(StrValue, strlen(StrValue), glbHandle1);    
    if(ret)
      fileClose (glbHandle1);
  } 
}

_Check_ResCode(diagRequest* obj,dword msgID,int Ex1,int Ex2)
{
  int Res_Now;
  Res_Now = diagGetLastResponseCode(obj);
  if(Res_Now !=Ex1 && Res_Now != Ex2)
  {
    testStepFail("","当前返回与期望不符");
  }
  else
  {
    testStepPass("","当前返回与期望一致");
  }
}

/*
  Flage = 0 无需安全访问
  Flage = 1 需安全访问
*/
_Set_11_Restoration(byte Flage)
{
  byte Temp[2]={0x11,0x01};
  int k,Serve_Pos;
  Serve_Pos = _Check_Serve(0x11,0,0);
  if(Serve_Pos == -1)
  {
    _WriteEx_and_Report("","未查询到支持11服务");
    return;
  }
  if(Flage == 1)
  {
    if(Serve_Data[Serve_Pos].Security_Access[0]==1)
      _unlockECU();
  }
  Temp[1] = Serve_Data[Serve_Pos].Serve_Fun[0];
  _Send_Diag(2,phyreq_ID,Temp);
  _TestResult(SendData,phyreq_ID,"",-1);
  testWaitForTimeout(2000); /*11复位后增加延时时间防止后续出错*/
  Session_BIN = 1;
}

/*
  通过种子计算出密钥并发送,发送多个正确秘钥
  len 发送长度
  ID 发送ID
  Temp_seed 种子
*/
_Send_Key_(byte len, dword ID,qword Temp_seed,int Type)   
{
  byte Key_Data[500];
  dword m=0;
  dword Skey;
  int i;
  word key_i,End_Byte;
  
  Key_Data[0] = 0x27;
  Key_Data[1] = SendKey_27;
  if(AES_128 == 0)
  {
    byte Skey_Temp_Byte[4];
    SecurityAccess(Temp_seed,Skey);
    testStep("密钥","计算出密钥为0x%2X",Skey);
    Skey_Temp_Byte[3] = Skey&0xFF;
    Skey_Temp_Byte[2] = (Skey>>8)&0xFF;
    Skey_Temp_Byte[1] = (Skey>>16)&0xFF;
    Skey_Temp_Byte[0] = (Skey>>24)&0xFF;
    for(m=2;m<len;m++)
      Key_Data[m] = Skey_Temp_Byte[(m-2)%4];
  }
  else if(AES_128 == 1)
  {
    _WriteEx_and_Report(ECU_project,"当前采用AES-CMAC算法");
    _Key_Count();
    for(key_i = 0; key_i < len; key_i++)
      Key_Data[key_i+2] = corresKey[key_i%16];
  }
  else if(AES_128 == 2)
  {
    _WriteEx_and_Report(ECU_project,"当前采用AES-CBC算法");
    for(m=0;m<16;m++)
      RA[m]=Seed_CBC[m];
    /*用密钥KEY解密RA 得到ra`*/
    AES128_CBC_decrypt_buffer(ra,RA,KEY_Len,Secret_KEY,Iv);
    /*ra`逆向*/
    reverseNum(ra,16);
    testWaitForTimeout(50);
    /*用密钥KEY加密r得到R*/
    AES128_CBC_encrypt_buffer(R,ra,KEY_Len,Secret_KEY,Iv);
    for(key_i = 0; key_i < len; key_i++)
      Key_Data[key_i+2] = R[key_i%16];
  }
  if(Type>=0)
    Key_Data[1] = Type;
  _Send_Diag(len,ID,Key_Data);   
}

_Key_Count() // 用于匹配简化输入调用，计算安全秘钥使用
{
  switch(@AUTO::Config_Switch)
  {
    case 2://长安掩码
      _SecurityAccess_AES(Seed_AES,fixByte_CCAG_APP,corresKey);break;
    case 4:
       if(Session_BIN == 2)
        _SecurityAccess_AES(Seed_AES,fixByte_Geely_Bt,corresKey);
       else
        _SecurityAccess_AES(Seed_AES,fixByte_Geely_APP,corresKey);
       break;
    case 6://瑞驰掩码
      _SecurityAccess_AES(Seed_AES,fixByte_RC_BT,corresKey);break;
    case 11:
      _SecurityAccess_AES(Seed_AES,fixByte_Chery_BT,corresKey);break;
    default:
      _WriteEx_and_Report("","未收到正确的配置信息");break;
  }
}

int _Check_Dword_in_Num(byte Da,byte Data[],int Len)//检测数据是否在整形数组中
{
  int flage,n;
  flage = -1;
  for(n=0;n<Len;n++)
  {
    if(Da==Data[n])
    {
      flage = n;
      break;
    }
  }
  return flage;
}
/*
    检测31H中当前寻址以及会话是否有支持的RID
*/
int _Check_Serve31H_(dword ID,byte Session)
{
  int i,Return_Value;
  byte Add,Sess;
  if(ID == funreq_ID)
    Add = 2;
  else if(ID == phyreq_ID)
    Add = 1;
  if(Session == defsession)
    Sess = 1;
  else if(Session == prosession)
    Sess = 2;
  else if(Session == exsession)
    Sess = 4;
  Return_Value = 0;
  for(i=0;i<Serve_31_Hex_Count;i++)
  {
    if((Serve_31_Hex[i].Serve_Addres[0]& Add) != 0)
    {
      if((Serve_31_Hex[i].Serve_Session[0]& Sess) != 0)
      {
        Return_Value = 1;
        break;
      }
    }
  }
  return Return_Value;
}