/*@!Encoding:936*/


variables
{
  word defaultValue[2][26]={{1,3,13,16,17,50,57,58,59,
                             62,142,150,316,317,494,540,547,565,615,
                             639,640,695,773,784,829,831},
  
                           { 0xE4,0x81,0x04,0x02,0x1D,0x03,0x03,0x01,0x01,
                             0x50,0x80,0x02,0x84,0x01,0x02,0x02,0x02,0x02,0x02,
                             0x01,0x02,0x03,0x01,0x01,0x01,0x02 }};   //默认配置
  int ccpNumscount;
  dword ccpNums[26]={1,3,13,16,17,50,57,58,59,62,142,150,316,317,494,540,547,565,615,639,640,695,773,784,829,831}; //从小到大排列
  /*
      CCP新增
          defaultValue：需修改个数以及在后面增加对应的CCP号和默认值
          ccpNums：需修改个数以及在后面增加对应的CCP号
          需新建对应的value数组
          byte ValidValue(word ccpNum,int len)：新增CCP号对应的内容
          dword CCPlen(word ccpNum)：新增CCP号对应的内容
  
      CCP删除
          defaultValue：需修改个数以及删除在后面增加对应的CCP号和默认值
          ccpNums：需修改个数以及在后面删除对应的CCP号
          其余保持不变即可
  */
  
  /*CCP --25R3--*/
  byte value1[109]={0x01,0x02,0x03,0x04,0x05,0x06,0x07,0x08,
                    0x09,0x0A,0x0B,0x0C,0x0D,0x0E,0x0F,0x10,
                    0x80,0x81,0x82,0x83,0x84,0x85,0x86,0x87,
                    0x88,0x8A,0x8B,0x8C,0x8D,0x8E,0x8F,0x90,
                    0x91,0x92,0x93,0x94,0x98,0xA1,0xA2,0xA3,
                    0xA4,0xA5,0xA6,0xA7,0xA8,0xA9,0xAA,0xAB,
                    0xAC,0xAD,0xAE,0xAF,0xB0,0xB1,0xB2,0xB3,
                    0xB4,0xB5,0xB6,0xB7,0xB8,0xB9,0xBA,0xBB,
                    0xBC,0xBD,0xBE,0xBF,0xC0,0xC1,0xC2,0xC3,
                    0xC4,0xC5,0xC6,0xC7,0xC8,0xC9,0xCB,0xCC,
                    0xCD,0xCE,0xCF,0xD0,0xE0,0xE1,0xE2,0xE3,
                    0xE4,0xE5,0xE6,0xE7,0xEA,0xEB,0xEC,0xEF,
                    0xF0,0xF1,0xF3,0xF4,0xF5,0xF6,0xF7,0xF8,
                    0xF9,0xFA,0xFB,0xFC,0xFD};
  
  byte value3[4]={0x01,0x02,0x80,0x81};
  
  byte value13[6]={0x01,0x02,0x03,0x04,0x80,0x81};
  
  byte value16[2]={0x01,0x02};
  
  byte value17[80]={0x01,0x02,0x03,0x04,0x05,0x06,0x07,0x08,
                    0x09,0x0A,0x0B,0x0C,0x0D,0x0E,0x0F,0x10,
                    0x11,0x12,0x13,0x14,0x15,0x16,0x17,0x18,
                    0x19,0x1A,0x1B,0x1C,0x1D,0x1E,0x1F,0x20,
                    0x21,0x22,0x23,0x24,0x25,0x26,0x27,0x80,
                    0x81,0x82,0x83,0x84,0x85,0x86,0x87,0x88,
                    0x89,0x8A,0x8B,0x8C,0x8D,0x8E,0x8F,0x90,
                    0x91,0x92,0x93,0x94,0x95,0x96,0x97,0x98,
                    0x99,0x9A,0x9B,0x9C,0x9D,0x9E,0x9F,0xA0,
                    0xA1,0xA2,0xA3,0xA8,0xAF,0xB0,0xB1,0xFD};
  
  byte value50[10]={0x01,0x02,0x03,0x04,0x05,0x06,0x07,0x08,0x80,0x81};
  
  byte value57[4]={0x01,0x02,0x03,0x04};
  
  byte value58[5]={0x01,0x02,0x03,0x80,0x81};
  
  byte value59[4]={0x01,0x02,0x80,0x82};
  
  byte value62[87]={0x01,0x3A,0x3D,0x3E,0x3F,0x40,0x41,0x42,
                    0x43,0x44,0x45,0x46,0x47,0x48,0x49,0x4A,
                    0x4B,0x4C,0x4D,0x4E,0x4F,0x50,0x51,0x52,
                    0x53,0x54,0x55,0x56,0x57,0x58,0x59,0x5A,
                    0x5B,0x5C,0x5D,0x5E,0x5F,0x60,0x61,0x62,
                    0x63,0x64,0x65,0x66,0x67,0x68,0x69,0x6A,
                    0x6B,0x6C,0x6D,0x6E,0x6F,0x70,0x71,0x72,
                    0x73,0x74,0x75,0x76,0x77,0x78,0x79,0x7A,
                    0x7B,0x7C,0x7D,0x7E,0x7F,0x80,0x81,0x82,
                    0x83,0x84,0x85,0x86,0x87,0x8B,0x8E,0x92,
                    0x93,0x96,0x9A,0x9E,0xA2,0xA6,0xFE};
  
  byte value100[5]={0x01,0x02,0x03,0x80,0x81};//CCP_25R3无此项
  
  byte value142[17]={0x01,0x02,0x03,0x04,0x05,0x06,0x07,0x08,
                     0x09,0x0A,0x80,0x81,0x82,0x83,0x84,0x85,0x86};
  
  byte value150[3]={0x01,0x02,0x05};  //CCP_25R3新增
  
  byte value316[11]={0x01,0x02,0x03,0x04,0x05,0x06,0x80,0x81,
                     0x82,0x83,0x84};
  
  byte value317[4]={0x01,0x02,0x03,0x04};
  
  byte value494[14]={0x01,0x02,0x03,0x04,0x05,0x80,0x81,0x82,0x83,
                     0x84,0x85,0x86,0x87,0x88};//CCP_25R3新增部分内容
  
  byte value540[2]={0x01,0x02};   //供应商不需要做
  
  byte value547[2]={0x01,0x02};   //供应商不需要做
  
  byte value565[3]={0x01,0x02,0x03};
  
  byte value566[69]={0x01,0x02,0x03,0x04,0x05,0x06,0x07,0x08,
                     0x09,0x10,0x11,0x12,0x13,0x14,0x15,0x16,
                     0x17,0x18,0x19,0x1A,0x1B,0x1C,0x1D,0x1E,
                     0x1F,0x20,0x21,0x22,0x23,0x24,0x25,0x26,
                     0x27,0x28,0x29,0x2A,0x2B,0x2C,0x2D,0x32,
                     0x33,0x3A,0x3B,0x3C,0x3D,0x3E,0x3F,0x41,
                     0x42,0x43,0x44,0x45,0x46,0x47,0x48,0x49,
                     0x4A,0x50,0x51,0x52,0x53,0x54,0x55,0x56,
                     0x57,0x58,0x59,0x5A,0x5B};//CCP_25R3无此项
  
  byte value615[3]={0x01,0x02,0x03};    //CCP_25R3新增
  
  byte value639[8]={0x01,0x02,0x03,0x04,0x05,0x06,0x07,0x08};
  
  byte value640[9]={0x01,0x02,0x03,0x04,0x05,0x06,0x07,0x08,0x09};
  
  byte value695[12]={0x01,0x02,0x03,0x04,0x05,0x06,0x07,0x08,
                     0x09,0x0A,0x0B,0x0C};    //CCP_25R3新增
  
  byte value773[8]={0x01,0x02,0x03,0x04,0x05,0x06,0x07,0x08};
  
  byte value784[4]={0x01,0x02,0x03,0x04};
  
  byte value798[5]={0x01,0x02,0x03,0x04,0x05};    //CCP_25R3新增，供应商不需要做
  
  byte value829[6]={0x01,0x02,0x03,0x04,0x05,0x06};
  
  byte value831[2]={0x01,0x02};
  
  byte value1260[4]={0x01,0x02,0x03,0x04};    //CCP_25R3新增，供应商不需要做
  
  byte value1261[3]={0x01,0x02,0x03};   //CCP_25R3新增，供应商不需要做
  
}


byte ValidValue(word ccpNum,int len)
{
  byte CCPvalue;

  switch(ccpNum)
  {
    case 1:  CCPvalue = value1[len];  break;
    case 3:  CCPvalue = value3[len];  break;
    case 13: CCPvalue = value13[len];  break;
    case 16: CCPvalue = value16[len];  break;
    case 17: CCPvalue = value17[len];  break;
    case 50: CCPvalue = value50[len];  break;
    case 57: CCPvalue = value57[len];  break;
    case 58: CCPvalue = value58[len];  break;
    case 59: CCPvalue = value59[len];  break;
    case 62: CCPvalue = value62[len];  break;
    case 100: CCPvalue = value100[len];  break;
    case 142:CCPvalue = value142[len];  break;
    case 150:CCPvalue = value150[len];  break;
    case 316:CCPvalue = value316[len];  break;
    case 317:CCPvalue = value317[len];  break;
    case 494:CCPvalue = value494[len];  break;
    case 540:CCPvalue = value540[len];  break;
    case 547:CCPvalue = value547[len];  break;
    case 565:CCPvalue = value565[len];  break;
    case 566:CCPvalue = value566[len];  break;
    case 615:CCPvalue = value615[len];  break;
    case 639:CCPvalue = value639[len];  break;
    case 640:CCPvalue = value640[len];  break;
    case 695:CCPvalue = value695[len];  break;
    case 773:CCPvalue = value773[len];  break;
    case 784:CCPvalue = value784[len];  break;
    case 798:CCPvalue = value798[len];  break;
    case 829:CCPvalue = value829[len];  break;
    case 831:CCPvalue = value831[len];  break;
    case 1260:CCPvalue = value1260[len];  break;
    case 1261:CCPvalue = value1261[len];  break;
  }
  return CCPvalue;
}
dword CCPlen(word ccpNum)
{  
  dword CCPlen;

  switch(ccpNum)
  {
    case 1:  return elCount(value1); break;
    case 3:  return elCount(value3); break;
    case 13:  return elCount(value13); break;
    case 16:  return elCount(value16); break;
    case 17:  return elCount(value17); break;
    case 50:  return elCount(value50); break;
    case 57:  return elCount(value57); break;
    case 58:  return elCount(value58); break;
    case 59:  return elCount(value59); break;
    case 62:  return elCount(value62); break;
    case 100:  return elCount(value100); break;
    case 142: return elCount(value142); break;
    case 150: return elCount(value150); break;
    case 316: return elCount(value316); break;
    case 317: return elCount(value317); break;
    case 494: return elCount(value494); break;
    case 540: return elCount(value540); break;
    case 547: return elCount(value547); break;
    case 565: return elCount(value565); break;
    case 566: return elCount(value566); break;
    case 615: return elCount(value615); break;
    case 639: return elCount(value639); break;
    case 640: return elCount(value640); break;
    case 695: return elCount(value695); break;
    case 773: return elCount(value773); break;
    case 784: return elCount(value784); break;
    case 798: return elCount(value798); break;
    case 829: return elCount(value829); break;
    case 831: return elCount(value831); break;
    case 1260: return elCount(value1260); break;
    case 1261: return elCount(value1261); break;
  }
  return 0;
}
