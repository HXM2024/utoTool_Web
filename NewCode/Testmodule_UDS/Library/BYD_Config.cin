/*@!Encoding:936*/

includes
{
  #include "BYD_Config_Fun.cin"
}

variables
{
  dword glbHandle12;
  char ECU_project3[50];
  
  
  byte ADS_Torque;
  byte LKA_Ang;
  byte DST;
  byte tune;
  byte Auto_Driver;
  byte Vehicle_Category;
  byte RCS;
  byte SFS;
  byte ATS;
  byte LKA_Torque;
  byte APA;
  byte LDW;
  byte ADS_Ang;
  byte SVC;
  byte SAC;
  byte SMS;
  byte VOT;
  byte Car_Config[4];
  diagRequest *BYD_Config;
  diagRequest *ReadData;
  dword LKA_Ang_ID = 0x1FC;
  dword LKA_Torque_ID = 0x318;
  dword APA_ID = 0x135;
  dword DST_ID = 0x27F;
  dword ADS_ID = 0x06D;
  dword SVC_SAC_ID = 0x094;
  dword Lose_0x1E2_DTC ;
  dword Lose_0x27E_DTC ;
  dword Lose_0x410_DTC ;
  dword Lose_0x240_DTC ;
  dword Lose_0x134_DTC ;
  dword Lose_0x057_DTC ;
  dword Lose_0x316_DTC ;
  char Cdd_Name_3[50];
  
  
  struct BYD_Default_Config{
    char Str_Config[50];
    byte Data_Config_Input[8];
    byte Data_Check[1];
    byte Data_Config_Send[8];
  }; 
  struct BYD_Default_Config Default_Config[10];   //存储BYD默认配置字列表
  dword Default_Config_Count;
  
  struct BYD_Config_Fun{
    char Str_Fun[50];
    dword DTC;
    int Exist;
    dword Id;
  }; 
  struct BYD_Config_Fun Config_Fun[50];   //存储BYD默认配置字列表
  dword Config_Fun_Count;
  
  
}
void _lost_node()
{
  testDisableMsg(0x1E2);
  testDisableMsg(0x27E);
  testDisableMsg(0x410);
  testDisableMsg(0x240);
  testDisableMsg(0x134);
  testDisableMsg(0x057);
  writeEx(-3,0,"丢失节点");
  testWaitForTimeout(2000);/*等待故障成熟*/
}
void _open_node()
{
  testEnableMsg(0x1E2);
  testEnableMsg(0x27E);
  testEnableMsg(0x410);
  testEnableMsg(0x240);
  testEnableMsg(0x134);
  testEnableMsg(0x057);
  writeEx(-3,0,"恢复节点");
  testWaitForTimeout(2000);/*等待故障恢复*/
}

void _Config_Check(byte data[],char str[],byte type)
{
  qword DTC;
  int _Flage;
  testStep(str,"擦除配置字并重启");
  writeEx(-3,0,"%s,擦除配置字并重启",str);
  _lost_node();
  _BYD_unlockECU();
  _Clear_BYD_Config(0);
  _Check_ReadConfig(0,data);
  _Set_11_Restoration_BYD();
  testWaitForTimeout(5000);/*BYD上电3s内不检测网络故障+故障成熟时间*/
  testStep(str,"写入预期配置字");
  writeEx(-3,0,"%s,写入预期配置字",str);
  _BYD_unlockECU();
  _Send_BYD_Config(type,data,1);
  _Check_ReadConfig(1,data);
  _Check_DTC(0);
  _open_node();
  _Check_Fun(str,0);
  
  testStep(str,"第一次检测完毕并重启");
  writeEx(-3,0,"第一次检测完毕并重启");
  _lost_node();
  _Set_11_Restoration_BYD();
  glbHandle12 = OpenFileRead (file_name_1,0);
  _Flage = getProfileInt(ECU_project3,str,_Flage,file_name_1);
  fileClose(glbHandle12);
  testWaitForTimeout(5000);/*BYD上电3s内不检测网络故障*/
  _Check_ReadConfig(1,data);
  if(strncmp(str,"LKA_Ang",strlen(str)) == 0&& (strncmp("LKA_Ang",str,strlen("LKA_Ang")) == 0))
    DTC = Lose_0x1E2_DTC;
  else if(strncmp(str,"LKA_Torque",strlen(str)) == 0&& (strncmp("LKA_Torque",str,strlen("LKA_Torque")) == 0))
    DTC = Lose_0x316_DTC;
  else if(strncmp(str,"APA",strlen(str)) == 0&& (strncmp("APA",str,strlen("APA")) == 0))
    DTC = Lose_0x134_DTC;
  else if(strncmp(str,"DST",strlen(str)) == 0&& (strncmp("DST",str,strlen("DST")) == 0))
    DTC = Lose_0x27E_DTC;
  else if((strncmp(str,"ADS_Torque",strlen(str)) == 0) && (strncmp("ADS_Torque",str,strlen("ADS_Torque")) == 0))
    DTC = Lose_0x057_DTC;
  else if((strncmp(str,"ADS_Ang",strlen(str)) == 0) && (strncmp("ADS_Ang",str,strlen("ADS_Ang")) == 0))
    DTC = Lose_0x057_DTC;
  else if((strncmp(str,"RCS",strlen(str)) == 0) && (strncmp("RCS",str,strlen("RCS")) == 0))
    DTC= Lose_0x410_DTC;
  else if((strncmp(str,"ATS",strlen(str)) == 0) && (strncmp("ATS",str,strlen("ATS")) == 0))
    DTC = Lose_0x240_DTC;
  else
    DTC = 0;
  if((strncmp(str,"ATS",strlen(str)) == 0) && ((data[1]>>4)&0x01==1))
    DTC = 0;
  if(_Flage == 0)
    DTC = 0;
  _Check_DTC(DTC);
  _open_node();
  if((strncmp(str,"ATS",strlen(str)) == 0) && (strncmp(str,"ATS",strlen(str)) == 0))
  {
    if((data[1]>>4)&0x01==1)
      _Check_Fun(str,1);
    else
      _Check_Fun(str,0);
    return;
  }
  _Check_Fun(str,1);
}

_Check_Fun(char str_1[],byte type)/*type =0:节点不外发  type =1:节点外发*/
{
  byte Temp_Fun;
  dword ID;
  float Ang_1;
  int Flage_2;
  Flage_2 = 0;
  Temp_Fun = 0;
  glbHandle12 = OpenFileRead (file_name_1,0);
  getProfileString("Project_Information","ECU_project","Null",ECU_project3,1000,file_name_1);  
  Temp_Fun = getProfileInt(ECU_project3,str_1,Temp_Fun,file_name_1);
  fileClose(glbHandle12);
  writeEx(-3,0,"/---------------------------------------/");
  writeEx(-3,0,"               %s               ",str_1);
  writeEx(-3,0,"/---------------------------------------/");
  if(strncmp(str_1,"LKA_Ang",strlen(str_1)) == 0)
    ID = LKA_Ang_ID;
  else if(strncmp(str_1,"SMS",strlen(str_1)) == 0)
  {}
  else if(strncmp(str_1,"LKA_Torque",strlen(str_1)) == 0)
    ID = LKA_Torque_ID;
  else if(strncmp(str_1,"APA",strlen(str_1)) == 0)
    ID = APA_ID;
  else if(strncmp(str_1,"DST",strlen(str_1)) == 0)
    ID = DST_ID;
  else if((strncmp(str_1,"SVC",strlen(str_1)) == 0) || (strncmp("SVC",str_1,strlen("SVC")) == 0))
    ID = SVC_SAC_ID;
  else if((strncmp(str_1,"SAC",strlen(str_1)) == 0) || (strncmp("SAC",str_1,strlen("SAC")) == 0))
    ID = SVC_SAC_ID;
  else if((strncmp(str_1,"ADS_Torque",strlen(str_1)) == 0) || (strncmp("ADS_Torque",str_1,strlen("ADS_Torque")) == 0))
  {
    ID = ADS_ID;
    Flage_2=1;
  }
  else if((strncmp(str_1,"ADS_Ang",strlen(str_1)) == 0) || (strncmp("ADS_Ang",str_1,strlen("ADS_Ang")) == 0))
  {
    ID = ADS_ID;
    Flage_2=2;
  }
  else if((strncmp(str_1,"RCS",strlen(str_1)) == 0) || (strncmp("RCS",str_1,strlen("RCS")) == 0))
  {
    Flage_2=3;
    Temp_Fun = 2;
  }
  else if((strncmp(str_1,"SFS",strlen(str_1)) == 0) || (strncmp("SFS",str_1,strlen("SFS")) == 0))
  {
    Flage_2=4;
    Temp_Fun = 2;
  }
  else if((strncmp(str_1,"ATS",strlen(str_1)) == 0) || (strncmp("ATS",str_1,strlen("ATS")) == 0))
  {
    Flage_2=5;
    Temp_Fun = 2;
  }
  else if((strncmp(str_1,"LDW",strlen(str_1)) == 0) || (strncmp("LDW",str_1,strlen("LDW")) == 0))
  {
    Flage_2=6;
    Temp_Fun = 2;
  }
  else if((strncmp(str_1,"ADS_LDW",strlen(str_1)) == 0) || (strncmp("ADS_LDW",str_1,strlen("ADS_LDW")) == 0))
  {
    Flage_2=7;
    Temp_Fun = 2;
  }
  else
    writeEx(-3,0,"输入值未查询到正确ID");
  if((strncmp(str_1,"LKA_Torque",strlen(str_1)) == 0) &&  type==1)
    _Check_EPS_TX(1,ID);
  else if(((strncmp(str_1,"SAC",strlen(str_1)) == 0)||(strncmp(str_1,"SVC",strlen(str_1)) == 0))&&  type==1)
    _Check_EPS_TX(1,ID);
  else
  {
    if(Temp_Fun==1)
      _Check_EPS_TX(type,ID);
    else if(Temp_Fun==0)
    {
      testStep(str_1,"无相应功能,期望报文不外发");
      writeEx(-3,0,"无相应功能,期望报文不外发");
      _Check_EPS_TX(0,ID);
    }
  }
  if(ID == LKA_Ang_ID && LKA_Ang==1 && Flage_2==0)  /*用于验证LKA角度控制是否可以激活*/
    _Check_ADAS_LKA_Ang(type);
  else if(ID == APA_ID && APA==1 && Flage_2==0)  /*用于验证APA是否可以激活*/
    _Check_APA(type);
  else if(ID == DST_ID && DST==1 && Flage_2==0)  /*用于验证DST是否可以激活*/
    _Check_DST(type);
  else if(ID == LKA_Torque_ID && LKA_Torque==1 && Flage_2==0)  /*用于验证LKA扭矩控制是否可以激活*/
    _Check_ADAS_LKA_Torque(type);
  else if(ID == ADS_ID && ADS_Torque==1 &&Flage_2==1)  /*用于验证高阶扭矩控制是否可以激活*/
    _Check_ADS_Torque(type);
  else if(ID == ADS_ID && ADS_Ang==1 &&Flage_2==2)    /*用于验证高阶转角控制是否可以激活*/
    _Check_ADS_Ang(type);
  else if( Flage_2==3)    /*用于验证RCS是否可以激活*/
    _Check_RCS(type);
  else if( Flage_2==4)    /*用于验证SFS是否可以激活*/
    _Check_SFS(type);
  else if( Flage_2==5)    /*用于验证ATS是否可以激活*/
    _Check_ATS(type);
  else if( Flage_2==6)    /*用于验证LDW是否可以激活*/
    _Check_LDW(type);
  else if( Flage_2==7)    /*用于验证ADS_LDW是否可以激活*/
    _Check_ADS_LDW(type);
}
/*
  type == 0: 21 00    
  type == 1: F1 A1   
  Checks = 1:正确校验  
  Checks = 0:错误校验位
*/
_Send_BYD_Config(byte type, byte Send_Data[],byte Checks) 
{
  int m;
  byte size;
  qword checksum_config;
  byte config_0[3] = {0x2E,0x21,0x00};
  byte config_1[3] = {0x2E,0xF1,0xA1};
  checksum_config = 0;
  size = 0x0B;
  diagResize(BYD_Config,size);
  if(type==0)
  {
    for(m=0;m<3;m++)
      DiagSetPrimitiveByte(BYD_Config,m,config_0[m]);
  }
  else
  {
    for(m=0;m<3;m++)
      DiagSetPrimitiveByte(BYD_Config,m,config_1[m]);
  }
  for(m=3;m<7;m++)
  {
    DiagSetPrimitiveByte(BYD_Config,m,Car_Config[m-3]);
    checksum_config = checksum_config + Car_Config[m-3];
  }
  for(m=7;m<0x0A;m++)
  {
    DiagSetPrimitiveByte(BYD_Config,m,Send_Data[m-7]);
    checksum_config = checksum_config + Send_Data[m-7];
  }
  if(Checks==1)
    checksum_config = (checksum_config^0x55)&0xFF;
  else if(Checks == 0)
    checksum_config = 0;
  DiagSetPrimitiveByte(BYD_Config,0x0a,checksum_config);
  _SendAndWriteReport(BYD_Config,@DID::phyreq_ID);
}
_Clear_BYD_Config(byte type) /*type==0: 全0x00    type==1:全0xFF*/
{
  int m;
  byte size;
  qword checksum_config;
  byte config_1[3] = {0x2E,0xF1,0xA1};
  checksum_config = 0;
  size = 0x0B;
  diagResize(BYD_Config,size);
  for(m=0;m<3;m++)
    DiagSetPrimitiveByte(BYD_Config,m,config_1[m]);
  if(type==0)
  {
    for(m=3;m<size-1;m++)
      DiagSetPrimitiveByte(BYD_Config,m,0x00);
    DiagSetPrimitiveByte(BYD_Config,m,0x55);
  }
  else
  {
    for(m=3;m<size;m++)
      DiagSetPrimitiveByte(BYD_Config,m,0xff);
  }
  _SendAndWriteReport(BYD_Config,@DID::phyreq_ID);
}
_Check_ReadConfig(byte type, byte data[])/*type==0: 检测擦除配置字后为全0    type==1: 正常读取*/
{
  byte Read_0[3] = {0x22,0x21,0x00};
  byte Read_1[3] = {0x22,0xF1,0xA1};
  byte size,RxSize,Temp_Flage;
  qword checksum_config;
  int m;
  size = 3;
  Temp_Flage = 0;
  checksum_config = 0;
  diagResize(ReadData,size);
  for(m=0;m<3;m++)
    DiagSetPrimitiveByte(ReadData,m,Read_0[m]);
  _SendAndWriteReport(ReadData,@DID::phyreq_ID);
  if(diagGetLastResponseCode(ReadData)==0)
    testWaitForDiagResponse(ReadData,500);
  if(diagGetLastResponseCode(ReadData)==-1)
  {
    RxSize = DiagGetRespPrimitiveSize(ReadData);
    if(RxSize != 0x0B)
    {
      testStepFail("0x21 0x00","读取配置字反馈长度异常,当前长度为0x%x",RxSize);
      return;
    }
    else
      testStepPass("0x21 0x00","长度与预期一致为0x0B");
    if(DiagGetRespPrimitiveByte(ReadData,0)!=0x62)
      testStepFail("","反馈值与预期不一致,预期为0x%2X,实际为0x%2X",0x62,DiagGetRespPrimitiveByte(ReadData,0));
    for(m=1;m<2;m++)
    {
      if(DiagGetRespPrimitiveByte(ReadData,m)!= Read_0[m])
        Temp_Flage = 1;
    }
    if(type==1)
    {
      for(m=3;m<7;m++)
      {
        if(DiagGetRespPrimitiveByte(ReadData,m)!= Car_Config[m-3])
          Temp_Flage = 2;   
        checksum_config = checksum_config + Car_Config[m-3];
      }
      for(m=7;m<0x0A;m++)
      {
        if(DiagGetRespPrimitiveByte(ReadData,m)!= data[m-7])
          Temp_Flage = 2;   
        checksum_config = checksum_config + data[m-7];
      }
      checksum_config = (checksum_config^0x55)&0xFF;
      if(DiagGetRespPrimitiveByte(ReadData,0x0A)!=checksum_config)
        Temp_Flage = 2;   
      if(Temp_Flage==0)
        testStepPass("0x21 0x00","读取到的配置字与写入保持一致");
      else if(Temp_Flage==1)
        testStepFail("0x21 0x00","标示符错误");
      else
        testStepFail("0x21 0x00","配置字与写入不一致");
    }
    else
    {
      for(m=3;m<0x0B;m++)
      {
        if(DiagGetRespPrimitiveByte(ReadData,m)!= 0x00)
          Temp_Flage = 2;
      }
      if(Temp_Flage==0)
        testStepPass("0x21 0x00","读取到的配置字与写入保持一致");
      else if(Temp_Flage==1)
        testStepFail("0x21 0x00","标示符错误");
      else
        testStepFail("0x21 0x00","配置字与写入不一致");
    }
  }
  else
    testStepFail("0x21 0x00","读取配置字失败");
  testWaitForTimeout(500);
  
  checksum_config = 0;
  Temp_Flage = 0;
  diagResize(ReadData,size);
  for(m=0;m<3;m++)
    DiagSetPrimitiveByte(ReadData,m,Read_1[m]);
  _SendAndWriteReport(ReadData,@DID::phyreq_ID);
  if(diagGetLastResponseCode(ReadData)==0)
    testWaitForDiagResponse(ReadData,500);
  if(diagGetLastResponseCode(ReadData)==-1)
  {
    RxSize = DiagGetRespPrimitiveSize(ReadData);
    if(RxSize != 0x0B)
    {
      testStepFail("0xF1 0xA1","读取配置字反馈长度异常,当前长度为0x%x",RxSize);
      return;
    }
    else
      testStepPass("0xF1 0xA1","长度与预期一致为0x0B");
    if(DiagGetRespPrimitiveByte(ReadData,0)!=0x62)
      testStepFail("","反馈值与预期不一致,预期为0x%2X,实际为0x%2X",0x62,DiagGetRespPrimitiveByte(ReadData,0));
    for(m=1;m<2;m++)
    {
      if(DiagGetRespPrimitiveByte(ReadData,m)!= Read_1[m])
        Temp_Flage = 1;
    }
    if(type==1)
    {
      for(m=3;m<7;m++)
      {
        if(DiagGetRespPrimitiveByte(ReadData,m)!= Car_Config[m-3])
          Temp_Flage = 2;   
        checksum_config = checksum_config + Car_Config[m-3];
      }
      for(m=7;m<0x0A;m++)
      {
        if(DiagGetRespPrimitiveByte(ReadData,m)!= data[m-7])
          Temp_Flage = 2; 
        checksum_config = checksum_config + data[m-7];
      }
      checksum_config = (checksum_config^0x55)&0xFF;
      if(DiagGetRespPrimitiveByte(ReadData,0x0A)!=checksum_config)
        Temp_Flage = 2;  
      if(Temp_Flage==0)
        testStepPass("0xF1 0xA1","读取到的配置字与写入保持一致");
      else if(Temp_Flage==1)
        testStepFail("0xF1 0xA1","标示符错误");
      else
        testStepFail("0xF1 0xA1","配置字与写入不一致");
    }
    else
    {
      for(m=3;m<0x0B;m++)
      {
        if(DiagGetRespPrimitiveByte(ReadData,m)!= 0x00)
          Temp_Flage = 2;
      }
      if(Temp_Flage==0)
        testStepPass("0xF1 0xA1","读取到的配置字与写入保持一致");
      else if(Temp_Flage==1)
        testStepFail("0xF1 0xA1","标示符错误");
      else
        testStepFail("0xF1 0xA1","配置字与写入不一致");
    }
  }
  else
    testStepFail("0x21 0xA1","读取配置字失败");
  testWaitForTimeout(200);
}

_Check_ReadConfig_(byte type, byte data[])/*type==0: 检测擦除配置字后为全0    type==1: 正常读取*/
{
  byte Read_0[3] = {0x22,0x21,0x00};
  byte Read_1[3] = {0x22,0xF1,0xA1};
  byte size,RxSize,Temp_Flage;
  qword checksum_config;
  int m;
  size = 3;
  Temp_Flage = 0;
  checksum_config = 0;
  diagResize(ReadData,size);
  for(m=0;m<3;m++)
    DiagSetPrimitiveByte(ReadData,m,Read_0[m]);
  _SendAndWriteReport(ReadData,@DID::phyreq_ID);
  if(diagGetLastResponseCode(ReadData)==0)
    testWaitForDiagResponse(ReadData,500);
  if(diagGetLastResponseCode(ReadData)==-1)
  {
    RxSize = DiagGetRespPrimitiveSize(ReadData);
    if(RxSize != 0x0B)
    {
      testStepFail("0x21 0x00","读取配置字反馈长度异常,当前长度为0x%x",RxSize);
      return;
    }
    else
      testStepPass("0x21 0x00","长度与预期一致为0x0B");
    if(DiagGetRespPrimitiveByte(ReadData,0)!=0x62)
      testStepFail("","反馈值与预期不一致,预期为0x%2X,实际为0x%2X",0x62,DiagGetRespPrimitiveByte(ReadData,0));
    if(type==1)
    {
      for(m=3;m<10;m++)
      {
        if(DiagGetRespPrimitiveByte(ReadData,m) != data[m])
          Temp_Flage = 2;
      }
      if(DiagGetRespPrimitiveByte(ReadData,0x0A)!=data[0xA])
        Temp_Flage = 1;   
      if(Temp_Flage==0)
        testStepPass("0x21 0x00","读取到的配置字与写入保持一致");
      else if(Temp_Flage==1)
        testStepFail("0x21 0x00","校验位错误");
      else
        testStepFail("0x21 0x00","配置字与写入不一致");
    }
    else
    {
      for(m=3;m<0x0B;m++)
      {
        if(DiagGetRespPrimitiveByte(ReadData,m)!= 0x00)
          Temp_Flage = 2;
      }
      if(Temp_Flage==0)
        testStepPass("0x21 0x00","读取到的配置字与写入保持一致");
      else if(Temp_Flage==1)
        testStepFail("0x21 0x00","标示符错误");
      else
        testStepFail("0x21 0x00","配置字与写入不一致");
    }
  }
  else
    testStepFail("0x21 0x00","读取配置字失败");
  testWaitForTimeout(500);
  
  checksum_config = 0;
  Temp_Flage = 0;
  diagResize(ReadData,size);
  for(m=0;m<3;m++)
    DiagSetPrimitiveByte(ReadData,m,Read_1[m]);
  _SendAndWriteReport(ReadData,@DID::phyreq_ID);
  if(diagGetLastResponseCode(ReadData)==0)
    testWaitForDiagResponse(ReadData,500);
  if(diagGetLastResponseCode(ReadData)==-1)
  {
    RxSize = DiagGetRespPrimitiveSize(ReadData);
    if(RxSize != 0x0B)
    {
      testStepFail("0xF1 0xA1","读取配置字反馈长度异常,当前长度为0x%x",RxSize);
      return;
    }
    else
      testStepPass("0xF1 0xA1","长度与预期一致为0x0B");
    if(DiagGetRespPrimitiveByte(ReadData,0)!=0x62)
      testStepFail("","反馈值与预期不一致,预期为0x%2X,实际为0x%2X",0x62,DiagGetRespPrimitiveByte(ReadData,0));
    for(m=1;m<2;m++)
    {
      if(DiagGetRespPrimitiveByte(ReadData,m)!= Read_1[m])
        Temp_Flage = 1;
    }
    if(type==1)
    {
      for(m=3;m<10;m++)
      {
        if(DiagGetRespPrimitiveByte(ReadData,m) != data[m])
          Temp_Flage = 2;
      }
      if(DiagGetRespPrimitiveByte(ReadData,0x0A)!=data[0xA])
        Temp_Flage = 1;   
      if(Temp_Flage==0)
        testStepPass("0xF1 0xA1","读取到的配置字与写入保持一致");
      else if(Temp_Flage==1)
        testStepFail("0xF1 0xA1","校验位错误");
      else
        testStepFail("0xF1 0xA1","配置字与写入不一致");
    }
    else
    {
      for(m=3;m<0x0B;m++)
      {
        if(DiagGetRespPrimitiveByte(ReadData,m)!= 0x00)
          Temp_Flage = 2;
      }
      if(Temp_Flage==0)
        testStepPass("0xF1 0xA1","读取到的配置字与写入保持一致");
      else if(Temp_Flage==1)
        testStepFail("0xF1 0xA1","标示符错误");
      else
        testStepFail("0xF1 0xA1","配置字与写入不一致");
    }
  }
  else
    testStepFail("0x21 0xA1","读取配置字失败");
  testWaitForTimeout(200);
}
void Get_value_BYD_Config()
{
  int k,m,i;
  char Temp_Value[200];
  char Temp_Value_1[1000];
  char Temp_Value_2[1000];
  m=0;
  Default_Config_Count = 0;
  snprintf(Temp_Value,elCount(Temp_Value),"%s","");
  snprintf(Temp_Value_1,elCount(Temp_Value_1),"%s","");
  snprintf(Temp_Value_2,elCount(Temp_Value_2),"%s","");
  glbHandle12 = OpenFileRead (file_name_1,0);
  getProfileString("Project_Information", "ECU_project","Null",ECU_project3, 1000, file_name_1);  
  
  ADS_Torque = getProfileInt(ECU_project3,"ADS_Torque",ADS_Torque,file_name_1);
  LKA_Ang = getProfileInt(ECU_project3,"LKA_Ang",LKA_Ang,file_name_1);
  DST = getProfileInt(ECU_project3,"DST",DST,file_name_1);
  tune = getProfileInt(ECU_project3,"tune",tune,file_name_1);
  Auto_Driver = getProfileInt(ECU_project3,"Auto_Driver",Auto_Driver,file_name_1);
  Vehicle_Category = getProfileInt(ECU_project3,"Vehicle_Category",Vehicle_Category,file_name_1);
  RCS = getProfileInt(ECU_project3,"RCS",RCS,file_name_1);
  SFS = getProfileInt(ECU_project3,"SFS",SFS,file_name_1);
  ATS = getProfileInt(ECU_project3,"ATS",ATS,file_name_1);
  LKA_Torque = getProfileInt(ECU_project3,"LKA_Torque",LKA_Torque,file_name_1);
  APA = getProfileInt(ECU_project3,"APA",APA,file_name_1);
  LDW = getProfileInt(ECU_project3,"LDW",LDW,file_name_1);
  ADS_Ang = getProfileInt(ECU_project3,"ADS_Ang",ADS_Ang,file_name_1);
  SVC = getProfileInt(ECU_project3,"SVC",SVC,file_name_1);
  SAC = getProfileInt(ECU_project3,"SAC",SAC,file_name_1);
  SMS = getProfileInt(ECU_project3,"SMS",SMS,file_name_1);
  VOT = getProfileInt(ECU_project3,"VOT",VOT,file_name_1);
  Lose_0x1E2_DTC = getProfileInt(ECU_project3,"Lose_0x1E2_DTC",Lose_0x1E2_DTC,file_name_1);
  Lose_0x27E_DTC = getProfileInt(ECU_project3,"Lose_0x27E_DTC",Lose_0x27E_DTC,file_name_1);
  Lose_0x410_DTC = getProfileInt(ECU_project3,"Lose_0x410_DTC",Lose_0x410_DTC,file_name_1);
  Lose_0x240_DTC = getProfileInt(ECU_project3,"Lose_0x240_DTC",Lose_0x240_DTC,file_name_1);
  Lose_0x134_DTC = getProfileInt(ECU_project3,"Lose_0x134_DTC",Lose_0x134_DTC,file_name_1);
  Lose_0x057_DTC = getProfileInt(ECU_project3,"Lose_0x057_DTC",Lose_0x057_DTC,file_name_1);
  Lose_0x316_DTC = getProfileInt(ECU_project3,"Lose_0x316_DTC",Lose_0x316_DTC,file_name_1);
  getProfileString(ECU_project3, "Cdd_Name","Null",Cdd_Name_3, 50, file_name_1);
  getProfileString(ECU_project3, "Car_Config","Null",Temp_Value, 200, file_name_1);
  getProfileString(ECU_project3, "Car_Config_Group","Null",Temp_Value_2, 1000, file_name_1);
  fileClose(glbHandle12);
  for(k=1;k<strlen(Temp_Value);k++)
  {
    if(Temp_Value[k]==44 || Temp_Value[k]==125)
    {
      Car_Config[m] = atol(Temp_Value_1);
      m++;
      snprintf(Temp_Value_1,elCount(Temp_Value_1),"%s","");
    }
    else
      snprintf(Temp_Value_1,elCount(Temp_Value_1),"%s%c",Temp_Value_1,Temp_Value[k]);
  }
  m = 0;
  for(k=0;k<strlen(Temp_Value_2);k++)
  {
    if(Temp_Value_2[k]==91)
    {
      for(m=k+1;m<strlen(Temp_Value_2);m++)
      {
        if(Temp_Value_2[m]==93 || Temp_Value_2[m]==125)
        {
          Default_Config_Count++;
          break;
        }
        else
          snprintf(Default_Config[Default_Config_Count].Str_Config,elCount(Default_Config[Default_Config_Count].Str_Config),"%s%c",Default_Config[Default_Config_Count].Str_Config,Temp_Value_2[m]);
      }
    }
    if(Temp_Value_2[k]==125)
      break;
  }
  for(i=0;i<Default_Config_Count;i++)
    Init_Struct_Config(Default_Config[i].Str_Config,i);
  testWaitForTimeout(200);
}
void Init_Struct_Config(char Str_[],int Pos_)
{
  char Temp_Value[100];
  char Temp_Value_1[100];
  qword Check_Sum;
  int k,m,j;
  snprintf(Temp_Value,elCount(Temp_Value),"%s","");
  snprintf(Temp_Value_1,elCount(Temp_Value_1),"%s","");
  glbHandle12 = OpenFileRead (file_name_1,0);
  getProfileString(ECU_project3, Str_,"Null",Temp_Value_1, 100, file_name_1);
  fileClose(glbHandle12);
  j = 0;
  for(k=0;k<strlen(Temp_Value_1);k++)
  {
    if(Temp_Value_1[k]==91)
    {
      for(m=k+1;m<strlen(Temp_Value_1);m++)
      {
        if(Temp_Value_1[m]==44 || Temp_Value_1[m]==93)
        {
          Default_Config[Pos_].Data_Config_Input[j] = atol(Temp_Value);
          snprintf(Temp_Value,elCount(Temp_Value),"%s","");
          j++;
          if(Temp_Value_1[m]==93)
            break;
        }
        else
          snprintf(Temp_Value,elCount(Temp_Value),"%s%c",Temp_Value,Temp_Value_1[m]);
      }
    }
  }
  Check_Sum = 0;
  for(j=0;j<7;j++)
  {
    Check_Sum = Check_Sum + Default_Config[Pos_].Data_Config_Input[j];
    Default_Config[Pos_].Data_Config_Send[j] = Default_Config[Pos_].Data_Config_Input[j];
  }
  Default_Config[Pos_].Data_Check[0] = ((Check_Sum^0x55) &0xFF);
  Default_Config[Pos_].Data_Config_Send[7] =  Default_Config[Pos_].Data_Check[0];
}
void Init_BYD_Config_Fun(byte Da_Input[])
{
  int i;
  Config_Fun_Count = 0;
  if((Da_Input[4]&0x80) != 0)
  {
    Config_Fun[Config_Fun_Count].Id = ADS_ID;
    snprintf(Config_Fun[Config_Fun_Count].Str_Fun,elCount(Config_Fun[Config_Fun_Count].Str_Fun),"ADS_Torque");
    Config_Fun[Config_Fun_Count].DTC = Lose_0x057_DTC;
    Config_Fun[Config_Fun_Count].Exist = ADS_Torque;
    Config_Fun_Count++;
  }
  if((Da_Input[4]&0x40) != 0)
  {
    Config_Fun[Config_Fun_Count].Id = LKA_Ang_ID;
    snprintf(Config_Fun[Config_Fun_Count].Str_Fun,elCount(Config_Fun[Config_Fun_Count].Str_Fun),"LKA_Ang");
    Config_Fun[Config_Fun_Count].DTC = Lose_0x1E2_DTC;
    Config_Fun[Config_Fun_Count].Exist = LKA_Ang;
    Config_Fun_Count++;
  }
  if((Da_Input[4]&0x20) != 0)
  {
    Config_Fun[Config_Fun_Count].Id = DST_ID;
    snprintf(Config_Fun[Config_Fun_Count].Str_Fun,elCount(Config_Fun[Config_Fun_Count].Str_Fun),"DST");
    Config_Fun[Config_Fun_Count].DTC = Lose_0x27E_DTC;
    Config_Fun[Config_Fun_Count].Exist = DST;
    Config_Fun_Count++;
  }
  if((Da_Input[5]&0x20) != 0)
  {
    Config_Fun[Config_Fun_Count].Id = 0;
    snprintf(Config_Fun[Config_Fun_Count].Str_Fun,elCount(Config_Fun[Config_Fun_Count].Str_Fun),"RCS");
    Config_Fun[Config_Fun_Count].DTC = Lose_0x410_DTC;
    Config_Fun[Config_Fun_Count].Exist = RCS;
    Config_Fun_Count++;
  }
  if((Da_Input[5]&0x10) != 0)
  {
    Config_Fun[Config_Fun_Count].Id = 0;
    snprintf(Config_Fun[Config_Fun_Count].Str_Fun,elCount(Config_Fun[Config_Fun_Count].Str_Fun),"SFS");
    Config_Fun[Config_Fun_Count].DTC = 0;
    Config_Fun[Config_Fun_Count].Exist = SFS;
    Config_Fun_Count++;
  }
  if((Da_Input[5]&0x08) != 0)
  {
    Config_Fun[Config_Fun_Count].Id = 0;
    snprintf(Config_Fun[Config_Fun_Count].Str_Fun,elCount(Config_Fun[Config_Fun_Count].Str_Fun),"ATS");
    Config_Fun[Config_Fun_Count].DTC = Lose_0x240_DTC;
    Config_Fun[Config_Fun_Count].Exist = ATS;
    Config_Fun_Count++;
  }
  if((Da_Input[5]&0x04) != 0)
  {
    Config_Fun[Config_Fun_Count].Id = LKA_Torque_ID;
    snprintf(Config_Fun[Config_Fun_Count].Str_Fun,elCount(Config_Fun[Config_Fun_Count].Str_Fun),"LKA_Torque");
    Config_Fun[Config_Fun_Count].DTC = Lose_0x316_DTC;
    Config_Fun[Config_Fun_Count].Exist = LKA_Torque;
    Config_Fun_Count++;
  }
  if((Da_Input[5]&0x02) != 0)
  {
    Config_Fun[Config_Fun_Count].Id = APA_ID;
    snprintf(Config_Fun[Config_Fun_Count].Str_Fun,elCount(Config_Fun[Config_Fun_Count].Str_Fun),"APA");
    Config_Fun[Config_Fun_Count].DTC = Lose_0x134_DTC;
    Config_Fun[Config_Fun_Count].Exist = APA;
    Config_Fun_Count++;
  }
  if((Da_Input[5]&0x01) != 0)
  {
    if((Da_Input[4]&0x80) != 0 || (Da_Input[6]&0x10) != 0)
    {
      Config_Fun[Config_Fun_Count].Id = 0;
      snprintf(Config_Fun[Config_Fun_Count].Str_Fun,elCount(Config_Fun[Config_Fun_Count].Str_Fun),"ADS_LDW");
      Config_Fun[Config_Fun_Count].DTC = Lose_0x057_DTC;
      Config_Fun[Config_Fun_Count].Exist = LDW;
      Config_Fun_Count++;
    }
    else
    {
      Config_Fun[Config_Fun_Count].Id = LKA_Torque_ID;
      snprintf(Config_Fun[Config_Fun_Count].Str_Fun,elCount(Config_Fun[Config_Fun_Count].Str_Fun),"LDW");
      Config_Fun[Config_Fun_Count].DTC = Lose_0x316_DTC;
      Config_Fun[Config_Fun_Count].Exist = LDW;
      Config_Fun_Count++;
    }
  }
  if((Da_Input[6]&0x10) != 0)
  {
    Config_Fun[Config_Fun_Count].Id = ADS_ID;
    snprintf(Config_Fun[Config_Fun_Count].Str_Fun,elCount(Config_Fun[Config_Fun_Count].Str_Fun),"ADS_Ang");
    Config_Fun[Config_Fun_Count].DTC = Lose_0x057_DTC;
    Config_Fun[Config_Fun_Count].Exist = ADS_Ang;
    Config_Fun_Count++;
  }
  if((Da_Input[6]&0x08) != 0)
  {
    Config_Fun[Config_Fun_Count].Id = SVC_SAC_ID;
    snprintf(Config_Fun[Config_Fun_Count].Str_Fun,elCount(Config_Fun[Config_Fun_Count].Str_Fun),"SVC");
    Config_Fun[Config_Fun_Count].DTC = 0;
    Config_Fun[Config_Fun_Count].Exist = SVC;
    Config_Fun_Count++;
  }
  if((Da_Input[6]&0x04) != 0)
  {
    Config_Fun[Config_Fun_Count].Id = SVC_SAC_ID;
    snprintf(Config_Fun[Config_Fun_Count].Str_Fun,elCount(Config_Fun[Config_Fun_Count].Str_Fun),"SAC");
    Config_Fun[Config_Fun_Count].DTC = 0;
    Config_Fun[Config_Fun_Count].Exist = SAC;
    Config_Fun_Count++;
  }
  if((Da_Input[6]&0x02) != 0)
  {
    Config_Fun[Config_Fun_Count].Id = 0;
    snprintf(Config_Fun[Config_Fun_Count].Str_Fun,elCount(Config_Fun[Config_Fun_Count].Str_Fun),"SMS");
    Config_Fun[Config_Fun_Count].DTC = 0;
    Config_Fun[Config_Fun_Count].Exist = SMS;
    Config_Fun_Count++;
  }
  if((Da_Input[6]&0x01) != 0)
  {
    Config_Fun[Config_Fun_Count].Id = 0;
    snprintf(Config_Fun[Config_Fun_Count].Str_Fun,elCount(Config_Fun[Config_Fun_Count].Str_Fun),"VOT");
    Config_Fun[Config_Fun_Count].DTC = 0;
    Config_Fun[Config_Fun_Count].Exist = VOT;
    Config_Fun_Count++;
  }
//  for(i=0;i<Config_Fun_Count;i++)
//  {
//    writeEx(-3,0,"-----------------------------------");
//    writeEx(-3,0,"Config_Fun[%d].Str_Fun = %s",i,Config_Fun[i].Str_Fun);
//    writeEx(-3,0,"Config_Fun[%d].Id = 0x%03X",i,Config_Fun[i].Id);
//    writeEx(-3,0,"Config_Fun[%d].DTC = 0x%06X",i,Config_Fun[i].DTC);
//    writeEx(-3,0,"Config_Fun[%d].Exist = %d",i,Config_Fun[i].Exist);
//  }
    
}
void Init_Config()
{
  WriteEx(-3,0,"初始化");
  _Init_Struct();
  Get_value();
  _Get_DTC_19();
  _Get_CarSpd_Engine();
  Get_value_BYD_Config();
  creat_log("\\BYD_配置字\\");
  _Return_Ang();
  startLogging();
  diagSetTarget(Cdd_Name_3);
  diagStopTesterPresent(Cdd_Name_3);
  _SetSession(defsession);
}
void Init_Config_()
{
  WriteEx(-3,0,"初始化");
  _Init_Struct();
  Get_value();
  _Get_DTC_19();
  _Get_CarSpd_Engine();
  Get_value_BYD_Config();
  creat_log("\\程序更新要求\\");
  startLogging();
  diagSetTarget(Cdd_Name_3);
  diagStopTesterPresent(Cdd_Name_3);
  _SetSession(defsession);
}
void Init_Config_Serve(dword Session)
{
  WriteEx(-3,0,"初始化");
  _Init_Struct();
//  Get_value();
//  _Get_DTC_19();
//  _Get_CarSpd_Engine();
//  Get_value_BYD_Config();
  creat_log("\\BYD特殊需求\\");
  startLogging();
  diagSetTarget(Cdd_Name_3);
  diagStopTesterPresent(Cdd_Name_3);
  _SetSession(Session);
}
void End_Config()
{
  stopLogging();
  testWaitForTimeout(1000);
}

void _2100_config_0(byte Input[],char _Str[],int POS,byte type) /*默认车型配置遍历  0:21 00  1:F1 A1*/
{
  byte data[11];
  int i;
  dword ExDTC[50],ExDTC_Count;
  for(i=3;i<11;i++)
    data[i] = Input[i-3];
  data[0] = 0x2E;
  if(type == 0)
  {
    data[1] = 0x21;
    data[2] = 0x00;
  }
  else
  {
    data[1] = 0xF1;
    data[2] = 0xA1;
  }
  ExDTC_Count = 0;
  Init_BYD_Config_Fun(Input);
  testStep(_Str,"擦除配置字并重启");
  _lost_node();
  _BYD_unlockECU();
  _Clear_BYD_Config(0);
  _Check_ReadConfig_(0,data);
  _Set_11_Restoration_BYD();
  testWaitForTimeout(4500);/*BYD上电3s内不检测网络故障*/
  testStep("","写入预期配置字");
  _BYD_unlockECU();
  _Send_Diag(11,@DID::phyreq_ID,data);
  _TestResult(SendData,@DID::phyreq_ID,"",-1);
  _Check_ReadConfig_(1,data);
  _Check_DTC(0);
  _open_node();
  for(i=0;i<Config_Fun_Count;i++)
  {
    _Check_Fun(Config_Fun[i].Str_Fun,0);
    if(Config_Fun[i].Exist != 0)
    {
      ExDTC[ExDTC_Count] = Config_Fun[i].DTC;
      ExDTC_Count++;
    }
  }
  testStep(_Str,"第一次检测完毕并重启");
  
  _lost_node();
  _Set_11_Restoration_BYD();
  testWaitForTimeout(4500);/*BYD上电3s内不检测网络故障*/
  _Check_ReadConfig_(1,data);
  _Check_DTC_Som_(ExDTC,ExDTC_Count);
  _open_node();
  for(i=0;i<Config_Fun_Count;i++)
    _Check_Fun(Config_Fun[i].Str_Fun,1);
  
}
void _2100_config_1(byte type) /*低阶*/
{
  byte data[3] = {0x64,0x3B,0x00};
  dword ExDTC[5];
  ExDTC[0] = Lose_0x1E2_DTC;
  ExDTC[1] = Lose_0x27E_DTC;
  ExDTC[2] = Lose_0x410_DTC;
  ExDTC[3] = Lose_0x240_DTC;
  ExDTC[4] = Lose_0x134_DTC;
  testStep("","擦除配置字并重启");
  _lost_node();
  _BYD_unlockECU();
  _Clear_BYD_Config(0);
  _Check_ReadConfig(0,data);
  _Set_11_Restoration_BYD();
  testWaitForTimeout(4500);/*BYD上电3s内不检测网络故障*/
  testStep("","写入预期配置字");
  _BYD_unlockECU();
  _Send_BYD_Config(type,data,1);
  _Check_ReadConfig(1,data);
  _Check_DTC(0);
  _open_node();
  _Check_Fun("LKA_Ang",0);
  _Check_Fun("DST",0);
  _Check_Fun("APA",0);
  _Check_Fun("RCS",0);
  _Check_Fun("SFS",0);
  _Check_Fun("ATS",0);
  _Check_Fun("LDW",0);
  
  testStep("","第一次检测完毕并重启");
  _lost_node();
  _Set_11_Restoration_BYD();
  testWaitForTimeout(4500);/*BYD上电3s内不检测网络故障*/
  _Check_ReadConfig(1,data);
  _Check_DTC_Som(ExDTC);
  _open_node();
  _Check_Fun("LKA_Ang",1);
  _Check_Fun("DST",1);
  _Check_Fun("APA",1);
  _Check_Fun("RCS",1);
  _Check_Fun("SFS",1);
  _Check_Fun("ATS",1);
  _Check_Fun("LDW",1);
}
void _2100_config_2(byte type) /*高阶*/
{
  byte data[3] = {0x81,0x39,0x10};
  dword ExDTC[3];
  ExDTC[0] = Lose_0x410_DTC;
  ExDTC[1] = Lose_0x240_DTC;
  ExDTC[2] = Lose_0x057_DTC;
  testStep("","擦除配置字并重启");
  _lost_node();
  _BYD_unlockECU();
  _Clear_BYD_Config(0);
  _Check_ReadConfig(0,data);
  _Set_11_Restoration_BYD();
  testWaitForTimeout(4500);/*BYD上电3s内不检测网络故障*/
  testStep("","写入预期配置字");
  _BYD_unlockECU();
  _Send_BYD_Config(type,data,1);
  _Check_ReadConfig(1,data);
  _Check_DTC(0);
  _open_node();
  _Check_Fun("ADS_Torque",0);
  _Check_Fun("ADS_Ang",0);
  _Check_Fun("ADS_LDW",0);
  _Check_Fun("RCS",0);
  _Check_Fun("SFS",0);
  _Check_Fun("ATS",0);
  
  testStep("","第一次检测完毕并重启");
  _lost_node();
  _Set_11_Restoration_BYD();
  testWaitForTimeout(4500);/*BYD上电3s内不检测网络故障*/
  _Check_ReadConfig(1,data);
  _Check_DTC_Som(ExDTC);
  _open_node();
  _Check_Fun("ADS_Torque",1);
  _Check_Fun("ADS_Ang",1);
  _Check_Fun("ADS_LDW",1);
  _Check_Fun("RCS",1);
  _Check_Fun("SFS",1);
  _Check_Fun("ATS",1);
}
void _2100_config_3(byte type) /*配置ADAS电机扭矩控制接口*/
{
  byte data[3] = {0x81,0x00,0x00};
  _Config_Check(data,"ADS_Torque",type);
}
void _2100_config_4(byte type) /*配置LKA(转角)*/
{
  byte data[3] = {0x41,0x00,0x00};
  _Config_Check(data,"LKA_Ang",type);
}
void _2100_config_5(byte type) /*配置DST*/
{
  byte data[3] = {0x21,0x00,0x00};
  _Config_Check(data,"DST",type);
}
void _2100_config_6(byte type) /*配置RCS*/
{
  byte data[3] = {0x01,0x20,0x00};
  _Config_Check(data,"RCS",type);
}
void _2100_config_7(byte type) /*配置SFS*/
{
  byte data[3] = {0x01,0x10,0x00};
  _Config_Check(data,"SFS",type);
}
void _2100_config_8(byte type) /*配置ATS*/
{
  byte data[3] = {0x01,0x08,0x00};
  _Config_Check(data,"ATS",type);
}
void _2100_config_9(byte type) /*配置LKA(扭矩)*/
{
  byte data[3] = {0x01,0x04,0x00};
  _Config_Check(data,"LKA_Torque",type);
}
void _2100_config_10(byte type) /*配置APA*/
{
  byte data[3] = {0x01,0x02,0x00};
  _Config_Check(data,"APA",type);
}
void _2100_config_11(byte type) /*配置LDW*/
{
  byte data[3] = {0x01,0x01,0x00};
  _Config_Check(data,"LDW",type);
}
void _2100_config_12(byte type) /*配置ADS转角转矩接口*/
{
  byte data[3] = {0x01,0x00,0x10};
  _Config_Check(data,"ADS_Ang",type);
}
void _2100_config_13(byte type) /*配置SVC通用振动接口*/
{
  byte data[3] = {0x01,0x00,0x08};
  _Config_Check(data,"SVC",type);
}
void _2100_config_14(byte type) /*配置SAC通用振动接口*/
{
  byte data[3] = {0x01,0x00,0x04};
  _Config_Check(data,"SAC",type);
}
void _2100_config_15(byte type) /*配置SMS目标转向档位*/
{
  byte data[3] = {0x01,0x00,0x02};
  _Config_Check(data,"SMS",type);
}
void _2100_config_16(byte type) /*配置原地转向【VOT】*/
{
  byte data[3] = {0x01,0x00,0x01};
  _Config_Check(data,"VOT",type);
}
void _2100_config_17(byte type) /*配置高阶ADS方案多级振感功能（扭矩）*/
{
  byte data[3] = {0x81,0x01,0x00};
  testStep("","擦除配置字并重启");
  _lost_node();
  _BYD_unlockECU();
  _Clear_BYD_Config(0);
  _Check_ReadConfig(0,data);
  _Set_11_Restoration_BYD();
  testWaitForTimeout(4500);/*BYD上电3s内不检测网络故障*/
  testStep("","写入预期配置字");
  _BYD_unlockECU();
  _Send_BYD_Config(type,data,1);
  _Check_ReadConfig(1,data);
  _Check_DTC(0);
  _open_node();
  _Check_Fun("ADS_Torque",0);
  _Check_Fun("ADS_LDW",0);
  
  testStep("","第一次检测完毕并重启");
  _lost_node();
  _Set_11_Restoration_BYD();
  testWaitForTimeout(4500);/*BYD上电3s内不检测网络故障*/
  _Check_ReadConfig(1,data);
  _Check_DTC(Lose_0x057_DTC);
  _open_node();
  _Check_Fun("ADS_Torque",1);
  _Check_Fun("ADS_LDW",1);
}
void _2100_config_18(byte type) /*配置高阶ADS方案多级振感功能（转角）*/
{
  byte data[3] = {0x01,0x01,0x10};
  testStep("","擦除配置字并重启");
  _lost_node();
  _BYD_unlockECU();
  _Clear_BYD_Config(0);
  _Check_ReadConfig(0,data);
  _Set_11_Restoration_BYD();
  testWaitForTimeout(4500);/*BYD上电3s内不检测网络故障*/
  testStep("","写入预期配置字");
  _BYD_unlockECU();
  _Send_BYD_Config(type,data,1);
  _Check_ReadConfig(1,data);
  _Check_DTC(0);
  _open_node();
  _Check_Fun("ADS_Ang",0);
  _Check_Fun("ADS_LDW",0);
  
  testStep("","第一次检测完毕并重启");
  _lost_node();
  _Set_11_Restoration_BYD();
  testWaitForTimeout(4500);/*BYD上电3s内不检测网络故障*/
  _Check_ReadConfig(1,data);
  _Check_DTC(Lose_0x057_DTC);
  _open_node();
  _Check_Fun("ADS_Ang",1);
  _Check_Fun("ADS_LDW",1);
}
void _2100_config_19(byte type) /*配置其他助力手感*/
{
  byte data[3] = {0x05,0x00,0x00};
  testStep("","擦除配置字并重启");
  _lost_node();
  _BYD_unlockECU();
  _Clear_BYD_Config(0);
  _Check_ReadConfig(0,data);
  _Set_11_Restoration_BYD();
  testWaitForTimeout(4500);/*BYD上电3s内不检测网络故障*/
  testStep("","写入预期配置字");
  _BYD_unlockECU();
  _Send_BYD_Config(type,data,1);
  _Check_ReadConfig(1,data);
  _Check_DTC(0);
  _open_node();
  
  testStep("","第一次检测完毕并重启");
  _lost_node();
  _Set_11_Restoration_BYD();
  testWaitForTimeout(4500);/*BYD上电3s内不检测网络故障*/
  _Check_ReadConfig(1,data);
  _Check_DTC(0);
  _open_node();
}

void _2100_config_20(byte type) /*全不配置*/
{
  byte data[3] = {0x00,0x00,0x00};
  testStep("","擦除配置字并重启");
  _lost_node();
  _BYD_unlockECU();
  _Clear_BYD_Config(0);
  _Check_ReadConfig(0,data);
  _Set_11_Restoration_BYD();
  testWaitForTimeout(4500);/*BYD上电3s内不检测网络故障*/
  testStep("","写入预期配置字");
  _BYD_unlockECU();
  _Send_BYD_Config(type,data,1);
  _Check_ReadConfig(1,data);
  _Check_DTC(0);
  _open_node();
  _Check_Fun("LKA_Ang",0);
  _Check_Fun("DST",0);
  _Check_Fun("APA",0);
  _Check_Fun("RCS",0);
  _Check_Fun("SFS",0);
  _Check_Fun("ATS",0);
  _Check_Fun("LDW",0);
  _Check_Fun("ADS_Torque",0);
  _Check_Fun("ADS_Ang",0);
  _Check_Fun("ADS_LDW",0);
  
  testStep("","第一次检测完毕并重启");
  _lost_node();
  _Set_11_Restoration_BYD();
  testWaitForTimeout(4500);/*BYD上电3s内不检测网络故障*/
  _Check_ReadConfig(1,data);
  _Check_DTC(0);
  _open_node();
  _Check_Fun("LKA_Ang",0);
  _Check_Fun("DST",0);
  _Check_Fun("APA",0);
  _Check_Fun("RCS",0);
  _Check_Fun("SFS",0);
  _Check_Fun("ATS",0);
  _Check_Fun("LDW",0);
  _Check_Fun("ADS_Torque",0);
  _Check_Fun("ADS_Ang",0);
  _Check_Fun("ADS_LDW",0);
}
_2100_config_21(byte type) /*否定响应码测试*/
{
  byte data[3] = {0x40,0x04,0x00};
  byte data_2[3] = {0x80,0x04,0x00};
  byte data_3[3] = {0xc0,0x00,0x00};
  byte data_4[3] = {0x00,0x80,0x00};
  byte data_5[3] = {0x00,0x08,0x02};
  byte data_6[3] = {0x82,0x39,0x00};
  char Temp_Str[50];
  snprintf(Temp_Str,elCount(Temp_Str),"%s_Functional",Cdd_Name_3);
  diagStartTesterPresent(Temp_Str);
  testStep("","擦除配置字并重启");
  _BYD_unlockECU();
  _Clear_BYD_Config(0);
  _Check_ReadConfig(0,data);
  _Set_11_Restoration_BYD();
  testWaitForTimeout(4500);/*BYD上电3s内不检测网络故障*/
  testStep("","写入预期配置字");
  _BYD_unlockECU();
  _Send_BYD_Config(type,data,1);
  _TestResult(BYD_Config,@DID::phyreq_ID,"",0x31);
  _Check_ReadConfig(0,data);
  
  testWaitForTimeout(1000);
  _Send_BYD_Config(type,data_2,1);
  _TestResult(BYD_Config,@DID::phyreq_ID,"",0x31);
  _Check_ReadConfig(0,data_2);
  
  testWaitForTimeout(1000);
  _Send_BYD_Config(type,data_3,1);
  _TestResult(BYD_Config,@DID::phyreq_ID,"",0x31);
  _Check_ReadConfig(0,data_3);
  
  testWaitForTimeout(1000);
  _Send_BYD_Config(type,data_4,1);
  _TestResult(BYD_Config,@DID::phyreq_ID,"",0x31);
  _Check_ReadConfig(0,data_4);
  
  testWaitForTimeout(1000);
  _Send_BYD_Config(type,data_5,1);
  _TestResult(BYD_Config,@DID::phyreq_ID,"",0x31);
  _Check_ReadConfig(0,data_5);
  
  testWaitForTimeout(1000);
  _Send_BYD_Config(type,data_6,0);
  _TestResult(BYD_Config,@DID::phyreq_ID,"",0x10);
  _Check_ReadConfig(0,data_6);
  diagStopTesterPresent(Temp_Str);
}
_2100_config_22() /*否定响应码测试*/
{
  byte data[3] = {0x81,0x39,0x10};
  byte data1[3] = {0x82,0x39,0x10};
  byte data_1[11] = {0x2E,0x21,0x00,0x00,0x00,0x00,0x00,0x00,0x00,0x00,0x00};
  byte data_2[11] = {0x2E,0x21,0x00,0x00,0x00,0x00,0x00,0x00,0x00,0x00,0x55};
  byte data_3[11] = {0x2E,0x21,0x00,0xff,0xff,0xff,0xff,0xff,0xff,0xff,0xff};
  char Temp_Str[50];
  snprintf(Temp_Str,elCount(Temp_Str),"%s_Functional",Cdd_Name_3);
  diagStartTesterPresent(Temp_Str);
  testStep("","擦除配置字并重启");
  _BYD_unlockECU();
  _Clear_BYD_Config(0);
  _Check_ReadConfig(0,data);
  _Set_11_Restoration_BYD();
  testWaitForTimeout(4500);/*BYD上电3s内不检测网络故障*/
  testStep("","写入预期配置字");
  _BYD_unlockECU();
  _Send_BYD_Config(0,data,1);
  _Check_ReadConfig(1,data);
  
  _Send_Diag(11,@DID::phyreq_ID,data_1);
  _TestResult(SendData,@DID::phyreq_ID,"",0x22);
  _Check_ReadConfig(1,data);
  _Send_Diag(11,@DID::phyreq_ID,data_2);
  _TestResult(SendData,@DID::phyreq_ID,"",0x22);
  _Check_ReadConfig(1,data);
  _Send_Diag(11,@DID::phyreq_ID,data_3);
  _TestResult(SendData,@DID::phyreq_ID,"",0x22);
  _Check_ReadConfig(1,data);
  
  _Send_BYD_Config(0,data1,1);
  _TestResult(BYD_Config,@DID::phyreq_ID,"",0x22);
  _Check_ReadConfig(1,data);
  
  _Clear_BYD_Config(0);
  _Check_ReadConfig(0,data);
  _Send_Diag(11,@DID::phyreq_ID,data_1);
  _TestResult(SendData,@DID::phyreq_ID,"",0x10);
  
  _Send_Diag(11,@DID::phyreq_ID,data_2);
  _TestResult(SendData,@DID::phyreq_ID,"",0x31);
  
  _Send_Diag(11,@DID::phyreq_ID,data_3);
  _TestResult(SendData,@DID::phyreq_ID,"",0x31);
  diagStopTesterPresent(Temp_Str);
}

_F1A1_Default_Config()
{
  byte data[3] = {0x22,0xF1,0xA1};
  _Check_ReadConfig(0,data);
  _85_Check_DTC(1,Unconfigured);
  _lost_node();
  _85_Check_DTC(1,Unconfigured);
  _open_node();
}
_F1A1_config_1() /*配置字擦除*/
{
  byte data[3] = {0x81,0x39,0x10};
  byte data_1[3] = {0x82,0x39,0x10};
  _lost_node();
  _BYD_unlockECU();
  _Clear_BYD_Config(0);
  _Check_ReadConfig(0,data);
  
  testStep("","写入预期配置字,开始测试");
  _Send_BYD_Config(1,data,1);
  _Set_11_Restoration_BYD();
  _Check_ReadConfig(1,data);
   
  _BYD_unlockECU();
  _Clear_BYD_Config(0);
  _Check_Fun("ADS_Torque",0);
  _Check_ReadConfig(0,data);
  _Set_11_Restoration_BYD();
  _Check_DTC(Unconfigured);
  
  _BYD_unlockECU();
  _Send_BYD_Config(1,data_1,1);
  _Set_11_Restoration_BYD();
  _Check_ReadConfig(1,data_1);
  
  _BYD_unlockECU();
  _Clear_BYD_Config(1);
  _Check_Fun("ADS_Torque",0);
  _Check_ReadConfig(0,data_1);
  _Set_11_Restoration_BYD();
  _Check_DTC(Unconfigured);
  
  _open_node();
}
_F1A1_config_2() /*否定响应码测试*/
{
  byte data[3] = {0x80,0x04,0x00};
  byte data_1[3] = {0xc0,0x00,0x00};
  byte data_2[3] = {0x01,0x38,0x00};
  byte data_4[3] = {0x01,0x39,0x00};
  byte data_5[3] = {0x00,0x80,0x00};
  byte data_6[3] = {0x00,0x08,0x02};
  byte data_7[3] = {0x82,0x39,0x00};
  byte data_3[11] = {0x2E,0xF1,0xA1,0x00,0x00,0x00,0x00,0x00,0x00,0x00,0x00};
  
  char Temp_Str[50];
  snprintf(Temp_Str,elCount(Temp_Str),"%s_Functional",Cdd_Name_3);
  diagStartTesterPresent(Temp_Str);
  testStep("","擦除配置字并重启");
  _BYD_unlockECU();
  _Clear_BYD_Config(0);
  _Check_ReadConfig(0,data);
  _Set_11_Restoration_BYD();
  testWaitForTimeout(4500);/*BYD上电3s内不检测网络故障*/
  testStep("","写入预期配置字");
  _BYD_unlockECU();
  _Send_BYD_Config(1,data,1);
  _Check_ReadConfig(0,data);
  
  _BYD_unlockECU();
  _Clear_BYD_Config(0);
  _Send_BYD_Config(1,data_1,1);
  _Check_ReadConfig(0,data);
  
  _BYD_unlockECU();
  _Clear_BYD_Config(0);
  _Send_BYD_Config(1,data_2,1);
  _Check_ReadConfig(1,data_2);
  _Send_Diag(11,@DID::phyreq_ID,data_3);
  _TestResult(SendData,@DID::phyreq_ID,"",0x22);
  _Check_ReadConfig(1,data_2);
  _Send_BYD_Config(1,data_4,1);
  _TestResult(BYD_Config,@DID::phyreq_ID,"",0x22);
  _Check_ReadConfig(1,data_2);
  
  _BYD_unlockECU();
  _Clear_BYD_Config(0);
  _Send_Diag(11,@DID::phyreq_ID,data_3);
  _TestResult(SendData,@DID::phyreq_ID,"",0x10);
  _Check_ReadConfig(0,data_2);
  
  _BYD_unlockECU();
  _Clear_BYD_Config(0);
  _Check_ReadConfig(0,data);
  _Send_BYD_Config(1,data_5,1);
  _TestResult(BYD_Config,@DID::phyreq_ID,"",0x31);
  _Check_ReadConfig(0,data_2);
  
  _Clear_BYD_Config(0);
  _Check_ReadConfig(0,data);
  _Send_BYD_Config(1,data_6,1);
  _TestResult(BYD_Config,@DID::phyreq_ID,"",0x31);
  _Check_ReadConfig(0,data_2);
  
  _Clear_BYD_Config(0);
  _Check_ReadConfig(0,data);
  _Send_BYD_Config(1,data_7,0);
  _TestResult(BYD_Config,@DID::phyreq_ID,"",0x10);
  _Check_ReadConfig(0,data_2);
  
  diagStopTesterPresent(Temp_Str);
}

_Other_BYD_01()
{
  testDisableMsg(DTC_19[1][0]);
  testWaitForTimeout(3000);
  _Set_11_Restoration_BYD();
  _Check_DTC(0);
  testEnableMsg(DTC_19[1][0]);
  testWaitForTimeout(2000);
}
_Other_BYD_02()
{
  testDisableMsg(DTC_19[1][0]);
  testWaitForTimeout(3000);
  _Set_11_Restoration_BYD();
  testWaitForTimeout(1000+(DTC_19[1][3])*1.1);
  _Check_DTC(DTC_19[1][1]);
  testEnableMsg(DTC_19[1][0]);
  testWaitForTimeout(2000);
}
_Other_BYD_03()
{
  byte data[2]={0x85,0x82};
  _SetSession(3);
  _Send_Diag(2,@DID::funreq_ID,data);
  testDisableMsg(DTC_19[1][0]);
  testWaitForTimeout(DTC_19[1][3]*1.2);
  data[1] = 0x81;
  _Send_Diag(2,@DID::funreq_ID,data);
  testWaitForTimeout(2000);
  _Check_DTC(0);
  testEnableMsg(DTC_19[1][0]);
  testWaitForTimeout(2000);
}
_Other_BYD_04()
{
  byte data[2]={0x85,0x82};
  _SetSession(3);
  _Send_Diag(2,@DID::funreq_ID,data);
  testDisableMsg(DTC_19[1][0]);
  testWaitForTimeout(DTC_19[1][3]*1.2);
  data[1] = 0x81;
  _Send_Diag(2,@DID::funreq_ID,data);
  testWaitForTimeout(3000+(DTC_19[1][3])*1.1);
  _Check_DTC(DTC_19[1][1]);
  testEnableMsg(DTC_19[1][0]);
  testWaitForTimeout(2000);
}
_Other_BYD_05()
{
  byte data[2]={0x85,0x82};
  dword Ex[1];
  _SetSession(3);
  testDisableMsg(DTC_19[1][0]);
  _WriteEx_and_Report("","丢失节点 0x%03X",DTC_19[1][0]);
  testWaitForTimeout(DTC_19[1][3]*0.5);
  _Send_01_Fault(phyreq_ID);
  _Send_Diag(2,@DID::funreq_ID,data);
  _Check_Response_DTC(Diag01,Ex);
  testWaitForTimeout(DTC_19[1][3]*0.6);
  _85_Check_DTC(1,0);
  testEnableMsg(DTC_19[1][0]);
  testWaitForTimeout(5000);
}
_Other_BYD_06()
{
  byte data[3]={0x28,0x83,0x03};
  _SetSession(3);
  _Send_Diag(3,@DID::funreq_ID,data);
  _TestResult(BYD_Config,@DID::funreq_ID,"",0);
  testWaitForTimeout(200);
  data[1] = 0x80;
  _Send_Diag(3,@DID::funreq_ID,data);
  _TestResult(BYD_Config,@DID::funreq_ID,"",0);
  if(testWaitForMessage(EPS_TxID_1,1000)==1)
    testStepPass("","时间小于1s");
  else
    testStepFail("","时间大于1s");
}
_Other_BYD_07()
{
  byte data[3]={0x28,0x83,0x03};
  _SetSession(3);
  _Send_Diag(3,@DID::funreq_ID,data);
  _TestResult(BYD_Config,@DID::funreq_ID,"",0);
  testWaitForTimeout(200);
  if(testWaitForMessage(EPS_TxID_1,1000)==1)
    testStepFail("","发送28 83 03后仍然在外发报文");
  else
    testStepPass("","外发报文停发");
  _Set_11_Restoration_BYD();
  if(testWaitForMessage(EPS_TxID_1,2000)==1)
    testStepPass("","外发报文外发时间小于2s");
  else
    testStepFail("","外发报文外发时间大于2s");
}
_BYD_34_Serve(dword ID,byte Session)
{
  byte Da[2]={0x34,0x00};
  _Send_Diag(2,ID,Da);
  _TestResult(SendData,ID,"",0x7F);
}
_BYD_36_Serve(dword ID,byte Session)
{
  byte Da[63],i;
  Da[0] = 0x36;
  for(i=1;i<63;i++)
  {
    Da[i] = 0;
  }
  _Send_Diag(63,ID,Da);
  _TestResult(SendData,ID,"",0x7F);
}
_BYD_37_Serve(dword ID,byte Session)
{
  byte Da[2]={0x37,0x00};
  _Send_Diag(2,ID,Da);
  _TestResult(SendData,ID,"",0x7F);
}



testcase Case_2100_config_0()/*遍历默认配置车型*/
{
  int i;
  Init_Config();
  for(i=0;i<Default_Config_Count;i++)
  {
    writeEx(-3,0,"/---------------------------------------/");
    writeEx(-3,0,"               %s               ",Default_Config[i].Str_Config);
    writeEx(-3,0,"/---------------------------------------/");
    teststep("","/---------------------------------------/");
    teststep("开始测试",Default_Config[i].Str_Config);
    teststep("","/---------------------------------------/");
    _2100_config_0(Default_Config[i].Data_Config_Send,Default_Config[i].Str_Config,i,0);
  }
  End_Config();
}
testcase Case_2100_config_1()/*低阶*/
{
  Init_Config();
  _2100_config_1(0);
  End_Config();
}
testcase Case_2100_config_2()/*高阶*/
{
  Init_Config();
  _2100_config_2(0);
  End_Config();
}
testcase Case_2100_config_3()/*配置ADAS电机扭矩控制接口*/
{
  Init_Config();
  _2100_config_3(0);
  End_Config();
}
testcase Case_2100_config_4() /*配置LKA(转角)*/
{
  Init_Config();
  _2100_config_4(0);
  End_Config();
}
testcase Case_2100_config_5()/*配置DST*/
{
  Init_Config();
  _2100_config_5(0);
  End_Config();
}
testcase Case_2100_config_6()/*配置RCS*/
{
  Init_Config();
  _2100_config_6(0);
  End_Config();
}
testcase Case_2100_config_7() /*配置SFS*/
{
  Init_Config();
  _2100_config_7(0);
  End_Config();
}
testcase Case_2100_config_8()/*配置ATS*/
{
  Init_Config();
  _2100_config_8(0);
  End_Config();
}
testcase Case_2100_config_9() /*配置LKA(扭矩)*/
{
  Init_Config();
  _2100_config_9(0);
  End_Config();
}
testcase Case_2100_config_10()/*配置APA*/
{
  Init_Config();
  _2100_config_10(0);
  End_Config();
}
testcase Case_2100_config_11()/*配置LDW*/
{
  Init_Config();
  _2100_config_11(0);
  End_Config();
}
testcase Case_2100_config_12() /*配置ADS转角转矩接口*/
{
  Init_Config();
  _2100_config_12(0);
  End_Config();
}
testcase Case_2100_config_13()/*配置SVC通用振动接口*/
{
  Init_Config();
  _2100_config_13(0);
  End_Config();
}
testcase Case_2100_config_14()/*配置SAC通用振动接口*/
{
  Init_Config();
  _2100_config_14(0);
  End_Config();
}
testcase Case_2100_config_15() /*配置SMS目标转向档位*/
{
  Init_Config();
  _2100_config_15(0);
  End_Config();
}
testcase Case_2100_config_16()/*配置原地转向【VOT】*/
{
  Init_Config();
  _2100_config_16(0);
  End_Config();
}
testcase Case_2100_config_17() /*配置高阶ADS方案多级振感功能(扭矩)*/
{
  Init_Config();
  _2100_config_17(0);
  End_Config();
}
testcase Case_2100_config_18() /*配置高阶ADS方案多级振感功能(转角)*/
{
  Init_Config();
  _2100_config_18(0);
  End_Config();
}
testcase Case_2100_config_19()/*配置其他助力手感*/
{
  Init_Config();
  _2100_config_19(0);
  End_Config();
}
testcase Case_2100_config_20() /*全不配置*/
{
  Init_Config();
  _2100_config_20(0);
  End_Config();
}
testcase Case_2100_config_21() /*否定响应码测试*/
{
  Init_Config();
  _2100_config_21(0);
  End_Config();
}
testcase Case_2100_config_22() /*否定响应码测试*/
{
  Init_Config();
  _2100_config_22();
  End_Config();
}


testcase Case_F1A1_config_0()/*遍历默认配置车型*/
{
  int i;
  Init_Config();
  for(i=0;i<Default_Config_Count;i++)
  {
    writeEx(-3,0,"/---------------------------------------/");
    writeEx(-3,0,"               %s               ",Default_Config[i].Str_Config);
    writeEx(-3,0,"/---------------------------------------/");
    teststep("","/---------------------------------------/");
    teststep("开始测试",Default_Config[i].Str_Config);
    teststep("","/---------------------------------------/");
    _2100_config_0(Default_Config[i].Data_Config_Send,Default_Config[i].Str_Config,i,1);
  }
  End_Config();
}
testcase Case_F1A1_Default_Config()/*配置字默认值*/
{
  Init_Config();
  _F1A1_Default_Config();
  End_Config();
}
testcase Case_F1A1_config_Clear()/*配置字擦除*/
{
  Init_Config();
  _F1A1_config_1();
  End_Config();
}
testcase Case_F1A1_config_1()/*低阶*/
{
  Init_Config();
  _2100_config_1(1);
  End_Config();
}
testcase Case_F1A1_config_2()/*高阶*/
{
  Init_Config();
  _2100_config_2(1);
  End_Config();
}
testcase Case_F1A1_config_3()/*配置ADAS电机扭矩控制接口*/
{
  Init_Config();
  _2100_config_3(1);
  End_Config();
}
testcase Case_F1A1_config_4() /*配置LKA(转角)*/
{
  Init_Config();
  _2100_config_4(1);
  End_Config();
}
testcase Case_F1A1_config_5()/*配置DST*/
{
  Init_Config();
  _2100_config_5(1);
  End_Config();
}
testcase Case_F1A1_config_6()/*配置RCS*/
{
  Init_Config();
  _2100_config_6(1);
  End_Config();
}
testcase Case_F1A1_config_7() /*配置SFS*/
{
  Init_Config();
  _2100_config_7(1);
  End_Config();
}
testcase Case_F1A1_config_8()/*配置ATS*/
{
  Init_Config();
  _2100_config_8(1);
  End_Config();
}
testcase Case_F1A1_config_9() /*配置LKA(扭矩)*/
{
  Init_Config();
  _2100_config_9(1);
  End_Config();
}
testcase Case_F1A1_config_10()/*配置APA*/
{
  Init_Config();
  _2100_config_10(1);
  End_Config();
}
testcase Case_F1A1_config_11()/*配置LDW*/
{
  Init_Config();
  _2100_config_11(1);
  End_Config();
}
testcase Case_F1A1_config_12() /*配置ADS转角转矩接口*/
{
  Init_Config();
  _2100_config_12(1);
  End_Config();
}
testcase Case_F1A1_config_13()/*配置SVC通用振动接口*/
{
  Init_Config();
  _2100_config_13(1);
  End_Config();
}
testcase Case_F1A1_config_14()/*配置SAC通用振动接口*/
{
  Init_Config();
  _2100_config_14(1);
  End_Config();
}
testcase Case_F1A1_config_15() /*配置SMS目标转向档位*/
{
  Init_Config();
  _2100_config_15(1);
  End_Config();
}
testcase Case_F1A1_config_16()/*配置原地转向【VOT】*/
{
  Init_Config();
  _2100_config_16(1);
  End_Config();
}
testcase Case_F1A1_config_17() /*配置高阶ADS方案多级振感功能(扭矩)*/
{
  Init_Config();
  _2100_config_17(1);
  End_Config();
}
testcase Case_F1A1_config_18() /*配置高阶ADS方案多级振感功能(转角)*/
{
  Init_Config();
  _2100_config_18(1);
  End_Config();
}
testcase Case_F1A1_config_19()/*配置其他助力手感*/
{
  Init_Config();
  _2100_config_19(1);
  End_Config();
}
testcase Case_F1A1_config_20() /*全不配置*/
{
  Init_Config();
  _2100_config_20(1);
  End_Config();
}
testcase Case_F1A1_config_21() /*否定响应码测试*/
{
  Init_Config();
  _F1A1_config_2();
  End_Config();
}
testcase Case_Other_BYD_01() /*初始化后（复位11服务）后3s开始检测通信类故障*/
{
  Init_Config_();
  _Other_BYD_01();
  End_Config();
}
testcase Case_Other_BYD_02() /*初始化后（复位11服务）后3s开始检测通信类故障*/
{
  Init_Config_();
  _Other_BYD_02();
  End_Config();
}
testcase Case_Other_BYD_03() /*使能DTC检测（85服务后）后3s开始检测通信类故障*/
{
  Init_Config_();
  _Other_BYD_03();
  End_Config();
}
testcase Case_Other_BYD_04() /*使能DTC检测（85服务后）后3s开始检测通信类故障*/
{
  Init_Config_();
  _Other_BYD_04();
  End_Config();
}
testcase Case_Other_BYD_05() /*禁止DTC检测（85服务后）后立即停止故障检测*/
{
  Init_Config_();
  _Other_BYD_05();
  End_Config();
}
testcase Case_Other_BYD_06() /*接收到使能报文发送（28服务）后1s内开始应用报文发送*/
{
  Init_Config_();
  _Other_BYD_06();
  End_Config();
}
testcase Case_Other_BYD_07() /*程序更新后执行复位（11服务）后2s内完成自检及报文发送*/
{
  Init_Config_();
  _Other_BYD_07();
  End_Config();
}
testcase Case_Serve_34_Phy_Def() 
{
  Init_Config_Serve(1);
  _BYD_34_Serve(@DID::phyreq_ID,1);
  End_Config();
}
testcase Case_Serve_34_Phy_Ex() 
{
  Init_Config_Serve(3);
  _BYD_34_Serve(@DID::phyreq_ID,3);
  End_Config();
}
testcase Case_Serve_34_Fun_Def() 
{
  Init_Config_Serve(1);
  _BYD_34_Serve(@DID::funreq_ID,1);
  End_Config();
}
testcase Case_Serve_34_Fun_Ex() 
{
  Init_Config_Serve(3);
  _BYD_34_Serve(@DID::funreq_ID,3);
  End_Config();
}
testcase Case_Serve_36_Phy_Def() 
{
  Init_Config_Serve(1);
  _BYD_36_Serve(@DID::phyreq_ID,1);
  End_Config();
}
testcase Case_Serve_36_Phy_Ex() 
{
  Init_Config_Serve(3);
  _BYD_36_Serve(@DID::phyreq_ID,3);
  End_Config();
}
testcase Case_Serve_36_Fun_Def() 
{
  Init_Config_Serve(1);
  _BYD_36_Serve(@DID::funreq_ID,1);
  End_Config();
}
testcase Case_Serve_36_Fun_Ex() 
{
  Init_Config_Serve(3);
  _BYD_36_Serve(@DID::funreq_ID,3);
  End_Config();
}
testcase Case_Serve_37_Phy_Def() 
{
  Init_Config_Serve(1);
  _BYD_37_Serve(@DID::phyreq_ID,1);
  End_Config();
}
testcase Case_Serve_37_Phy_Ex() 
{
  Init_Config_Serve(3);
  _BYD_37_Serve(@DID::phyreq_ID,3);
  End_Config();
}
testcase Case_Serve_37_Fun_Def() 
{
  Init_Config_Serve(1);
  _BYD_37_Serve(@DID::funreq_ID,1);
  End_Config();
}
testcase Case_Serve_37_Fun_Ex() 
{
  Init_Config_Serve(3);
  _BYD_37_Serve(@DID::funreq_ID,3);
  End_Config();
}