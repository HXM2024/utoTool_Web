/*@!Encoding:936*/
variables
{
  byte Read_Config_SGMW[3] = {0x22,0xC1,0x01};
  byte Write_Config_SGMW[255];
}

// void Init_SGMW_Config()
// {
//   int i;
//   Init_Main_Special("\\五菱_配置字\\",exsession);  
//   _get_Arry("Config_ALL");
//   for(i=0;i<3;i++)
//     Write_Config_SGMW[i] = Arry_Data[i];
//   for(i=3;i<Config_Len;i++)
//     Write_Config_SGMW[i] = 0;
//   _get_Arry("Read_Config");
//   for(i=0;i<3;i++)
//     Read_Config_SGMW[i] = Arry_Data[i];
//   _unlockECU();
//   _Send_Diag(Config_Len,phyreq_ID,Write_Config_SGMW);
//   _TestResult(SendData,phyreq_ID,"",-1);
//   _Set_11_Restoration();
//   testWaitForTimeout(1000);
//   _WriteEx_and_Report("","/*----------------开始测试----------------*/");
// }

void Init_SGMW_Config(byte Type)
{
  int i;
  Init_Main_Special("\\五菱_配置字\\",exsession);  
  _get_Arry("Config_ALL");
  for(i=0;i<3;i++)
    Write_Config_SGMW[i] = Arry_Data[i];
  for(i=3;i<Config_Len;i++)
    Write_Config_SGMW[i] = 0;
  _get_Arry("Read_Config");
  for(i=0;i<3;i++)
    Read_Config_SGMW[i] = Arry_Data[i];
  if(Type == 1)
  {
    _unlockECU();
    _Send_Diag(Config_Len,phyreq_ID,Write_Config_SGMW);
    _TestResult(SendData,phyreq_ID,"",-1);
    _Set_11_Restoration(0);
    testWaitForTimeout(1000);
  }
  _WriteEx_and_Report("","/*----------------开始测试----------------*/");
}

void Config_Default_SGMW() /*默认值*/
{
  dword DTC_Ex[20];
  byte Send_Data_85[2] = {0x85,2};
  int i;
  for(i=3;i<Config_Len;i++)
    Write_Config_SGMW[i] = 0;
  
  _Send_Diag(3,phyreq_ID,Read_Config_SGMW);
  _TestResult(SendData,phyreq_ID,"",-1);
  _Check_Response_Config(SendData,Write_Config_SGMW);
  testWaitForTimeout(500);
  _Check_DTC_Res(1,Unconfigured,0);
  
  _SetSession(exsession);
  _Send_Diag(2,phyreq_ID,Send_Data_85);
  _TestResult(SendData,phyreq_ID,"",-1);
  testWaitForTimeout(500);
  _Clear_DTC(phyreq_ID);
  testWaitForTimeout(500);
  _Check_DTC_Res(1,0,Unconfigured);
  Send_Data_85[1] = 0x01;
  _Send_Diag(2,phyreq_ID,Send_Data_85);
  _TestResult(SendData,phyreq_ID,"",-1);
  testWaitForTimeout(500);
  _Check_DTC_Res(1,Unconfigured,0);
  
  _Set_11_Restoration(); //20260622新增重启步骤
  _Close_All_Advanced_function();
  testWaitForTimeout(CAN_Init_Time+2000);
  _Check_DTC_Res(1,0,Advanced_function[0].DTC);
  _Open_All_Advanced_function();
}


void Config_Unconfig_SGMW()/*未配置_DTC测试*/
{
  dword DTC_Ex[20];
  byte Send_DTC[3] = {0x19,0x02,0x89};
  int i;
  for(i=3;i<Config_Len;i++)
    Write_Config_SGMW[i] = 0;
  
  _unlockECU();
  _Send_Diag(Config_Len,phyreq_ID,Write_Config_SGMW);
  _TestResult(SendData,phyreq_ID,"",-1);
  _Send_Diag(3,phyreq_ID,Read_Config_SGMW);
  _TestResult(SendData,phyreq_ID,"",-1);
  _Check_Response_Config(SendData,Write_Config_SGMW);
  testWaitForTimeout(500);
  _85_Check_DTC(1,Unconfigured);

  _get_Arry("Config_ALL");
  for(i=3;i<Config_Len;i++)
    Write_Config_SGMW[i] = Arry_Data[i];
  _Send_Diag(Config_Len,phyreq_ID,Write_Config_SGMW);
  _TestResult(SendData,phyreq_ID,"",-1);
  _Send_Diag(3,phyreq_ID,Read_Config_SGMW);
  _TestResult(SendData,phyreq_ID,"",-1);
  _Check_Response_Config(SendData,Write_Config_SGMW);
  testWaitForTimeout(500);
  _Send_Diag(3,phyreq_ID,Send_DTC);
  _Check_190201(SendData,Unconfigured,0x01);
  
  _Set_11_Restoration();
  testWaitForTimeout(1000);
  _K30_OFF();
  testWaitForTimeout(2000);
  _K30_ON();
  testWaitForTimeout(2000);
  _Send_Diag(3,phyreq_ID,Read_Config_SGMW);
  _TestResult(SendData,phyreq_ID,"",-1);
  _Check_Response_Config(SendData,Write_Config_SGMW);
  
  _K30_OFF();
  testWaitForTimeout(2000);
  _K30_ON();
  testWaitForTimeout(2000);
  _Send_Diag(3,phyreq_ID,Read_Config_SGMW);
  _TestResult(SendData,phyreq_ID,"",-1);
  _Check_Response_Config(SendData,Write_Config_SGMW);
}

void Config_0xFF_SGMW()/*全0XFF*/
{
  dword DTC_Ex[20];
  int i;
  for(i=3;i<Config_Len;i++)
    Write_Config_SGMW[i] = 0xFF;
  _unlockECU();
  _Send_Diag(Config_Len,phyreq_ID,Write_Config_SGMW);
  _TestResult(SendData,phyreq_ID,"",-1);
  _Send_Diag(3,phyreq_ID,Read_Config_SGMW);
  _TestResult(SendData,phyreq_ID,"",-1);
  _Check_Response_Config(SendData,Write_Config_SGMW);
  _Close_All_Advanced_function();
  testWaitForTimeout(2000);
  _Advanced_function_DTC(Write_Config_SGMW,DTC_Ex);
  
  _Set_11_Restoration();
  _Send_Diag(3,phyreq_ID,Read_Config_SGMW);
  _TestResult(SendData,phyreq_ID,"",-1);
  _Check_Response_Config(SendData,Write_Config_SGMW);
  testWaitForTimeout(CAN_Init_Time+2000);
  _Check_DTC(1,DTC_Ex);
  _Open_All_Advanced_function();
  testWaitForTimeout(2000);
}
void Config_NoADAS_SGMW()/*未配置_有ADAS*/
{
  dword DTC_Ex[20];
  int i;
  for(i=3;i<Config_Len;i++)
    Write_Config_SGMW[i] = 0xFF;
  Write_Config_SGMW[3] = 0x7F;
  _unlockECU();
  _Send_Diag(Config_Len,phyreq_ID,Write_Config_SGMW);
  _TestResult(SendData,phyreq_ID,"",-1);
  _Send_Diag(3,phyreq_ID,Read_Config_SGMW);
  _TestResult(SendData,phyreq_ID,"",-1);
  _Check_Response_Config(SendData,Write_Config_SGMW);
  _Close_All_Advanced_function();
  testWaitForTimeout(2000);
  _Advanced_function_DTC(Write_Config_SGMW,DTC_Ex);
  
  _Set_11_Restoration();
  _Send_Diag(3,phyreq_ID,Read_Config_SGMW);
  _TestResult(SendData,phyreq_ID,"",-1);
  _Check_Response_Config(SendData,Write_Config_SGMW);
  testWaitForTimeout(CAN_Init_Time+2000);
  _85_Check_DTC(1,Unconfigured);
  _Open_All_Advanced_function();
  testWaitForTimeout(2000);
}

void Config_Common_SGMW(dword ConfigData)/*常规配置函数*/
{
  dword DTC_Ex[20];
  int i;
  for(i=3;i<Config_Len;i++)
    Write_Config_SGMW[i] = 0;
  Write_Config_SGMW[3] = ((ConfigData>>8)&0xFF);
  Write_Config_SGMW[4] = (ConfigData&0xFF);

  _WriteEx_and_Report("","步骤一：通过安全访问并写入配置字");
  _unlockECU();
  _Send_Diag(Config_Len,phyreq_ID,Write_Config_SGMW);
  _TestResult(SendData,phyreq_ID,"",-1);

  _WriteEx_and_Report("","步骤二：读取写入的配置并重启(丢失节点验证DTC)");
  _Send_Diag(3,phyreq_ID,Read_Config_SGMW);
  _TestResult(SendData,phyreq_ID,"",-1);
  _Check_Response_Config(SendData,Write_Config_SGMW);
  _Close_All_Advanced_function();
  testWaitForTimeout(2000);
  _Advanced_function_DTC(Write_Config_SGMW,DTC_Ex);
  _Set_11_Restoration();
  
  _WriteEx_and_Report("","步骤三：重启后再次读取配置(获取故障码并判断)");
  _Send_Diag(3,phyreq_ID,Read_Config_SGMW);
  _TestResult(SendData,phyreq_ID,"",-1);
  _Check_Response_Config(SendData,Write_Config_SGMW);
  testWaitForTimeout(CAN_Init_Time+2000);
  _Check_DTC(1,DTC_Ex);
  _Open_All_Advanced_function();
  testWaitForTimeout(2000);
  writeEx(-3,0,"手动验证功能配置是否生效");
}

void Config_Restriction_SGMW()/*写入限制*/
{
  dword DTC_Ex[20];
  byte Send_DTC[3] = {0x19,0x02,0x89};
  int i;
  for(i=3;i<Config_Len;i++)
    Write_Config_SGMW[i] = 0;
  Write_Config_SGMW[3] = 0x80;
  Write_Config_SGMW[4] = 0x00;

  _WriteEx_and_Report("","步骤一：通过安全访问并写入配置字");
  _unlockECU();
  _Send_Diag(Config_Len,phyreq_ID,Write_Config_SGMW);
  _TestResult(SendData,phyreq_ID,"",-1);
  _Send_Diag(3,phyreq_ID,Read_Config_SGMW);
  _TestResult(SendData,phyreq_ID,"",-1);
  _Check_Response_Config(SendData,Write_Config_SGMW);
  _Check_DTC_Res(0x89,0,Unconfigured);

  _WriteEx_and_Report("","步骤二~三：遍历写入值");
  Write_Config_SGMW[3] = 0x00;
  for(i=1;i<=0xFF;i++)
  {
    if(i==2 || i==3 || i==4)
      continue;
    Write_Config_SGMW[4] = i;
    _Send_Diag(Config_Len,phyreq_ID,Write_Config_SGMW);
    _TestResult(SendData,phyreq_ID,"",-1);

    Write_Config_SGMW[4] = 0;
    _Send_Diag(3,phyreq_ID,Read_Config_SGMW);
    _TestResult(SendData,phyreq_ID,"",-1);
    _Check_Response_Config(SendData,Write_Config_SGMW);

    _Send_Diag(3,phyreq_ID,Send_DTC);
    _Check_190201(SendData,Unconfigured,0x09);
  }
  
  _WriteEx_and_Report("","步骤四：写入全0xFF");
  for(i=3;i<Config_Len;i++)
    Write_Config_SGMW[i] = 0xFF;
  _Send_Diag(Config_Len,phyreq_ID,Write_Config_SGMW);
  _TestResult(SendData,phyreq_ID,"",-1);
  for(i=3;i<Config_Len;i++)
    Write_Config_SGMW[i] = 0;
  _Send_Diag(3,phyreq_ID,Read_Config_SGMW);
  _TestResult(SendData,phyreq_ID,"",-1);
  _Check_Response_Config(SendData,Write_Config_SGMW);
  _Send_Diag(3,phyreq_ID,Send_DTC);
  _Check_190201(SendData,Unconfigured,0x09);
  
  _WriteEx_and_Report("","步骤五：写入Byte1为0x7F，其余0xFF");
  for(i=3;i<Config_Len;i++)
    Write_Config_SGMW[i] = 0xFF;
  Write_Config_SGMW[3] = 0x7F;
  _Send_Diag(Config_Len,phyreq_ID,Write_Config_SGMW);
  _TestResult(SendData,phyreq_ID,"",-1);
  for(i=3;i<Config_Len;i++)
    Write_Config_SGMW[i] = 0;
  _Send_Diag(3,phyreq_ID,Read_Config_SGMW);
  _TestResult(SendData,phyreq_ID,"",-1);
  _Check_Response_Config(SendData,Write_Config_SGMW);
  _Send_Diag(3,phyreq_ID,Send_DTC);
  _Check_190201(SendData,Unconfigured,0x09);
  
  _WriteEx_and_Report("","步骤六：Byte2为0x02，其余为0xFF");
  for(i=3;i<Config_Len;i++)
    Write_Config_SGMW[i] = 0xFF;
  Write_Config_SGMW[4] = 0x02;
  _Send_Diag(Config_Len,phyreq_ID,Write_Config_SGMW);
  _TestResult(SendData,phyreq_ID,"",-1);
  _Send_Diag(3,phyreq_ID,Read_Config_SGMW);
  _TestResult(SendData,phyreq_ID,"",-1);
  _Check_Response_Config(SendData,Write_Config_SGMW);
  _Send_Diag(3,phyreq_ID,Send_DTC);
  _Check_190201(SendData,Unconfigured,0x01);
}


void SGMW_F190_Loop() 
{
  Byte Send_Data_2E[0x14];
  Byte Send_Data_22[3];
  Byte Send_1002[2] = {0x10,0x02};
  int i,j;
  Send_Data_2E[0] = 0x2E; Send_Data_22[0] = 0x22;
  Send_Data_2E[1] = 0xF1; Send_Data_22[1] = 0xF1;
  Send_Data_2E[2] = 0x90; Send_Data_22[2] = 0x90;
  for(i=0;i<500;i++)
  {
    for(j=3;j<0x14;j++)
      Send_Data_2E[j] = i%0xFF;
    _unlockECU();
    _Send_Diag(3,phyreq_ID,Send_Data_22);
    _TestResult(SendData,phyreq_ID,"",-1);
    _Send_Diag(0x14,phyreq_ID,Send_Data_2E);
    _TestResult(SendData,phyreq_ID,"",-1);
    _Set_11_Restoration(0);
    _Send_Diag(3,phyreq_ID,Send_Data_22);
    _TestResult(SendData,phyreq_ID,"",-1);
    _Check_Response_Config(SendData,Send_Data_2E);
    _Send_Diag(2,phyreq_ID,Send_1002);
    _TestResult(SendData,phyreq_ID,"",-1);
    testWaitForTimeout(2000);
    _Send_Diag(3,phyreq_ID,Send_Data_22);
    _TestResult(SendData,phyreq_ID,"",-1);
    _Check_Response_Config(SendData,Send_Data_2E);
    _SetSession(defsession);
    testWaitForTimeout(2000);
  }
}


void SGMW_Part_number()
{
  int i,Pos_Time,Time;
  byte Part_number[100],Part_number_Len;
  byte Read_Part_number[3] = {0x22,0xF1,0xCB};
  byte Data_Send[6] = {0x19,0x04,0,0,0,0x01};
  dword DTC_In[2],DTC_Not[2];
  char Str[50],Te[100],Da_Temp[2][50];
  
  _Set_Ready(0);Time = 90;
  snprintf(Str,elCount(Str),"%s","LocalTime");
  snprintf(Te,elCount(Te),"%s","2022/02/22_22:22:22");
  snprintf(Da_Temp[0],elCount(Da_Temp[0]),"20220222222222"); 
  snprintf(Da_Temp[1],elCount(Da_Temp[1]),"20220222222222"); 
  Pos_Time = _Check_StrPossion_Res(Str,1);  
  if(Pos_Time == -1)
    _WriteEx_and_Report("","未检测到时间输入,后续不检测时间相关快照数据");
  Data_Send[2] = (Struct_CarSpd.Lost_DTC>>16)&0xFF;
  Data_Send[3] = (Struct_CarSpd.Lost_DTC>>8) &0xFF;
  Data_Send[4] = (Struct_CarSpd.Lost_DTC>>0) &0xFF;
  _K30_OFF();
  testWaitForTimeout(2000);
  _K30_ON();
  _K15_ON();
  testWaitForTimeout(2000);
  _Check_DTC_Res(0x89,0,Ang_NotCal);
  _Send_Diag(3,phyreq_ID,Read_Part_number);
  if(diagGetLastResponseCode(SendData) == 0x00)
    testWaitForDiagResponse(SendData,500);
  if(diagGetLastResponseCode(SendData)!= -1)
  {
    testStepFail("","未获取到正确的原始零件号");
    return;
  }
  Part_number_Len = DiagGetRespPrimitiveSize(SendData);
  for(i=0;i<Part_number_Len;i++)
    Part_number[i] = DiagGetRespPrimitiveByte(SendData,i);
  for(i=0;i<DTC_19_Count;i++)
  {
    if(DTC_19[i][0] == Struct_CarSpd.Sig_Id) //跳过车速防止后续快照被影响
      continue;
    _TestDisableMsg(DTC_19[i][0]);
  }
  testWaitForTimeout(3000);
  _Open_All();
  testWaitForTimeout(3000);
  for(i=0;i<Node_Invalid_Count;i++)
  {
    _Set_Sig(Node_Invalid[i].Signal_Name,Node_Invalid[i].Invalid_Value);
    testWaitForTimeout(Node_Invalid[i].Time*1.2);
    _Set_Sig(Node_Invalid[i].Signal_Name,Node_Invalid[i].Normal_Value);
    testWaitForTimeout(Node_Invalid[i].Time*1.2);
  }
  DTC_In[0] = Abnormal_Reset;        DTC_Not[0] = 0;
  DTC_In[1] = Node_Invalid[i].DTC;   DTC_Not[1] = 0;
  _Check_DTC_Res(0x89,DTC_In,DTC_Not);
  if(Pos_Time != -1)
  {
    _Set_Time(Te,1);
    testWaitForTimeout(5000);
  }
  _TestDisableMsg(Struct_CarSpd.Sig_Id);
  if(Pos_Time != -1)
  {
    _Send_Diag(6,phyreq_ID,Data_Send);
    _Get_1904_All_Data(SendData);
    _Check_1904_Specified(Str,Da_Temp,0);
  }
  _K15_OFF();  testWaitForTimeout(2000);
  _K15_ON();   testWaitForTimeout(2000);
  _Check_DTC_Res(0x89,Struct_CarSpd.Lost_DTC,0);
  _Send_Diag(3,phyreq_ID,Read_Part_number);
  _Check_Response(SendData,Part_number_Len,Part_number);
  if(Pos_Time != -1)
  {
    _Send_Diag(6,phyreq_ID,Data_Send);
    _Get_1904_All_Data(SendData);
    _Check_1904_Specified(Str,Da_Temp,0);
  }
  for(i=0;i<100;i++)
  {
    _WriteEx_and_Report("","当前第 %d 次上下电",i+1);
    _WriteEx_and_Report("","下电等待时间 %d ms",Time);
    _K15_OFF();  testWaitForTimeout(Time);
    _K30_OFF();  testWaitForTimeout(2000);
    _K30_ON();   
    _K15_ON();   testWaitForTimeout(2000);
    _Check_DTC_Res(0x89,Struct_CarSpd.Lost_DTC,0);
    _Send_Diag(3,phyreq_ID,Read_Part_number);
    _Check_Response(SendData,Part_number_Len,Part_number);
    if(Pos_Time != -1)
    {
      _Send_Diag(6,phyreq_ID,Data_Send);
      _Get_1904_All_Data(SendData);
      _Check_1904_Specified(Str,Da_Temp,0);
    }
    Time+=5;
  }
  _TestEnableMsg(Struct_CarSpd.Sig_Id);
}


testcase Case_Config_Default_SGMW()
{
  Init_SGMW_Config(0);
  Config_Default_SGMW();
  _End();
}
testcase Case_Config_Common_SGMW()
{
  dword Config_Title;
  Config_Title = GetInformationFromTitle();
  Init_SGMW_Config(1);
  Config_Common_SGMW(Config_Title);
  _End();
}

testcase Case_Config_Unconfig_SGMW()
{
  Init_SGMW_Config(1);
  Config_Unconfig_SGMW();
  _End();
}
testcase Case_Config_0xFF_SGMW()
{
  Init_SGMW_Config(1);
  Config_0xFF_SGMW();
  _End();
}
testcase Case_Config_NoADAS_SGMW()
{
  Init_SGMW_Config(1);
  Config_NoADAS_SGMW();
  _End();
}
testcase Case_Config_Restriction_SGMW()
{
  Init_SGMW_Config(1);
  Config_Restriction_SGMW();
  _End();
}

testcase Case_SGMW_F190_Loop() /*五菱F190写入值压力测试*/
{
  Init_Main_Def();
  SGMW_F190_Loop();
  End_Main();
}
testcase Case_SGMW_Part_number() /*五菱F190写入值压力测试*/
{
  Init_Main_Def();
  SGMW_Part_number();
  End_Main();
}



// testcase Case_Config_IsNotADAS_SGMW()
// {
//   dword Config_Title;
//   Config_Title = GetInformationFromTitle();
//   Init_SGMW_Config(1);
//   Config_IsNotADAS_SGMW();
//   _End();
// }
// testcase Case_Config_IsADAS_SGMW()
// {
//   Init_SGMW_Config(1);
//   Config_IsADAS_SGMW();
//   _End();
// }
// testcase Case_Config_IsADAS_And_APA_SGMW()
// {
//   Init_SGMW_Config(1);
//   Config_IsADAS_And_APA_SGMW();
//   _End();
// }

//void Config_Default_SGMW() /*默认值*/
//{
//  dword DTC_Ex[20];
//  int i;
//  for(i=3;i<Config_Len;i++)
//    Write_Config_SGMW[i] = 0;
//  
//  _unlockECU();
//  _Send_Diag(Config_Len,phyreq_ID,Write_Config_SGMW);
//  _TestResult(SendData,phyreq_ID,"",-1);
//  _Send_Diag(3,phyreq_ID,Read_Config_SGMW);
//  _TestResult(SendData,phyreq_ID,"",-1);
//  _Check_Response_Config(SendData,Write_Config_SGMW);
//  _Set_11_Restoration();
//  _Send_Diag(3,phyreq_ID,Read_Config_SGMW);
//  _TestResult(SendData,phyreq_ID,"",-1);
//  _Check_Response_Config(SendData,Write_Config_SGMW);
//  _Close_All_Advanced_function();
//  testWaitForTimeout(CAN_Init_Time+2000);
//  _85_Check_DTC(1,Unconfigured);
//  _Open_All_Advanced_function();
//}

// void Config_IsNotADAS_SGMW() /*已配置_无ADAS*/
// {
//   dword DTC_Ex[20];
//   int i;
//   for(i=3;i<Config_Len;i++)
//     Write_Config_SGMW[i] = 0;
//   Write_Config_SGMW[3] = 0x80;
//   Write_Config_SGMW[4] = 0x02;
//   _unlockECU();
//   _Send_Diag(Config_Len,phyreq_ID,Write_Config_SGMW);
//   _TestResult(SendData,phyreq_ID,"",-1);
//   _Send_Diag(3,phyreq_ID,Read_Config_SGMW);
//   _TestResult(SendData,phyreq_ID,"",-1);
//   _Check_Response_Config(SendData,Write_Config_SGMW);
//   _Close_All_Advanced_function();
//   testWaitForTimeout(2000);
//   _Advanced_function_DTC(Write_Config_SGMW,DTC_Ex);
  
//   _Set_11_Restoration();
//   _Send_Diag(3,phyreq_ID,Read_Config_SGMW);
//   _TestResult(SendData,phyreq_ID,"",-1);
//   _Check_Response_Config(SendData,Write_Config_SGMW);
//   testWaitForTimeout(CAN_Init_Time+2000);
//   _Check_DTC(1,DTC_Ex);
//   _Open_All_Advanced_function();
//   testWaitForTimeout(2000);
// }

// void Config_IsADAS_SGMW()/*已配置_有ADAS*/
// {
//   dword DTC_Ex[20];
//   int i;
//   for(i=3;i<Config_Len;i++)
//     Write_Config_SGMW[i] = 0;
//   Write_Config_SGMW[3] = 0xC0;
//   Write_Config_SGMW[4] = 0x02;
  
//   _unlockECU();
//   _Send_Diag(Config_Len,phyreq_ID,Write_Config_SGMW);
//   _TestResult(SendData,phyreq_ID,"",-1);
//   _Send_Diag(3,phyreq_ID,Read_Config_SGMW);
//   _TestResult(SendData,phyreq_ID,"",-1);
//   _Check_Response_Config(SendData,Write_Config_SGMW);
//   _Close_All_Advanced_function();
//   testWaitForTimeout(2000);
//   _Advanced_function_DTC(Write_Config_SGMW,DTC_Ex);
  
//   _Set_11_Restoration();
//   _Send_Diag(3,phyreq_ID,Read_Config_SGMW);
//   _TestResult(SendData,phyreq_ID,"",-1);
//   _Check_Response_Config(SendData,Write_Config_SGMW);
//   testWaitForTimeout(CAN_Init_Time+2000);
//   _Check_DTC(1,DTC_Ex);
//   _Open_All_Advanced_function();
//   testWaitForTimeout(2000);
// }

// void Config_IsADAS_And_APA_SGMW()/*已配置_有ADAS与APA*/
// {
//   dword DTC_Ex[20];
//   int i;
//   for(i=3;i<Config_Len;i++)
//     Write_Config_SGMW[i] = 0;
//   Write_Config_SGMW[3] = 0xE0;
//   Write_Config_SGMW[4] = 0x02;
  
//   _unlockECU();
//   _Send_Diag(Config_Len,phyreq_ID,Write_Config_SGMW);
//   _TestResult(SendData,phyreq_ID,"",-1);
//   _Send_Diag(3,phyreq_ID,Read_Config_SGMW);
//   _TestResult(SendData,phyreq_ID,"",-1);
//   _Check_Response_Config(SendData,Write_Config_SGMW);
//   _Close_All_Advanced_function();
//   testWaitForTimeout(2000);
//   _Advanced_function_DTC(Write_Config_SGMW,DTC_Ex);
  
//   _Set_11_Restoration();
//   _Send_Diag(3,phyreq_ID,Read_Config_SGMW);
//   _TestResult(SendData,phyreq_ID,"",-1);
//   _Check_Response_Config(SendData,Write_Config_SGMW);
//   testWaitForTimeout(CAN_Init_Time+2000);
//   _Check_DTC(1,DTC_Ex);
//   _Open_All_Advanced_function();
//   testWaitForTimeout(2000);
// }

