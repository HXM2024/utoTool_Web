/*@!Encoding:936*/
includes
{
  // 包含必要的头文件
}

variables
{
  // SHA-256常量K (前64个质数的立方根的小数部分前32位)
   dword K[64] = {
    0x428a2f98, 0x71374491, 0xb5c0fbcf, 0xe9b5dba5,
    0x3956c25b, 0x59f111f1, 0x923f82a4, 0xab1c5ed5,
    0xd807aa98, 0x12835b01, 0x243185be, 0x550c7dc3,
    0x72be5d74, 0x80deb1fe, 0x9bdc06a7, 0xc19bf174,
    0xe49b69c1, 0xefbe4786, 0x0fc19dc6, 0x240ca1cc,
    0x2de92c6f, 0x4a7484aa, 0x5cb0a9dc, 0x76f988da,
    0x983e5152, 0xa831c66d, 0xb00327c8, 0xbf597fc7,
    0xc6e00bf3, 0xd5a79147, 0x06ca6351, 0x14292967,
    0x27b70a85, 0x2e1b2138, 0x4d2c6dfc, 0x53380d13,
    0x650a7354, 0x766a0abb, 0x81c2c92e, 0x92722c85,
    0xa2bfe8a1, 0xa81a664b, 0xc24b8b70, 0xc76c51a3,
    0xd192e819, 0xd6990624, 0xf40e3585, 0x106aa070,
    0x19a4c116, 0x1e376c08, 0x2748774c, 0x34b0bcb5,
    0x391c0cb3, 0x4ed8aa4a, 0x5b9cca4f, 0x682e6ff3,
    0x748f82ee, 0x78a5636f, 0x84c87814, 0x8cc70208,
    0x90befffa, 0xa4506ceb, 0xbef9a3f7, 0xc67178f2
  };
  
  // 最大输入数据长度（字节），可根据需要调整
  const int MAX_INPUT_LENGTH = 1024;

  // SHA-256计算中使用的变量
  dword t1, t2;
  dword w[64];
  dword h0, h1, h2, h3, h4, h5, h6, h7;
  dword originalBitLen, paddingLen, totalLen, blockCount;
  dword highBitLen, lowBitLen;
  byte paddedMessage[MAX_INPUT_LENGTH * 2 + 72]; // 足够大的缓冲区，用于存放填充后的消息
  
//  // 十六进制字符表
  char hexChars[16] ;
}

// 辅助函数：循环右移
dword rotr(dword x, int n) {
  return (x >> n) | (x << (32 - n));
}

// 辅助函数：右移
dword shr(dword x, int n) {
  return x >> n;
}

// 逻辑函数
dword Ch(dword x, dword y, dword z) {
  return (x & y) ^ (~x & z);
}

dword Maj(dword x, dword y, dword z) {
  return (x & y) ^ (x & z) ^ (y & z);
}

// 重命名函数，避免大小写冲突
dword SigmaUpper0(dword x) {
  return rotr(x, 2) ^ rotr(x, 13) ^ rotr(x, 22);
}

dword SigmaUpper1(dword x) {
  return rotr(x, 6) ^ rotr(x, 11) ^ rotr(x, 25);
}

dword sigmaLower0(dword x) {
  return rotr(x, 7) ^ rotr(x, 18) ^ shr(x, 3);
}

dword sigmaLower1(dword x) {
  return rotr(x, 17) ^ rotr(x, 19) ^ shr(x, 10);
}

// 主函数：计算SHA-256哈希
// 参数：data - 输入数据数组
//       len  - 输入数据长度（字节）
//       hash - 输出哈希值（32字节数组）
void sha256(byte data[], dword len, byte hash[]) {
  // 重置工作变量，确保每次调用都从干净的状态开始
  
  int  i,j, k;
  dword a, b, c, d, e, f, g, h;
  a = 0; b = 0; c = 0; d = 0; e = 0; f = 0; g = 0; h = 0;
  t1 = 0; t2 = 0;
  h0 = 0; h1 = 0; h2 = 0; h3 = 0; h4 = 0; h5 = 0; h6 = 0; h7 = 0;
  
  for (i = 0; i < 64; i++) {
    w[i] = 0;
  }
  
  // 计算需要填充的字节数
  // 填充规则：先添加一个0x80字节，然后添加0x00直到长度满足 (原始长度 + 1 + k + 8) % 64 == 0
  // 其中k是填充的0x00字节数，最后8字节存储原始位长度（大端序）
  originalBitLen = len * 8;
  paddingLen = 64 - ((len + 9) % 64);
  if (paddingLen == 64) {
    paddingLen = 0;
  }
  totalLen = len + 1 + paddingLen + 8;
  blockCount = totalLen / 64;
  
  // 检查缓冲区是否足够大
  if (totalLen > (MAX_INPUT_LENGTH * 2 + 72)) {
//    write("Error: Input data too large for buffer");
    for (i = 0; i < 32; i++) {
      hash[i] = 0;
    }
    return;
  }
  
  // 创建填充后的消息缓冲区
  // 复制原始数据
  for (i = 0; i < len; i++) {
    paddedMessage[i] = data[i];
  }
  
  // 添加填充字节
  paddedMessage[len] = 0x80; // 添加1
  for (i = len + 1; i < len + 1 + paddingLen; i++) {
    paddedMessage[i] = 0x00; // 添加0
  }
  
  // 添加原始位长度（大端序，64位）
  // 注意：CAPL中需要将64位长度拆分为两个32位整数
  highBitLen = 0; // 对于小于2^32位的数据，高位为0
  lowBitLen = originalBitLen;
  
  // 存储高位（大端序）
  for (i = 0; i < 4; i++) {
    paddedMessage[totalLen - 8 + i] = (highBitLen >> (24 - i * 8)) & 0xFF;
  }
  
  // 存储低位（大端序）
  for (i = 0; i < 4; i++) {
    paddedMessage[totalLen - 4 + i] = (lowBitLen >> (24 - i * 8)) & 0xFF;
  }
  
  // 初始哈希值
  h0 = 0x6a09e667;
  h1 = 0xbb67ae85;
  h2 = 0x3c6ef372;
  h3 = 0xa54ff53a;
  h4 = 0x510e527f;
  h5 = 0x9b05688c;
  h6 = 0x1f83d9ab;
  h7 = 0x5be0cd19;
  
  // 处理每个512位块
  for (i = 0; i < blockCount; i++) {
    // 将块分解为16个32位字（大端序）
    for (j = 0; j < 16; j++) {
      w[j] = 0;
      for (k = 0; k < 4; k++) {
        w[j] = (w[j] << 8) | paddedMessage[i * 64 + j * 4 + k];
      }
    }
    
    // 扩展16个字为64个字
    for (j = 16; j < 64; j++) {
      w[j] = sigmaLower1(w[j-2]) + w[j-7] + sigmaLower0(w[j-15]) + w[j-16];
    }
    
    // 初始化工作变量
    a = h0;
    b = h1;
    c = h2;
    d = h3;
    e = h4;
    f = h5;
    g = h6;
    h = h7;
    
    // 主循环
    for (j = 0; j < 64; j++) {
      t1 = h + SigmaUpper1(e) + Ch(e, f, g) + K[j] + w[j];
      t2 = SigmaUpper0(a) + Maj(a, b, c);
      h = g;
      g = f;
      f = e;
      e = d + t1;
      d = c;
      c = b;
      b = a;
      a = t1 + t2;
    }
    
    // 更新哈希值
    h0 += a;
    h1 += b;
    h2 += c;
    h3 += d;
    h4 += e;
    h5 += f;
    h6 += g;
    h7 += h;
  }
  
  // 将最终哈希值转换为字节数组（大端序）
  for (i = 0; i < 4; i++) {
    hash[i] = (h0 >> (24 - i * 8)) & 0xFF;
  }
  for (i = 0; i < 4; i++) {
    hash[4 + i] = (h1 >> (24 - i * 8)) & 0xFF;
  }
  for (i = 0; i < 4; i++) {
    hash[8 + i] = (h2 >> (24 - i * 8)) & 0xFF;
  }
  for (i = 0; i < 4; i++) {
    hash[12 + i] = (h3 >> (24 - i * 8)) & 0xFF;
  }
  for (i = 0; i < 4; i++) {
    hash[16 + i] = (h4 >> (24 - i * 8)) & 0xFF;
  }
  for (i = 0; i < 4; i++) {
    hash[20 + i] = (h5 >> (24 - i * 8)) & 0xFF;
  }
  for (i = 0; i < 4; i++) {
    hash[24 + i] = (h6 >> (24 - i * 8)) & 0xFF;
  }
  for (i = 0; i < 4; i++) {
    hash[28 + i] = (h7 >> (24 - i * 8)) & 0xFF;
  }
}

// 将哈希值转换为十六进制字符串
void hashToHexString(byte hash[], char str[]) {
  int i;
  for (i = 0; i < 32; i++) {
    str[i*2] = hexChars[(hash[i] >> 4) & 0x0F];
    str[i*2 + 1] = hexChars[hash[i] & 0x0F];
  }
  str[64] = 0; // 字符串结束符
}

//// 示例使用函数
//void exampleUsage() {
//  write("=== SHA-256 Example Usage ===");
//  write("Input: 'Hello World' (11 bytes)");
//  
//  sha256(exampleData, 11, exampleHash);
//  hashToHexString(exampleHash, exampleHashStr);
//  
//  write("SHA-256 Hash: %s", exampleHashStr);
//  write("Expected:     a591a6d40bf420404a011733cfb7b190d62c65bf0bcda32b57b277d9ad9f146e");
//}

