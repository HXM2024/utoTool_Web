/*@!Encoding:936*/
includes
{
  
}
variables
{
  
}

void Init_Main_19_RC()
{
  Init_Main_Special("\\瑞驰_快照\\",defsession);
  Init_For_Snapshot();
}
void End_Main_19_RC()
{
  End_Main();
}

void Serve19_Snapshot_RC_01(dword ID,byte Session)   /*故障码全局快照（电压、车速、里程、时间）更新及存储机制测试*/
{
  int i;
  byte Data_Send[6] = {0x19,0x04,0,0,0,0xff};
  float Da_Temp[2];
  char Str_Temp[2][50];
  int j;
  Data_Send[2] = (DTC_19[Node_1904_Pos][1]>>16);
  Data_Send[3] = (DTC_19[Node_1904_Pos][1]>>8);
  Data_Send[4] = (DTC_19[Node_1904_Pos][1]&0xFF);
  _Clear_DTC(phyreq_ID);
  _WriteEx_and_Report("","设置第一次值");
  for(i=0;i<mixArray_Len;i++)
  {
    _Step_1904(mixArray[i].Str_DID_1904,0); //设置值
    _Step_1904_(mixArray[i].Str_DID_1904,0,1);//将预期结果赋值给第二组快照
  }
  _Close_One_Node(DTC_19[Node_1904_Pos]);
  _Send_Diag(6,ID,Data_Send);
  _Check_1904(SendData,"All",Da_Temp,Str_Temp,0);
  
  _WriteEx_and_Report("","设置第二次值");
  for(i=0;i<mixArray_Len;i++)
    _Step_1904(mixArray[i].Str_DID_1904,1); //设置值
  _Open_One_Node(DTC_19[Node_1904_Pos]);
  _Close_One_Node(DTC_19[Node_1904_Pos]);
  _Send_Diag(6,ID,Data_Send);
  _Check_1904(SendData,"All",Da_Temp,Str_Temp,0);
  _Open_One_Node(DTC_19[Node_1904_Pos]);
  
  _WriteEx_and_Report("","设置第三次值");
  for(i=0;i<mixArray_Len;i++)
    _Step_1904(mixArray[i].Str_DID_1904,2); //设置值
  _Send_Diag(6,ID,Data_Send);
  _Check_1904(SendData,"All",Da_Temp,Str_Temp,0);
  _Set_11_Restoration();
  testWaitForTimeout(1000);
  _Send_Diag(6,ID,Data_Send);
  _Check_1904(SendData,"All",Da_Temp,Str_Temp,0);
  
  for(i=0;i<mixArray_Len;i++)
    _Step_1904_(mixArray[i].Str_DID_1904,2,1);
  _Close_One_Node(DTC_19[Node_1904_Pos]);
  _Send_Diag(6,ID,Data_Send);
  _Check_1904(SendData,"All",Da_Temp,Str_Temp,0);
  
  _WriteEx_and_Report("","设置第四次值");
  for(i=0;i<mixArray_Len;i++)
  {
    _Step_1904(mixArray[i].Str_DID_1904,3); //设置值
    _Step_1904_(mixArray[i].Str_DID_1904,3,1);
  }
  _Power_Down_19();
  _Power_Up_19();
  testWaitForTimeout(3000);
  _Send_Diag(6,ID,Data_Send);
  _Check_1904(SendData,"All",Da_Temp,Str_Temp,0);
  
  _Open_One_Node(DTC_19[Node_1904_Pos]);
  _Clear_DTC(phyreq_ID);
  for(i=0;i<mixArray_Len;i++)
    _Step_1904_(mixArray[i].Str_DID_1904,3,0);
  _Close_One_Node(DTC_19[Node_1904_Pos]);
  _Send_Diag(6,ID,Data_Send);
  _Check_1904(SendData,"All",Da_Temp,Str_Temp,0);
  _Open_One_Node(DTC_19[Node_1904_Pos]);
}

void Serve19_Snapshot_RC_02(dword ID,byte Session)   /*故障码全局快照（车速、里程）丢失/无效的填充值测试*/
{
  int i;
  byte Data_Send[6] = {0x19,0x04,0,0,0,0xff};
  float Da_Temp[2];
  char Str_Temp[2][50],Str_[100];
  int Len_ID[10],Len_ID_Save[10],Str_Pos;
  Char Str_Len[10];
  Data_Send[2] = (DTC_19[Node_1904_Pos][1]>>16);
  Data_Send[3] = (DTC_19[Node_1904_Pos][1]>>8);
  Data_Send[4] = (DTC_19[Node_1904_Pos][1]&0xFF);
  _Power_Down();
  _Close_All();
  testWaitForTimeout(200);
  _Power_Up();
  _Check_DTC_Res(0x89,DTC_19[Node_1904_Pos][1],0);
  _Open_One_Node(DTC_19[Node_1904_Pos]);
  _Clear_DTC(phyreq_ID);
  _Send_Diag(6,ID,Data_Send);
  _Check_19_NoFreeze(SendData," ");
  _Close_One_Node(DTC_19[Node_1904_Pos]);
  _Send_Diag(6,ID,Data_Send);
  _Get_1904_All_Data(SendData);
  for(i=0;i<Freeze_Frame_CAN_Error_Count;i++)
  {
    snprintf(Str_,elCount(Str_),"%s","");
    snprintf(Str_,elCount(Str_),"%s",Freeze_Frame_CAN_Error[i]);
    snprintf(Str_Temp[0],elCount(Str_Temp[0]),"FFFFFF");
    if(strncmp(Str_,"LocalTime",strlen(Str_))==0)
      _Check_1904_Specified(Str_,Str_Temp,1);
    else
      _Check_1904_Specified(Str_,Da_Temp,1);
    testWaitForTimeout(500);
  }
  _Open_One_Node(DTC_19[Node_1904_Pos]);
  _Clear_DTC(phyreq_ID);
  _Send_Diag(6,ID,Data_Send);
  _Check_19_NoFreeze(SendData," ");
  _Power_Down();
  _Open_All();
  for(i=0;i<Freeze_Frame_CAN_Error_Count;i++)
  {
    snprintf(Str_,elCount(Str_),"%s","");
    snprintf(Str_,elCount(Str_),"%s",Freeze_Frame_CAN_Error[i]);
    Str_Pos = _Check_StrPossion_Res(Str_,1);
    Len_ID[i] = atol(mixArray[Str_Pos].Sig_Name_Node);
    snprintf(Str_Len,elCount(Str_Len),"DLC_%X",Len_ID[i]);
    Len_ID_Save[i] = getValue(Str_Len);
    _Set_Sig(Str_Len,Len_ID_Save[i]-1);
  }
  for(i=0;i<Freeze_Frame_CAN_Error_Count;i++)
  {
    if(Len_ID[i] == 0x107)
    {
      snprintf(Str_Len,elCount(Str_Len),"DLC_%X",0x1F8);
      Len_ID_Save[Freeze_Frame_CAN_Error_Count] = getValue(Str_Len);
      _Set_Sig(Str_Len,Len_ID_Save[Freeze_Frame_CAN_Error_Count]-1);
    }
    else if(Len_ID[i] == 0x1F8)
    {
      snprintf(Str_Len,elCount(Str_Len),"DLC_%X",0x107);
      Len_ID_Save[Freeze_Frame_CAN_Error_Count] = getValue(Str_Len);
      _Set_Sig(Str_Len,Len_ID_Save[Freeze_Frame_CAN_Error_Count]-1);
    }
  }
  testWaitForTimeout(1000);
  _Power_Up();
  _Close_One_Node(DTC_19[Node_1904_Pos]);
  _Send_Diag(6,ID,Data_Send);
  _Get_1904_All_Data(SendData);
  for(i=0;i<Freeze_Frame_CAN_Error_Count;i++)
  {
    snprintf(Str_,elCount(Str_),"%s","");
    snprintf(Str_,elCount(Str_),"%s",Freeze_Frame_CAN_Error[i]);
    snprintf(Str_Temp[0],elCount(Str_Temp[0]),"FFFFFF");
    if(strncmp(Str_,"LocalTime",strlen(Str_))==0)
      _Check_1904_Specified(Str_,Str_Temp,1);
    else
      _Check_1904_Specified(Str_,Da_Temp,1);
    testWaitForTimeout(500);
  }
  _Open_One_Node(DTC_19[Node_1904_Pos]);
  for(i=0;i<Freeze_Frame_CAN_Error_Count;i++)
  {
    snprintf(Str_Len,elCount(Str_Len),"DLC_%X",Len_ID[i]);
    _Set_Sig(Str_Len,Len_ID_Save[i]);
  }
  for(i=0;i<Freeze_Frame_CAN_Error_Count;i++)
  {
    if(Len_ID[i] == 0x107)
    {
      snprintf(Str_Len,elCount(Str_Len),"DLC_%X",0x1F8);
      _Set_Sig(Str_Len,Len_ID_Save[Freeze_Frame_CAN_Error_Count]);
    }
    else if(Len_ID[i] == 0x1F8)
    {
      snprintf(Str_Len,elCount(Str_Len),"DLC_%X",0x107);
      _Set_Sig(Str_Len,Len_ID_Save[Freeze_Frame_CAN_Error_Count]);
    }
  }
  testWaitForTimeout(1000);
}

void Serve19_Snapshot_RC_03(dword ID,byte Session)   /*故障码全局快照（车速、里程）先正常后丢失的填充值测试*/
{
  int i;
  byte Data_Send[6] = {0x19,0x04,0,0,0,0xff};
  float Da_Temp[2];
  char Str_Temp[2][50],Str_[100];
  int Len_ID[10],Str_Pos;
  Data_Send[2] = (DTC_19[Node_1904_Pos][1]>>16);
  Data_Send[3] = (DTC_19[Node_1904_Pos][1]>>8);
  Data_Send[4] = (DTC_19[Node_1904_Pos][1]&0xFF);
  
  for(i=0;i<Freeze_Frame_CAN_Error_Count;i++)
  {
    snprintf(Str_,elCount(Str_),"%s",Freeze_Frame_CAN_Error[i]);
    _Step_1904(Str_,0); //设置值
    _Step_1904_(Str_,0,1);//将预期结果赋值给第二组快照
  }
  _Clear_DTC(phyreq_ID);
  _Send_Diag(6,ID,Data_Send);
  _Check_19_NoFreeze(SendData," ");
  _Close_One_Node(DTC_19[Node_1904_Pos]);
  _Send_Diag(6,ID,Data_Send);
  _Check_1904(SendData,"All",Da_Temp,Str_Temp,0);
  
  for(i=0;i<Freeze_Frame_CAN_Error_Count;i++)
  {
    snprintf(Str_,elCount(Str_),"%s","");
    snprintf(Str_,elCount(Str_),"%s",Freeze_Frame_CAN_Error[i]);
    Str_Pos = _Check_StrPossion_Res(Str_,1);
    Len_ID[i] = atol(mixArray[i].Sig_Name_Node);
  }
  for(i=0;i<Freeze_Frame_CAN_Error_Count;i++)
  {
    if(Len_ID[i] == 0x107)
      Len_ID[Freeze_Frame_CAN_Error_Count] = 0x1F8;
    if(Len_ID[i] == 0x1F8)
      Len_ID[Freeze_Frame_CAN_Error_Count] = 0x107;
  }
  for(i=0;i<Freeze_Frame_CAN_Error_Count+1;i++)
    _TestDisableMsg(Len_ID[i]);
  testWaitForTimeout(2000);
  _Open_One_Node(DTC_19[Node_1904_Pos]);
  _Close_One_Node(DTC_19[Node_1904_Pos]);
  _Send_Diag(6,ID,Data_Send);
  _Check_1904(SendData,"All",Da_Temp,Str_Temp,0);
  _K15_OFF();
  testWaitForTimeout(2000);
  _Open_One_Node(DTC_19[Node_1904_Pos]);
  _K15_ON();
  testWaitForTimeout(3000);
  _Send_Diag(6,ID,Data_Send);
  _Check_1904(SendData,"All",Da_Temp,Str_Temp,0);
  _Close_One_Node(DTC_19[Node_1904_Pos]);
  _Send_Diag(6,ID,Data_Send);
  _Get_1904_All_Data(SendData);
  for(i=0;i<Freeze_Frame_CAN_Error_Count;i++)
  {
    snprintf(Str_,elCount(Str_),"%s","");
    snprintf(Str_,elCount(Str_),"%s",Freeze_Frame_CAN_Error[i]);
    if(strncmp(Str_,"CarSpd",strlen(Str_)) == 0 && strlen(Str_) == strlen("CarSpd"))
      Da_Temp[1] = 0x1FFF;
    else
      Da_Temp[1] = 0xffffff;
    _Check_1904_Specified(Str_,Da_Temp,0);
    testWaitForTimeout(500);
  }
  _Open_One_Node(DTC_19[Node_1904_Pos]);
  _Clear_DTC(phyreq_ID);
  _K15_OFF();
  testWaitForTimeout(2000);
  _K15_ON();
  testWaitForTimeout(3000);
  _Close_One_Node(DTC_19[Node_1904_Pos]);
  _Send_Diag(6,ID,Data_Send);
  _Get_1904_All_Data(SendData);
  for(i=0;i<Freeze_Frame_CAN_Error_Count;i++)
  {
    snprintf(Str_,elCount(Str_),"%s","");
    snprintf(Str_,elCount(Str_),"%s",Freeze_Frame_CAN_Error[i]);
    if(strncmp(Str_,"CarSpd",strlen(Str_)) == 0 && strlen(Str_) == strlen("CarSpd"))
      Da_Temp[0] = 0x1FFF;
    else
      Da_Temp[0] = 0xffffff;
    _Check_1904_Specified(Str_,Da_Temp,0);
    testWaitForTimeout(500);
  }
  _Open_One_Node(DTC_19[Node_1904_Pos]);
  for(i=0;i<Freeze_Frame_CAN_Error_Count+1;i++)
    _TestEnableMsg(Len_ID[i]);
}

void Serve19_Snapshot_RC_04(dword ID,byte Session)   /*故障码全局快照（车速、里程）先正常后无效的填充值测试*/
{
  int i;
  byte Data_Send[6] = {0x19,0x04,0,0,0,0xff};
  float Da_Temp[2];
  char Str_Temp[2][50],Str_[100];
  int Len_ID[10],Len_ID_Save[10],Str_Pos;
  Char Str_Len[10];
  Data_Send[2] = (DTC_19[Node_1904_Pos][1]>>16);
  Data_Send[3] = (DTC_19[Node_1904_Pos][1]>>8);
  Data_Send[4] = (DTC_19[Node_1904_Pos][1]&0xFF);
  
  for(i=0;i<Freeze_Frame_CAN_Error_Count;i++)
  {
    snprintf(Str_,elCount(Str_),"%s",Freeze_Frame_CAN_Error[i]);
    _Step_1904(Str_,0); //设置值
    _Step_1904_(Str_,0,1);//将预期结果赋值给第二组快照
  }
  _Clear_DTC(phyreq_ID);
  _Send_Diag(6,ID,Data_Send);
  _Check_19_NoFreeze(SendData," ");
  _Close_One_Node(DTC_19[Node_1904_Pos]);
  _Send_Diag(6,ID,Data_Send);
  _Check_1904(SendData,"All",Da_Temp,Str_Temp,0);
  
  for(i=0;i<Freeze_Frame_CAN_Error_Count;i++)
  {
    snprintf(Str_,elCount(Str_),"%s","");
    snprintf(Str_,elCount(Str_),"%s",Freeze_Frame_CAN_Error[i]);
    Str_Pos = _Check_StrPossion_Res(Str_,1);
    Len_ID[i] = atol(mixArray[Str_Pos].Sig_Name_Node);
    snprintf(Str_Len,elCount(Str_Len),"DLC_%X",Len_ID[i]);
    Len_ID_Save[i] = getValue(Str_Len);
    _Set_Sig(Str_Len,Len_ID_Save[i]-1);
    
    if(Len_ID[i] == 0x107)
    {
      snprintf(Str_Len,elCount(Str_Len),"DLC_%X",0x1F8);
      Len_ID[Freeze_Frame_CAN_Error_Count] = 0x1F8;
      Len_ID_Save[Freeze_Frame_CAN_Error_Count] = getValue(Str_Len);
      _Set_Sig(Str_Len,Len_ID_Save[Freeze_Frame_CAN_Error_Count]-1);
    }
    else if(Len_ID[i] == 0x1F8)
    {
      snprintf(Str_Len,elCount(Str_Len),"DLC_%X",0x107);
      Len_ID[Freeze_Frame_CAN_Error_Count] = 0x107;
      Len_ID_Save[Freeze_Frame_CAN_Error_Count] = getValue(Str_Len);
      _Set_Sig(Str_Len,Len_ID_Save[Freeze_Frame_CAN_Error_Count]-1);
    }
  }
  testWaitForTimeout(2000);

  _Open_One_Node(DTC_19[Node_1904_Pos]);
  _Close_One_Node(DTC_19[Node_1904_Pos]);
  _Send_Diag(6,ID,Data_Send);
  _Check_1904(SendData,"All",Da_Temp,Str_Temp,0);
  
  
  _K15_OFF();
  testWaitForTimeout(2000);
  _Open_One_Node(DTC_19[Node_1904_Pos]);
  _K15_ON();
  testWaitForTimeout(3000);
  _Send_Diag(6,ID,Data_Send);
  _Get_1904_All_Data(SendData);
  for(i=0;i<Freeze_Frame_CAN_Error_Count;i++)
  {
    snprintf(Str_,elCount(Str_),"%s","");
    snprintf(Str_,elCount(Str_),"%s",Freeze_Frame_CAN_Error[i]);
    if(strncmp(Str_,"CarSpd",strlen(Str_)) == 0 && strlen(Str_) == strlen("CarSpd"))
      Da_Temp[1] = 0x1FFF;
    else
      Da_Temp[1] = 0xffffff;
    _Check_1904_Specified(Str_,Da_Temp,0);
    testWaitForTimeout(500);
  }
  _Close_One_Node(DTC_19[Node_1904_Pos]);
  _Send_Diag(6,ID,Data_Send);
  _Get_1904_All_Data(SendData);
  for(i=0;i<Freeze_Frame_CAN_Error_Count;i++)
  {
    snprintf(Str_,elCount(Str_),"%s","");
    snprintf(Str_,elCount(Str_),"%s",Freeze_Frame_CAN_Error[i]);
    _Check_1904_Specified(Str_,Da_Temp,0);
    testWaitForTimeout(500);
  }
  _Open_One_Node(DTC_19[Node_1904_Pos]);
  _Clear_DTC(phyreq_ID);
  _K15_OFF();
  testWaitForTimeout(2000);
  _K15_ON();
  testWaitForTimeout(3000);
  _Close_One_Node(DTC_19[Node_1904_Pos]);
  _Send_Diag(6,ID,Data_Send);
  _Get_1904_All_Data(SendData);
  for(i=0;i<Freeze_Frame_CAN_Error_Count;i++)
  {
    snprintf(Str_,elCount(Str_),"%s","");
    snprintf(Str_,elCount(Str_),"%s",Freeze_Frame_CAN_Error[i]);
    if(strncmp(Str_,"CarSpd",strlen(Str_)) == 0 && strlen(Str_) == strlen("CarSpd"))
      Da_Temp[0] = 0x1FFF;
    else
      Da_Temp[0] = 0xffffff;
    _Check_1904_Specified(Str_,Da_Temp,0);
    testWaitForTimeout(500);
  }
  _Open_One_Node(DTC_19[Node_1904_Pos]);
  for(i=0;i<Freeze_Frame_CAN_Error_Count+1;i++)
  {
    snprintf(Str_Len,elCount(Str_Len),"DLC_%X",Len_ID[i]);
    _Set_Sig(Str_Len,Len_ID_Save[i]);
  }
}

void Serve19_Snapshot_RC_05(dword ID,byte Session)   /*故障码全局快照（主辅车速策略）填充值测试*/
{
  int i;
  byte Data_Send[6] = {0x19,0x04,0,0,0,0xff};
  float Da_Temp[2];
  char Str_[100];
  int Len_ID_Save[10];
  Char Str_Len[10];
  
  snprintf(Str_,elCount(Str_),"CarSpd");
  Data_Send[2] = (DTC_19[Node_1904_Pos][1]>>16);
  Data_Send[3] = (DTC_19[Node_1904_Pos][1]>>8);
  Data_Send[4] = (DTC_19[Node_1904_Pos][1]&0xFF);
  _Set_Sig(Struct_CarSpd.CarSpd_Sig,10);
  _Set_Sig(Struct_CarSpd.Auxiliary_Speed_Sig,20);
  testWaitForTimeout(1000);
  _Clear_DTC(phyreq_ID);
  _Send_Diag(6,ID,Data_Send);
  _Check_19_NoFreeze(SendData," ");
  
  Da_Temp[0] = 10;Da_Temp[1] = 10;
  _Close_One_Node(DTC_19[Node_1904_Pos]);
  _Send_Diag(6,ID,Data_Send);
  _Get_1904_All_Data(SendData);
  _Check_1904_Specified(Str_,Da_Temp,0);
  
  _Open_One_Node(DTC_19[Node_1904_Pos]);
  _TestDisableMsg(Struct_CarSpd.Sig_Id);
  testWaitForTimeout(1000);
  _Close_One_Node(DTC_19[Node_1904_Pos]);
  Da_Temp[1] = 20;
  _Send_Diag(6,ID,Data_Send);
  _Get_1904_All_Data(SendData);
  _Check_1904_Specified(Str_,Da_Temp,0);
  
  _Open_One_Node(DTC_19[Node_1904_Pos]);
  _TestEnableMsg(Struct_CarSpd.Sig_Id);
  testWaitForTimeout(1000);
  snprintf(Str_Len,elCount(Str_Len),"DLC_%X",Struct_CarSpd.Sig_Id);
  Len_ID_Save[0] = getValue(Str_Len);
  _Set_Sig(Str_Len,Len_ID_Save[0]-1);
  testWaitForTimeout(1000);
  _Close_One_Node(DTC_19[Node_1904_Pos]);
  _Send_Diag(6,ID,Data_Send);
  _Get_1904_All_Data(SendData);
  _Check_1904_Specified(Str_,Da_Temp,0);
  
  _Open_One_Node(DTC_19[Node_1904_Pos]);
  _Set_Sig(Str_Len,Len_ID_Save[0]);
  testWaitForTimeout(1000);
  _TestDisableMsg(Struct_CarSpd.Auxiliary_Speed_Node);
  testWaitForTimeout(1000);
  _Close_One_Node(DTC_19[Node_1904_Pos]);
  _Send_Diag(6,ID,Data_Send);
  _Get_1904_All_Data(SendData);
  Da_Temp[1] = 10;
  _Check_1904_Specified(Str_,Da_Temp,0);
  
  _Open_One_Node(DTC_19[Node_1904_Pos]);
  _TestEnableMsg(Struct_CarSpd.Auxiliary_Speed_Node);
  testWaitForTimeout(1000);
  snprintf(Str_Len,elCount(Str_Len),"DLC_%X",Struct_CarSpd.Auxiliary_Speed_Node);
  Len_ID_Save[1] = getValue(Str_Len);
  _Set_Sig(Str_Len,Len_ID_Save[1]-1);
  testWaitForTimeout(1000);
  _Close_One_Node(DTC_19[Node_1904_Pos]);
  _Send_Diag(6,ID,Data_Send);
  _Get_1904_All_Data(SendData);
  _Check_1904_Specified(Str_,Da_Temp,0);
  
  _Open_One_Node(DTC_19[Node_1904_Pos]);
  _Set_Sig(Str_Len,Len_ID_Save[1]);
  testWaitForTimeout(1000);
  _TestDisableMsg(Struct_CarSpd.Auxiliary_Speed_Node);
  _TestDisableMsg(Struct_CarSpd.Sig_Id);
  testWaitForTimeout(2000);
  _Close_One_Node(DTC_19[Node_1904_Pos]);
  _Send_Diag(6,ID,Data_Send);
  _Get_1904_All_Data(SendData);
  _Check_1904_Specified(Str_,Da_Temp,0);
  _Power_Down();
  testWaitForTimeout(2000);
  _Power_Up();
  testWaitForTimeout(2000);
  _Send_Diag(6,ID,Data_Send);
  _Get_1904_All_Data(SendData);
  Da_Temp[1] = 0x1FFF;
  _Check_1904_Specified(Str_,Da_Temp,0);
  _TestEnableMsg(Struct_CarSpd.Auxiliary_Speed_Node);
  _TestEnableMsg(Struct_CarSpd.Sig_Id);
  _Open_One_Node(DTC_19[Node_1904_Pos]);
}

void Serve19_Snapshot_RC_06(dword ID,byte Session)   /*快照与22服务读出的值对比测试*/
{
  int i,Fun_DIDPos,Sw_temp;
  byte Data_Send[6] = {0x19,0x04,0,0,0,0xff};
  float Da_Temp[2];
  char Str_[100],Str_Temp[2][50],DIDStr[50];
  dword FunDID[4] = {0xCF00,0xCF01,0xCF03,0xCF05};
  byte Send_Data_22[3] = {0x22,0x33,0x0C};
  
  Data_Send[2] = (DTC_19[Node_1904_Pos][1]>>16);
  Data_Send[3] = (DTC_19[Node_1904_Pos][1]>>8);
  Data_Send[4] = (DTC_19[Node_1904_Pos][1]&0xFF);
  _Get_FunDID_Data();
  for(i=0;i<mixArray_Len;i++)
  {
    _Step_1904(mixArray[i].Str_DID_1904,0); //设置值
    _Step_1904_(mixArray[i].Str_DID_1904,0,1);//将预期结果赋值给第二组快照
  }
  _Clear_DTC(phyreq_ID);
  _Close_One_Node(DTC_19[Node_1904_Pos]);
  _Send_Diag(6,ID,Data_Send);
  _Check_1904(SendData,"All",Da_Temp,Str_Temp,0);
  for(i=0;i<4;i++)
  {
    Send_Data_22[0] = 0x22;
    Send_Data_22[1] = (FunDID[i]>>8)&0xFF;
    Send_Data_22[2] = FunDID[i]&0xFF;
    Fun_DIDPos = _Check_DID_Pos(FunDID[i]);
    DID_Function[Fun_DIDPos].Value_Set_Flage = 1;
    if(Fun_DIDPos == -1)
      _WriteEx_and_Report("功能DID","未获取到对应的DID:0x%04X数据",FunDID[i]);
    else if(Fun_DIDPos >= 0)
    {
       snprintf(DIDStr,elCount(DIDStr),"%s",DID_Function[Fun_DIDPos].Sig_Step);
       _Str_Upper(DIDStr);
      Sw_temp = _Check_StrPossion_Res(DID_Function[Fun_DIDPos].Sig_Step,1); //检测字符串是否在预期输入中
      if(Sw_temp != -1)
      {
        if(DID_Function[Fun_DIDPos].Time_Flage == 1)
          snprintf(DID_Function[Fun_DIDPos].LocalTime_Ex[0],elCount(DID_Function[Fun_DIDPos].LocalTime_Ex[0]),"%s",mixArray[Sw_temp].LocalTime_Value_2[0]);
        else
          DID_Function[Fun_DIDPos].Value_Ex[0] = mixArray[Sw_temp].Vaule_Ex_2[0];
        Check_ReadFunDID(Send_Data_22,Fun_DIDPos,ID,1,0,0,1);
      }
      else
        _WriteEx_and_Report("功能DID","未获取到对应的DID:0x%04X与快照相匹配的数据",FunDID[i]);
    }
  }
}

testcase Case_Snapshot_RC_01() /*故障码全局快照（电压、车速、里程、时间）更新及存储机制测试*/
{
  Init_Main_19_RC();
  Serve19_Snapshot_RC_01(phyreq_ID,defsession);
  End_Main_19_RC();
}
testcase Case_Snapshot_RC_02() /*故障码全局快照（车速、里程）丢失/无效的填充值测试*/
{
  Init_Main_19_RC();
  Serve19_Snapshot_RC_02(phyreq_ID,defsession);
  End_Main_19_RC();
}
testcase Case_Snapshot_RC_03() /*故障码全局快照（车速、里程）先正常后丢失的填充值测试*/
{
  Init_Main_19_RC();
  Serve19_Snapshot_RC_03(phyreq_ID,defsession);
  End_Main_19_RC();
}
testcase Case_Snapshot_RC_04() /*故障码全局快照（车速、里程）先正常后无效的填充值测试*/
{
  Init_Main_19_RC();
  Serve19_Snapshot_RC_04(phyreq_ID,defsession);
  End_Main_19_RC();
}
testcase Case_Snapshot_RC_05() /*故障码全局快照（主辅车速策略）填充值测试*/
{
  Init_Main_19_RC();
  Serve19_Snapshot_RC_05(phyreq_ID,defsession);
  End_Main_19_RC();
}
testcase Case_Snapshot_RC_06() /*快照与22服务读出的值对比测试*/
{
  Init_Main_19_RC();
  Serve19_Snapshot_RC_06(phyreq_ID,defsession);
  End_Main_19_RC();
}