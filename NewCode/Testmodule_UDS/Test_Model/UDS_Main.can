/*@!Encoding:936*/
includes
{
  #include "..\Library\SGMW_Snapshot.cin"
  #include "..\Library\SGMW_Config.cin"
  
  #include "..\Library\RC_Snapshot.cin"
  #include "..\Library\Chery_Config.cin"

  #include "..\Library\ChangAn_Config.cin"
  #include "..\Library\ChangAn_Snapshot.cin"

  #include "..\Library\GAC_Config.cin"
  #include "..\Library\GAC_Snapshot.cin"

  #include "..\Library\Geely_1.0_Config.cin"
  #include "..\Library\Geely_3.0_Config.cin"
  #include "..\Library\Geely_Snapshot.cin"
  #include "..\Library\Geely_CCP.cin"
  
  #include "..\Library\Extend_UDS_Diag.cin"
  #include "..\Library\BT_Security.cin"
  #include "..\Library\TP_Function.cin"
  #include "Function.can"
//  #include "..\Library\BYD_Config.cin"
}

variables
{
  byte NRC13 = 0x13;
  byte NRC31 = 0x31;
  byte NRC22 = 0x22;
  byte NRC7E = 0x7E;
  byte NRC7F = 0x7F;
  byte NRC11 = 0x11;
  byte NRC12 = 0x12;
  byte NRC78 = 0x78;
  byte NRC33 = 0x33;
  byte NRC24 = 0x24;
  byte NRC35 = 0x35;
  byte NRC36 = 0x36;
  byte NRC37 = 0x37;
  char Temp_Log_Name[200];
  mstimer CAN_BUS_loader_H;
  mstimer CAN_BUS_loader_L;
  qword count_Bus;
  mstimer Time_Count;
  byte Time_Flage;
  qword Time_Count_Time;
  int Change_Load;
}

on timer CAN_BUS_loader_H
{
  int k;
  message * mg1;
  qword ID;
  int H_Load,L_Load;
  if((phyreq_ID-0x100)<0)
    ID = 0x001;
  else
    ID = (phyreq_ID-0x100);
  if(ID == Response_ID || ID == funreq_ID)
    ID = ID - 0x10;
  mg1.id  = ID;
  mg1.dlc = 8;
  for(k=0;k<count_Bus;k++)
    output(mg1);
  testWaitForTimeout(100);
  if(Change_Load == 0)
  {
    H_Load = High_Load_Range[1];
    L_Load = High_Load_Range[0];
  }
  else
  {
    H_Load = High_Load_Range[1] - 20;
    L_Load = High_Load_Range[0] - 20;
  }
  if(canGetBusLoad(1)>H_Load)
    count_Bus--;
  else if(canGetBusLoad(1)<L_Load)
    count_Bus++;
  setTimer(CAN_BUS_loader_H,200);
}
on timer CAN_BUS_loader_L
{
  int k;
  message * mg2;
  qword ID;
  int H_Load,L_Load;
  if((phyreq_ID+0x100)>0x7FF)
    ID = 0X7FF;
  else
    ID = phyreq_ID+0x100;
  if(ID == Response_ID || ID == funreq_ID)
    ID = ID - 0x10;
  mg2.id  = ID;
  mg2.dlc = 8;
  for(k=0;k<count_Bus;k++)
    output(mg2);
  testWaitForTimeout(100);
  if(Change_Load == 0)
  {
    H_Load = High_Load_Range[1];
    L_Load = High_Load_Range[0];
  }
  else
  {
    H_Load = High_Load_Range[1] - 20;
    L_Load = High_Load_Range[0] - 20;
  }
  if(canGetBusLoad(1)>H_Load)
    count_Bus--;
  else if(canGetBusLoad(1)<L_Load)
    count_Bus++;
  setTimer(CAN_BUS_loader_L,200);
}
on timer Time_Count
{
  testWaitForTimeout(Time_Count_Time);
  Time_Flage =1;
}

void Init_Main_Traversal_DID(byte Session)
{
  Init();
  testWaitForTimeout(500);
  _Clear_DTC(phyreq_ID);
  _SetSession(Session);
}

void Init_Main_Def()
{
  Init();
  _Start();
  testWaitForTimeout(500);
  _Clear_DTC(phyreq_ID);
  testWaitForTimeout(100);
  _SetSession(defsession);
  testWaitForTimeout(200);
  _WriteEx_and_Report("","初始化完成");
}
void Init_Main_Special(char Str[],byte Session)
{
  Init();
  _Start(Str);
  testWaitForTimeout(500);
  _Clear_DTC(phyreq_ID);
  testWaitForTimeout(100);
  _SetSession(Session);
  testWaitForTimeout(200);
  _WriteEx_and_Report("","初始化完成");
}
void Init_Main_Ex()
{
  Init();
  _Start();
  testWaitForTimeout(500);
  _Clear_DTC(phyreq_ID);
  testWaitForTimeout(100);
  _SetSession(exsession);
  testWaitForTimeout(200);
  _WriteEx_and_Report("","初始化完成");
}
void End_Main()
{
  diagStopTesterPresent(Cdd_Name);
  _End();
  snprintf(Fault_Data_Report,elCount(Fault_Data_Report),"");
  snprintf(Fault_Data_Write,elCount(Fault_Data_Write),"");
  snprintf(Fault_Data_Send,elCount(Fault_Data_Send),"");
  _Set_CarSpd(0);
  _Clear_Seed();
  Time_Flage = 0;
  Change_Load = 0;
  Get_Seed_Flage = 0;
  Serve_31_NewNRC22 = 0;
  for(i=0;i<Node_Temp_List_Count;i++)
    Node_Temp_List[i]=0;
  Node_Temp_List_Count =0;
  testWaitForTimeout(1000);
}

void Init()
{
  _WriteEx_and_Report("","初始化");
  count_Bus = 400;
  Get_value();
  _Init_Struct();
  _Get_DTC_19();
  _Get_CarSpd_Engine();
  diagSetTarget(Cdd_Name);
  if(Unlock_1002 == -1)
    Unlock_1002 = _Check_Serve(0x10,2,5);
  Support_ReadSession = 0;
  Res_NRC78 = 0;
}

void _ID_Traversal()
{
  byte Data[8] = {0x02,0x10,0x01,0x55,0x55,0x55,0x55,0x55};
  message *Msg;
  dword ID;
  int Res_Flage,i;
  Msg.dlc = 8;
  Msg.FDF = 0;
  Msg.BRS = 0;
  if(Support_CAN == 2)
  {
    Msg.FDF = 1;
    Msg.BRS = 1;
  }
  testWaitForTimeout(500);
  for(i=0;i<8;i++)
    Msg.byte(i) = Data[i];
  for(i=ID_Range[0];i<=ID_Range[1];i++)
  {
    Msg.id = i;
    Res_Flage = 0;
    output(Msg);
    if(i == Response_ID)
      testWaitForTimeout(2);  /*增加等待时间防止在此处里面发送后就判断到本身的返回*/
    Res_Flage = testWaitForMessage(Response_ID,100);
    if(Res_Flage == 1 )
    {
      if(i==phyreq_ID || i == funreq_ID)
        testStepPass("","0x%03X ID收到响应",i);
      else
        testStepFail("","0x%03X ID收到响应",i);
    }
    else if(Res_Flage == 0)
    {
      if(i==phyreq_ID || i == funreq_ID)
        testStepFail("","0x%03X ID未收到响应",i);
    }
  }
}

void _ID_ExTraversal()
{
  byte Data[8] = {0x02,0x10,0x01,0x55,0x55,0x55,0x55,0x55};
  message *Msg;
  message *RxMsg;
  dword ID;
  int Res_Flage;
  Msg.dlc = 8;
  Msg.FDF = 0;
  Msg.BRS = 0;
  if(Support_CAN == 2)
  {
    Msg.FDF = 1;
    Msg.BRS = 1;
  }
  Msg.id = phyreq_ID;
  for(i=0;i<8;i++)
    Msg.byte(i+1) = Data[i];
  testWaitForTimeout(100);
  for(i=0x01;i<=0xEF;i++)
  {
    Msg.byte(0) = i;
    output(Msg);
    Res_Flage = testWaitForMessage(Response_ID,100);
    if(Res_Flage == 1 )
    {
      testGetWaitEventMsgData(RxMsg);
      if(RxMsg.byte(0)<0xF0)
        testStepPass("","收到应答但Byte(0)不是诊断仪目标地址,当前应答Byte(0) = 0x%02X",RxMsg.byte(0));
      else
        testStepFail("","收到应答但Byte(0)在诊断仪目标地址范围内,当前应答Byte(0) = 0x%02X",RxMsg.byte(0));
    }
    else if(Res_Flage == 0)
      testStepPass("","0x%02X 无响应",i);
  }
}

void _ID_Mix_Traversal()
{
  byte Data[8] = {0x02,0x10,0x01,0x55,0x55,0x55,0x55,0x55};
  message * Msg;
  dword ID;
  int Res_Flage;
  dword ID_Hbyte,ID_Lbyte,Loop;
  Msg.dlc = 8;
  Msg.FDF = 0;
  Msg.BRS = 0;
  if(Support_CAN == 2)
  {
    Msg.FDF = 1;
    Msg.BRS = 1;
  }
  for(i=0;i<8;i++)
    Msg.byte(i) = Data[i];
  testWaitForTimeout(500);
  
  ID_Hbyte = 0x18DA0000;
  ID_Lbyte = 0x000000F1;
  Loop = 0;
  for(Loop=0;Loop<=0xFF;Loop++)
  {
    ID = ID_Hbyte + (Loop<<8) + ID_Lbyte;
    Msg.id = mkExtId(ID);
    Res_Flage = 0;
    output(Msg);
    Res_Flage = testWaitForMessage(Response_ID,100);
    if(Res_Flage == 1 )
      testStepFail("","0x%08X ID收到响应",ID);
  }

  ID_Hbyte = 0x18DB0000;
  ID_Lbyte = 0x000000F1;
  Loop = 0;
  for(Loop=0;Loop<=0xFF;Loop++)
  {
    ID = ID_Hbyte + (Loop<<8) + ID_Lbyte;
    Msg.id = mkExtId(ID);
    Res_Flage = 0;
    output(Msg);
    Res_Flage = testWaitForMessage(Response_ID,100);
    if(Res_Flage == 1 )
      testStepFail("","0x%08X ID收到响应",ID);
  }
}

void _ID_Mix_ExTraversal()
{
  byte Data[8] = {0x02,0x10,0x01,0x55,0x55,0x55,0x55,0x55};
  message * Msg;
  dword ID;
  int Res_Flage;
  dword ID_Hbyte,ID_Lbyte,Loop;
  Msg.dlc = 8;
  Msg.FDF = 0;
  Msg.BRS = 0;
  if(Support_CAN == 2)
  {
    Msg.FDF = 1;
    Msg.BRS = 1;
  }
  Msg.byte(0) = 0x01;
  for(i=0;i<8;i++)
    Msg.byte(i+1) = Data[i];
  testWaitForTimeout(500);
  
  ID_Hbyte = 0x18CE0000;
  ID_Lbyte = 0x000000F1;
  Loop = 0;
  for(Loop=0;Loop<=0xFF;Loop++)
  {
    ID = ID_Hbyte + (Loop<<8) + ID_Lbyte;
    Msg.id = mkExtId(ID);
    Res_Flage = 0;
    output(Msg);
    Res_Flage = testWaitForMessage(Response_ID,100);
    if(Res_Flage == 1 )
      testStepFail("","0x%08X ID收到响应",ID);
  }

  ID_Hbyte = 0x18CD0000;
  ID_Lbyte = 0x000000F1;
  Loop = 0;
  for(Loop=0;Loop<=0xFF;Loop++)
  {
    ID = ID_Hbyte + (Loop<<8) + ID_Lbyte;
    Msg.id = mkExtId(ID);
    Res_Flage = 0;
    output(Msg);
    Res_Flage = testWaitForMessage(Response_ID,100);
    if(Res_Flage == 1 )
      testStepFail("","0x%08X ID收到响应",ID);
  }
}

void _APP_Valid_1002()
{
  byte Send_1002[2] = {0x10,0x02};
  byte Send_19[3] = {0x19,0x02,0x01};
  byte Send_2[2] = {0x11,0x02};
  int Serve_Pos,MsgFlage,DiagFlage;
  int Time;
  Serve_Pos = _Check_Serve(0x11,0,0);
  Send_2[1] = Serve_Data[Serve_Pos].Serve_Fun[0];
  _Set_Ready(0);
  testWaitForTimeout(500);
  for(Time=0;Time<1000;Time=Time+5)
  {
    MsgFlage = 0;
    DiagFlage = 0;
    _WriteEx_and_Report("","K30异常复位");
    _SetSession(exsession);
    _Other_1002();
    _Send_Diag_NoTime(2,phyreq_ID,Send_1002);
    if(Time == 0)
      Time = 1;
    testWaitForTimeout(Time);
    _WriteEx_and_Report("","等待 %d ms",Time);
    _Power_Down_();
    testWaitForTimeout(1000);
    _Power_Up_();
    testWaitForTimeout(2000);
    if(Time == 1)
      Time = Time -1;
    _Send_Diag(3,phyreq_ID,Send_19);
    if(diagGetLastResponseCode(SendData) == 0)
      testWaitForDiagResponse(SendData,1000);
    if(diagGetLastResponseCode(SendData) != -1 )
    {
      DiagFlage = -1;
      testStep("","19服务响应异常,当前时间为 %d ms",Time);
    }
    MsgFlage = _Check_EPS_TX(1,EPS_TxID_1);
    if(MsgFlage == -1 && DiagFlage == -1)
    {
      testStepFail("","当前APP异常,等待时间为 %d ms",Time);
      {
        /*新增判断，当出现APP异常时，需要判断返回APP后再看是否正常*/
        _SetSession(defsession);
        testWaitForTimeout(2000);
        _Send_Diag(3,phyreq_ID,Send_19);
        if(diagGetLastResponseCode(SendData) == 0)
          testWaitForDiagResponse(SendData,1000);
        if(diagGetLastResponseCode(SendData) != -1 )
          break;
      }
    }
    _WriteEx_and_Report("","11复位");
    _SetSession(exsession);
    _Other_1002();
    _Send_Diag(2,phyreq_ID,Send_1002);
    _TestResult(SendData,phyreq_ID,"",-1);
    testWaitForTimeout(2000);
    _Send_Diag_NoTime(2,phyreq_ID,Send_2);
    if(Time == 0)
      Time = 1;
    testWaitForTimeout(Time);
    _WriteEx_and_Report("","等待 %d ms",Time);
    _Power_Down_();
    testWaitForTimeout(1000);
    _Power_Up_();
    testWaitForTimeout(2000);
    if(Time == 1)
      Time = Time -1;
    _Send_Diag(3,phyreq_ID,Send_19);
    if(diagGetLastResponseCode(SendData) == 0)
      testWaitForDiagResponse(SendData,1000);
    if(diagGetLastResponseCode(SendData) != -1 )
    {
      DiagFlage = -1;
      testStep("","19服务响应异常,当前时间为 %d ms",Time);
    }
    MsgFlage = _Check_EPS_TX(1,EPS_TxID_1);
    if(MsgFlage == -1 && DiagFlage == -1)
    {
      testStepFail("","当前APP异常,等待时间为 %d ms",Time);
      {
        /*新增判断，当出现APP异常时，需要判断返回APP后再看是否正常*/
        _SetSession(defsession);
        testWaitForTimeout(2000);
        _Send_Diag(3,phyreq_ID,Send_19);
        if(diagGetLastResponseCode(SendData) == 0)
          testWaitForDiagResponse(SendData,1000);
        if(diagGetLastResponseCode(SendData) != -1 )
          break;
      }
    }
  }
}
void _APP_Valid_Serve_11()
{
  byte Send_19[3] = {0x19,0x02,0x01};
  byte Send_2[2] = {0x11,0x02};
  int Serve_Pos,MsgFlage,DiagFlage;
  int Time,Flage,Access;
  Flage = 1;Access = 0;
  MsgFlage = 0;
  DiagFlage = 0;
  Serve_Pos = _Check_Serve(0x11,0,0);
  Send_2[1] = Serve_Data[Serve_Pos].Serve_Fun[0];
  if(Serve_Data[Serve_Pos].Security_Access[0] == 1)
  {
    Flage = 0;
    Access = 1;
  }
  if(Flage == 1 && _Check_Serve_IDAndSess(0x11,phyreq_ID,defsession) != 1)
    Flage = 0;
  
  _Set_Ready(0);
  testWaitForTimeout(500);
  for(Time=0;Time<1000;Time=Time+5)
  {
    if(Access == 1)
      _unlockECU();
    else
      _SetSession(exsession);
    
    MsgFlage = 0;
    DiagFlage = 0;
    _Send_Diag_NoTime(2,phyreq_ID,Send_2);
    if(Time == 0)
      Time = 1;
    testWaitForTimeout(Time);
    _WriteEx_and_Report("","等待 %d ms",Time);
    _Power_Down_();
    testWaitForTimeout(1000);
    _Power_Up_();
    testWaitForTimeout(2000);
    if(Time == 1)
      Time = Time -1;
    _Send_Diag(3,phyreq_ID,Send_19);
    if(diagGetLastResponseCode(SendData) == 0)
      testWaitForDiagResponse(SendData,1000);
    if(diagGetLastResponseCode(SendData) != -1 )
    {
      DiagFlage = -1;
      testStep("","19服务响应异常,当前时间为 %d ms",Time);
    }
    MsgFlage = _Check_EPS_TX(1,EPS_TxID_1);
    if(MsgFlage == -1 && DiagFlage == -1)
    {
      testStepFail("","当前APP异常,等待时间为 %d ms",Time);
      {
        /*新增判断，当出现APP异常时，需要判断返回APP后再看是否正常*/
        _SetSession(defsession);
        testWaitForTimeout(2000);
        _Send_Diag(3,phyreq_ID,Send_19);
        if(diagGetLastResponseCode(SendData) == 0)
          testWaitForDiagResponse(SendData,1000);
        if(diagGetLastResponseCode(SendData) != -1 )
          break;
      }
    }
    
    if(Flage == 1)
    {
      _Send_Diag_NoTime(2,phyreq_ID,Send_2);
      if(Time == 0)
        Time = 1;
      testWaitForTimeout(Time);
      _WriteEx_and_Report("","等待 %d ms",Time);
      _Power_Down_();
      testWaitForTimeout(1000);
      _Power_Up_();
      testWaitForTimeout(2000);
      if(Time == 1)
        Time = Time -1;
      _Send_Diag(3,phyreq_ID,Send_19);
      if(diagGetLastResponseCode(SendData) == 0)
        testWaitForDiagResponse(SendData,1000);
      if(diagGetLastResponseCode(SendData) != -1 )
      {
        DiagFlage = -1;
        testStep("","19服务响应异常,当前时间为 %d ms",Time);
      }
      MsgFlage = _Check_EPS_TX(1,EPS_TxID_1);
      if(MsgFlage == -1 && DiagFlage == -1)
      {
        testStepFail("","当前APP异常,等待时间为 %d ms",Time);
        {
          /*新增判断，当出现APP异常时，需要判断返回APP后再看是否正常*/
          _SetSession(defsession);
          testWaitForTimeout(2000);
          _Send_Diag(3,phyreq_ID,Send_19);
          if(diagGetLastResponseCode(SendData) == 0)
            testWaitForDiagResponse(SendData,1000);
          if(diagGetLastResponseCode(SendData) != -1 )
            break;
        }
      }
    }
  }
}
void _APP_Valid_Serve_2E()
{
  byte Send_19[3] = {0x19,0x02,0x01};
  int Time,MsgFlage,DiagFlage;
  
  _get_Str_Traversal("DID_2E_Traversal");
  _get_2E_DID(Traversal_DID[0]);
  _Set_Ready(0);
  testWaitForTimeout(500);
  if(DID_2E_SendData_1_Len <3)
  {
    DID_2E_SendData_1_Len = 4;
    DID_2E_SendData_1[0] = 0x2E;
  }
  for(Time=0;Time<1000;Time=Time+5)
  {
    MsgFlage = 0;
    DiagFlage = 0;
    _unlockECU();
    _Send_Diag_NoTime(DID_2E_SendData_1_Len,phyreq_ID,DID_2E_SendData_1);
    if(Time == 0)
      Time = 1;
    testWaitForTimeout(Time);
    _WriteEx_and_Report("","等待 %d ms",Time);
    _Power_Down_();
    testWaitForTimeout(1000);
    _Power_Up_();
    testWaitForTimeout(2000);
    if(Time == 1)
      Time = Time -1;
    _Send_Diag(3,phyreq_ID,Send_19);
    if(diagGetLastResponseCode(SendData) == 0)
      testWaitForDiagResponse(SendData,1000);
    if(diagGetLastResponseCode(SendData) != -1 )
    {
      DiagFlage = -1;
      testStep("","19服务响应异常,当前时间为 %d ms",Time);
    }
    MsgFlage = _Check_EPS_TX(1,EPS_TxID_1);
    if(MsgFlage == -1 && DiagFlage == -1)
    {
      testStepFail("","当前APP异常,等待时间为 %d ms",Time);
      {
        /*新增判断，当出现APP异常时，需要判断返回APP后再看是否正常*/
        _SetSession(defsession);
        testWaitForTimeout(2000);
        _Send_Diag(3,phyreq_ID,Send_19);
        if(diagGetLastResponseCode(SendData) == 0)
          testWaitForDiagResponse(SendData,1000);
        if(diagGetLastResponseCode(SendData) != -1 )
          break;
      }
    }
  }
}
void _APP_Valid_Serve_31()
{
  byte Send_19[3] = {0x19,0x02,0x01};
  byte Send_Data[10];
  int Time,MsgFlage,DiagFlage,i;
  
  _Get_31_ServeData(0,Send_Data,0);
  
  _get_Arry("Angle_Calibration");
  if(Arry_Len>0)
  {
    Len_31H = Arry_Len;
    for(i=0;i<Arry_Len;i++)
      Send_Data[i] = Arry_Data[i];
  }
  _Set_Ready(0);
  testWaitForTimeout(500);
  for(Time=0;Time<1000;Time=Time+5)
  {
    MsgFlage = 0;
    DiagFlage = 0;
    _unlockECU();
    _Send_Diag_NoTime(Len_31H,phyreq_ID,Send_Data);
    if(Time == 0)
      Time = 1;
    testWaitForTimeout(Time);
    _WriteEx_and_Report("","等待 %d ms",Time);
    _Power_Down_();
    testWaitForTimeout(1000);
    _Power_Up_();
    testWaitForTimeout(2000);
    if(Time == 1)
      Time = Time -1;
    _Send_Diag(3,phyreq_ID,Send_19);
    if(diagGetLastResponseCode(SendData) == 0)
      testWaitForDiagResponse(SendData,1000);
    if(diagGetLastResponseCode(SendData) != -1 )
    {
      DiagFlage = -1;
      testStep("","19服务响应异常,当前时间为 %d ms",Time);
    }
    MsgFlage = _Check_EPS_TX(1,EPS_TxID_1);
    if(MsgFlage == -1 && DiagFlage == -1)
    {
      testStepFail("","当前APP异常,等待时间为 %d ms",Time);
      {
        /*新增判断，当出现APP异常时，需要判断返回APP后再看是否正常*/
        _SetSession(defsession);
        testWaitForTimeout(2000);
        _Send_Diag(3,phyreq_ID,Send_19);
        if(diagGetLastResponseCode(SendData) == 0)
          testWaitForDiagResponse(SendData,1000);
        if(diagGetLastResponseCode(SendData) != -1 )
          break;
      }
    }
  }
}
void _APP_Valid_Serve_27()
{
  byte Send_19[3] = {0x19,0x02,0x01};
  int Time,MsgFlage,DiagFlage;
  
  _Set_Ready(0);
  testWaitForTimeout(500);
  for(Time=0;Time<1000;Time=Time+5)
  {
    MsgFlage = 0;
    DiagFlage = 0;
    _SetSession(exsession);
    _Send_Key_NoResponse(SendKey_Len,phyreq_ID,_get_seed(phyreq_ID),1);
    Get_Seed_Flage = 1;
    if(Time == 0)
      Time = 1;
    testWaitForTimeout(Time);
    _WriteEx_and_Report("","等待 %d ms",Time);
    _Power_Down_();
    testWaitForTimeout(1000);
    _Power_Up_();
    testWaitForTimeout(2000);
    if(Time == 1)
      Time = Time -1;
    _Send_Diag(3,phyreq_ID,Send_19);
    if(diagGetLastResponseCode(SendData) == 0)
      testWaitForDiagResponse(SendData,1000);
    if(diagGetLastResponseCode(SendData) != -1 )
    {
      DiagFlage = -1;
      testStep("","19服务响应异常,当前时间为 %d ms",Time);
    }
    MsgFlage = _Check_EPS_TX(1,EPS_TxID_1);
    if(MsgFlage == -1 && DiagFlage == -1)
    {
      testStepFail("","当前APP异常,等待时间为 %d ms",Time);
      {
        /*新增判断，当出现APP异常时，需要判断返回APP后再看是否正常*/
        _SetSession(defsession);
        testWaitForTimeout(2000);
        _Send_Diag(3,phyreq_ID,Send_19);
        if(diagGetLastResponseCode(SendData) == 0)
          testWaitForDiagResponse(SendData,1000);
        if(diagGetLastResponseCode(SendData) != -1 )
          break;
      }
    }
    
    _SetSession(exsession);
    _Send_Key_NoResponse(SendKey_Len,phyreq_ID,_get_seed(phyreq_ID),0);
    if(Time == 0)
      Time = 1;
    testWaitForTimeout(Time);
    _WriteEx_and_Report("","等待 %d ms",Time);
    _Power_Down_();
    testWaitForTimeout(1000);
    _Power_Up_();
    testWaitForTimeout(2000);
    if(Time == 1)
      Time = Time -1;
    _Send_Diag(3,phyreq_ID,Send_19);
    if(diagGetLastResponseCode(SendData) == 0)
      testWaitForDiagResponse(SendData,1000);
    if(diagGetLastResponseCode(SendData) != -1 )
    {
      DiagFlage = -1;
      testStep("","19服务响应异常,当前时间为 %d ms",Time);
    }
    MsgFlage = _Check_EPS_TX(1,EPS_TxID_1);
    if(MsgFlage == -1 && DiagFlage == -1)
    {
      testStepFail("","当前APP异常,等待时间为 %d ms",Time);
      {
        /*新增判断，当出现APP异常时，需要判断返回APP后再看是否正常*/
        _SetSession(defsession);
        testWaitForTimeout(2000);
        _Send_Diag(3,phyreq_ID,Send_19);
        if(diagGetLastResponseCode(SendData) == 0)
          testWaitForDiagResponse(SendData,1000);
        if(diagGetLastResponseCode(SendData) != -1 )
          break;
      }
    }
  }
}

void _APP_Valid_Serve_Other()
{
  byte Send_19[3] = {0x19,0x02,0x01};
  byte Data_Send[4];
  byte Len[5] = {4,3,3,3,2};
  int i,Time,Flage;
  int Pos_28,Pos_85,MsgFlage,DiagFlage;
  
  Pos_28 = _Check_Serve(0x28,0,0);
  Pos_85 = _Check_Serve(0x85,0,0);
  _Set_Ready(0);
  testWaitForTimeout(500);
  for(Time=0;Time<1000;Time=Time+5)
  {
    if(Flage == 0)
    {
      for(i=0;i<5;i++)
      {
        if(i==0)
        {
          Data_Send[0] = 0x14; Data_Send[1] = 0xFF;
          Data_Send[2] = 0xFF; Data_Send[3] = 0xFF;
        }
        else if(i==1)
        {
          Data_Send[0] = 0x19; Data_Send[1] = 0x02;
          Data_Send[2] = 0x89; 
        }
        else if(i==2)
        {
          Data_Send[0] = 0x22; Data_Send[1] = 0x35;
          Data_Send[2] = 0x70; 
        }
        else if(i==3)
        {
          Data_Send[0] = 0x28; Data_Send[1] = Serve_Data[Pos_28].Serve_Fun[0];
          Data_Send[2] = Serve_Data[Pos_28].Serve_Para[0][0]; 
        }
        else if(i==4)
        {
          Data_Send[0] = 0x85; Data_Send[1] = Serve_Data[Pos_85].Serve_Fun[0];
        }
        MsgFlage = 0;
        DiagFlage = 0;
        if(i>2)
          _SetSession(exsession);
        _Send_Diag_NoTime(Len[i],phyreq_ID,Data_Send);
        if(Time == 0)
          Time = 1;
        testWaitForTimeout(Time);
        _WriteEx_and_Report("","等待 %d ms",Time);
        _Power_Down_();
        testWaitForTimeout(1000);
        _Power_Up_();
        testWaitForTimeout(2000);
        if(Time == 1)
          Time = Time -1;
        _Send_Diag(3,phyreq_ID,Send_19);
        if(diagGetLastResponseCode(SendData) == 0)
          testWaitForDiagResponse(SendData,1000);
        if(diagGetLastResponseCode(SendData) != -1 )
        {
          DiagFlage = -1;
          testStep("","19服务响应异常,当前时间为 %d ms",Time);
        }
        MsgFlage = _Check_EPS_TX(1,EPS_TxID_1);
        if(MsgFlage == -1 && DiagFlage == -1)
        {
          testStepFail("","当前APP异常,等待时间为 %d ms",Time);
          {
            /*新增判断，当出现APP异常时，需要判断返回APP后再看是否正常*/
            _SetSession(defsession);
            testWaitForTimeout(2000);
            _Send_Diag(3,phyreq_ID,Send_19);
            if(diagGetLastResponseCode(SendData) == 0)
              testWaitForDiagResponse(SendData,1000);
            if(diagGetLastResponseCode(SendData) != -1 )
              break;
          }
        }
      }
    }
  }
}

void _Geely1_0_NRC22_Test()
{
  byte Send_1101[2] = {0x11,0x01};
  byte Send_1103[2] = {0x11,0x03};
  byte Send_1002[2] = {0x10,0x02};
  byte Send_85[2] = {0x85,0x01};
  byte Send_28[3] = {0x28,0x00,0X01};
  byte Send_14[4] = {0x14,0xFF,0xFF,0xFF};
  _TestDisableMsg(Struct_Ready.Sig_Id);
  testWaitForTimeout(1000);
  _SetSession(exsession);
  _Send_Diag(2,phyreq_ID,Send_1101);
  _TestResult(SendData,phyreq_ID,"",-1);
  testWaitForTimeout(700);
  _SetSession(exsession);
  _Send_Diag(2,phyreq_ID,Send_1002);
  _TestResult(SendData,phyreq_ID,"",-1);
  testWaitForTimeout(2000);
  _SetSession(defsession);
  testWaitForTimeout(2000);
  _SetSession(exsession);
  _Send_Diag(2,phyreq_ID,Send_1103);
  _TestResult(SendData,phyreq_ID,"",-1);
  testWaitForTimeout(700);
  _SetSession(exsession);
  _Send_Diag(2,phyreq_ID,Send_1101);
  _TestResult(SendData,phyreq_ID,"",-1);
  testWaitForTimeout(700);
  _Send_Diag(4,phyreq_ID,Send_14);
  _TestResult(SendData,phyreq_ID,"",-1);
  _SetSession(exsession);
  _Send_Diag(2,phyreq_ID,Send_1101);
  _TestResult(SendData,phyreq_ID,"",-1);
  testWaitForTimeout(700);
  _SetSession(exsession);
  _Send_Diag(3,phyreq_ID,Send_28);
  _TestResult(SendData,phyreq_ID,"",-1);
  _SetSession(exsession);
  _Send_Diag(2,phyreq_ID,Send_1103);
  _TestResult(SendData,phyreq_ID,"",-1);
  testWaitForTimeout(700);
  _SetSession(exsession);
  _Send_Diag(2,phyreq_ID,Send_85);
  _TestResult(SendData,phyreq_ID,"",-1);
  _TestEnableMsg(Struct_Ready.Sig_Id);
}

void _Interrupt_10H()
{
  byte Data_Send[2] = {0x10,0x02};
  _SetSession(exsession);
  _Other_1002();
  _Send_Diag_3E80_After_NRC78(elcount(Data_Send),phyreq_ID,Data_Send);
  _TestResult(SendData,phyreq_ID,"",-1);
  testWaitForTimeout(2000);
  _SetSession(defsession);
  testWaitForTimeout(2000);
}

void _Interrupt_11H()
{
  int Serve_Pos,i;
  Byte Send_Data_11[2];
  Serve_Pos = _Check_Serve(0x11,0,0);
  Send_Data_11[0] = 0x11;
  for(i=0;i<Serve_Data[Serve_Pos].Serve_Fun_Count;i++)
  {
    Send_Data_11[1] = Serve_Data[Serve_Pos].Serve_Fun[i];
    _SetSession(exsession);
    if(Serve_Data[Serve_Pos].Security_Access[i] == 1)
      _unlockECU();
    _Send_Diag_3E80_After_NRC78(elcount(Send_Data_11),phyreq_ID,Send_Data_11);
    _TestResult(SendData,phyreq_ID,"",-1);
    testWaitForTimeout(2000);
  }
}

void _Interrupt_14H()
{
  int Serve_Pos,i;
  Byte Send_Data_14[4] = {0x14,0xFF,0xFF,0xFF};

  if((_Set_NRC22(0x14,0,2)&0x20) != 0)
  {
    float Ready_Now;
    Ready_Now = _Get_Ready();
    if(Ready_Now == Ready_NRC22)
    {
      if(Ready_NRC22 == 0)
        _Set_Ready(Struct_Ready.Ready_Active);
      else
        _Set_Ready(0);
    }
  }
  _Send_Diag_3E80_After_NRC78(elcount(Send_Data_14),phyreq_ID,Send_Data_14);
  _TestResult(SendData,phyreq_ID,"",-1);
}

void _Interrupt_27H()
{
  _SetSession(exsession);
  _Send_Key_NRC78(SendKey_Len,phyreq_ID,_get_seed_NRC78(phyreq_ID),0);
  testWaitForTimeout(2000);
  _SetSession(exsession);
  _Send_Key_NRC78(SendKey_Len,phyreq_ID,_get_seed_NRC78(phyreq_ID),0);
}

void _Interrupt_2EH()
{
  int i;
  _get_Str_Traversal("DID_2E_Traversal");
  for(i=0;i<Traversal_Count;i++)
  {

    _SetSession(defsession);
    testWaitForTimeout(200);
    _unlockECU();
    _get_2E_DID(Traversal_DID[i]);
    writeEx(-3,0,"0x%02X  0x%02X",DID_2E_SendData_1[1],DID_2E_SendData_1[2]);
    _Send_Diag_3E80_After_NRC78(DID_2E_SendData_1_Len,phyreq_ID,DID_2E_SendData_1);
    _TestResult(SendData,phyreq_ID,"",-1);
    testWaitForTimeout(200);
  }
}

void _Interrupt_31H()
{
  int i;
  byte Send_Data_31[10];
  _SetSession(exsession);
  _unlockECU();
  Send_Data_31[0] = 0x31;
  for(i=0;i<Serve_31_Hex_Count;i++)
  {
    Send_Data_31[2] = Serve_31_Hex[i].Routine[0];
    Send_Data_31[3] = Serve_31_Hex[i].Routine[1];
    Send_Data_31[1] = Serve_31_Hex[i].Control_Type[0];
    if(Serve_31_Hex[i].Routine_Len==5)
      Send_Data_31[4] = Serve_31_Hex[i].Control_Option[0][0];
    _Send_Diag_3E80_After_NRC78(Serve_31_Hex[i].Routine_Len,phyreq_ID,Send_Data_31);
    _TestResult(SendData,phyreq_ID,"",-1);
    testWaitForTimeout(500);
  }
}

void _10_Phy_Def_01(dword ID)
{
  byte Send_Data[2]={0x10,0x01};
  byte Serve_27[2] = {0x27,0x01};
  Serve_27[1] = RequestSeed_27;
  if( Serve_10_01_Time_Flage == 0 )
  {
    _Send_Diag(2,ID,Send_Data);
    testWaitForDiagResponse(SendData,p2cmax);
    _TestResult(SendData,ID,"",-1);
    _Send_Diag(2,phyreq_ID,Serve_27);
    _TestResult(SendData,phyreq_ID,"",NRC7F);
    _Send_And_Check_NowSession(ID,defsession);
  }
  else
  {
    _Send_Diag_NoTime(2,ID,Send_Data);
    _Check_10_01(6,Send_Data[1],P2can_server,P2_can_server);
    _Send_Diag(2,phyreq_ID,Serve_27);
    _TestResult(SendData,phyreq_ID,"",NRC7F);
    _Send_And_Check_NowSession(ID,defsession);
  }
}
void _10_Phy_Def_02(dword ID,dword Session)
{
  byte Temp_0[2]={0x10,0x2};
  byte Temp_14[4]={0x14,0xff,0xff,0xff};
  
  if(_Check_Serve(0x10,0x02,4)==-1) //子功能不支持
  {
    _Send_Diag(2,ID,Temp_0);
    _TestResult(SendData,ID,"",NRC12);
    _Send_Diag(4,phyreq_ID,Temp_14);
    _TestResult(SendData,ID,"",-1);
    _Send_And_Check_NowSession(ID,Session);
  }
  else
  {
    if(_Check_Fun_IDAndSess(0x10,0x02,ID,Session) == 1)
    {
      _Other_1002();
      _Send_Diag(2,ID,Temp_0);
      _Check_10_01(6,Temp_0[1],P2can_server,P2_can_server);
      testWaitForTimeout(2000);/*进入10 02 后需延时1S防止无响应问题*/
      _Send_Diag(4,phyreq_ID,Temp_14);
      _TestResult(SendData,phyreq_ID,"",NRC11);
      _Send_And_Check_NowSession(ID,2);
      _SetSession(defsession); // 退出10 02
    }
    else
    {
      _Send_Diag(2,ID,Temp_0);
      _TestResult(SendData,ID,"",NRC7E);
      _Send_Diag(4,phyreq_ID,Temp_14);
      _TestResult(SendData,phyreq_ID,"",-1);
      _Send_And_Check_NowSession(ID,Session);
    }
  }
}
void _10_Phy_Def_03(dword ID)
{ 
  byte Send_Data[2]={0x10,0x03};
  byte Serve_27[2] = {0x27,0x01};
  Serve_27[1] = RequestSeed_27;
  if( Serve_10_01_Time_Flage == 0 )
  {
    _Send_Diag(2,ID,Send_Data);
    testWaitForDiagResponse(SendData,p2cmax);
    _TestResult(SendData,ID,"",-1);
    _Send_Diag(2,phyreq_ID,Serve_27);
    _TestResult(SendData,phyreq_ID,"",-1);
    _Send_And_Check_NowSession(ID,exsession);
  }
  else
  {
    _Send_Diag_NoTime(2,ID,Send_Data);
    _Check_10_01(6,Send_Data[1],P2can_server,P2_can_server);
    _Send_Diag(2,phyreq_ID,Serve_27);
    _TestResult(SendData,phyreq_ID,"",-1);
    _Send_And_Check_NowSession(ID,exsession);
  }
}
void _10_Phy_Def_04(dword ID,byte Session)//肯定响应抑制位
{
  _Step_Serve_RSP(0x10,ID,Session);
}

void _10_Phy_Def_08(dword ID,byte Session)/*NRC13*/
{
  byte Temp_0[2]={0x10,0x01};
  dword Len;
  char Temp_Str[300];
  int Flage_Return,m;
  int i,j,Serve_Pos;
  Len = _Check_CANFD_Flage();
  _WriteEx_and_Report("遍历","10 01服务长度");
  
  snprintf(Fault_Data_Write,elCount(Fault_Data_Write),"%s","");
  testGetCurrentTestCaseTitle(Fault_Data_Write,400);
  snprintf(Fault_Data_Write,elCount(Fault_Data_Write),"\n %s: \n    遍历11服务NRC13时,异常响应: \n",Fault_Data_Write);
  File_Write(Error_File,Error_FileName,Fault_Data_Write,2);
  Serve_Pos = _Check_Serve(0x10,0,0);
  for(j=0;j<Serve_Data[Serve_Pos].Serve_Fun_Count;j++)
  {
    Temp_0[1] = Serve_Data[Serve_Pos].Serve_Fun[j];
    if(_Check_Fun_IDAndSess(0x10,Temp_0[1],ID,Session) != 1)
      continue;
    for(i=1;i<=Len;i++)
    {
      if(i==2)
      {
        _WriteEx_and_Report("","当前长度已测试，跳过");
        continue;
      }
      _Send_Diag(i,ID,Temp_0);
      Flage_Return = _TestResult(SendData,ID,"",NRC13);
      if(Flage_Return == -1)
      {
        snprintf(Fault_Data_Send,elCount(Fault_Data_Send),"[  %s","");
        for(m=0;m<i;m++)
          snprintf(Fault_Data_Send,elCount(Fault_Data_Send),"%s %02X",Fault_Data_Send,DiagGetPrimitiveByte(SendData,m));
        snprintf(Fault_Data_Send,elCount(Fault_Data_Send),"%s  ] \n",Fault_Data_Send);
        File_Write(Error_File,Error_FileName,Fault_Data_Send,2);
      }
      testWaitForTimeout(50);
    }
  }
}

void _10_Phy_Def_09(dword ID,byte Session)/*NRC12*/
{
  byte Temp_0[2]={0x10,0x01};
  dword i=0;
  int Flage_Return,m;
  _WriteEx_and_Report("遍历","10服务子功能");
  
  snprintf(Fault_Data_Write,elCount(Fault_Data_Write),"%s","");
  testGetCurrentTestCaseTitle(Fault_Data_Write,400);
  snprintf(Fault_Data_Write,elCount(Fault_Data_Write),"\n %s: \n    遍历11服务NRC12时,异常响应: \n",Fault_Data_Write);
  File_Write(Error_File,Error_FileName,Fault_Data_Write,2);
  
  for(i=0;i<=0xFF;i++)
  {
    if((_Check_Serve(0x10,i,4) != -1) || (((i>>4)==0x08) && (_Check_Serve(0x10,i&0x0F,4) != -1) && (_Check_Serve(0x10,i&0x0F,9) == 1)) )
    {
      _WriteEx_and_Report("","当前子功能已测试，跳过");
      continue;
    }
    if(i==0x60 && Factory_1060 == 1)
    {
      _WriteEx_and_Report("","工厂模式子功能，跳过");
      continue;  
    }
    Temp_0[1] = i;
    _Send_Diag(2,ID,Temp_0);
    Flage_Return = _TestResult(SendData,ID,"",NRC12);
    if(Flage_Return == -1)
    {
      snprintf(Fault_Data_Send,elCount(Fault_Data_Send),"[  0x%02X 0x%02X  ] \n",DiagGetPrimitiveByte(SendData,0),DiagGetPrimitiveByte(SendData,1));
      File_Write(Error_File,Error_FileName,Fault_Data_Send,2);
    }
    testWaitForTimeout(50);
  }
}

void _10_Phy_Def_10_CarSpd(dword ID,byte Session)   /*车速*/
{
  byte Temp_0[2]={0x10,0x01};
  byte Temp_1[2]={0x10,0x02};
  int Serve_Pos,NRC22_Flage;
  Serve_Pos = _Check_Serve(0x10,0x02,4);
  if(Serve_Pos == -1)
    _WriteEx_and_Report("","当前项目不支持10 02,跳过检测");
  else if(_Check_Fun_IDAndSess(0x10,0x02,ID,Session) == 1)
  {
    _Other_1002();
    NRC22_Flage = _Set_NRC22(0x10,0x02,2);
    if(NRC22_Flage == -1)
      _WriteEx_and_Report("","无NRC22条件");
    else if((NRC22_Flage &0x01) != 0)
    {
       _WriteEx_and_Report("步骤0","设置车速 > NRC22车速");
      _Set_CarSpd(NRC22_CarSpd+1);
      _WriteEx_and_Report("步骤1","发送 02 10 02 55 55 55 55 55");
      _Send_Diag(2,ID,Temp_1);
      _TestResult(SendData,ID,"",NRC22);
      _WriteEx_and_Report("步骤2","发送 04 14 FF FF FF 55 55 55");
      _Clear_DTC(phyreq_ID,-1,"");
      _Send_And_Check_NowSession(ID,Session); 
      _WriteEx_and_Report("步骤3","设置车速 = NRC22车速");
      _Set_CarSpd(NRC22_CarSpd);
      _WriteEx_and_Report("步骤4","发送 02 10 02 55 55 55 55 55");
      _Send_Diag(2,ID,Temp_1);
      _TestResult(SendData,ID,"",-1);
      testWaitForTimeout(2000);
      _WriteEx_and_Report("步骤5","发送 04 14 FF FF FF 55 55 55");
      _Clear_DTC(phyreq_ID,NRC11,"");
      _Send_And_Check_NowSession(ID,2); 
      _WriteEx_and_Report("步骤6","发送 02 10 01 55 55 55 55 55");
      _Send_Diag(2,ID,Temp_0);
      _Check_10_01(6,Temp_0[1],P2can_server,P2_can_server);
      testWaitForTimeout(2000);
      _Send_And_Check_NowSession(ID,defsession); 
      _Other_1002();
      _WriteEx_and_Report("步骤7","设置车速 > NRC22车速，再丢失车速");
      _Set_CarSpd(NRC22_CarSpd+1);
      _TestDisableMsg(Struct_CarSpd.Sig_Id);
      testWaitForTimeout(Struct_CarSpd.Lost_Time*1.1);
      _WriteEx_and_Report("步骤8","发送 02 10 02 55 55 55 55 55");
      _Send_Diag(2,ID,Temp_1);
      _TestResult(SendData,ID,"",-1);
      testWaitForTimeout(2000);
      _WriteEx_and_Report("步骤9","发送 04 14 FF FF FF 55 55 55");
      _Clear_DTC(phyreq_ID,NRC11,"");
      _Send_And_Check_NowSession(ID,2); 
      _WriteEx_and_Report("步骤10","发送 02 10 01 55 55 55 55 55");
      _Send_Diag(2,ID,Temp_0);
      _Check_10_01(6,Temp_0[1],P2can_server,P2_can_server);
      testWaitForTimeout(2000);
      _Send_And_Check_NowSession(ID,defsession); 
      _Set_CarSpd(0);
      _TestEnableMsg(Struct_CarSpd.Sig_Id);
      testWaitForTimeout(1000);
      _Other_1002();
      _WriteEx_and_Report("步骤11","设置车速 > NRC22车速，再无效车速");
      _Set_CarSpd(NRC22_CarSpd+1);
      _Set_CarSpd_Invalid(Struct_CarSpd.Invalid_Value[0]);
      _WriteEx_and_Report("步骤12","发送 02 10 02 55 55 55 55 55");
      _Send_Diag(2,ID,Temp_1);
      _TestResult(SendData,ID,"",-1);
      testWaitForTimeout(2000);
      _Send_And_Check_NowSession(ID,2); 
      _WriteEx_and_Report("步骤13","发送 04 14 FF FF FF 55 55 55");
      _Clear_DTC(phyreq_ID,NRC11,"");
      _WriteEx_and_Report("步骤14","发送 02 10 01 55 55 55 55 55");
      _Send_Diag(2,ID,Temp_0);
      _Check_10_01(6,Temp_0[1],P2can_server,P2_can_server);
      testWaitForTimeout(2000);
      _Send_And_Check_NowSession(ID,defsession); 
    }
    else
      _WriteEx_and_Report("","无NRC22车速条件");
    _Reset_CarSpd_Invalid();
    _Set_CarSpd(0);
  }
  else
    _WriteEx_and_Report("","当前寻址及会话下不支持0x10 0x02");
}

void _10_Phy_Def_10_Battery(dword ID,byte Session)   /*电压*/
{
  byte Temp_0[2]={0x10,0x01};
  byte Temp_1[2]={0x10,0x02};
  byte Temp_2[4]={0x14,0xff,0xff,0xff};
  int Serve_Pos,NRC22_Flage;
  
  Serve_Pos = _Check_Serve(0x10,0x02,4);
  if(Serve_Pos == -1)
    _WriteEx_and_Report("","当前项目不支持10 02,跳过检测");
  else if(_Check_Fun_IDAndSess(0x10,0x02,ID,Session) == 1)
  {
    NRC22_Flage = _Set_NRC22(0x10,0x02,2);
    if(NRC22_Flage == -1)
      _WriteEx_and_Report("","无NRC22条件");
    else if((NRC22_Flage &0x02) != 0)
    {
      _Other_1002();
      _Set_Battery(12);
      _WriteEx_and_Report("步骤0","设置电压 > NRC22高压");
      _Set_Battery(NRC22_Battery_Hight+0.2);
      _WriteEx_and_Report("步骤1","发送 02 10 02 55 55 55 55 55");
      _Send_Diag(2,ID,Temp_1);
      _TestResult(SendData,ID,"",NRC22);
      _WriteEx_and_Report("步骤2","发送 04 14 FF FF FF 55 55 55");
      _Send_Diag(4,phyreq_ID,Temp_2);
      _TestResult(SendData,phyreq_ID,"",-1);
      _Send_And_Check_NowSession(ID,Session); 
      _Set_Battery(NRC22_Battery_Hight-0.2);
      _WriteEx_and_Report("步骤4","发送 02 10 02 55 55 55 55 55");
      _Send_Diag(2,ID,Temp_1);
      _TestResult(SendData,ID,"",-1);
      testWaitForTimeout(2000);
      _WriteEx_and_Report("步骤5","发送 04 14 FF FF FF 55 55 55");
      _Send_And_Check_NowSession(ID,2); 
      _Send_Diag(4,phyreq_ID,Temp_2);
      _TestResult(SendData,phyreq_ID,"",NRC11);
      _WriteEx_and_Report("步骤6","发送 02 10 01 55 55 55 55 55");
      _Send_Diag(2,ID,Temp_0);
      _TestResult(SendData,ID,"",-1); 
      testWaitForTimeout(2000);
      _Send_And_Check_NowSession(ID,defsession); 
      if(Session != defsession)
        _SetSession(Session);
      
      _Send_And_Check_NowSession(ID,Session); 
      _WriteEx_and_Report("","设置电压恢复正常");
      _Set_Battery(12);
      _WriteEx_and_Report("步骤7","设置电压 < NRC22低压");
      _Set_Battery(NRC22_Battery_Low-0.2);
      _WriteEx_and_Report("步骤8","发送 02 10 02 55 55 55 55 55");
      _Send_Diag(2,ID,Temp_1);
      _TestResult(SendData,ID,"",NRC22);
      _Send_And_Check_NowSession(ID,Session); 
      _WriteEx_and_Report("步骤9","发送 04 14 FF FF FF 55 55 55");
      _Send_Diag(4,phyreq_ID,Temp_2);
      _TestResult(SendData,phyreq_ID,"",-1);
      _WriteEx_and_Report("步骤10","设置电压 = NRC22低压");
      _Set_Battery(NRC22_Battery_Low+0.2);
      _WriteEx_and_Report("步骤11","发送 02 10 02 55 55 55 55 55");
      _Send_Diag(2,ID,Temp_1);
      _Check_10_01(6,Temp_1[1],P2can_server,P2_can_server);
      testWaitForTimeout(2000);
      _WriteEx_and_Report("步骤12","发送 04 14 FF FF FF 55 55 55");
      _Send_Diag(4,phyreq_ID,Temp_2);
      _TestResult(SendData,phyreq_ID,"",NRC11);
      _Send_And_Check_NowSession(ID,2); 
      _WriteEx_and_Report("步骤13","发送 02 10 01 55 55 55 55 55");
      _Send_Diag(2,ID,Temp_0);
      _Check_10_01(6,Temp_0[1],P2can_server,P2_can_server);
      testWaitForTimeout(2000);
      _Send_And_Check_NowSession(ID,defsession); 
      _WriteEx_and_Report("","设置电压恢复正常");
      _Set_Battery(12);
    }
    else
      _WriteEx_and_Report("","无NRC22电压条件");
  }
  else
    _WriteEx_and_Report("","当前寻址及会话下不支持0x10 0x02");
}
void _10_Phy_Def_10_Ready(dword ID,byte Session)   /*发动机*/
{
  byte Temp_0[2]={0x10,0x01};
  byte Temp_1[2]={0x10,0x02};
  int Serve_Pos,NRC22_Flage;
  
  Serve_Pos = _Check_Serve(0x10,0x02,4);
  if(Serve_Pos == -1)
    _WriteEx_and_Report("","当前项目不支持10 02,跳过检测");
  else if(_Check_Fun_IDAndSess(0x10,0x02,ID,Session) == 1)
  {
    _Other_1002();
    NRC22_Flage = _Set_NRC22(0x10,0x02,2);
    if(NRC22_Flage == -1)
      _WriteEx_and_Report("","无NRC22条件");
    else if((NRC22_Flage &0x20) != 0)
    {
      _Set_Ready(Ready_NRC22);
      testWaitForTimeout(500);
      _Send_Diag(2,ID,Temp_1);
      _TestResult(SendData,ID,"",NRC22);
      testWaitForTimeout(500);
      _Send_And_Check_NowSession(ID,Session); 
      _TestDisableMsg(Struct_Ready.Sig_Id);
      testWaitForTimeout(1000);
      _Send_Diag(2,ID,Temp_1);
      _TestResult(SendData,ID,"",-1);
      _TestEnableMsg(Struct_Ready.Sig_Id);
      testWaitForTimeout(2000);
      _Send_And_Check_NowSession(ID,2); 
      _SetSession(defsession);
      testWaitForTimeout(2000);
      _SetSession(Session);
      _Set_Sig(Struct_Ready.ReadyInvalid_Sig,Struct_Ready.Invalid_Value[0]);
      testWaitForTimeout(Struct_Ready.Invalid_Time*1.2);
      _Other_1002();
      _Send_Diag(2,ID,Temp_1);
      _TestResult(SendData,ID,"",-1);
      testWaitForTimeout(1000);
      _Send_And_Check_NowSession(ID,2); 
      _Set_Sig(Struct_Ready.ReadyInvalid_Sig,Struct_Ready.Normal_Value[0]);
      testWaitForTimeout(Struct_Ready.Invalid_Time*1.2);
      if(Ready_NRC22 != 0)
        _Set_Ready(0);
      else
        _Set_Ready(Struct_Ready.Ready_Active);
      _SetSession(defsession);
      _SetSession(Session);
      _Other_1002();
      _Send_Diag(2,ID,Temp_1);
      _TestResult(SendData,ID,"",-1);
      testWaitForTimeout(1000);
      _Send_And_Check_NowSession(ID,2); 
      _SetSession(defsession);
    }
    else
      _WriteEx_and_Report("","无NRC22发动机条件");
  }
  else
    _WriteEx_and_Report("","当前寻址及会话下不支持0x10 0x02");
}
void _10_Phy_Def_10_Torque(dword ID,byte Session) /* NRC22-转矩 */
{
  byte Temp_0[2]={0x10,0x02};
  byte Temp_2[4]={0x14,0xff,0xff,0xff};
  char str[100];
  int Serve_Pos,NRC22_Flage,i;
  
  Serve_Pos = _Check_Serve(0x10,0x02,4);
  if(Serve_Pos == -1)
    _WriteEx_and_Report("","当前项目不支持10 02,跳过检测");
  else if(_Check_Fun_IDAndSess(0x10,0x02,ID,Session) == 1)
  {
    NRC22_Flage = _Set_NRC22(0x10,0x02,2);
    if(NRC22_Flage == -1)
      _WriteEx_and_Report("","无NRC22条件");
    else if((NRC22_Flage &0x04) != 0)
    {
      for(i=0;i<2;i++)  //左右侧
      {
        _SetSession(Session);
        _Other_1002();
        snprintf(str,elCount(str),"%s","");
        if(i==0)
          snprintf(str,elCount(str),"控制力矩满足NRC22条件,大于 %.2f Nm,并保持",NRC22_TasTorque+0.2);
        else
          snprintf(str,elCount(str),"控制力矩满足NRC22条件,大于 %.2f Nm,并保持",(NRC22_TasTorque+0.2)*(-1));
        testWaitForTesterConfirmation(str,30000);
        _Send_Diag(2,ID,Temp_0);
        _TestResult(SendData,ID,"",NRC22);
        _Send_And_Check_NowSession(ID,Session); 
        _Send_Diag(4,phyreq_ID,Temp_2);
        _TestResult(SendData,phyreq_ID,"",-1);
        snprintf(str,elCount(str),"%s","");
        if(i==0)
          snprintf(str,elCount(str),"控制力矩小于NRC22条件,小于 %.2f Nm,并保持",NRC22_TasTorque-0.2);
        else
          snprintf(str,elCount(str),"控制力矩小于NRC22条件,小于 %.2f Nm,并保持",(NRC22_TasTorque-0.2)*(-1));
        testWaitForTesterConfirmation(str,30000);
        _Send_Diag(2,ID,Temp_0);
        _TestResult(SendData,ID,"",-1);
        testWaitForTimeout(2000);
        _Send_And_Check_NowSession(ID,2); 
        _SetSession(defsession); //退出10 02
        testWaitForTimeout(2000);
      }
      snprintf(str,elCount(str),"%s","");
      snprintf(str,elCount(str),"松开方向盘");
      testWaitForTesterConfirmation(str,30000);
    }
    else
      _WriteEx_and_Report("","无NRC22扭矩条件");
  }
  else
    _WriteEx_and_Report("","当前寻址及会话下不支持0x10 0x02");
}

void _10_Phy_Def_10_Geely3_0(dword ID,byte Session) /* NRC22-Geely3.0 */
{
  byte Temp_0[2]={0x10,0x02};
  byte Data_Programmed[10];
  int  Data_Programmed_Count;
  int i,j;
  char Serve_85_CarSpdQFTemp[10];
  byte Serve_85_CarSpdQF[10];
  int Serve_85_CarSpdQF_Count;
  Serve_85_CarSpdQF_Count = getProfileArray(ECU_project,"Serve_85_CarSpdQF",Serve_85_CarSpdQFTemp,elCount(Serve_85_CarSpdQFTemp),file_name_1);
  for(i=0;i<Serve_85_CarSpdQF_Count;i++)
    Serve_85_CarSpdQF[i] = Serve_85_CarSpdQFTemp[i];
  if(Geely3_Flage == 1 )
  {
    
    _Get_NRC_Mapping(0x10);
    _get_Arry("Pre_Programmed");
    for(i=0;i<Arry_Len;i++)
      Data_Programmed[i] = Arry_Data[i];
    Data_Programmed_Count = Arry_Len;
    for(j=0;j<2;j++)
    {
      if(j==1)
      {
        _WriteEx_and_Report("","车速大于NRC22车速，遍历VehSpdLgtQf值");
        _Set_CarSpd(NRC22_CarSpd+1);
      }
      else
      {
        _WriteEx_and_Report("","车速小于NRC22车速，遍历VehSpdLgtQf值");
        _Set_CarSpd(0);
      }
      _Set_Ready(0xB);
      for(i=0;i<4;i++)
      {
        _SetSession(defsession);
        if(Session != defsession)
          _SetSession(Session);
        _Set_CarSpd_Invalid(i);
        testWaitForTimeout(1000);
        _Send_Diag(Data_Programmed_Count,ID,Data_Programmed);
        if(((_Check_Dword_in_Num(i,Serve_85_CarSpdQF,Serve_85_CarSpdQF_Count)== -1) && j==0) || j==1)
          _Check_31Routine_Rx(Data_Programmed,0);
        else
          _Check_31Routine_Rx(Data_Programmed,1);
        _Send_Diag(2,ID,Temp_0);
        if(j==1)
        {
          _TestResult(SendData,ID,"",CarSpd_NRC);
          _Send_And_Check_NowSession(ID,defsession); 
        }
        else if(j==0 && (_Check_Dword_in_Num(i,Serve_85_CarSpdQF,Serve_85_CarSpdQF_Count)== -1))
        {
          _TestResult(SendData,ID,"",CarSpd_Invalid_NRC);
          _Send_And_Check_NowSession(ID,defsession); 
        }
        else
        {
          _TestResult(SendData,ID,"",-1);
          testWaitForTimeout(2000);
          _Send_And_Check_NowSession(ID,2); 
        }
      }
      if(j==0)
        _WriteEx_and_Report("","步骤1-4测试结束");
      else if(j==1)
        _WriteEx_and_Report("","步骤5-8测试结束");
    }
    {
      _WriteEx_and_Report("","发动机为0xB,车速QF为0,车速大于NRC22车速后丢失");
      _SetSession(defsession);
      if(Session != defsession)
        _SetSession(Session);
      _Set_CarSpd(NRC22_CarSpd+1);
      _Set_Ready(0xB);
      _Set_CarSpd_Invalid(0);
      testWaitForTimeout(1000);
      _TestDisableMsg(Struct_CarSpd.Sig_Id);
      testWaitForTimeout(Struct_CarSpd.Lost_Time+500);
      _Send_Diag(Data_Programmed_Count,ID,Data_Programmed);
      _Check_31Routine_Rx(Data_Programmed,1);
      _Send_Diag(2,ID,Temp_0);
      _TestResult(SendData,ID,"",-1);
      testWaitForTimeout(2000);
      _Send_And_Check_NowSession(ID,2); 
      _TestEnableMsg(Struct_CarSpd.Sig_Id);
      testWaitForTimeout(1000);
      _WriteEx_and_Report("","步骤9测试结束");
    }
    {
      _WriteEx_and_Report("","车速小于NRC22车速,车速QF为3,遍历发动机值");
      _Set_CarSpd(NRC22_CarSpd-1);
      _Set_CarSpd_Invalid(3);
      for(i=0;i<Struct_Ready.Ready_ValueRange_Count;i++)
      {
        _SetSession(defsession);
        if(Session != defsession)
          _SetSession(Session);
        _Set_Ready(Struct_Ready.Ready_ValueRange[i]);
        testWaitForTimeout(1000);
        _Send_Diag(Data_Programmed_Count,ID,Data_Programmed);
        if(Struct_Ready.Ready_ValueRange[i] != Ready_NRC22)
        {
          _Check_31Routine_Rx(Data_Programmed,1);
          _Send_Diag(2,ID,Temp_0);
          _TestResult(SendData,ID,"",-1);
          testWaitForTimeout(2000);
          _Send_And_Check_NowSession(ID,2); 
        }
        else
        {
          _Check_31Routine_Rx(Data_Programmed,0);
          _Send_Diag(2,ID,Temp_0);
          _TestResult(SendData,ID,"",Ready_NRC);
          testWaitForTimeout(2000);
        }
      }
      _WriteEx_and_Report("","步骤10-14测试结束");
    }
    {
      _WriteEx_and_Report("","车速小于NRC22车速,车速QF为3,发动机为0xD,丢失发动机");
      _SetSession(defsession);
      if(Session != defsession)
        _SetSession(Session);
      _Set_Ready(0xD);
      _TestDisableMsg(Struct_Ready.Sig_Id);
      testWaitForTimeout(Struct_Ready.Lost_Time*1.5);
      _Send_Diag(Data_Programmed_Count,ID,Data_Programmed);
       _Check_31Routine_Rx(Data_Programmed,1);
      _Send_Diag(2,ID,Temp_0);
      _TestResult(SendData,ID,"",-1);
      testWaitForTimeout(2000);
      _Send_And_Check_NowSession(ID,2); 
      _TestEnableMsg(Struct_Ready.Sig_Id);
      testWaitForTimeout(1000);
      _WriteEx_and_Report("","步骤15测试结束");
    }
    {
      _WriteEx_and_Report("","车速小于NRC22车速,车速QF为3,发动机为0xB,电压测试");
      _Set_Ready(0xB);
      testWaitForTimeout(1000);
      for(i=0;i<4;i++)
      {
        _SetSession(defsession);
        if(Session != defsession)
          _SetSession(Session);
        if(i==0)
          _Set_Battery(NRC22_Battery_Low+0.2);
        else if(i==1)
          _Set_Battery(NRC22_Battery_Hight-0.2);
        else if(i==2)
          _Set_Battery(NRC22_Battery_Low-0.2);
        else
          _Set_Battery(NRC22_Battery_Hight+0.2);
        _Send_Diag(Data_Programmed_Count,ID,Data_Programmed);
        if(i<2)
          _Check_31Routine_Rx(Data_Programmed,1);
        else
          _Check_31Routine_Rx(Data_Programmed,0);
        _Send_Diag(2,ID,Temp_0);
        if(i == 2)
        {
          _TestResult(SendData,ID,"",L_Battery_NRC);
          _Send_And_Check_NowSession(ID,defsession); 
        }
        else if(i == 3)
        {
          _TestResult(SendData,ID,"",H_Battery_NRC);
          _Send_And_Check_NowSession(ID,defsession); 
        }
        else 
        {
          _TestResult(SendData,ID,"",-1);
          testWaitForTimeout(2000);
          _Send_And_Check_NowSession(ID,2); 
        }
      }
      _Set_Battery(12);
      _WriteEx_and_Report("","步骤16-19测试结束");
    }
    {
      _WriteEx_and_Report("","车速小于NRC22车速,车速QF为3,发动机为0xD/0xB,车速丢失");
      _SetSession(defsession);
      if(Session != defsession)
        _SetSession(Session);
      _Set_Ready(0xD);
      _Set_CarSpd_Invalid(3);
      _TestDisableMsg(Struct_CarSpd.Sig_Id);
      testWaitForTimeout(Struct_CarSpd.Lost_Time*1.5);
      _Send_Diag(Data_Programmed_Count,ID,Data_Programmed);
      _Check_31Routine_Rx(Data_Programmed,0);
      _Send_Diag(2,ID,Temp_0);
      _TestResult(SendData,ID,"",Ready_NRC);
      testWaitForTimeout(2000);
      _Send_And_Check_NowSession(ID,defsession); 
      _TestEnableMsg(Struct_CarSpd.Sig_Id);
      testWaitForTimeout(2000);
        
      _Set_Ready(0xB);
      _TestDisableMsg(Struct_CarSpd.Sig_Id);
      testWaitForTimeout(2000);
      _Send_Diag(Data_Programmed_Count,ID,Data_Programmed);
      _Check_31Routine_Rx(Data_Programmed,1);
      _Send_Diag(2,ID,Temp_0);
      _TestResult(SendData,ID,"",-1);
      testWaitForTimeout(2000);
      _Send_And_Check_NowSession(ID,2); 
      _TestEnableMsg(Struct_CarSpd.Sig_Id);
      testWaitForTimeout(2000);
      _WriteEx_and_Report("","步骤20-21测试结束");
    }
    {
      int Temp_Data[5] = {1,0,2,2,3};
      _WriteEx_and_Report("","车速小于NRC22车速,发动机为0xD,丢失发动机信号,车速QF遍历");
      for(i=0;i<5;i++)
      {
        _SetSession(defsession);
        if(Session != defsession)
          _SetSession(Session);
        _Set_Ready(0xD);
        if(i==2)
          _Set_CarSpd(NRC22_CarSpd+1);
        else
          _Set_CarSpd(NRC22_CarSpd-1);
        _Set_CarSpd_Invalid(Temp_Data[i]);
        _TestDisableMsg(Struct_Ready.Sig_Id);
        testWaitForTimeout(2000);
        _Send_Diag(Data_Programmed_Count,ID,Data_Programmed);
        if((_Check_Dword_in_Num(Temp_Data[i],Serve_85_CarSpdQF,Serve_85_CarSpdQF_Count)!= -1) && i!=2)
          _Check_31Routine_Rx(Data_Programmed,1);
        else
          _Check_31Routine_Rx(Data_Programmed,0);
        _Send_Diag(2,ID,Temp_0);
        if(_Check_Dword_in_Num(Temp_Data[i],Serve_85_CarSpdQF,Serve_85_CarSpdQF_Count)== -1)
        {
          _TestResult(SendData,ID,"",CarSpd_Invalid_NRC);
          _Send_And_Check_NowSession(ID,defsession); 
        }
        else if(i == 2)
        {
          _TestResult(SendData,ID,"",CarSpd_NRC);
          _Send_And_Check_NowSession(ID,defsession); 
        }
        else
        {
          _TestResult(SendData,ID,"",-1);
          testWaitForTimeout(2000);
          _Send_And_Check_NowSession(ID,2); 
        }
        _TestEnableMsg(Struct_Ready.Sig_Id);
        testWaitForTimeout(1000);
      }
      _WriteEx_and_Report("","步骤22-26测试结束");
    }
    {
      _WriteEx_and_Report("","发动机为0xD,丢失发动机和车速信号,电压测试");
      _Set_Ready(0xD);
      for(i=0;i<4;i++)
      {
        _SetSession(defsession);
        if(Session != defsession)
          _SetSession(Session);
        
        if(i==0)
          _Set_Battery(NRC22_Battery_Low+0.2);
        else if(i==1)
          _Set_Battery(NRC22_Battery_Hight-0.2);
        else if(i==2)
          _Set_Battery(NRC22_Battery_Low-0.2);
        else
          _Set_Battery(NRC22_Battery_Hight+0.2);
        _TestDisableMsg(Struct_CarSpd.Sig_Id);
        testWaitForTimeout(Struct_CarSpd.Lost_Time*1.5);
        _TestDisableMsg(Struct_Ready.Sig_Id);
        testWaitForTimeout(Struct_Ready.Lost_Time*1.5);
        
        _Send_Diag(Data_Programmed_Count,ID,Data_Programmed);
        if(i<2)
          _Check_31Routine_Rx(Data_Programmed,1);
        else
          _Check_31Routine_Rx(Data_Programmed,0);
        _Send_Diag(2,ID,Temp_0);
        if(i == 2)
        {
          _TestResult(SendData,ID,"",L_Battery_NRC);
          _Send_And_Check_NowSession(ID,defsession); 
        }
        else if(i == 3)
        {
          _TestResult(SendData,ID,"",H_Battery_NRC);
          _Send_And_Check_NowSession(ID,defsession); 
        }
        else 
        {
          _TestResult(SendData,ID,"",-1);
          testWaitForTimeout(2000);
          _Send_And_Check_NowSession(ID,2); 
        }
        _TestEnableMsg(Struct_CarSpd.Sig_Id);
        _TestEnableMsg(Struct_Ready.Sig_Id);
        _Set_Battery(12);
        testWaitForTimeout(1000);
      }
      _WriteEx_and_Report("","步骤27-30测试结束");
    }
    _Set_CarSpd(0);
    _Reset_CarSpd_Invalid();
    _Set_Ready(0);
  }
  else
    _WriteEx_and_Report("","非Geely3.0平台,不适用");
}

void _10_Phy_Def_11(dword ID) /* S3server */
{
  byte Temp_0[2]={0x10,0x03};
  byte Temp_1[3]={0x28,0x00,0x03};
  int Start_time=4900;/*设定起始的会话维持时间*/
  int Count_time=10;/*会话维持时间每次累计加10ms*/
  
  _WriteEx_and_Report("步骤1","发送 02 10 03 55 55 55 55 55");
  _Send_Diag(2,ID,Temp_0);
  if(diagGetLastResponseCode(SendData)==-1)
  {
    testStepPass("步骤1","收到肯定响应");
    _WriteEx_and_Report("步骤2","测试10 03的会话维持时间");
    _Send_And_Check_NowSession(ID,exsession); 
    for(Start_time;Start_time<5200;Start_time+=Count_time)
    {
      testWaitForTimeout(Start_time);
      _Send_Diag(3,phyreq_ID,Temp_1);
      if(diagGetLastResponseCode(SendData)== 0x7f)
        break;
    }
    _Send_And_Check_NowSession(ID,defsession); 
    if(4950<=Start_time && Start_time<=5050)
      testStepPass("","03会话维持时间在5s ± 50ms内，当前约为%d ms",Start_time);
    else
      testStepFail("","03会话维持时间不在5s ± 50ms内，当前约为%d ms",Start_time);;
  }
  else
    testStepFail("","10 03未收到响应或收到否定应答");
}

void _10_Phy_Ex_13(dword ID)
{
  byte Temp_1[2]={0x10,0x02};
  byte Temp_2[4]={0x14,0xff,0xff,0xff};
  byte Fun_Pos;
  Fun_Pos = _Check_Serve(0x10,0x02,4);
  if(_Check_Fun_IDAndSess(0x10,0x02,ID,exsession) == 1)
  {
    if(Other_1002 == 1)
    {
      _SetSession(exsession); 
      _Other_1002();
      _Send_Diag(2,ID,Temp_1);  
      _TestResult(SendData,ID,"",-1);
      _Send_And_Check_NowSession(ID,exsession); 
    }
    else 
    {
      _Send_Diag(2,ID,Temp_1);  
      _TestResult(SendData,ID,"",-1);
      testWaitForTimeout(2000);/*进入10 02 后需延时1S防止无响应问题*/
      _Send_And_Check_NowSession(ID,2); 
    }
    _SetSession(defsession);
    testWaitForTimeout(1000);
    _SetSession(exsession);
    if(Other_1002==1)
      _Other_1002();
    Temp_1[1]=0x82;
    _Send_Diag_NoTime(2,ID,Temp_1);  
    testWaitForDiagResponse(SendData,p2cmax);
    if(diagGetLastResponseCode(SendData)==0x78)
    {
      testWaitForDiagResponse(SendData,1000);
      _TestResult(SendData,ID,"",-1);
    }
    if(diagGetLastResponseCode(SendData)==0)
    {
      _TestResult(SendData,ID,"",0);
    }
    testWaitForTimeout(2000);/*进入10 02 后需延时1S防止无响应问题*/
    _Send_And_Check_NowSession(ID,2); 
    _Send_Diag(4,ID,Temp_2);
    _TestResult(SendData,ID,"",NRC11);
    testWaitForTimeout(1000);
    _SetSession(defsession);
  }
  else
    _WriteEx_and_Report("","当前不支持10 02,跳过测试");
}
void _10_Phy_Ex_19(dword ID,byte Session)/*NRC33*/
{
  byte Temp_2[2]={0x10,0x02};
  int Serve_Pos;
  Serve_Pos = _Check_Serve(0x10,02,0);
  if(_Check_Serve(0x10,02,4) == -1)
  {
    _WriteEx_and_Report("","当前不支持10 02");
    _Send_Diag(2,ID,Temp_2);
    _TestResult(SendData,ID,"",NRC12);
  }
  else
  {
    if(_Check_Fun_IDAndSess(0x10,0x02,ID,Session) == 1)
    {
      if(_Check_Serve(0x10,0x02,5) == 1)
      {
        _Send_Diag(2,ID,Temp_2);
        _TestResult(SendData,ID,"",NRC33);
        _Switch_To_Def();
        _Switch_To_Ex();
        _WriteEx_and_Report("","发送预编程报文");
        _get_Arry("Pre_Programmed");
        _Send_Diag(Arry_Len,phyreq_ID,Arry_Data);
        if(Pre_Programmed_UnlockECU == 1)
          _TestResult(SendData,phyreq_ID,"",NRC33);
        else
          _TestResult(SendData,phyreq_ID,"",-1);
        _Send_Diag(2,ID,Temp_2);
        _TestResult(SendData,ID,"",NRC33);
      }
      else
        _WriteEx_and_Report("跳过测试","0x10 0x02无需安全访问");
    }
  }
}
void _10_Phy_Ex_20(dword ID)/*NRC22预编程*/
{
  byte Temp_0[2]={0x10,0x03};
  byte Temp_1[2]={0x10,0x01};
  byte Temp_2[2]={0x10,0x02};
  byte Temp_3[4]={0x14,0xff,0xff,0xff};
  byte Temp_4[2]={0x10,0x82};
  int Serve_Pos,Fun_Pos;
  Serve_Pos = _Check_Serve(0x10,0,0);
  Fun_Pos = _Check_Serve(0x10,0x02,4);
  if(Fun_Pos == -1)
    _WriteEx_and_Report("","不支持10 02");
  else
  {
    if(Pre_Programmed_1002 == 1 )
    {
      _WriteEx_and_Report("步骤1","发送 02 10 03 55 55 55 55 55");
      _Send_Diag(2,ID,Temp_0);  
      _Check_10_01(6,Temp_0[1],P2can_server,P2_can_server);
      _Send_And_Check_NowSession(ID,exsession); 
      _Pre_Programmed();
      _WriteEx_and_Report("步骤3","发送 02 10 01 55 55 55 55 55");
      _Send_Diag(2,ID,Temp_1);  
      _Check_10_01(6,Temp_1[1],P2can_server,P2_can_server);
      _Send_And_Check_NowSession(ID,defsession); 
      _WriteEx_and_Report("步骤4","发送 02 10 03 55 55 55 55 55");
      _Send_Diag(2,ID,Temp_0); 
      _Check_10_01(6,Temp_0[1],P2can_server,P2_can_server); 
      _unlockECU();
      _WriteEx_and_Report("步骤7","发送 02 10 02 55 55 55 55 55");
      _Send_Diag(2,ID,Temp_2);  
      _TestResult(SendData,ID,"",NRC22);
      _Send_And_Check_NowSession(ID,exsession); 
      _WriteEx_and_Report("步骤8","发送 04 14 FF FF FF 55 55 55");
      _Send_Diag(4,ID,Temp_3);  
      _TestResult(SendData,ID,"",-1);
      if(Serve_Data[Serve_Pos].RSP[Fun_Pos] == 1)
      {
        _WriteEx_and_Report("步骤9","发送 02 10 82 55 55 55 55 55");
        _Send_Diag(2,ID,Temp_2);  
        _TestResult(SendData,ID,"",NRC22);
        _Send_And_Check_NowSession(ID,exsession); 
        _WriteEx_and_Report("步骤10","发送 04 14 FF FF FF 55 55 55");
        _Send_Diag(4,ID,Temp_3);  
        _TestResult(SendData,ID,"",-1);
      }
      else
        _WriteEx_and_Report("","10 02不支持肯定响应抑制位");
      
      _WriteEx_and_Report("","发送预编程报文");
      _get_Arry("Pre_Programmed");
      _Send_Diag(Arry_Len,phyreq_ID,Arry_Data);
      _TestResult(SendData,phyreq_ID,"",-1);
      
      _WriteEx_and_Report("步骤12","发送 02 10 03 55 55 55 55 55");
      _Send_Diag(2,ID,Temp_0);  
      _Check_10_01(6,Temp_0[1],P2can_server,P2_can_server);
      _Send_And_Check_NowSession(ID,exsession); 
      _unlockECU();
      _WriteEx_and_Report("步骤15","发送 02 10 02 55 55 55 55 55");
      _Send_Diag(2,ID,Temp_2);
      _TestResult(SendData,ID,"",-1);
      testWaitForTimeout(2000);
      _Send_And_Check_NowSession(ID,2); 
      _WriteEx_and_Report("步骤16","发送 04 14 FF FF FF 55 55 55");
      _Send_Diag(4,ID,Temp_3);  
      _TestResult(SendData,ID,"",NRC11);
      _Send_Diag(2,ID,Temp_1);  
      _TestResult(SendData,ID,"",-1);
      _Send_And_Check_NowSession(ID,defsession); 
    }
    if(Pre_Programmed_1002 == 0)
      _WriteEx_and_Report("跳过测试","该项目服务无预编程条件");
  }
}
void _10_Phy_Ex_21(dword ID)/*NRC22车速*/
{
  byte Temp_0[2]={0x10,0x01};
  byte Temp_1[2]={0x10,0x02};
  byte Temp_3[2]={0x10,0x03};
  byte Temp_4[2]={0x10,0x82};
  int Serve_Pos,Fun_Pos,NRC22_Flage;
  Serve_Pos = _Check_Serve(0x10,0x02,0);
  Fun_Pos = _Check_Serve(0x10,0x02,4);
  if(Serve_Pos == -1)
    _WriteEx_and_Report("","当前项目不支持10 02,跳过检测");
  else if(_Check_Fun_IDAndSess(0x10,0x02,ID,exsession) == 1)
  {
    NRC22_Flage = _Set_NRC22(0x10,0x02,2);
    if(NRC22_Flage == -1)
      _WriteEx_and_Report("","无NRC22条件");
    else if(NRC22_Flage &0x01 != 0)
    {
      _Other_1002();
      _WriteEx_and_Report("","设置车速 > NRC22车速");
      _Set_CarSpd(NRC22_CarSpd+1);
      _WriteEx_and_Report("步骤6","发送 02 10 02 55 55 55 55 55");
      _Send_Diag(2,ID,Temp_1);
      _TestResult(SendData,ID,"",NRC22);
      _WriteEx_and_Report("步骤7","发送 04 14 FF FF FF 55 55 55");
      _Clear_DTC(phyreq_ID,-1,"");
      _Send_And_Check_NowSession(ID,exsession); 
      if(Serve_Data[Serve_Pos].RSP[Fun_Pos] == 1)
      {
        _WriteEx_and_Report("步骤8","发送 02 10 82 55 55 55 55 55");
        _Send_Diag(2,phyreq_ID,Temp_4);
        _TestResult(SendData,phyreq_ID,"",NRC22);
        _Send_And_Check_NowSession(ID,exsession); 
        _WriteEx_and_Report("步骤9","发送 04 14 FF FF FF 55 55 55");
        _Clear_DTC(phyreq_ID,-1,"");
      }
      else
        _WriteEx_and_Report("","10 02不支持肯定响应抑制位");
      
      _WriteEx_and_Report("步骤10","设置车速 = NRC22车速");
      _Set_CarSpd(NRC22_CarSpd);
      _WriteEx_and_Report("步骤11","发送 02 10 02 55 55 55 55 55");
      _Send_Diag(2,ID,Temp_1);
      _TestResult(SendData,ID,"",-1);
      testWaitForTimeout(2000);
      _Send_And_Check_NowSession(ID,2); 
      _WriteEx_and_Report("步骤12","发送 02 10 01 55 55 55 55 55");
      _Send_Diag(2,ID,Temp_0);
      _Check_10_01(6,Temp_0[1],P2can_server,P2_can_server);
      _Send_And_Check_NowSession(ID,defsession); 
      testWaitForTimeout(2000);
      _WriteEx_and_Report("步骤13","发送 02 10 03 55 55 55 55 55");
      _Send_Diag(2,ID,Temp_3);
      _Check_10_01(6,Temp_3[1],P2can_server,P2_can_server);
      _Send_And_Check_NowSession(ID,exsession); 
      
      _Set_CarSpd(0);
      _Other_1002();
      _WriteEx_and_Report("步骤17","设置车速 > NRC22车速，再丢失车速");
      _Set_CarSpd(NRC22_CarSpd+1);
      _TestDisableMsg(Struct_CarSpd.Sig_Id);
      testWaitForTimeout(Struct_CarSpd.Lost_Time*1.1);
      _WriteEx_and_Report("步骤18","发送 02 10 02 55 55 55 55 55");
      _Send_Diag(2,ID,Temp_1);
      _Check_10_01(6,Temp_1[1],P2can_server,P2_can_server);
       // _getnrc78(SendData,ID,"",-1);
      testWaitForTimeout(2000);
      _Send_And_Check_NowSession(ID,2); 
        _WriteEx_and_Report("步骤19","发送 02 10 01 55 55 55 55 55");
        _Send_Diag(2,ID,Temp_0);
        _Check_10_01(6,Temp_0[1],P2can_server,P2_can_server);
      _Send_And_Check_NowSession(ID,defsession); 
      testWaitForTimeout(2000);
        _WriteEx_and_Report("步骤20","发送 02 10 03 55 55 55 55 55");
        _Send_Diag(2,ID,Temp_3);
        _Check_10_01(6,Temp_3[1],P2can_server,P2_can_server);
      _Send_And_Check_NowSession(ID,exsession); 
      _TestEnableMsg(Struct_CarSpd.Sig_Id);
      _Set_CarSpd(0);
      testWaitForTimeout(1000);
      _Other_1002();
      _WriteEx_and_Report("步骤24","设置车速 > NRC22车速，再无效车速");
      _Set_CarSpd(NRC22_CarSpd+1);
      _Set_CarSpd_Invalid(Struct_CarSpd.Invalid_Value[0]);
      _WriteEx_and_Report("步骤25","发送 02 10 02 55 55 55 55 55");
      _Send_Diag(2,ID,Temp_1);
      _Check_10_01(6,Temp_1[1],P2can_server,P2_can_server);
      testWaitForTimeout(2000);
      _Send_And_Check_NowSession(ID,2); 
//        _getnrc78(SendData,ID,"",-1);
      _WriteEx_and_Report("步骤26","发送 02 10 01 55 55 55 55 55");
      testWaitForTimeout(500);
      _Send_Diag(2,ID,Temp_0);
      _Check_10_01(6,Temp_0[1],P2can_server,P2_can_server);
      _Send_And_Check_NowSession(ID,defsession); 
      _Reset_CarSpd_Invalid();
      _Set_CarSpd(0);
      testWaitForTimeout(2000);
    }
    else
      _WriteEx_and_Report("","无NRC22车速条件");
  }
}

void _10_Phy_Ex_24(dword ID,byte Session)/*S3server*/
{
  byte Temp_0[2]={0x10,0x02};
  byte Temp_1[4]={0x14,0xff,0xff,0xff};
  int Start_time;/*设定起始的会话维持时间*/
  int Count_time=10;/*会话维持时间每次累计加10ms*/
  int SessRes;
  Start_time = 4900;
  if(_Check_Fun_IDAndSess(0x10,0x02,ID,Session) == 1)
  {
    _Send_And_Check_NowSession(ID,Session);
    _Other_1002();
    _Send_Diag(2,ID,Temp_0);
    if(diagGetLastResponseCode(SendData)==-1)
    {
      testStepPass("步骤1","收到肯定响应");
      _WriteEx_and_Report("步骤2","测试10 02的会话维持时间");
      testWaitForTimeout(2000);
      _Send_And_Check_NowSession(ID,2); 
      _Send_Diag(4,phyreq_ID,Temp_1);/*加入一条诊断发送防止前面无读取当前会话导致等待时间超过5S*/
      if(Support_ReadSession == 1 && Read_Now_Session_BT == 1)
      {
        for(Start_time;Start_time<5200;Start_time+=Count_time)
        {
          testWaitForTimeout(Start_time);
          if(Start_time<=4990)
            SessRes = _Send_And_Check_NowSession(ID,2); 
          else
            SessRes = _Send_And_Check_NowSession(ID,0xFF); 
          if(SessRes != 2)
            break;
        }
      }
      else
      {
        for(Start_time;Start_time<5200;Start_time+=Count_time)
        {
          testWaitForTimeout(Start_time);
          _Send_Diag(4,phyreq_ID,Temp_1);
          if(diagGetLastResponseCode(SendData)== -1)
            break;
        }
      }
      _Send_And_Check_NowSession(ID,defsession); 
      _WriteEx_and_Report("","会话维持时间当前约为 %d ms",Start_time);
      if(4900<=Start_time && Start_time<=5100)
        testStepPass("","会话维持时间在5s ± 100ms内，当前约为%d ms",Start_time);
      else
        testStepFail("","会话维持时间不在5s ± 100ms内，当前约为%d ms",Start_time);
      _SetSession(defsession);
      testWaitForTimeout(2000);
    }
    else
      testStepFail("","10 02未收到响应或收到否定应答");
  }
  else
    _WriteEx_and_Report("","当前会话不支持10 02");
}
void _10_Fun_Ex_42(dword ID)
{
  byte Temp_0[2]={0x10,0x1};
  byte Temp_1[2]={0x10,0x2};
  byte Temp_2[2]={0x10,0x3}; 
  int Serve_Pos,Fun_Pos,NRC22_Flage;
  Serve_Pos = _Check_Serve(0x10,0x02,0);
  Fun_Pos = _Check_Serve(0x10,0x02,4);
  if(Fun_Pos != -1)
  {
    if(_Check_Fun_IDAndSess(0x10,0x02,ID,exsession) == 1)
    {
      _Send_Diag(2,ID,Temp_2);
      _Check_10_01(6,Temp_2[1],P2can_server,P2_can_server);
      _Send_Diag(2,ID,Temp_1);
      if(Serve_Data[Serve_Pos].Security_Access[Fun_Pos] == 1)
        _TestResult(SendData,ID,"",NRC33);
      else if(Other_1002 == 1)
        _TestResult(SendData,ID,"",NRC22);
      else
      {
        _TestResult(SendData,ID,"",-1);
        testWaitForTimeout(2000);
        _SetSession(defsession);
        testWaitForTimeout(1000);
      }
      if(Unlock_1002 == 1)
      {
        _Send_Diag(2,ID,Temp_0);
        _Check_10_01(6,Temp_0[1],P2can_server,P2_can_server);
        _Send_Diag(2,ID,Temp_2);
        _Check_10_01(6,Temp_2[1],P2can_server,P2_can_server);
        if(Other_1002 == 1)
        {
          if(Pre_Programmed_UnlockECU == 1 && Pre_Programmed_1002)
          {
            _WriteEx_and_Report("","预编程需要安全访问,无法测试");
          }
          else
          {
            _Pre_Programmed();
            _Send_Diag(2,ID,Temp_1);
            _TestResult(SendData,ID,"",NRC33);
          }
        }
        else
        {
          _Send_Diag(2,ID,Temp_1);
          _TestResult(SendData,ID,"",-1);
        }
      }
    }
    else
      _WriteEx_and_Report("","当前寻址及会话下不支持该子功能");
  }
}
void _10_Fun_Ex_43(dword ID)/*预编程*/
{
  byte Temp_0[2]={0x10,0x1};
  byte Temp_1[2]={0x10,0x2};
  byte Temp_2[2]={0x10,0x3};
  byte Temp_3[2]={0x10,0x82};
  byte Temp_4[4]={0x14,0xff,0xff,0xff};
  
  if(_Check_Fun_IDAndSess(0x10,0x02,ID,exsession) == 1 && Pre_Programmed_1002 == 1)
  {
    _WriteEx_and_Report("步骤1","发送 02 10 03 55 55 55 55 55");
    _Send_Diag(2,ID,Temp_2);
    _Check_10_01(6,Temp_2[1],P2can_server,P2_can_server);
    _Send_And_Check_NowSession(ID,exsession); 
    _Pre_Programmed();
    _WriteEx_and_Report("步骤3","发送 02 10 01 55 55 55 55 55");
    _Send_Diag(2,ID,Temp_0);
    _Check_10_01(6,Temp_0[1],P2can_server,P2_can_server);
    _Send_And_Check_NowSession(ID,defsession); 
    _WriteEx_and_Report("步骤4","发送 02 10 03 55 55 55 55 55");
    _Send_Diag(2,ID,Temp_2);
    _Check_10_01(6,Temp_2[1],P2can_server,P2_can_server);
    _Send_And_Check_NowSession(ID,exsession); 
    _unlockECU();
    _WriteEx_and_Report("步骤7","发送 02 10 02 55 55 55 55 55");
    _Send_Diag(2,ID,Temp_1);
    _TestResult(SendData,ID,"",NRC22);
    _Send_And_Check_NowSession(ID,exsession); 
    _WriteEx_and_Report("步骤8","发送 04 14 FF FF FF 55 55 55");
    _Send_Diag(4,ID,Temp_4);
    _TestResult(SendData,ID,"",-1);
    _WriteEx_and_Report("步骤9","发送 02 10 02 55 55 55 55 55");
    _Send_Diag(2,ID,Temp_3);
    _TestResult(SendData,ID,"",NRC22);
    _Send_And_Check_NowSession(ID,exsession); 
    _WriteEx_and_Report("步骤10","发送 04 14 FF FF FF 55 55 55");
    _Send_Diag(4,ID,Temp_4);
    _TestResult(SendData,ID,"",-1);
    _Pre_Programmed();
    _WriteEx_and_Report("步骤12","发送 02 10 03 55 55 55 55 55");
    _Send_Diag(2,ID,Temp_2);
    _Check_10_01(6,Temp_2[1],P2can_server,P2_can_server);
    _unlockECU();
    _WriteEx_and_Report("步骤15","发送 02 10 02 55 55 55 55 55");
    _Send_Diag(2,ID,Temp_1);
    _TestResult(SendData,ID,"",-1);
    _Send_And_Check_NowSession(ID,2); 
    _WriteEx_and_Report("步骤16","发送 04 14 FF FF FF 55 55 55");
    _Send_Diag(4,ID,Temp_4);
    _TestResult(SendData,ID,"",NRC11);
  }
  else
    _WriteEx_and_Report("","当前寻址及会话下不支持10 02或无预编程条件");
}

void _Serve10_01(dword ID,byte Session)   /*NRC优先级*/
{
  int Serve_Pos,Fun_Pos,i,j;
  byte Send_Data[100];
  byte Temp_14[4]={0x14,0xff,0xff,0xff};
  int Re,Temp_Flage_0x7E;
  
  Serve_Pos = _Check_Serve(0x10,0,0);
  Send_Data[0] = 0x10;
  for(j=0;j<Serve_Data[Serve_Pos].Serve_Fun_Count;j++)
  {
    writeEx(-3,0,"/*-----------开始测试 0x10 0x%02X NRC优先级-----------*/",Serve_Data[Serve_Pos].Serve_Fun[j]);
    Temp_Flage_0x7E = 0;
    Fun_Pos = _Check_Serve(0x10,Serve_Data[Serve_Pos].Serve_Fun[j],4);
    Re = _Check_Fun_IDAndSess(0x10,Serve_Data[Serve_Pos].Serve_Fun[j],ID,Session);
    if(Re == 1)
    {
      if(Serve_Data[Serve_Pos].Serve_Fun[j] == 0x02 && Session == defsession)
        _Set_NRC_Step(0x10,Serve_Data[Serve_Pos].Serve_Fun[j],0,Send_Data);
      else
        _Set_NRC_Step(0x10,Serve_Data[Serve_Pos].Serve_Fun[j],6,Send_Data);
      if(Fun_NRC_Count == 0)
      {
        _WriteEx_and_Report("","未输入NRC，跳过测试");
        return;
      }
      for(i=0;i<=Fun_NRC_Count;i++)
      {
        if(i>0) //第一次反馈最高优先级不做处理,其余依次恢复
        {
          _Recover_NRC_Step(Fun_NRC[i-1],Serve_Pos,Fun_Pos,Send_Data);
          if(Pre_Programmed_1002==1 && Fun_NRC[i-1]==0x22 && Serve_Data[Serve_Pos].Serve_Fun[j] == 0x02)
          {
            _get_Arry("Pre_Programmed");
            if(Arry_Len == 0)
              _WriteEx_and_Report("","未查询到对应预编程报文");
            else
            {
              _Send_Diag(Arry_Len,phyreq_ID,Arry_Data);
              _TestResult(SendData,phyreq_ID,"",-1);
            }
          }
        }
        if(Fun_NRC[i] == 0x7E)
          continue;
        if(i == Fun_NRC_Count)
        {
          writeEx(-3,0,"期望收到 正响应");
          _Send_Diag(Fun_NRC_Send_Len,ID,Send_Data);
          _TestResult(SendData,ID,"",-1);
          if(Serve_Data[Serve_Pos].Serve_Fun[j] == 0x02)
          {
            testWaitForTimeout(2000);
            _Send_Diag(4,phyreq_ID,Temp_14);
            _TestResult(SendData,phyreq_ID,"",NRC11);
            _SetSession(defsession);
            testWaitForTimeout(1000);
          }
        }
        else
        {
          writeEx(-3,0,"期望收到 NRC%02X",Fun_NRC[i]);
          _Send_Diag(Fun_NRC_Send_Len,ID,Send_Data);
          _TestResult(SendData,ID,"",Fun_NRC[i]);
        }
        testWaitForTimeout(100);
      }
      _SetSession(Session);
      testWaitForTimeout(500);
    }
    else
    {
      if(Serve_Data[Serve_Pos].Serve_Fun[j] == 0x02)
        _Set_NRC_Step(0x10,Serve_Data[Serve_Pos].Serve_Fun[j],0,Send_Data);
      else
        _Set_NRC_Step(0x10,Serve_Data[Serve_Pos].Serve_Fun[j],6,Send_Data);
      if(Fun_NRC_Count == 0)
      {
        _WriteEx_and_Report("","未输入NRC，跳过测试");
        return;
      }
      for(i=0;i<Fun_NRC_Count;i++)
      {
        if(i>0) //第一次反馈最高优先级不做处理,其余依次恢复
        {
          _Recover_NRC_Step(Fun_NRC[i-1],Serve_Pos,Fun_Pos,Send_Data);
          if(Fun_NRC[i-1]==0x7E)
          {
            Send_Data[1] = Session;
            Temp_Flage_0x7E = 1;
          }
          if(Pre_Programmed_1002==1 && Fun_NRC[i-1]==0x22 && Send_Data[1] == 0x02)
          {
            _get_Arry("Pre_Programmed");
            if(Arry_Len == 0)
              _WriteEx_and_Report("","未查询到对应预编程报文");
            else
            {
              _Send_Diag(Arry_Len,phyreq_ID,Arry_Data);
              _TestResult(SendData,phyreq_ID,"",-1);
            }
          }
        }
        {
          writeEx(-3,0,"期望收到 NRC%02X",Fun_NRC[i]);
          _Send_Diag(Fun_NRC_Send_Len,ID,Send_Data);
          _TestResult(SendData,ID,"",Fun_NRC[i]);
        }
        testWaitForTimeout(100);
      }
      if(Temp_Flage_0x7E == 1)
      {
        Fun_NRC_Send_Len = 2;
        Send_Data[1] = Serve_Data[Serve_Pos].Serve_Fun[j];
        _Send_Diag(Fun_NRC_Send_Len,ID,Send_Data);
        _TestResult(SendData,ID,"",0x7E);
      }
    }
  }
  // if(_Check_Serve_IDAndSess(0x10,ID,Session) == 1)
  // {
  //   Send_Data[0] = 0x10;
  //   Fun_Pos = _Check_Serve(0x10,0x02,4);
  //   Re = _Check_Fun_IDAndSess(0x10,0x02,ID,Session);
  //   if(Re == 1)
  //   {
  //     _Set_NRC_Step(0x10,Serve_Data[Serve_Pos].Serve_Fun[1],6,Send_Data);
  //     if(Fun_NRC_Count == 0)
  //     {
  //       _WriteEx_and_Report("","未输入NRC，跳过测试");
  //       return;
  //     }
  //     for(i=0;i<=Fun_NRC_Count;i++)
  //     {
  //       if(i>0) //第一次反馈最高优先级不做处理,其余依次恢复
  //       {
  //         _Recover_NRC_Step(Fun_NRC[i-1],Serve_Pos,Fun_Pos,Send_Data);
  //         if(Pre_Programmed_1002==1 && Fun_NRC[i-1]==0x22)
  //         {
  //           _get_Arry("Pre_Programmed");
  //           if(Arry_Len == 0)
  //             _WriteEx_and_Report("","未查询到对应预编程报文");
  //           else
  //           {
  //             _Send_Diag(Arry_Len,phyreq_ID,Arry_Data);
  //             _TestResult(SendData,phyreq_ID,"",-1);
  //           }
  //         }
  //       }
  //       if(i == Fun_NRC_Count)
  //       {
  //         _Send_Diag(Fun_NRC_Send_Len,ID,Send_Data);
  //         _TestResult(SendData,ID,"",-1);
  //         testWaitForTimeout(2000);
  //         _Send_Diag(4,phyreq_ID,Temp_14);
  //         _TestResult(SendData,phyreq_ID,"",NRC11);
  //         _SetSession(defsession);
  //         testWaitForTimeout(1000);
  //       }
  //       else
  //       {
  //         _Send_Diag(Fun_NRC_Send_Len,ID,Send_Data);
  //         _TestResult(SendData,ID,"",Fun_NRC[i]);
  //       }
  //       testWaitForTimeout(100);
  //     }
  //     _SetSession(exsession);
  //   }
  //   else if(Re == 0)
  //   {
  //     _Set_NRC_Step(0x10,Serve_Data[Serve_Pos].Serve_Fun[1],0,Send_Data);
  //     if(Fun_NRC_Count == 0)
  //     {
  //       _WriteEx_and_Report("","未输入NRC，跳过测试");
  //       return;
  //     }
  //     for(i=0;i<Fun_NRC_Count;i++)
  //     {
  //       if(i>0) //第一次反馈最高优先级不做处理,其余依次恢复
  //       {
  //         _Recover_NRC_Step(Fun_NRC[i-1],Serve_Pos,Fun_Pos,Send_Data);
  //         if(Fun_NRC[i-1]==0x7E)
  //         {
  //           Send_Data[1] = 0x03;
  //           Temp_Flage_0x7E = 1;
  //         }
  //         if(Pre_Programmed_1002==1 && Fun_NRC[i-1]==0x22)
  //         {
  //           _get_Arry("Pre_Programmed");
  //           if(Arry_Len == 0)
  //             _WriteEx_and_Report("","未查询到对应预编程报文");
  //           else
  //           {
  //             _Send_Diag(Arry_Len,phyreq_ID,Arry_Data);
  //             _TestResult(SendData,phyreq_ID,"",-1);
  //           }
  //         }
  //       }
  //       {
  //         _Send_Diag(Fun_NRC_Send_Len,ID,Send_Data);
  //         _TestResult(SendData,ID,"",Fun_NRC[i]);
  //       }
  //       testWaitForTimeout(100);
  //     }
  //       Fun_NRC_Send_Len = 2;
  //       Send_Data[1] = 0x01;
  //       _Send_Diag(Fun_NRC_Send_Len,ID,Send_Data);
  //       _TestResult(SendData,ID,"",-1);
  //     if(Temp_Flage_0x7E == 1)
  //     {
  //       Send_Data[1] = 0x02;
  //       _Send_Diag(Fun_NRC_Send_Len,ID,Send_Data);
  //       _TestResult(SendData,ID,"",0x7E);
  //     }
  //       Send_Data[1] = 0x03;
  //       _Send_Diag(Fun_NRC_Send_Len,ID,Send_Data);
  //       _TestResult(SendData,ID,"",-1);
  //   }
  //   else
  //     _WriteEx_and_Report("","当前不支持10 02");
  // }
}
void _Serve10_02(dword ID,byte Session,byte Serv_,byte Type)/*遍历NRC22条件*/
{
  int Serve_Pos,i;
  int Fun_Count;
  char Temp_Str[200];
  char Temp_Str_[200];
  int Clear_Config_Flage,SWhere;
  int Flage_In,Start_Fun;
  Get_value_For_NRC22_Loop();
  if(Serv_ != 0x31)
    Serve_Pos = _Check_Serve(Serv_,0,0);
  snprintf(Temp_Str,elCount(Temp_Str),"");
  snprintf(Temp_Str_,elCount(Temp_Str_),"");
  snprintf(Temp_Str,elCount(Temp_Str),"     开始测试%02X服务",Serv_);
  Start_Fun = 0;
  if(Serv_ != 0x31)
  {
    if(Serve_Pos != -1)
    {
      Fun_Count = Serve_Data[Serve_Pos].Serve_Fun_Count;
      
      Clear_Config_Flage = 0;
      if(Serv_ == 0x2E)
      {
        _get_Str_Traversal("DID_2E_Traversal");
        Fun_Count = Traversal_Count;
        if(strncmp(ECU_project,"BYD",strlen(ECU_project)) == 0 && strlen(ECU_project) == strlen("BYD"))
        {
          for(i=0;i<Traversal_Count;i++)
          {
            if((strncmp(Traversal_DID[i],"DID2E_F1A1",strlen(Traversal_DID[i])) == 0 && strlen(Traversal_DID[i]) == strlen("DID2E_F1A1")) || (strncmp(Traversal_DID[i],"DID2E_2100",strlen(Traversal_DID[i])) == 0 && strlen(Traversal_DID[i]) == strlen("DID2E_2100")))
            {
              SWhere = i;
              Clear_Config_Flage = 1;
              break;
            }
          }
          if(Clear_Config_Flage == 1)
          {
            byte Data_Send[11] = {0x2E,0xF1,0xA1,0,0,0,0,0,0,0,0x55};
            _unlockECU();
            _Send_Diag(11,phyreq_ID,Data_Send);
            _TestResult(SendData,ID,"",-1);
            _SetSession(Session);
          }
        }  
      }
      
      Flage_In = _Check_Dword_in_Num(Serv_,NRC22_Loop_Fun,NRC22_Loop_Fun_Count);/*判断是否检测全部子功能*/
      if(Flage_In == -1)
      {
        int Fun_Pos;
        Fun_Count = 1;
        Fun_Pos = _Check_Dword_in_Num(Serv_,NRC22_Loop_Fun_Pos,NRC22_Loop_Fun_Pos_Count);
        if(Fun_Pos!= -1)
        {
          Start_Fun = NRC22_Loop_Fun_Pos[Fun_Pos][1]-1;
          Fun_Count = Start_Fun+1;
        }
      }
      if(Serv_ == 0x22)  //22服务特殊处理,仅验证一个
        Fun_Count = 1;
      for(i=Start_Fun;i<Fun_Count;i++)
      {
        snprintf(Temp_Str,elCount(Temp_Str),"     开始测试%02X服务%02X子功能,NRC22条件",Serv_,Serve_Data[Serve_Pos].Serve_Fun[i]);
        if(Serv_ == 0x14)
          snprintf(Temp_Str,elCount(Temp_Str),"     开始测试%02X服务,NRC22条件",Serv_);
        if(_Check_Fun_IDAndSess(Serv_,Serve_Data[Serve_Pos].Serve_Fun[i],ID,Session) == 1)
        {
          _WriteEx_and_Report("","------------------------------------------------------");
          _WriteEx_and_Report("",Temp_Str);
          _WriteEx_and_Report("","------------------------------------------------------");
          _NRC22_Test_Loop(Serv_,i,ID,Session,Type);
        }
        else
        {
          snprintf(Temp_Str_,elCount(Temp_Str_),"0x%02X 0x%02X",Serv_,Serve_Data[Serve_Pos].Serve_Fun[i]);
          _WriteEx_and_Report(Temp_Str_,"当前寻址或会话下不支持该子功能");
        }
      }
      if(Clear_Config_Flage == 1)
      {
        _unlockECU();
        _get_2E_DID(Traversal_DID[SWhere]);
        _Send_Diag(DID_2E_SendData_1_Len,phyreq_ID,DID_2E_SendData_1);
        _TestResult(SendData,ID,"",-1);
      }
    }
  }
  else if(Serv_ == 0x31)
  {
    Fun_Count = Serve_31_Hex_Count;
    
    Flage_In = _Check_Dword_in_Num(Serv_,NRC22_Loop_Fun,NRC22_Loop_Fun_Count);/*判断是否检测全部子功能*/
    if(Flage_In == -1)
    {
      int Fun_Pos;
      Fun_Count = 1;
      Fun_Pos = _Check_Dword_in_Num(Serv_,NRC22_Loop_Fun_Pos,NRC22_Loop_Fun_Pos_Count);
      if(Fun_Pos!= -1)
      {
        Start_Fun = NRC22_Loop_Fun_Pos[Fun_Pos][1]-1;
        Fun_Count = Start_Fun+1;
      }
    }
    for(i=Start_Fun;i<Fun_Count;i++)
    {
      snprintf(Temp_Str,elCount(Temp_Str),"     开始测试%02X服务%02X%02X例程,NRC22条件",Serv_,Serve_31_Hex[i].Routine[0],Serve_31_Hex[i].Routine[1]);
      {
        _WriteEx_and_Report("","------------------------------------------------------");
        _WriteEx_and_Report("",Temp_Str);
        _WriteEx_and_Report("","------------------------------------------------------");
        _NRC22_Test_Loop(Serv_,i,ID,Session,Type);
      }
    }
  }
}
void _Serve10_03(dword ID,byte Session)   /*1002自动退出诊断故障*/
{
  byte Send[2] = {0x10,0x02};
  _Set_Ready(0);
  _Power_Down();
  _Power_Up();
  testWaitForTimeout(1000);
  StepByGeely3_0(0x19,1);
  _SetSession(Session);
  _85_Check_DTC(9,0);
  
  _Set_Ready(0);
  _Other_1002();
  _Send_Diag(2,ID,Send);
  _TestResult(SendData,ID,"",-1);
  testWaitForTimeout(S3_85_Time);
  _Set_Ready(Struct_Ready.Ready_Active);
  testWaitForTimeout(6000);
  _85_Check_DTC(9,0);
  _K30_OFF();
  testWaitForTimeout(1000);
  _K30_ON();
  testWaitForTimeout(CAN_Init_Time+1000);
  if(CAN_Init_Time+1000<5000 && Geely3_Flage == 1)
    testWaitForTimeout(5000 - CAN_Init_Time);
  _85_Check_DTC(9,Abnormal_Reset);
  _Set_Ready(0);
}
void _Serve10_04(dword ID,byte Session)   /*1002会话切换诊断故障*/
{
  byte Send[2] = {0x10,0x02};
  _Set_Ready(0);
  _Power_Down();
  _Power_Up();
  testWaitForTimeout(1000);
  StepByGeely3_0(0x19,1);
  _SetSession(Session);
  _85_Check_DTC(9,0);
  
  _Set_Ready(0);
  _Other_1002();
  _Send_Diag(2,ID,Send);
  _TestResult(SendData,ID,"",-1);
  testWaitForTimeout(1000);
  _SetSession(defsession);
  testWaitForTimeout(1000);
  _Set_Ready(Struct_Ready.Ready_Active);
  testWaitForTimeout(6000);
  _85_Check_DTC(9,0);
  
  _K30_OFF();
  testWaitForTimeout(1000);
  _K30_ON();
  testWaitForTimeout(CAN_Init_Time+1000);
  if(CAN_Init_Time+1000<5000 && Geely3_Flage == 1)
    testWaitForTimeout(5000 - CAN_Init_Time);
  _85_Check_DTC(9,Abnormal_Reset);
  _Set_Ready(0);
}
void _Serve10_05(dword ID,byte Session)   /*1002复位诊断故障*/
{
  byte Send[2] = {0x10,0x02};
  byte Send_2[2] = {0x11,0x02};
  int Serve_Pos;
  Serve_Pos = _Check_Serve(0x11,0,0);
  Send_2[1] = Serve_Data[Serve_Pos].Serve_Fun[0];
  
  _Set_Ready(0);
  _Power_Down();
  _Power_Up();
  testWaitForTimeout(1000);
  StepByGeely3_0(0x19,1);
  _SetSession(Session);
  _85_Check_DTC(9,0);
  
  _Set_Ready(0);
  _Other_1002();
  _Send_Diag(2,ID,Send);
  _TestResult(SendData,ID,"",-1);
  testWaitForTimeout(1000);
  if(Serve_Data[Serve_Pos].Security_Access[0] == 1)
  {
    Security_access_BT();
    testWaitForTimeout(500);
  }
  _Send_Diag(2,ID,Send_2);
  _TestResult(SendData,ID,"",-1);
  testWaitForTimeout(3000);
  _Set_Ready(Struct_Ready.Ready_Active);
  testWaitForTimeout(6000);
  _85_Check_DTC(9,0);
  
  _K30_OFF();
  testWaitForTimeout(1000);
  _K30_ON();
  testWaitForTimeout(CAN_Init_Time+1000);
  if(CAN_Init_Time+1000<5000 && Geely3_Flage == 1)
    testWaitForTimeout(5000 - CAN_Init_Time);
  _85_Check_DTC(9,Abnormal_Reset);
  _Set_Ready(0);
}

/*
    长安工厂模式力矩相关测试
    Type = 0：进入工厂模式
    Type = 1：退出工厂模式
*/
void _Serve10_CCAG_Torque(dword ID,byte Session,byte Type)/*工厂模式-力矩边界值*/
{
  byte Send_Data_1[2];
  Byte Send_Fac_In[6] = {0x2E,1,0,0,0,0};
  int i,j;
  float Torque_Set[4] = {2,1.9,-2,-1.9};
  Send_Data_1[0] = 0x10;
  if(Type == 0)
    Send_Fac_In[3] = 0;
  else
    Send_Fac_In[3] = 1;
  _unlockECU();
  _Send_Diag(6,phyreq_ID,Send_Fac_In);
  _TestResult(SendData,phyreq_ID,"",-1);
  _Set_11_Restoration(0);
  testWaitForTimeout(1000);
  for(i=0;i<4;i++) 
  {
    _TestWaitForTesterConfirmation("施加方向盘力矩 %.2f Nm，并保持",Torque_Set[i]);
    for(j=1;j<4;j++)
    {
      if(j==2)
        _Pre_Programmed();
      Send_Data_1[1] = j;
      _Send_Diag(2,ID,Send_Data_1);
      if((j == 2) && (i==0 || i == 2))
        _TestResult(SendData,ID,"",0x22);
      else
      {
        _TestResult(SendData,ID,"",-1);
        if(j == 2)
        {
          testWaitForTimeout(1000);
          _SetSession(defsession);
          testWaitForTimeout(2000);
        }
      }
    }
  }
}

/*
    长安工厂模式电压相关测试
    Type = 0：进入工厂模式
    Type = 1：退出工厂模式
*/
void _Serve10_CCAG_Battery(dword ID,byte Session,byte Type)/*工厂模式-电压边界*/
{
  byte Send_Data_1[2];
  Byte Send_Fac_In[6] = {0x2E,1,0,0,0,0};
  int i,j;
  float Battery_Set[4] = {8.9,9,16.1,16};
  Send_Data_1[0] = 0x10;
  if(Type == 0)
    Send_Fac_In[3] = 0;
  else
    Send_Fac_In[3] = 1;
  _unlockECU();
  _Send_Diag(6,phyreq_ID,Send_Fac_In);
  _TestResult(SendData,phyreq_ID,"",-1);
  _Set_11_Restoration(0);
  testWaitForTimeout(1000);
  for(i=0;i<4;i++)
  {
    _Set_Battery(Battery_Set[i]);
    for(j=1;j<4;j++)
    {
      if(j==2)
        _Pre_Programmed();
      Send_Data_1[1] = j;
      _Send_Diag(2,ID,Send_Data_1);
      if((j == 2) && (i==0 || i == 2))
        _TestResult(SendData,ID,"",0x22);
      else
      {
        _TestResult(SendData,ID,"",-1);
        if(j == 2)
        {
          testWaitForTimeout(1000);
          _SetSession(defsession);
          testWaitForTimeout(2000);
        }
      }
    }
  }
}

void _ServeNRC7F(dword ID,byte Session,byte Serve)/*7F>13*/
{
  byte Send_Data[20];
  int Serve_Pos,i,j,k,LenMax,FlagePara,PosForPara;
  Send_Data[0] = Serve;
  Serve_Pos = _Check_Serve(Serve,0,0);
  
  if(Serve != 0x31)
  {
    if(_Check_Serve_IDAndSess(Serve,ID,Session) != 1)
    {
      for(i=1;i<20;i++)
        Send_Data[i] = 0;
      LenMax = Get_ServeMaxLen(Serve,1);
      if(Serve == 0x2E)
        LenMax = 3;
      for(i=1;i<=LenMax+1;i++)
      {
        if(Serve == 0x2E && i == 2)
          continue;
        if(Serve == 0x27 && (i > 3 && i < SendKey_Len))
          continue;
        if(i>=2) // 当长度≥2时开始遍历全部支持的子功能
        {
          for(j=0;j<Serve_Data[Serve_Pos].Serve_Fun_Count+1;j++)
          {
            PosForPara = j;
            if(Serve == 0x2E || Serve == 0x22)
            {
              if(j == Serve_Data[Serve_Pos].Serve_Fun_Count) //测试完全部支持子功能后测试1个不支持子功能
                _Get_Serve_NRC31(Serve,0,Send_Data);
              else
              {
                Send_Data[1] = (Serve_Data[Serve_Pos].Serve_Fun[j]>>8) &0xFF;
                Send_Data[2] = Serve_Data[Serve_Pos].Serve_Fun[j] &0xFF;
              }
            }
            else //非2E服务取子功能
            {
              if(j == Serve_Data[Serve_Pos].Serve_Fun_Count) //测试完全部支持子功能后测试1个不支持子功能
              {
                Send_Data[1] = _Get_Invalid_Fun(Serve,0);
                PosForPara = j-1;
              }
              else
                Send_Data[1] = Serve_Data[Serve_Pos].Serve_Fun[j];
            }
            FlagePara = (Serve_Data[Serve_Pos].Serve_Para_Count[PosForPara] == 0)?0:1;
            if(FlagePara == 1 && i>2)
            {
              for(k=0;k<Serve_Data[Serve_Pos].Serve_Para_Count[PosForPara]+1;k++)
              {
                if(k == Serve_Data[Serve_Pos].Serve_Para_Count[PosForPara])
                  _Get_Serve_NRC31(Serve,0,Send_Data);
                else
                  Send_Data[2] = Serve_Data[Serve_Pos].Serve_Para[PosForPara][k];
                _Send_Diag(i,ID,Send_Data);
                _TestResult(SendData,ID,"",NRC7F);
                testWaitForTimeout(50);
              }
            }
            else
            {
              _Send_Diag(i,ID,Send_Data);
              _TestResult(SendData,ID,"",NRC7F);
              testWaitForTimeout(50);
            }
          }
        }
        else //长度为1，仅发送一次
        {
          _Send_Diag(i,ID,Send_Data);
          _TestResult(SendData,ID,"",NRC7F);
          testWaitForTimeout(50);
        }
      }
      if(Serve == 0x10 || Serve == 0x11)
        _Send_And_Check_NowSession(ID,Session); 
    }
  }
  else
  {
    for(i=1;i<20;i++)
      Send_Data[i] = 0;
    LenMax = Get_ServeMaxLen(Serve,1);
    for(i=1;i<=LenMax+1;i++)
    {
      if(i==3)
        continue;
      if(i==1)
      {
        _Send_Diag(i,ID,Send_Data);
        _TestResult(SendData,ID,"",NRC7F);
        testWaitForTimeout(50);
      }
      else if(i==2) //无对应RID情况下，测试01-03例程控制，对0x70进行不支持测试
      {
        for(j=1;j<4;j++)
        {
          Send_Data[1] = j;
          _Send_Diag(i,ID,Send_Data);
          _TestResult(SendData,ID,"",NRC7F);
          testWaitForTimeout(50);
        }
        Send_Data[1] = 0x70;
        _Send_Diag(i,ID,Send_Data);
        _TestResult(SendData,ID,"",NRC7F);
        testWaitForTimeout(50);
      }
      else
      {
        for(j=0;j<=Serve_31_Hex_Count;j++)
        {
          dword Temp_RID,RID_Pos;
          if(j != Serve_31_Hex_Count)
          {
            if(_Check_Serve_IDAndSess(0x31,j,ID,Session) == 1)
              continue;
          }
          if(j == Serve_31_Hex_Count)
            Send_Data[2] = _Get_Invalid_RID();
          else
          {
            Send_Data[2] = Serve_31_Hex[j].Routine[0];
            Send_Data[3] = Serve_31_Hex[j].Routine[1];
            Temp_RID = ((Send_Data[2]<<8)|Send_Data[3]);
          }
          RID_Pos = (j==Serve_31_Hex_Count)?(j-1):j;
          for(k=0;k<=Serve_31_Hex[RID_Pos].Control_Type_Count;k++)
          {
            Send_Data[1] = (k==Serve_31_Hex[RID_Pos].Control_Type_Count)?_Get_Invalid_RID_Control_Type(Temp_RID):Serve_31_Hex[RID_Pos].Control_Type[k];
            FlagePara = (k==Serve_31_Hex[RID_Pos].Control_Type_Count)?(k-1):k;
            if(i==4)
            {
              _Send_Diag(i,ID,Send_Data);
              _TestResult(SendData,ID,"",NRC7F);
              testWaitForTimeout(50);
            }
            if((Serve_31_Hex[RID_Pos].Routine_Len>=5) && i>=5 && j!=Serve_31_Hex_Count)
            {
              for(PosForPara=0;PosForPara<=Serve_31_Hex[RID_Pos].Control_Option_Count[FlagePara];PosForPara++)
              {
                if(PosForPara == Serve_31_Hex[RID_Pos].Control_Option_Count[FlagePara])
                  Send_Data[4] = _Get_Invalid_RID_Control_Option(0x31,Temp_RID,Serve_31_Hex[RID_Pos].Control_Type[FlagePara],0);
                else
                  Send_Data[4] = Serve_31_Hex[RID_Pos].Control_Option[FlagePara][PosForPara];
                _Send_Diag(i,ID,Send_Data);
                _TestResult(SendData,ID,"",NRC7F);
                testWaitForTimeout(50);
              }
            }
            else if((Serve_31_Hex[RID_Pos].Routine_Len || j==Serve_31_Hex_Count) && i>=5)
            {
              Send_Data[4] = random(255)&0xFF;
              _Send_Diag(i,ID,Send_Data);
              _TestResult(SendData,ID,"",NRC7F);
              testWaitForTimeout(50);
            }
          }
        }
      }
    }
  }
}
void _Serve11_01(dword ID,byte Session)/*遍历支持的子功能*/
{
  byte Send_Data[2];
  int Serve_Pos,Temp_Flage;
  byte Seed[2] = {0x27,0x02};
  Send_Data[0] = 0x11;
  Seed[1] = RequestSeed_27;
  Serve_Pos = _Check_Serve(0x11,0,0);
  if(Serve_Pos == -1)
    _WriteEx_and_Report("","未查询到0x11服务支持");
  else
  {
    for(i=0;i<Serve_Data[Serve_Pos].Serve_Fun_Count;i++)
    {
      if(i != 0)
        _SetSession(Session);
      Send_Data[1] = Serve_Data[Serve_Pos].Serve_Fun[i];
      Temp_Flage = _Check_Fun_IDAndSess(0x11,Send_Data[1],ID,Session);
      if(Temp_Flage == 1)
      {
        if( Serve_Data[Serve_Pos].Security_Access[i] == 1)
        {
          _Send_Diag(2,ID,Send_Data);
          _TestResult(SendData,ID,"",NRC33);
          _Send_And_Check_NowSession(ID,Session); 
          _unlockECU();
        }
        _Send_Diag(2,ID,Send_Data);
        _TestResult(SendData,ID,"",-1);
        testWaitForTimeout(Wait_Time_11);
        _Send_Diag(2,phyreq_ID,Seed);
        _TestResult(SendData,phyreq_ID,"",NRC7F);
        _Send_And_Check_NowSession(ID,defsession); 
        /**************************助力检测***********************/
        {
          /*----------------暂无法实现---------------*/
        }
      }
      else if(Temp_Flage == 0 || (Temp_Flage == -1 && Session == defsession))
      {
        _Send_Diag(2,ID,Send_Data);
        _TestResult(SendData,ID,"",NRC7F);
        if(Session == exsession)
        {
          testWaitForTimeout(Wait_Time_11);
          _Send_Diag(2,phyreq_ID,Seed);
          _TestResult(SendData,phyreq_ID,"",-1);
        }
        _Send_And_Check_NowSession(phyreq_ID,Session); 
      }
      else if(Temp_Flage == -1 && Session == exsession)
      {
        _Send_Diag(2,ID,Send_Data);
        _TestResult(SendData,ID,"",NRC12);
        testWaitForTimeout(Wait_Time_11);
        _Send_Diag(2,phyreq_ID,Seed);
        _TestResult(SendData,phyreq_ID,"",-1);
        _Send_And_Check_NowSession(phyreq_ID,Session); 
      }
      testWaitForTimeout(2000);
    }
  }
}
void _Serve11_02(dword ID,byte Session)/*肯定响应抑制位测试*/
{
  _Step_Serve_RSP(0x11,ID,Session);
}

void _Serve11_03(dword ID,byte Session)/*NRC12*/
{
  byte Send_Data[2];
  int Serve_Pos,i;
  Send_Data[0] = 0x11;
  Serve_Pos = _Check_Serve(0x11,0,0);
  if(_Check_Serve_IDAndSess(0x11,ID,Session) == 1)
  {
    if(Serve_Data[Serve_Pos].Security_Access[0]==1)
      _unlockECU();
    for(i=0;i<=0xFF;i++)
    {
      Send_Data[1] = i;
      if((_Check_Serve(0x11,i,4)!=-1) || ((_Check_Serve(0x11,(i&0x0F),4)!=-1) && ((i>>4)==0x08) && (_Check_Serve(0x11,i&0x0F,9) == 1)))
      {
        _WriteEx_and_Report("0x11服务","0x%02X该子功能支持",i);
        continue;
      }
      else
      {
        _Send_Diag(2,ID,Send_Data);
        _TestResult(SendData,ID,"",NRC12);
      }
    }
  }
  else
    _WriteEx_and_Report("","当前寻址或会话下不支持该服务");
}
void _Serve11_04(dword ID,byte Session)   /*NRC13*/
{
  byte Temp_0[2]={0x11,0x01};
  byte Len;
  int Serve_Pos,i;
  Len = _Check_CANFD_Flage();
  Serve_Pos = _Check_Serve(0x11,0,0);
  if(Len < Serve_Data[Serve_Pos].Serve_Fun_Len[0])
    Len = Serve_Data[Serve_Pos].Serve_Fun_Len[0]+1;
  if(_Check_Serve_IDAndSess(0x11,ID,Session) == 1)
  {
    if(Serve_Data[Serve_Pos].Security_Access[0]==1)
      _unlockECU();
    for(i=1;i<=Len;i++)
    {
      if(i==2)
      {
        _WriteEx_and_Report("","该长度支持，跳过");
        continue;
      }
      _Send_Diag(i,ID,Temp_0);
      _TestResult(SendData,ID,"",NRC13);
      testWaitForTimeout(50);
    }
  }
  else
    _WriteEx_and_Report("","当前寻址或会话下不支持该服务");
}

void _Serve11_05(dword ID,byte Session)   /*NRC22_车速*/
{
  int Serve_Pos,NRC22_Flage;
  int i;
  byte Send_Data[2];
  Serve_Pos = _Check_Serve(0x11,0,0);
  if(Serve_Pos == -1)
    _WriteEx_and_Report("","当前项目不支持11服务,跳过检测");
  else
  {
    Send_Data[0] = 0x11;
    for(i=0;i<Serve_Data[Serve_Pos].Serve_Fun_Count;i++)
    {
      Send_Data[1] = Serve_Data[Serve_Pos].Serve_Fun[i];
      if(_Check_Fun_IDAndSess(0x11,Serve_Data[Serve_Pos].Serve_Fun[i],ID,Session) == 1)
      {
        NRC22_Flage = _Set_NRC22(0x11,Serve_Data[Serve_Pos].Serve_Fun[i],2);
        if(NRC22_Flage == -1)
          _WriteEx_and_Report("","无NRC22条件");
        else if((NRC22_Flage &0x01) != 0)
        {
          if(i != 0 && Session != defsession)
            _SetSession(defsession);
          if(Serve_Data[Serve_Pos].Security_Access[i] == 1)
            _unlockECU();
          else
            _SetSession(exsession);
          {
            /*******车速>NRC22车速*******/
            _Set_CarSpd(NRC22_CarSpd + 1);
            _Send_Diag(2,ID,Send_Data);
            _TestResult(SendData,ID,"",NRC22);
            _Send_And_Check_NowSession(ID,exsession); 
            testWaitForTimeout(2000);
          }
          {
            /*******车速 = NRC22车速*******/
            _Set_CarSpd(NRC22_CarSpd);
            _Send_Diag(2,ID,Send_Data);
            _TestResult(SendData,ID,"",-1);
            testWaitForTimeout(2000);
            _Send_And_Check_NowSession(ID,defsession); 
          }
          _Set_CarSpd(0);
          if(Session != defsession && Serve_Data[Serve_Pos].Security_Access[i] == 1)
            _unlockECU();
          else if(Session != defsession && Serve_Data[Serve_Pos].Security_Access[i] == 0)
            _SetSession(exsession);
          _Set_CarSpd(NRC22_CarSpd + 1);
          {
            /*******车速信号丢失*******/
            _WriteEx_and_Report("","丢失车速节点");
            _TestDisableMsg(Struct_CarSpd.Sig_Id);
            testWaitForTimeout(Struct_CarSpd.Lost_Time*1.2);
            _Send_Diag(2,ID,Send_Data);
            _TestResult(SendData,ID,"",-1);
            testWaitForTimeout(2000);
            _Send_And_Check_NowSession(ID,defsession); 
          }
          _Set_CarSpd(0);
          _TestEnableMsg(Struct_CarSpd.Sig_Id);
          testWaitForTimeout(Struct_CarSpd.Lost_Time*1.2);
          if(Session != defsession && Serve_Data[Serve_Pos].Security_Access[i] == 1)
            _unlockECU();
          else if(Session != defsession && Serve_Data[Serve_Pos].Security_Access[i] == 0)
            _SetSession(exsession);
          {
            /*******车速无效*******/
            _Set_CarSpd_Invalid(Struct_CarSpd.Invalid_Value[0]);
            _Send_Diag(2,ID,Send_Data);
            _TestResult(SendData,ID,"",-1);
            testWaitForTimeout(2000);
            _Send_And_Check_NowSession(ID,defsession); 
          }
          _Reset_CarSpd_Invalid();
          _Set_CarSpd(0);
        }
        else
          _WriteEx_and_Report("","无NRC22车速条件");
      }
      else
        _WriteEx_and_Report("","0x11 0x%02X当前会话或寻址不支持",Serve_Data[Serve_Pos].Serve_Fun[i]);
    }
  }
}

void _Serve11_06(dword ID,byte Session)   /*NRC22_档位*/
{
  int Serve_Pos,NRC22_Flage;
  int i,j;
  byte Send_Data[2],Send_Data_2[2];
  Serve_Pos = _Check_Serve(0x11,0,0);
  if(Serve_Pos == -1)
    _WriteEx_and_Report("","当前项目不支持11服务,跳过检测");
  else
  {
    Send_Data[0] = 0x11;
    Send_Data_2[0] = 0x27;
    Send_Data_2[1] = RequestSeed_27;
    for(i=0;i<Serve_Data[Serve_Pos].Serve_Fun_Count;i++)
    {
      Send_Data[1] = Serve_Data[Serve_Pos].Serve_Fun[i];
      if(_Check_Fun_IDAndSess(0x11,Serve_Data[Serve_Pos].Serve_Fun[i],ID,Session) == 1)
      {
        NRC22_Flage = _Set_NRC22(0x11,Serve_Data[Serve_Pos].Serve_Fun[i],2);
        if(NRC22_Flage == -1)
          _WriteEx_and_Report("","无NRC22条件");
        else if((NRC22_Flage &0x08) != 0)
        {
          if(i != 0 && Session != defsession)
            _SetSession(defsession);
          if(Serve_Data[Serve_Pos].Security_Access[i] == 1)
            _unlockECU();
          else
            _SetSession(exsession);
          {
            for(j=NRC_22_Gears_Range[0];j<=NRC_22_Gears_Range[1];j++)
            {
              if(j==NRC_22_Gears_Normal)
                continue;
              _Set_Gears(j);
              testWaitForTimeout(200);
              _Send_Diag(2,ID,Send_Data);
              _TestResult(SendData,ID,"",NRC22);
              testWaitForTimeout(2000);
              _Send_Diag(2,ID,Send_Data_2);
              _TestResult(SendData,ID,"",-1);
              _Send_And_Check_NowSession(ID,exsession); 
            }
            {
              _TestDisableMsg(Gears_ID);
              testWaitForTimeout(1000);
              _Send_Diag(2,ID,Send_Data);
              _TestResult(SendData,ID,"",-1);
              testWaitForTimeout(2000);
              _Send_Diag(2,ID,Send_Data_2);
              _TestResult(SendData,ID,"",NRC7F);
              _Send_And_Check_NowSession(ID,defsession); 
            }
            _TestEnableMsg(Gears_ID);
            testWaitForTimeout(1000);
            if(Session != defsession && Serve_Data[Serve_Pos].Security_Access[i] == 1)
              _unlockECU();
            else if(Session != defsession && Serve_Data[Serve_Pos].Security_Access[i] == 0)
              _SetSession(exsession);
            testWaitForTimeout(1000);
            {
              _Set_Gears(NRC_22_Gears_Normal);
              testWaitForTimeout(200);
              _Send_Diag(2,ID,Send_Data);
              _TestResult(SendData,ID,"",-1);
              testWaitForTimeout(2000);
              _Send_Diag(2,ID,Send_Data_2);
              _TestResult(SendData,ID,"",NRC7F);
              _Send_And_Check_NowSession(ID,defsession); 
            }
          }
        }
        else
          _WriteEx_and_Report("","无NRC22档位条件");
      }
      else
        _WriteEx_and_Report("","0x11 0x%02X当前会话或寻址不支持",Serve_Data[Serve_Pos].Serve_Fun[i]);
    }
  }
}

void _Serve11_06_Ready(dword ID,byte Session)   /*NRC22_发动机*/
{
  int Serve_Pos,NRC22_Flage;
  int i,j;
  byte Send_Data[2],Send_Data_2[2];
  Serve_Pos = _Check_Serve(0x11,0,0);
  if(Serve_Pos == -1)
    _WriteEx_and_Report("","当前项目不支持11服务,跳过检测");
  else
  {
    Send_Data[0] = 0x11;
    Send_Data_2[0] = 0x27;
    Send_Data_2[1] = RequestSeed_27;
    for(i=0;i<Serve_Data[Serve_Pos].Serve_Fun_Count;i++)
    {
      Send_Data[1] = Serve_Data[Serve_Pos].Serve_Fun[i];
      if(_Check_Fun_IDAndSess(0x11,Serve_Data[Serve_Pos].Serve_Fun[i],ID,Session) == 1)
      {
        NRC22_Flage = _Set_NRC22(0x11,Serve_Data[Serve_Pos].Serve_Fun[i],2);
        if(NRC22_Flage == -1)
          _WriteEx_and_Report("","无NRC22条件");
        else if((NRC22_Flage &0x20) != 0)
        {
          if(i != 0 && Session != defsession)
            _SetSession(defsession);
          if(Serve_Data[Serve_Pos].Security_Access[i] == 1)
            _unlockECU();
          else
            _SetSession(exsession);
          {
            
            _Set_Ready(Ready_NRC22);
            testWaitForTimeout(1000);
            _Send_Diag(2,ID,Send_Data);
            _TestResult(SendData,ID,"",NRC22);
            testWaitForTimeout(1000);
            _Send_And_Check_NowSession(ID,exsession); 
            _TestDisableMsg(Struct_Ready.Sig_Id);
            testWaitForTimeout(Struct_Ready.Invalid_Time*1.2);
            _Send_Diag(2,ID,Send_Data);
            _TestResult(SendData,ID,"",-1);
            testWaitForTimeout(2000);
            _TestEnableMsg(Struct_Ready.Sig_Id);
            testWaitForTimeout(Struct_Ready.Invalid_Time*1.2);
            
            if(Session!=defsession)
              _SetSession(Session);
            if(Serve_Data[Serve_Pos].Security_Access[i] == 1)
              _unlockECU();
            _Set_Sig(Struct_Ready.ReadyInvalid_Sig,Struct_Ready.Invalid_Value[0]);
            testWaitForTimeout(Struct_Ready.Invalid_Time*1.2);
            _Send_Diag(2,ID,Send_Data);
            _TestResult(SendData,ID,"",-1);
            testWaitForTimeout(2000);
            _Send_And_Check_NowSession(ID,defsession); 
            _Set_Sig(Struct_Ready.ReadyInvalid_Sig,Struct_Ready.Normal_Value[0]);
            testWaitForTimeout(Struct_Ready.Invalid_Time*1.2);
            _Set_Ready(0);
            
          }
        }
        else
          _WriteEx_and_Report("","无NRC22发动机条件");
      }
      else
        _WriteEx_and_Report("","0x11 0x%02X当前会话或寻址不支持",Serve_Data[Serve_Pos].Serve_Fun[i]);
    }
  }
}
void _Serve11_06_Fac_Torque(dword ID,byte Session)   /*NRC22_工厂模式_力矩*/
{
  int Serve_Pos,NRC22_Flage;
  int i,j;
  byte Send_Data[2],Send_Key[2];
  char str[300];
  
  Serve_Pos = _Check_Serve(0x11,0,0);
  if(Serve_Pos == -1)
    _WriteEx_and_Report("","当前项目不支持11服务,跳过检测");
  else
  {
    _WriteEx_and_Report("","测试工厂模式NRC22力矩条件");
    Send_Data[0] = 0x11;
    Send_Key[0] = 0x27;
    Send_Key[1] = RequestSeed_27;
    for(i=0;i<Serve_Data[Serve_Pos].Serve_Fun_Count;i++)
    {
      Send_Data[1] = Serve_Data[Serve_Pos].Serve_Fun[i];
      if(_Check_Fun_IDAndSess(0x11,Serve_Data[Serve_Pos].Serve_Fun[i],ID,Session) == 1)
      {
        NRC22_Flage = _Set_NRC22(0x11,Serve_Data[Serve_Pos].Serve_Fun[i],2);
        if(NRC22_Flage == -1)
          _WriteEx_and_Report("","无NRC22条件");
        else if((NRC22_Flage &0x04) != 0)
        {
          if(NRC22_TasTorque_Fac_Flage == 1)
          {
            if(i==0)
              _Factory_Mode(0);
            for(j=0;j<2;j++)//左右
            {
              _SetSession(Session);
              snprintf(str,elCount(str),"%s","");
              if(i==0)
                snprintf(str,elCount(str),"控制力矩满足工厂模式NRC22条件,大于 %.2f Nm,并保持",NRC22_TasTorque_Fac+0.2);
              else
                snprintf(str,elCount(str),"控制力矩满足工厂模式NRC22条件,大于 %.2f Nm,并保持",(NRC22_TasTorque_Fac+0.2)*(-1));
              testWaitForTesterConfirmation(str,30000);
              _Send_Diag(2,ID,Send_Data);
              _TestResult(SendData,ID,"",NRC22);
              testWaitForTimeout(2000);
              if(Session== exsession && diagGetLastResponseCode(SendData)>0)
              {
                _Send_Diag(2,phyreq_ID,Send_Key);
                _TestResult(SendData,phyreq_ID,"",-1);
              }
              else
              {
                _Send_Diag(2,phyreq_ID,Send_Key);
                _TestResult(SendData,phyreq_ID,"",NRC7F);
              }
              _SetSession(Session);
              snprintf(str,elCount(str),"%s","");
              if(i==0)
                snprintf(str,elCount(str),"控制力矩不满足工厂模式NRC22条件,小于 %.2f Nm,并保持",NRC22_TasTorque_Fac-0.2);
              else
                snprintf(str,elCount(str),"控制力矩不满足工厂模式NRC22条件,小于 %.2f Nm,并保持",(NRC22_TasTorque_Fac-0.2)*(-1));
              testWaitForTesterConfirmation(str,30000);
              _Send_Diag(2,ID,Send_Data);
              _TestResult(SendData,ID,"",-1);
              testWaitForTimeout(2000);
              if(Session== exsession && diagGetLastResponseCode(SendData)>0)
              {
                _Send_Diag(2,phyreq_ID,Send_Key);
                _TestResult(SendData,phyreq_ID,"",-1);
              }
              else
              {
                _Send_Diag(2,phyreq_ID,Send_Key);
                _TestResult(SendData,phyreq_ID,"",NRC7F);
              }
              snprintf(str,elCount(str),"%s","");
              snprintf(str,elCount(str),"松开方向盘");
              testWaitForTesterConfirmation(str,30000);
              testWaitForTimeout(2000);
            }
            _Factory_Mode(1);
          }
          else
            _WriteEx_and_Report("","无工厂模式力矩条件");
        }
        else
          _WriteEx_and_Report("","无NRC22力矩条件");
      }
      else
        _WriteEx_and_Report("","0x11 0x%02X当前会话或寻址不支持",Serve_Data[Serve_Pos].Serve_Fun[i]);
    }
  }
}

void _Serve11_06_Torque(dword ID,byte Session)   /*NRC22_力矩*/
{
  int Serve_Pos,NRC22_Flage;
  int i,j;
  byte Send_Data[2],Send_Key[2];
  char str[300];
  
  Serve_Pos = _Check_Serve(0x11,0,0);
  if(Serve_Pos == -1)
    _WriteEx_and_Report("","当前项目不支持11服务,跳过检测");
  else
  {
    _WriteEx_and_Report("","测试NRC22力矩条件");
    Send_Data[0] = 0x11;
    Send_Key[0] = 0x27;
    Send_Key[1] = RequestSeed_27;
    for(i=0;i<Serve_Data[Serve_Pos].Serve_Fun_Count;i++)
    {
      Send_Data[1] = Serve_Data[Serve_Pos].Serve_Fun[i];
      if(_Check_Fun_IDAndSess(0x11,Serve_Data[Serve_Pos].Serve_Fun[i],ID,Session) == 1)
      {
        NRC22_Flage = _Set_NRC22(0x11,Serve_Data[Serve_Pos].Serve_Fun[i],2);
        if(NRC22_Flage == -1)
          _WriteEx_and_Report("","无NRC22条件");
        else if((NRC22_Flage &0x04) != 0)
        {
          if(strncmp(ECU_project,"ChangAn",strlen(ECU_project)) == 0)
            _Factory_Mode(1);
          if(Session == defsession)
            _SetSession(defsession);
          for(j=0;j<2;j++)//左右
          {
              _SetSession(exsession);
              snprintf(str,elCount(str),"%s","");
              if(i==0)
                snprintf(str,elCount(str),"控制力矩满足NRC22条件,大于 %.2f Nm,并保持",NRC22_TasTorque+0.2);
              else
                snprintf(str,elCount(str),"控制力矩满足NRC22条件,大于 %.2f Nm,并保持",(NRC22_TasTorque+0.2)*(-1));
              testWaitForTesterConfirmation(str,30000);
              _Send_Diag(2,ID,Send_Data);
              _TestResult(SendData,ID,"",NRC22);
              _Send_And_Check_NowSession(ID,exsession); 
              testWaitForTimeout(2000);
              if(Session== exsession && diagGetLastResponseCode(SendData)>0)
              {
                _Send_Diag(2,phyreq_ID,Send_Key);
                _TestResult(SendData,phyreq_ID,"",-1);
              }
              else
              {
                _Send_Diag(2,phyreq_ID,Send_Key);
                _TestResult(SendData,phyreq_ID,"",NRC7F);
              }
              _SetSession(Session);
              snprintf(str,elCount(str),"%s","");
              if(i==0)
                snprintf(str,elCount(str),"控制力矩不满足NRC22条件,小于 %.2f Nm,并保持",NRC22_TasTorque-0.2);
              else
                snprintf(str,elCount(str),"控制力矩不满足NRC22条件,小于 %.2f Nm,并保持",(NRC22_TasTorque-0.2)*(-1));
              testWaitForTesterConfirmation(str,30000);
              _Send_Diag(2,ID,Send_Data);
              _TestResult(SendData,ID,"",-1);
              testWaitForTimeout(2000);
              _Send_And_Check_NowSession(ID,defsession); 
              if(Session== exsession && diagGetLastResponseCode(SendData)>0)
              {
                _Send_Diag(2,phyreq_ID,Send_Key);
                _TestResult(SendData,phyreq_ID,"",-1);
              }
              else
              {
                _Send_Diag(2,phyreq_ID,Send_Key);
                _TestResult(SendData,phyreq_ID,"",NRC7F);
              }
              snprintf(str,elCount(str),"%s","");
              snprintf(str,elCount(str),"松开方向盘");
              testWaitForTesterConfirmation(str,30000);
              testWaitForTimeout(2000);
          }
        }
        else
          _WriteEx_and_Report("","无NRC22力矩条件");
      }
      else
        _WriteEx_and_Report("","0x11 0x%02X当前会话或寻址不支持",Serve_Data[Serve_Pos].Serve_Fun[i]);
    }
  }
}

void _Serve11_06_Fac_Battery(dword ID,byte Session)   /*NRC22_工厂模式_电压*/
{
  int Serve_Pos,NRC22_Flage;
  int i,j;
  byte Send_Data[2],Send_Key[2];
  char str[300];
  Serve_Pos = _Check_Serve(0x11,0,0);
  if(Serve_Pos == -1)
    _WriteEx_and_Report("","当前项目不支持11服务,跳过检测");
  else
  {
    _WriteEx_and_Report("","测试工厂模式NRC22电压条件");
    Send_Data[0] = 0x11;
    Send_Key[0] = 0x27;
    Send_Key[1] = RequestSeed_27;
    for(i=0;i<Serve_Data[Serve_Pos].Serve_Fun_Count;i++)
    {
      Send_Data[1] = Serve_Data[Serve_Pos].Serve_Fun[i];
      if(_Check_Fun_IDAndSess(0x11,Serve_Data[Serve_Pos].Serve_Fun[i],ID,Session) == 1)
      {
        NRC22_Flage = _Set_NRC22(0x11,Serve_Data[Serve_Pos].Serve_Fun[i],2);
        if(NRC22_Flage == -1)
          _WriteEx_and_Report("","无NRC22条件");
        else if((NRC22_Flage &0x02) != 0)
        {
            if(i==0)
              _Factory_Mode(0);
            _SetSession(Session);
            _Set_Battery(NRC22_Battery_Low - 0.2);
            _Send_Diag(2,ID,Send_Data);
            _TestResult(SendData,ID,"",NRC22);
            _Send_And_Check_NowSession(ID,Session); 
              testWaitForTimeout(2000);
            if(Session== exsession && diagGetLastResponseCode(SendData)>0)
            {
              _Send_Diag(2,phyreq_ID,Send_Key);
              _TestResult(SendData,phyreq_ID,"",-1);
            }
            else
            {
              _Send_Diag(2,phyreq_ID,Send_Key);
              _TestResult(SendData,phyreq_ID,"",NRC7F);
            }
            _SetSession(Session);
            _Set_Battery(NRC22_Battery_Low + 0.3);
            _Send_Diag(2,ID,Send_Data);
            _TestResult(SendData,ID,"",-1);
              testWaitForTimeout(2000);
            _Send_And_Check_NowSession(ID,defsession); 
            if(Session== exsession && diagGetLastResponseCode(SendData)>0)
            {
              _Send_Diag(2,phyreq_ID,Send_Key);
              _TestResult(SendData,phyreq_ID,"",-1);
            }
            else
            {
              _Send_Diag(2,phyreq_ID,Send_Key);
              _TestResult(SendData,phyreq_ID,"",NRC7F);
            }
            _SetSession(Session);
            _Set_Battery(NRC22_Battery_Hight + 0.3);
            _Send_Diag(2,ID,Send_Data);
            _TestResult(SendData,ID,"",NRC22);
            _Send_And_Check_NowSession(ID,Session); 
              testWaitForTimeout(2000);
            if(Session== exsession && diagGetLastResponseCode(SendData)>0)
            {
              _Send_Diag(2,phyreq_ID,Send_Key);
              _TestResult(SendData,phyreq_ID,"",-1);
            }
            else
            {
              _Send_Diag(2,phyreq_ID,Send_Key);
              _TestResult(SendData,phyreq_ID,"",NRC7F);
            }
            _SetSession(Session);
            _Set_Battery(NRC22_Battery_Hight - 0.2);
            _Send_Diag(2,ID,Send_Data);
            _TestResult(SendData,ID,"",-1);
              testWaitForTimeout(2000);
            _Send_And_Check_NowSession(ID,defsession); 
            if(Session== exsession && diagGetLastResponseCode(SendData)>0)
            {
              _Send_Diag(2,phyreq_ID,Send_Key);
              _TestResult(SendData,phyreq_ID,"",-1);
            }
            else
            {
              _Send_Diag(2,phyreq_ID,Send_Key);
              _TestResult(SendData,phyreq_ID,"",NRC7F);
            }
            _Set_Battery(12);
            _Factory_Mode(1);
        }
        else
          _WriteEx_and_Report("","无NRC22电压条件");
      }
      else
        _WriteEx_and_Report("","0x11 0x%02X当前会话或寻址不支持",Serve_Data[Serve_Pos].Serve_Fun[i]);
    }
  }
}
void _Serve11_06_Battery(dword ID,byte Session)   /*NRC22_电压*/
{
  int Serve_Pos,NRC22_Flage;
  int i,j;
  byte Send_Data[2],Send_Key[2];
  char str[300];
  
  Serve_Pos = _Check_Serve(0x11,0,0);
  if(Serve_Pos == -1)
    _WriteEx_and_Report("","当前项目不支持11服务,跳过检测");
  else
  {
    _WriteEx_and_Report("","测试NRC22电压条件");
    Send_Data[0] = 0x11;
    Send_Key[0] = 0x27;
    Send_Key[1] = RequestSeed_27;
    for(i=0;i<Serve_Data[Serve_Pos].Serve_Fun_Count;i++)
    {
      Send_Data[1] = Serve_Data[Serve_Pos].Serve_Fun[i];
      if(_Check_Fun_IDAndSess(0x11,Serve_Data[Serve_Pos].Serve_Fun[i],ID,Session) == 1)
      {
        NRC22_Flage = _Set_NRC22(0x11,Serve_Data[Serve_Pos].Serve_Fun[i],2);
        if(NRC22_Flage == -1)
          _WriteEx_and_Report("","无NRC22条件");
        else if((NRC22_Flage &0x02) != 0)
        {
          if(i==0)
          {
            if(strncmp(ECU_project,"ChangAn",strlen(ECU_project)) == 0)
              _Factory_Mode(1);
          }
          _SetSession(Session);
          _Set_Battery(NRC22_Battery_Low - 0.2);
          _Send_Diag(2,ID,Send_Data);
          _TestResult(SendData,ID,"",NRC22);
          _Send_And_Check_NowSession(ID,Session); 
            testWaitForTimeout(2000);
          if(Session== exsession && diagGetLastResponseCode(SendData)>0)
          {
            _Send_Diag(2,phyreq_ID,Send_Key);
            _TestResult(SendData,phyreq_ID,"",-1);
          }
          else
          {
            _Send_Diag(2,phyreq_ID,Send_Key);
            _TestResult(SendData,phyreq_ID,"",NRC7F);
          }
          _SetSession(Session);
          _Set_Battery(NRC22_Battery_Low + 0.3);
          _Send_Diag(2,ID,Send_Data);
          _TestResult(SendData,ID,"",-1);
            testWaitForTimeout(2000);
          _Send_And_Check_NowSession(ID,defsession); 
          if(Session== exsession && diagGetLastResponseCode(SendData)>0)
          {
            _Send_Diag(2,phyreq_ID,Send_Key);
            _TestResult(SendData,phyreq_ID,"",-1);
          }
          else
          {
            _Send_Diag(2,phyreq_ID,Send_Key);
            _TestResult(SendData,phyreq_ID,"",NRC7F);
          }
          _SetSession(Session);
          _Set_Battery(NRC22_Battery_Hight + 0.3);
          _Send_Diag(2,ID,Send_Data);
          _TestResult(SendData,ID,"",NRC22);
            testWaitForTimeout(2000);
          _Send_And_Check_NowSession(ID,Session); 
          if(Session== exsession && diagGetLastResponseCode(SendData)>0)
          {
            _Send_Diag(2,phyreq_ID,Send_Key);
            _TestResult(SendData,phyreq_ID,"",-1);
          }
          else
          {
            _Send_Diag(2,phyreq_ID,Send_Key);
            _TestResult(SendData,phyreq_ID,"",NRC7F);
          }
          _SetSession(Session);
          _Set_Battery(NRC22_Battery_Hight - 0.2);
          _Send_Diag(2,ID,Send_Data);
          _TestResult(SendData,ID,"",-1);
            testWaitForTimeout(2000);
          _Send_And_Check_NowSession(ID,defsession); 
          if(Session== exsession && diagGetLastResponseCode(SendData)>0)
          {
            _Send_Diag(2,phyreq_ID,Send_Key);
            _TestResult(SendData,phyreq_ID,"",-1);
          }
          else
          {
            _Send_Diag(2,phyreq_ID,Send_Key);
            _TestResult(SendData,phyreq_ID,"",NRC7F);
          }
          _Set_Battery(12);
          if(strncmp(ECU_project,"ChangAn",strlen(ECU_project)) == 0)
            _Factory_Mode(1);
        }
        else
          _WriteEx_and_Report("","无NRC22电压条件");
      }
      else
        _WriteEx_and_Report("","0x11 0x%02X当前会话或寻址不支持",Serve_Data[Serve_Pos].Serve_Fun[i]);
    }
  }
}
void _Serve11_07(dword ID,byte Session)   /*NRC优先级*/
{
  int Serve_Pos,i;
  byte Send_Data[100];
  
  Serve_Pos = _Check_Serve(0x11,0,0);
  if(_Check_Serve_IDAndSess(0x11,ID,Session) == 1)
  {
    Send_Data[0] = 0x11;
    _Set_NRC_Step(0x11,Serve_Data[Serve_Pos].Serve_Fun[0],6,Send_Data);
    if(Fun_NRC_Count == 0)
    {
      _WriteEx_and_Report("","未输入NRC，跳过测试");
      return;
    }
    for(i=0;i<=Fun_NRC_Count;i++)
    {
      if(i>0) //第一次反馈最高优先级不做处理,其余依次恢复
      {
        _Recover_NRC_Step(Fun_NRC[i-1],Serve_Pos,0,Send_Data);
      }
      if(i == Fun_NRC_Count)
      {
        _Send_Diag(Fun_NRC_Send_Len,ID,Send_Data);
        _TestResult(SendData,ID,"",-1);
      }
      else
      {
        _Send_Diag(Fun_NRC_Send_Len,ID,Send_Data);
        _TestResult(SendData,ID,"",Fun_NRC[i]);
      }
      testWaitForTimeout(100);
    }
  }
  else
    _WriteEx_and_Report("","0x11 0x%02X当前会话或寻址不支持",Serve_Data[Serve_Pos].Serve_Fun[0]);
}

void _Serve11_08(dword ID,byte Session)/*  NRC22-吉利3.0*/
{
  byte Send_Data_01[2] = {0x11,0x01};
  byte Send_Data_81[2] = {0x11,0x81};
  char Serve_85_CarSpdQFTemp[10];
  byte Serve_85_CarSpdQF[10];
  int Serve_85_CarSpdQF_Count;
  int i,j;
  Serve_85_CarSpdQF_Count = getProfileArray(ECU_project,"Serve_85_CarSpdQF",Serve_85_CarSpdQFTemp,elCount(Serve_85_CarSpdQFTemp),file_name_1);
  for(i=0;i<Serve_85_CarSpdQF_Count;i++)
    Serve_85_CarSpdQF[i] = Serve_85_CarSpdQFTemp[i];
  
  diagStartTesterPresent(Cdd_Name);
  _Set_Ready(Struct_Ready.Ready_Active);
  testWaitForTimeout(6000);
  
  for(j=0;j<7;j++)
  {
    diagStartTesterPresent(Cdd_Name);
    if(j==1)
      _Set_CarSpd(NRC22_CarSpd+1);
    else 
      _Set_CarSpd(NRC22_CarSpd-1);
    
    _Set_Ready(0xB);
    _Set_CarSpd_Invalid(3);
    if(j==0 || j==1)  /*此用例测试VehSpdLgtQf=2或3能支持85服务，需要遍历VehSpdLgtQf值*/
    {
      _WriteEx_and_Report("","测试支持11服务的VehSpdLgtQf，需要遍历VehSpdLgtQf值");
      for(i=0;i<4;i++)
      {
        _Set_CarSpd_Invalid(i);
        testWaitForTimeout(1000);
        if((_Check_Dword_in_Num(i,Serve_85_CarSpdQF,Serve_85_CarSpdQF_Count)!= -1) && j == 0)
        {
          _Send_Diag(2,ID,Send_Data_01);
          _TestResult(SendData,ID,"",-1);
          StepForGeelyServe11(Session);
          _Send_Diag(2,ID,Send_Data_81);
          _TestResult(SendData,ID,"",0);
          StepForGeelyServe11(Session);
        }
        else
        {
          _Send_Diag(2,ID,Send_Data_01);
          _TestResult(SendData,ID,"",CarSpd_Invalid_NRC);
          _Send_Diag(2,ID,Send_Data_81);
          _TestResult(SendData,ID,"",CarSpd_Invalid_NRC);
        }
      }
      if(j==1)
      {
        _Set_CarSpd_Invalid(0);
        _TestDisableMsg(Struct_CarSpd.Sig_Id);
        testWaitForTimeout(Struct_CarSpd.Lost_Time*1.5);
        _Send_Diag(2,ID,Send_Data_01);
        _TestResult(SendData,ID,"",-1);
        StepForGeelyServe11(Session);
        _Send_Diag(2,ID,Send_Data_81);
        _TestResult(SendData,ID,"",-1);
        StepForGeelyServe11(Session);
        _TestEnableMsg(Struct_CarSpd.Sig_Id);
        _WriteEx_and_Report("","步骤5-9测试结束");
      }
      else
        _WriteEx_and_Report("","步骤1-4测试结束");
    }
    else if(j==2)  /*此用例测试Usgmode≠0xD(driving)能支持85服务，需要遍历Usgmode值以及丢失*/
    {
      _WriteEx_and_Report("","此用例测试Usgmode≠0xD(driving)能支持11服务，需要遍历Usgmode值以及丢失");
      for(i=0;i<5;i++)
      {
        byte Temp[5]={0,1,2,0xB,0xD};
        _Set_Ready(Temp[i]);
        testWaitForTimeout(1000);
        _Send_Diag(2,ID,Send_Data_01);
        if(Temp[i]==0xD)
          _TestResult(SendData,ID,"",Ready_NRC);
        else
        {
          _TestResult(SendData,ID,"",-1);
          StepForGeelyServe11(Session);
        }
        _Send_Diag(2,ID,Send_Data_81);
        if(Temp[i]==0xD)
          _TestResult(SendData,ID,"",Ready_NRC);
        else
        {
          _TestResult(SendData,ID,"",-1);
          StepForGeelyServe11(Session);
        }
      }
      _Set_Ready(0xD);
      _TestDisableMsg(Struct_Ready.Sig_Id);
      testWaitForTimeout(3000);
      _Send_Diag(2,ID,Send_Data_01);
      _TestResult(SendData,ID,"",-1);
      StepForGeelyServe11(Session);
      _Send_Diag(2,ID,Send_Data_81);
      _TestResult(SendData,ID,"",-1);
      StepForGeelyServe11(Session);
      _TestEnableMsg(Struct_Ready.Sig_Id);
      _WriteEx_and_Report("","步骤10-15测试结束");
    }
    else if(j==3)/*测试电压条件*/
    { 
      float Temp[4]={1,2,3,4};
      _WriteEx_and_Report("","测试电压条件");
      Temp[0]=NRC22_Battery_Low+0.2;
      Temp[1]=NRC22_Battery_Hight-0.2;
      Temp[2]=NRC22_Battery_Low-0.2;
      Temp[3]=NRC22_Battery_Hight+0.2;
      for(i=0;i<4;i++)
      {
        _Set_Battery(Temp[i]);
        if(i<2)
        {
          _Send_Diag(2,ID,Send_Data_01);
          _TestResult(SendData,ID,"",-1);
          StepForGeelyServe11(Session);
          _Send_Diag(2,ID,Send_Data_81);
          _TestResult(SendData,ID,"",-1);
          StepForGeelyServe11(Session);
        }
        else if(i==2)
        {
          _Send_Diag(2,ID,Send_Data_01);
          _TestResult(SendData,ID,"",L_Battery_NRC);
          _Send_Diag(2,ID,Send_Data_81);
          _TestResult(SendData,ID,"",L_Battery_NRC);
        }
        else if(i==3)
        {
          _Send_Diag(2,ID,Send_Data_01);
          _TestResult(SendData,ID,"",H_Battery_NRC);
          _Send_Diag(2,ID,Send_Data_81);
          _TestResult(SendData,ID,"",H_Battery_NRC);
        }
      }
      _Set_Battery(12);
      _WriteEx_and_Report("","步骤16-19测试结束");
    }
    else if(j==4)/*Usgmode(0x2E0:VehModMngtGlbSafe1)=0xD，车速<3km/h，VehSpdLgtQf=3，电压为13.5V时丢失0xE0节点发送报文：*/
    {
      _WriteEx_and_Report("","Usgmode(0x2E0:VehModMngtGlbSafe1)=0xD，车速<3km/h，VehSpdLgtQf=3，电压为13.5V时丢失0xE0节点发送报文");
      _Set_Ready(0xD);
      _TestDisableMsg(Struct_CarSpd.Sig_Id);
      testWaitForTimeout(5000);
      _Send_Diag(2,ID,Send_Data_01);
      _TestResult(SendData,ID,"",Ready_NRC);
      _Send_Diag(2,ID,Send_Data_81);
      _TestResult(SendData,ID,"",Ready_NRC);
      _TestEnableMsg(Struct_CarSpd.Sig_Id);
      testWaitForTimeout(1000);
      _Set_Ready(0xB);
      _TestDisableMsg(Struct_CarSpd.Sig_Id);
      testWaitForTimeout(5000);
      _Send_Diag(2,ID,Send_Data_01);
      _TestResult(SendData,ID,"",-1);
      StepForGeelyServe11(Session);
      _Send_Diag(2,ID,Send_Data_81);
      _TestResult(SendData,ID,"",-1);
      StepForGeelyServe11(Session);
      _TestEnableMsg(Struct_CarSpd.Sig_Id);
      testWaitForTimeout(1000);
      _WriteEx_and_Report("","步骤20-21测试结束");
    }
    else if(j==5)/*步骤22&23、VehSpdLgtQf不满足；步骤24、车速不满足；步骤25&26、VehSpdLgtQf满足取值遍历*/
    {
      int Qf[4] = {1,0,2,3};
      _Set_Ready(0xD);
      _WriteEx_and_Report("","步骤22&23：VehSpdLgtQf不满足。步骤24：车速不满足。步骤25&26：VehSpdLgtQf满足取值遍历");
      _WriteEx_and_Report("","步骤22，步骤23，步骤25，步骤26");
      for(i=0;i<4;i++)
      {
        _Set_CarSpd_Invalid(Qf[i]);
        testWaitForTimeout(500);
        _TestDisableMsg(Struct_Ready.Sig_Id);
        testWaitForTimeout(2000);
        if(_Check_Dword_in_Num(Qf[i],Serve_85_CarSpdQF,Serve_85_CarSpdQF_Count)!= -1)
        {
          _Send_Diag(2,ID,Send_Data_01);
          _TestResult(SendData,ID,"",-1);
          StepForGeelyServe11(Session);
          _Send_Diag(2,ID,Send_Data_81);
          _TestResult(SendData,ID,"",-1);
          StepForGeelyServe11(Session);
        }
        else
        {
          _Send_Diag(2,ID,Send_Data_01);
          _TestResult(SendData,ID,"",CarSpd_Invalid_NRC);
          _Send_Diag(2,ID,Send_Data_81);
          _TestResult(SendData,ID,"",CarSpd_Invalid_NRC);
        }
        _TestEnableMsg(Struct_Ready.Sig_Id);
        testWaitForTimeout(2000);
      }
      _WriteEx_and_Report("","步骤24，放于循环外测试");
      _Set_CarSpd(NRC22_CarSpd+1);
      _Set_CarSpd_Invalid(2);
      _TestDisableMsg(Struct_Ready.Sig_Id);
      testWaitForTimeout(2000);
      _Send_Diag(2,ID,Send_Data_01);
      _TestResult(SendData,ID,"",CarSpd_NRC);
      _Send_Diag(2,ID,Send_Data_81);
      _TestResult(SendData,ID,"",CarSpd_NRC);
      _TestEnableMsg(Struct_Ready.Sig_Id);
      testWaitForTimeout(2000);
      _WriteEx_and_Report("","步骤22-26测试结束");
    }
    else if(j==6)/*在Usgmode不满足且Usgmode和车速均丢失的前提下设计以下电压临界值步骤情况*/
    {
      float Temp[4]={1,2,3,4};
      _WriteEx_and_Report("","在Usgmode不满足且Usgmode和车速均丢失的前提下设计以下电压临界值步骤情况");
      Temp[0]=NRC22_Battery_Low+0.2;
      Temp[1]=NRC22_Battery_Hight-0.2;
      Temp[2]=NRC22_Battery_Low-0.2;
      Temp[3]=NRC22_Battery_Hight+0.2;
      _Set_Ready(0xD);
      _Set_CarSpd_Invalid(3);
      _Set_CarSpd(NRC22_CarSpd-1);
      testWaitForTimeout(1000);
      for(i=0;i<4;i++)
      {
        _Set_Battery(Temp[i]);
        _TestDisableMsg(Struct_Ready.Sig_Id);
        _TestDisableMsg(Struct_CarSpd.Sig_Id);
        testWaitForTimeout(2000);
        if(i<2)
        {
          _Send_Diag(2,ID,Send_Data_01);
          _TestResult(SendData,ID,"",-1);
          StepForGeelyServe11(Session);
          _Send_Diag(2,ID,Send_Data_81);
          _TestResult(SendData,ID,"",-1);
          StepForGeelyServe11(Session);
        }
        else if(i==2)
        {
          _Send_Diag(2,ID,Send_Data_01);
          _TestResult(SendData,ID,"",L_Battery_NRC);
          _Send_Diag(2,ID,Send_Data_81);
          _TestResult(SendData,ID,"",L_Battery_NRC);
        }
        else if(i==3)
        {
          _Send_Diag(2,ID,Send_Data_01);
          _TestResult(SendData,ID,"",H_Battery_NRC);
          _Send_Diag(2,ID,Send_Data_81);
          _TestResult(SendData,ID,"",H_Battery_NRC);
        }
        _TestEnableMsg(Struct_Ready.Sig_Id);
        _TestEnableMsg(Struct_CarSpd.Sig_Id);
        testWaitForTimeout(1000);
      }
      _Set_Battery(12);
      _WriteEx_and_Report("","步骤27-30测试结束");
    }
  }
  _Set_CarSpd(0);
  _Reset_CarSpd_Invalid();
}

void _Serve14_01(dword ID,byte Session) // 14 FF FF FF
{
  byte Temp[1];
  byte Temp_3[2] = {0x11,0x01};
  
  _Set_Ready(0);
  _Power_Down();
  testWaitForTimeout(1000); 
  _Power_Up(); //上下电排除之前DTC的干扰
  StepByGeely3_0(0x19,1);
  testWaitForTimeout(CAN_Init_Time);
  if(Session != defsession)
  {
    _SetSession(Session);
    diagStartTesterPresent(Cdd_Name);
  }
  testWaitForTimeout(200);
  _WriteEx_and_Report("步骤1","丢失所有节点再恢复，制造车速节点当前故障，读取故障并清除");
  _Close_All();
  testWaitForTimeout(5000);
  _Open_All();
  testWaitForTimeout(4000);
  _TestDisableMsg(Struct_CarSpd.Sig_Id);
  testWaitForTimeout(Struct_CarSpd.Lost_Time*1.2);
  _Send_09_Fault(phyreq_ID);
  _Check_DTC_Mask(Diag09,Struct_CarSpd.Lost_DTC,0x9);
  // _Check_DTC(Diag09,Struct_CarSpd.Lost_DTC);
  _Clear_DTC(ID);
  Temp[0] = 0x54;
  _Check_Response(ClearDTC,1,Temp);
  _WriteEx_and_Report("步骤2","故障成熟前后分别读取DTC");
  testWaitForTimeout(10);
  _85_Check_DTC(9,0);
  testWaitForTimeout(Struct_CarSpd.Lost_Time*1.2);
  _Send_09_Fault(phyreq_ID);
  _Check_DTC_Mask(Diag09,Struct_CarSpd.Lost_DTC,0x09);
  
  if(_Check_Serve(0x11,0x01,4) != -1)
  {
    
    _WriteEx_and_Report("步骤3","当前支持11 01进行复位相关测试");
    if((Session == defsession) && (_Check_Serve(0x11,0x01,2)==4) && (_Check_Serve(0x11,0x01,5) == 0))
      _SetSession(exsession);
    if(_Check_Serve(0x11,0x01,5) == 1)
      _unlockECU();
    _Send_Diag(2,phyreq_ID,Temp_3);
    _TestResult(SendData,phyreq_ID,"",-1);
    testWaitForTimeout(Wait_Time_11 + CAN_Init_Time + Struct_CarSpd.Lost_Time*1.2);
    if(Session != defsession)
      _SetSession(Session);
    
    _Send_09_Fault(phyreq_ID);
    _Check_DTC_Mask(Diag09,Struct_CarSpd.Lost_DTC,0x09);
    _WriteEx_and_Report("步骤4","恢复节点使其成为历史故障，读取故障");
    _TestEnableMsg(Struct_CarSpd.Sig_Id);
    testWaitForTimeout(Struct_CarSpd.Lost_Time*1.3);
    _Send_09_Fault(phyreq_ID);
    _Check_DTC_Mask(Diag09,Struct_CarSpd.Lost_DTC,0x08);
    _WriteEx_and_Report("步骤5","清除故障，等待故障成熟时间后再次读取故障");
    _Clear_DTC(ID);
    testWaitForTimeout(Struct_CarSpd.Lost_Time*1.3);
    _Check_DTC_Res(0x09,0,Struct_CarSpd.Lost_DTC);
    _WriteEx_and_Report("步骤6","重启后再次读取故障");
    if((Session == defsession) && (_Check_Serve(0x11,0x01,2)==4) && (_Check_Serve(0x11,0x01,5) == 0))
      _SetSession(exsession);
    if(_Check_Serve(0x11,0x01,5) == 1)
      _unlockECU();
    _Send_Diag(2,phyreq_ID,Temp_3);
    _TestResult(SendData,phyreq_ID,"",-1);
    testWaitForTimeout(Wait_Time_11 + CAN_Init_Time + Struct_CarSpd.Lost_Time*1.2);
    if(Session != defsession)
      _SetSession(Session);
    _Check_DTC_Res(0x09,0,Struct_CarSpd.Lost_DTC);
  }
}

void _Serve14_02(dword ID) //NRC13
{
  byte Temp_0[4]={0x14,0xff,0xff,0xff};
  dword Len;
  Len = _Check_CANFD_Flage();
  _WriteEx_and_Report("遍历","14 FF FF FF服务长度");
  for(i=1;i<=Len;i++)
  {
    if(i==4)
    {
      _WriteEx_and_Report("","当前长度已测试，跳过");
      continue;
    }
    _Send_Diag(i,ID,Temp_0);
    if(ID == phyreq_ID)
      _TestResult(SendData,ID,"",NRC13);
    else if(ID == funreq_ID && Fun_NRC13 == 1)
      _TestResult(SendData,ID,"",NRC13);
    else if(ID == funreq_ID && Fun_NRC13 == 0)
      _Check_NoResponse(SendData);
  }
}

void _Serve14_03(dword ID) //清除指定DTC
{
  byte Temp_0[4]={0x14,0xff,0xff,0xff};
  int i = 0;
  if(Clear_DTC_Ex == 0)   //不支持清除指定DTC
  {
    for(i=0;i<ALL_DTC_Num;i++)
    {
      Temp_0[1] = (ALL_DTC[i]>>16) &0xFF;
      Temp_0[2] = (ALL_DTC[i]>>8) &0xFF;
      Temp_0[3] = ALL_DTC[i] &0xFF;
      
      _Send_Diag(4,ID,Temp_0);
      _TestResult(SendData,ID,"",NRC31);
      testWaitForTimeout(30);
    }
  }
  else
  {
    byte Get_19[3]={0x19,0x02,0x09};
    dword DTC_Res[255],Res_Len;
    dword DTC_Res_2[255],Res_Len_2;
    byte DTC_ResCount;
    byte DTC_ResCount_2;
    dword DTC_ResCheck[255];
    byte DTC_ResCount_Check;
    dword DTC_NotRes[255];
    byte DTC_NotResCount;
    int n;
    DTC_ResCount = 0;
    DTC_NotResCount = 0;
    DTC_ResCount_Check =0;
    Get_19[2] = 0x09;
    diagStartTesterPresent(Cdd_Name);
    {        
      int m;
      StepByGeely3_0(0x19,1);
      for(m=0;m<DTC_19_Count;m++)
      {
        if(DTC_19[m][0] == Struct_Ready.Sig_Id && Geely3_Flage == 1)
          continue;
        _TestDisableMsg(DTC_19[m][0]);
      }
      testWaitForTimeout(3000);  //制造当前故障
      for(m=0;m<DTC_19_Count;m++)
        _TestEnableMsg(DTC_19[m][0]);
      testWaitForTimeout(3000);  //转为历史故障
      for(m=0;m<Node_Invalid_Count;m++)
      {
        if(Node_Invalid[m].Node == Struct_Ready.Sig_Id && Geely3_Flage == 1)
          continue;
        _Set_Sig(Node_Invalid[m].Signal_Name,Node_Invalid[m].Invalid_Value);
        testWaitForTimeout(Node_Invalid[m].Time*1.2);
        _Set_Sig(Node_Invalid[m].Signal_Name,Node_Invalid[m].Normal_Value);
        testWaitForTimeout(Node_Invalid[m].Time*1.2);
        // _Invalid_Node(Node_Invalid[m].Node);
        // _Set_Sig(Node_Invalid[i].Signal_Name,Node_Invalid[i].Invalid_Value);
        // testWaitForTimeout(500);
        // _Recover_Invalid_Node(Node_Invalid[m].Node);
        // testWaitForTimeout(500);
      }
      _Send_Diag(3,ID,Get_19);
      if(diagGetLastResponseCode(SendData)==0)
        testWaitForDiagResponse(SendData,2000);
      if(diagGetLastResponseCode(SendData)!= -1)
        testStepFail("","未收到正响应");
      else
      {
        Res_Len = DiagGetRespPrimitiveSize(SendData);
        DTC_ResCount = (Res_Len - 3)/4;
        for(i=0;i<DTC_ResCount;i++)
          DTC_Res[i] = (diagGetRespPrimitiveByte(SendData,i*4+3+0)<<16) | (diagGetRespPrimitiveByte(SendData,i*4+3+1)<<8) | (diagGetRespPrimitiveByte(SendData,i*4+3+2));
          
        for(i=0;i<DTC_19_Count;i++)
        {
          if(_Check_Dword_in_Num(DTC_19[i][1],DTC_Res,DTC_ResCount) == -1)
          {
            testStepFail("","0x%06X未在返回数据中",DTC_19[i][1]);
            DTC_NotRes[DTC_NotResCount] = DTC_19[i][1];
            DTC_NotResCount++;
          }
        }
        for(i=0;i<Node_Invalid_Count;i++)
        {
          if(_Check_Dword_in_Num(Node_Invalid[i].DTC,DTC_Res,DTC_ResCount) == -1)
          {
            testStepFail("","0x%06X未在返回数据中",Node_Invalid[i].DTC);
            DTC_NotRes[DTC_NotResCount] = DTC_19[i][1];
            DTC_NotResCount++;
          }
        }
        if(DTC_NotResCount == 0)
          testStepPass("","所有网络节点DTC均已获取到");
        //确保仅清除指定DTC
        for(i=0;i<DTC_ResCount;i++)
          DTC_ResCheck[i] = DTC_Res[i];
        DTC_ResCount_Check = DTC_ResCount;
        for(i=0;i<DTC_ResCount;i++)
        {
          DTC_ResCount_2 = 0;
          Res_Len_2 = 0;
          Temp_0[1] = (DTC_Res[i]>>16) &0xFF;
          Temp_0[2] = (DTC_Res[i]>>8) &0xFF;
          Temp_0[3] = DTC_Res[i] &0xFF;
          _Send_Diag(4,ID,Temp_0);
          _TestResult(SendData,ID,"",-1);
          testWaitForTimeout(200);/*增加200ms延时防止14服务响应过快但实际未处理完成*/
          _Send_Diag(3,ID,Get_19);
          if(diagGetLastResponseCode(SendData)==0)
            testWaitForDiagResponse(SendData,2000);
          if(diagGetLastResponseCode(SendData)!= -1)
            testStepFail("","未收到正响应");
          else
          {
            Res_Len_2 = DiagGetRespPrimitiveSize(SendData);
            DTC_ResCount_2 = (Res_Len_2 - 3)/4;
            for(n=0;n<DTC_ResCount_2;n++)
              DTC_Res_2[n] = (DiagGetPrimitiveByte(SendData,n*4+3+0)<<16) | (DiagGetPrimitiveByte(SendData,n*4+3+1)<<8) | (DiagGetPrimitiveByte(SendData,n*4+3+2));  //14清除后再次获取到的所有反馈DTC
            if(_Check_Dword_in_Num(DTC_Res[i],DTC_Res_2,DTC_ResCount_2) == -1)
              testStepPass("","指定DTC: 0x%X ,已被清除",DTC_Res[i]);
            else
              testStepFail("","指定DTC: 0x%X ,未被清除",DTC_Res[i]);
            if(DTC_ResCount_2!= DTC_ResCount_Check -1)
            {
              if(_Check_Dword_in_Num(DTC_Res[i],DTC_Whitelist,DTC_Whitelist_Count) == -1) //待清除DTC不在白名单中
              {
                if(DTC_ResCount_2 < DTC_ResCount_Check-1)
                  testStepFail("","有其余DTC被清除");
                else
                  testStepFail("","当前DTC个数与上次一致且待清除DTC不在白名单中,0x14未成功清除或出现新的DTC");
              }
              else
                _WriteEx_and_Report("","当前为白名单中故障,DTC清除后再次成熟");
            }
            
            //再获取第二次反馈的值做下一次判断的初始数组
            for(n=0;n<DTC_ResCount_2;n++)
              DTC_ResCheck[n] = DTC_Res_2[n];
            DTC_ResCount_Check = DTC_ResCount_2;
          }
        }
        //其余DTC仅判断正响应
        for(i=0;i<ALL_DTC_Num;i++)
        {
          if(_Check_Dword_in_Num(ALL_DTC[i],DTC_Res,DTC_ResCount) != -1)
            continue;
          Temp_0[1] = (ALL_DTC[i]>>16) &0xFF;
          Temp_0[2] = (ALL_DTC[i]>>8) &0xFF;
          Temp_0[3] = ALL_DTC[i] &0xFF;
          _Send_Diag(4,ID,Temp_0);
          _TestResult(SendData,ID,"",-1);
          testWaitForTimeout(500);
        }

        _WriteEx_and_Report("","重启后检测无其余故障");
        _Set_11_Restoration();
        testWaitForTimeout(CAN_Init_Time + 2000);
        _85_Check_DTC(9,0);
      }
    }
  }
}

void _Serve14_05(dword ID,dword Session)  /*NRC31*/
{
  byte Temp_0[4]={0x14,0xff,0xff,0xff};
  byte Send_14;
  int i,Flage;
  dword DTC_Check;
  Init_For_14();
  if(ID == phyreq_ID && Session == defsession)
    Send_14 = Serve_14_31[0];
  else if(ID == phyreq_ID && Session == exsession)
    Send_14 = Serve_14_31[1];
  else if(ID == funreq_ID && Session == defsession)
    Send_14 = Serve_14_31[2];
  else if(ID == funreq_ID && Session == exsession)
    Send_14 = Serve_14_31[3];
  Flage = 0;
  
  snprintf(Fault_Data_Write,elCount(Fault_Data_Write),"%s","");
  testGetCurrentTestCaseTitle(Fault_Data_Write,400);
  snprintf(Fault_Data_Write,elCount(Fault_Data_Write),"\n %s: \n    遍历14服务NRC31数据时,异常响应: \n",Fault_Data_Write);
  File_Write(Error_File,Error_FileName,Fault_Data_Write,2);
  
  if(Clear_DTC_Ex == 0)   //不支持清除指定DTC
  {
    for(i=0;i<ALL_DTC_Num;i++)
    {
      Temp_0[1] = (ALL_DTC[i]>>16) &0xFF;
      Temp_0[2] = (ALL_DTC[i]>>8) &0xFF;
      Temp_0[3] = ALL_DTC[i] &0xFF;
      
      _Send_Diag(4,ID,Temp_0);
      if(ID == phyreq_ID)
        _TestResult(SendData,ID,"",NRC31);
      else if(ID == funreq_ID)
        _Check_NoResponse(SendData);
    }
  }
  else
  {
    int Byte_M,Byte_L;
    Temp_0[1] = Send_14;
    for(Byte_M = 0;Byte_M <= 0xFF;Byte_M++) 
    {
      Temp_0[2] = Byte_M;
      for(Byte_L = 0;Byte_L <= 0xFF;Byte_L++)
      {
        Temp_0[3] = Byte_L;
        DTC_Check =( (Temp_0[1] << 16) | (Byte_M << 8) | (Byte_L) );
        if( _Check_Dword_in_Num(DTC_Check,ALL_DTC,ALL_DTC_Num) == -1)
        {
          _Send_Diag(4,ID,Temp_0);
          Flage = _TestResult(SendData,ID,"",NRC31);
          if(Flage == -1)
          {
            char Str[50];
            snprintf(Str,elCount(Str),"[ 0x%02X 0x%02X 0x%02X ] \n",Send_14,Byte_M,Byte_L);
            File_Write(Error_File,Error_FileName,Str,2);
          }
        }
      }
    }
  }
}

void _Serve14_06(dword ID,dword Session)  /*NRC优先级*/
{
  int Serve_Pos,i;
  byte Send_Data[100];
  
  Serve_Pos = _Check_Serve(0x14,0,0);
  if(_Check_Serve_IDAndSess(0x14,ID,Session) == 1)
  {
    Send_Data[0] = 0x14;
    _Set_NRC_Step(0x14,Serve_Data[Serve_Pos].Serve_Fun[0],6,Send_Data);
    if(Fun_NRC_Count == 0)
    {
      _WriteEx_and_Report("","未输入NRC，跳过测试");
      return;
    }
    for(i=0;i<=Fun_NRC_Count;i++)
    {
      if(i>0) //第一次反馈最高优先级不做处理,其余依次恢复
      {
        _Recover_NRC_Step(Fun_NRC[i-1],Serve_Pos,0,Send_Data);
      }
      if(i == Fun_NRC_Count)
      {
        _Send_Diag(Fun_NRC_Send_Len,ID,Send_Data);
        _TestResult(SendData,ID,"",-1);
      }
      else
      {
        _Send_Diag(Fun_NRC_Send_Len,ID,Send_Data);
        _TestResult(SendData,ID,"",Fun_NRC[i]);
      }
      testWaitForTimeout(100);
    }
  }
}

void _Serve14_07(dword ID,dword Session)  /*状态20/27测试*/
{
  dword DTC[100];
  byte Send[3] = {0x19,0x02,0x20};
  int i;
  if(Geely3_Flage == 1)
  {
    _Set_Ready(0);
    _Power_Down();
    testWaitForTimeout(1000); 
    _Power_Up(); //上下电排除之前DTC的干扰
    StepByGeely3_0(0x19,1);
    if(Session != defsession)
    {
      _SetSession(Session);
      diagStartTesterPresent(Cdd_Name);
    }
    _WriteEx_and_Report("Step","步骤1");
    testWaitForTimeout(200);
    _Close_All();
    testWaitForTimeout(5000);
    _Open_All();
    testWaitForTimeout(6000);
    for(i=0;i<DTC_19_Count;i++)
      DTC[i] = DTC_19[i][1];
    _TestDisableMsg(Struct_CarSpd.Sig_Id);
    testWaitForTimeout(Struct_CarSpd.Lost_Time*1.3);
    _Check_DTC(9,DTC);
    _Clear_DTC(ID);
    _Check_DTC_Res(0x09,0,Struct_CarSpd.Lost_DTC);
    testWaitForTimeout(Struct_CarSpd.Lost_Time*1.3);
    _Check_DTC_Res(0x09,Struct_CarSpd.Lost_DTC,0);
    _Set_11_Restoration();
    testWaitForTimeout(6000);
    _Check_DTC_Res(0x09,Struct_CarSpd.Lost_DTC,0);


    _WriteEx_and_Report("Step","步骤2");
    if(Session != defsession)
      _SetSession(Session);
    _TestEnableMsg(Struct_CarSpd.Sig_Id);
    testWaitForTimeout(Struct_CarSpd.Lost_Time*1.3);
    _Check_DTC_Res_InHis_NotNowOrHis(0x09,Struct_CarSpd.Lost_DTC,0);
    _Clear_DTC(ID);
    testWaitForTimeout(Struct_CarSpd.Lost_Time*1.3);
    _Check_DTC_Res(9,0,Struct_CarSpd.Lost_DTC);
    _Set_11_Restoration();
    testWaitForTimeout(6000);
    _Check_DTC_Res(9,0,Struct_CarSpd.Lost_DTC);

    _WriteEx_and_Report("Step","步骤3");
    if(Session != defsession)
      _SetSession(Session);
    _Close_All();
    testWaitForTimeout(5000);
    _Open_All();
    testWaitForTimeout(6000);
    Send[2] = 0x20;
    _Send_Diag(3,ID,Send);
    _Check_Response_DTC(SendData,DTC);
    _Clear_DTC(ID);
    testWaitForTimeout(3000);
    for(i=0;i<DTC_19_Count;i++)
      DTC[i] = 0;
    _Send_Diag(3,ID,Send);
    _Check_Response_DTC(SendData,DTC);
    _Clear_DTC(ID);
    testWaitForTimeout(3000);
    Send[2] = 0x27;
    _Send_Diag(3,ID,Send);
    _Check_Response_DTC(SendData,DTC);
  }
  else
    _WriteEx_and_Report("","非Geely3.0平台及以上项目，不测试此项内容");
}

void _Serve22_01(dword ID,byte Session)/*遍历需要判断的数据*/
{
  byte Temp_DID[3]={0x22,0x00,0x00};
  char Temp_Str[300];
  dword Fun_Temp;
  int m=0,Flage;
  
  if(_Check_Serve_IDAndSess(0x22,ID,Session) == 1)
  {
    snprintf(Fault_Data_Write,elCount(Fault_Data_Write),"%s","");
    testGetCurrentTestCaseTitle(Fault_Data_Write,400);
    snprintf(Fault_Data_Write,elCount(Fault_Data_Write),"\n %s: \n    遍历22DID数据时,异常响应: \n",Fault_Data_Write);
    File_Write(Error_File,Error_FileName,Fault_Data_Write,2);
    
    _get_Arry("Read_Now_Session");
    _get_Str_Traversal("DID_22_Traversal");
    for(m=0;m<Traversal_Count;m++)
    { 
      snprintf(Temp_Str,elCount(Temp_Str),"遍历22服务_%s",Traversal_DID[m]);
      creat_log("\\DID_22\\",Temp_Str); //单独生成logging日志存放，防止过大导致一个logging不好查看
      testStep(Traversal_DID[m],"--------------------------------分隔符--------------------------------");
      startLogging();
      if(m > 0)
        _SetSession(Session);
      _Get_DID(Traversal_DID[m]);
      Temp_DID[1] = DID_byte1;
      Temp_DID[2] = DID_byte2;
      Fun_Temp = ((DID_byte1<<8)|DID_byte2);
      if(_Check_Serve(0x22,Fun_Temp,5) == 1)
      {
        if(Session == defsession)
        {
          _WriteEx_and_Report("","当前DID：%04X 读取需要安全访问，默认会话下验证返回NRC31",Fun_Temp);
          _Send_Diag(3,ID,Temp_DID);
          _TestResult(SendData,ID,"",NRC31);
          continue;
        }
        _unlockECU();
      }
      Flage = _Check_22DID(ID,Temp_DID,Session,0);
      stopLogging();
      testWaitForTimeout(500);
      if(Flage == -1)
      {
        char Str[50];
        snprintf(Str,elCount(Str),"[  %s  ] \n",Traversal_DID[m]);
        File_Write(Error_File,Error_FileName,Str,2);
      }
    }
  }
  else
    _WriteEx_and_Report("","当前服务不支持");
}
void _Serve22_02(dword ID,byte Session)/*遍历需要判断的数据并验证异常写入*/
{
  byte Temp_DID[3]={0x22,0x00,0x00};
  char Temp_Str[300];
  dword Fun_Temp;
  int m=0,Flage;
  
  if(_Check_Serve_IDAndSess(0x22,ID,Session) == 1)
  {
    snprintf(Fault_Data_Write,elCount(Fault_Data_Write),"%s","");
    testGetCurrentTestCaseTitle(Fault_Data_Write,400);
    snprintf(Fault_Data_Write,elCount(Fault_Data_Write),"\n %s: \n    遍历22DID数据并异常写入时,异常响应: \n",Fault_Data_Write);
    File_Write(Error_File,Error_FileName,Fault_Data_Write,2);
    
    _get_Str_Traversal("DID_22_Traversal");
    for(m=0;m<Traversal_Count;m++)
    { 
      snprintf(Temp_Str,elCount(Temp_Str),"遍历22服务并异常写入_%s",Traversal_DID[m]);
      creat_log("\\DID_22\\",Temp_Str); //单独生成logging日志存放，防止过大导致一个logging不好查看
      testStep(Traversal_DID[m],"--------------------------------分隔符--------------------------------");
      startLogging();
      if(m > 0)
        _SetSession(Session);
      _Get_DID(Traversal_DID[m]);
      Temp_DID[1] = DID_byte1;
      Temp_DID[2] = DID_byte2;
      Fun_Temp = ((DID_byte1<<8)|DID_byte2);
      if(_Check_Serve(0x22,Fun_Temp,5) == 1)
      {
        if(Session == defsession)
        {
          _WriteEx_and_Report("","当前DID：%04X 读取需要安全访问，默认会话下验证返回NRC31",Fun_Temp);
          _Send_Diag(3,ID,Temp_DID);
          _TestResult(SendData,ID,"",NRC31);
          continue;
        }
        _unlockECU();
      }
      Flage = _Check_22DID(ID,Temp_DID,Session,1);
      stopLogging();
      testWaitForTimeout(500);
      if(Flage == -1)
      {
        char Str[50];
        snprintf(Str,elCount(Str),"[  %s  ] \n",Traversal_DID[m]);
        File_Write(Error_File,Error_FileName,Str,2);
      }
    }
  }
  else
    _WriteEx_and_Report("","当前服务不支持");
}

void _Serve22_03(dword ID,byte Session)/*NRC优先级*/
{
  int Serve_Pos,i;
  byte Send_Data[100];
  
  Serve_Pos = _Check_Serve(0x22,0,0);
  if(_Check_Serve_IDAndSess(0x22,ID,Session) == 1)
  {
    Send_Data[0] = 0x22;
    _Set_NRC_Step(0x22,Serve_Data[Serve_Pos].Serve_Fun[0],6,Send_Data);
    if(Fun_NRC_Count == 0)
    {
      _WriteEx_and_Report("","未输入NRC，跳过测试");
      return;
    }
    for(i=0;i<=Fun_NRC_Count;i++)
    {
      if(i>0) //第一次反馈最高优先级不做处理,其余依次恢复
      {
        _Recover_NRC_Step(Fun_NRC[i-1],Serve_Pos,0,Send_Data);
      }
      if(i == Fun_NRC_Count)
      {
        _Send_Diag(Fun_NRC_Send_Len,ID,Send_Data);
        _TestResult(SendData,ID,"",-1);
      }
      else
      {
        _Send_Diag(Fun_NRC_Send_Len,ID,Send_Data);
        _TestResult(SendData,ID,"",Fun_NRC[i]);
      }
      testWaitForTimeout(100);
    }
  }
}

void _Serve22_04(dword ID,byte Session)/*NRC13*/
{
  byte Temp_0[3]={0x22,0xF1,0x80}; 
  byte i;
  int Len;
  int Return_Va,Serve_Pos;
  Return_Va = _Check_Serve_IDAndSess(0x22,ID,Session);
  if(Return_Va == 1)
  {
    _get_Str_Traversal("DID_22_Traversal");
    _get_DID(Traversal_DID[0]);
    _WriteEx_and_Report("",Traversal_DID[0]);
    Temp_0[1] = DID_byte1;
    Temp_0[2] = DID_byte2;
    Len = _Check_CANFD_Flage();
    if(DID_22_Support > 1)
      Len = DID_22_Support*2+3;
    for(i=1;i<=Len;i++)
    {
      if((i%2==1)&&(i!=1)&&i<=DID_22_Support*2+1)
      {
        _WriteEx_and_Report("","当前长度支持，跳过检测");
        continue;
      }
      _Send_Diag(i,ID,Temp_0);
      _TestResult(SendData,ID,"",NRC13);
      testWaitForTimeout(300);
    }
  }
  else if(Return_Va == -1)
    _WriteEx_and_Report("","当前寻址不支持该服务");
  else if(Return_Va == 0)
    _WriteEx_and_Report("","当前会话不支持该服务");
}

void _Serve22_05(dword ID,byte Session)/*NRC31*/
{
  byte Send_Data[3]={0x22,0xF1,0x80}; 
  dword byte1,byte2,Fun_Send;
  int Return_Va;
  int Flage;
  Return_Va = _Check_Serve_IDAndSess(0x22,ID,Session);
  
  snprintf(Fault_Data_Write,elCount(Fault_Data_Write),"%s","");
  testGetCurrentTestCaseTitle(Fault_Data_Write,400);
  snprintf(Fault_Data_Write,elCount(Fault_Data_Write),"\n %s: \n    遍历22服务NRC31时,异常响应: \n",Fault_Data_Write);
  File_Write(Error_File,Error_FileName,Fault_Data_Write,2);
  
  if(Return_Va == 1)
  {
    if(Traversal_22==0)
    {
      for(byte1=0;byte1<=0xff;byte1++)
      {
        Send_Data[1]=byte1;
        for(byte2=0;byte2<=0xff;byte2++)
        {
          Send_Data[2]=byte2;
          Fun_Send = (byte1 << 8) ^ byte2;
          if(_Check_Serve(0x22,Fun_Send,4) != -1)
          {
            _WriteEx_and_Report("","该子功能支持，跳过检测");
            continue;
          }
          else
          {
            _Send_Diag(3,ID,Send_Data);
            Flage = _TestResult(SendData,ID,"",NRC31);
            testWaitForTimeout(10);
            if(Flage == -1)
            {
              char Str[30];
              snprintf(Str,elCount(Str),"[  0x%02X 0x%02X  ] \n",byte1,byte2);
              File_Write(Error_File,Error_FileName,Str,2);
            }
          }
        }
      } 
    }
    if(Traversal_22 != 0)
    {
      Send_Data[1] = Traversal_22;
      byte1 = Traversal_22;
      for(byte2=0;byte2<=0xff;byte2++)
      {
        Send_Data[2]=byte2;
        Fun_Send = (Traversal_22 << 8) ^ byte2;
        if(_Check_Serve(0x22,Fun_Send,4) != -1)
        {
          _WriteEx_and_Report("","该子功能支持，跳过检测");
          continue;
        }
        else
        {
          _Send_Diag(3,ID,Send_Data);
          Flage = _TestResult(SendData,ID,"",NRC31);
          testWaitForTimeout(10);
          if(Flage == -1)
          {
            char Str[30];
            snprintf(Str,elCount(Str),"[  0x%02X 0x%02X  ] \n",byte1,byte2);
            File_Write(Error_File,Error_FileName,Str,2);
          }
        }
      }
    }
  }
  else if(Return_Va == -1)
    _WriteEx_and_Report("","当前寻址不支持该服务");
  else if(Return_Va == 0)
    _WriteEx_and_Report("","当前会话不支持该服务");
}

void _Serve22_06(dword ID,byte Session)/*一次性读多个DID支持的DID*/
{
  DID_Read_Some(ID,Session,"DID_Read_Plural");
}
void _Serve22_07(dword ID,byte Session)/*一次性读多个相同DID支持的DID*/
{
  DID_Read_Some(ID,Session,"DID_Read_Plural_Same");
}
void _Serve22_08(dword ID,byte Session)/*一次性读多个DID部分支持*/
{
  DID_Read_Some(ID,Session,"DID_Read_Plural_Some_NotSupport");
}
void _Serve22_09(dword ID,byte Session)/*其他*/
{
  int i;
  if(DID_22_Support >1)
  {
    _Get_ReadPlural();
    if(Plural_DID_Count == 0)
    {
      _WriteEx_and_Report("","无其余测试情况输入");
      return;
    }
    for(i=0;i<Plural_DID_Count;i++)
    {
      writeEx(-3,0,"开始测试:   %s   ",Plural_DID[i]);
      DID_Read_Some(ID,Session,Plural_DID[i]);
    }
  }
  else
    _WriteEx_and_Report("","当前项目仅支持一次读取一组DID");
}


_Serve23_01(dword ID,byte Session)
{
  byte Send_Data_23[8] = {0x23,0x24,0,0,0,0,0,0};
  if(_Check_Serve_IDAndSess(0x23,ID,Session) != 1)
  {
    _Send_Diag(0x8,ID,Send_Data_23);
    _TestResult(SendData,ID,"",NRC7F);
  }
}
_Serve23_02(dword ID,byte Session)
{
  byte Send_Data_22[3] = {0x22,0xD1,0x23};
  byte Send_Data_23[20] ;
  byte DataSaveFor23[100];
  int i,j,Flage,StructPos,DataPos,m,PosForLen;
  struct SaveDataForD123
  {
    dword Addr[10];
    int Len[10];
    int AddrCount;
  };
  struct SaveDataForD123 SaveData;
  int ResLen,OffSet,CountLen;
  int LenLen,AddLen;
  GetInforMationFromVBF();
  _Send_Diag(0x3,ID,Send_Data_22);
  _TestResult(SendData,ID,"",-1);
  if(diagGetLastResponseCode(SendData) == -1)
  {
    ResLen = DiagGetRespPrimitiveSize(SendData);
    if(ResLen != 0x17)
      testStepFail("","返回长度异常，期望长度为0x17，实际长度为0x%02X",ResLen);
    else
      testStepPass("","长度与预期一致");
    if(DiagGetRespPrimitiveByte(SendData,3) != 0x03)
      testStepFail("","返回数据段个数异常，期望为0x03，实际长度为0x%02X",DiagGetRespPrimitiveByte(SendData,3));
    else
      testStepPass("","返回数据段个数与预期一致为3");
    if(DiagGetRespPrimitiveByte(SendData,4) != 0x24)
      testStepFail("","返回数据段个数异常，期望为0x24，实际长度为0x%02X",DiagGetRespPrimitiveByte(SendData,3));
    else
      testStepPass("","返回数据段个数与预期一致为0x24");
    OffSet = 5;
    LenLen = (DiagGetRespPrimitiveByte(SendData,4)>>4)&0xF;
    AddLen = (DiagGetRespPrimitiveByte(SendData,4))&0xF;
    CountLen = LenLen + AddLen;
    SaveData.AddrCount = (ResLen - OffSet)/CountLen;
    for(i=0;i<SaveData.AddrCount;i++) //装载所有文件地址
    {
      SaveData.Len[i] = 0;
      SaveData.Addr[i] = 0;
      for(j=0;j<LenLen;j++)
        SaveData.Len[i] = SaveData.Len[i] + (DiagGetRespPrimitiveByte(SendData,j+OffSet+i*CountLen)<<(8*(LenLen-j-1)));
      for(j=0;j<AddLen;j++)
        SaveData.Addr[i] = SaveData.Addr[i] + (DiagGetRespPrimitiveByte(SendData,LenLen+j+OffSet+i*CountLen)<<(8*(AddLen-j-1)));
    }
    for(i=0;i<SaveData.AddrCount;i++)
    {
      for(j=0;j<2;j++)
      {
        if((SaveData.Addr[i] == Struct_VBF_Addr[j].StartAddr[0])  || (SaveData.Addr[i] != Struct_VBF_Addr[j].StartAddr[0]+SaveData.Len[i]))
          break;
      }
      if(j>=2)
        testStepFail("","当前返回数据地址不在文件地址中");
      else
        testStepPass("","返回地址段在输入文件中");
    }
  }
  _unlockECU();
  Send_Data_23[0] = 0x23;Send_Data_23[1] = 0x24;
  for(m=0;m<3;m++)
  {
    PosForLen = 0;
    for(i=0;i<AddLen;i++)
      Send_Data_23[i+2] = (SaveData.Addr[m]>>((AddLen-i-1)*8)&0xFF);
    for(i=0;i<LenLen;i++)
      Send_Data_23[i+2+AddLen] = (SaveData.Len[m]>>((LenLen-i-1)*8)&0xFF);
    _Send_Diag(2+AddLen+LenLen,ID,Send_Data_23);
    _TestResult(SendData,ID,"",-1);
    if(StopForVBFTest == 1)
    {
      _WriteEx_and_Report("","后续数据无法验证,跳过数据验证步骤");
      return;
    }
    if(diagGetLastResponseCode(SendData) == -1)
    {
      ResLen = DiagGetRespPrimitiveSize(SendData);
      if(ResLen!= SaveData.Len[m]+1)
        testStepFail("","23 24返回的长度异常,期望为0x%X，实际为0x%X",SaveData.Len[m]+1,ResLen);
      for(i=1;i<ResLen;i++)
        DataSaveFor23[i-1] = DiagGetRespPrimitiveByte(SendData,i);
      Flage = 0;
      for(i=0;i<2;i++)
      {
        for(j=0;j<Struct_VBF_Addr[i].BlockCount;j++)
        {
          if(SaveData.Addr[m] == Struct_VBF_Addr[i].StartAddr[j])
          {
            DataPos = j;
            Flage = 1; break;
          }
          if(SaveData.Addr[m] == Struct_VBF_Addr[i].StartAddr[j]+SaveData.Len[m])
          {
            DataPos = j; PosForLen = SaveData.Len[m];
            Flage = 1; break;
          }
        }
        if(Flage == 1)
        {
          StructPos = i;
          break;
        }
      }
      Flage = 0;
      if(PosForLen == 0)
      {
        for(i=0;i<ResLen-2;i++)
        {
          if(DataSaveFor23[i] != Struct_VBF_Addr[StructPos].DataSave[i])
          {
            testStepFail("","期望第 %d 数据位返回为0x%02X ,实际返回数据为0x%02X",i,Struct_VBF_Addr[StructPos].DataSave[i],DataSaveFor23[i]);
            Flage = 1;
          }
        }
      }
      else
      {
        for(i=0;i<ResLen-2;i++)
        {
          if(DataSaveFor23[i] != Struct_VBF_Addr[StructPos].DataSave[i+PosForLen])
          {
            testStepFail("","期望第 %d 数据位返回为0x%02X ,实际返回数据为0x%02X",i,Struct_VBF_Addr[StructPos].DataSave[i+PosForLen],DataSaveFor23[i]);
            Flage = 1;
          }
        }
      }
      if(Flage == 0)
        testStepPass("","返回数据与文件中数据完全一致");
    }
  }
}
void _Serve23_03(dword ID,byte Session)/*NRC优先级*/
{
  int Serve_Pos,i;
  byte Send_Data[100];
  Serve_Pos = _Check_Serve(0x23,0,0);
  if(_Check_Serve_IDAndSess(0x23,ID,Session) == 1)
  {
    GetInforMationFromVBF();
    if(StopForVBFTest == 1)
      return;
    Send_Data[0] = 0x23;
    _Set_NRC_Step(0x23,Serve_Data[Serve_Pos].Serve_Fun[0],6,Send_Data);
    if(Fun_NRC_Count == 0)
    {
      _WriteEx_and_Report("","未输入NRC，跳过测试");
      return;
    }
    for(i=0;i<=Fun_NRC_Count;i++)
    {
      if(i>0) //第一次反馈最高优先级不做处理,其余依次恢复
      {
        _Recover_NRC_Step(Fun_NRC[i-1],Serve_Pos,0,Send_Data);
      }
      if(i == Fun_NRC_Count)
      {
        _Send_Diag(Fun_NRC_Send_Len,ID,Send_Data);
        _TestResult(SendData,ID,"",-1);
      }
      else
      {
        _Send_Diag(Fun_NRC_Send_Len,ID,Send_Data);
        _TestResult(SendData,ID,"",Fun_NRC[i]);
      }
      if( Fun_NRC[i] == 0x31 && NRC31_Count == 1 && NRC31_total == 2)
      {        
        int k;
        _WriteEx_and_Report("","测试地址错误长度正确");
        Send_Data[6] = 0;
        Send_Data[7] = 3;
        _Send_Diag(Fun_NRC_Send_Len,ID,Send_Data);
        _TestResult(SendData,ID,"",Fun_NRC[i]);
        testWaitForTimeout(100);
        Send_Data[6] = 0;
        Send_Data[7] = 0;
        for(k=0;k<4;k++) //默认地址占4个长度
          Send_Data[k+2] = (Struct_VBF_Addr[0].StartAddr[0]>>((4-k-1)*8)&0xFF);
        _Send_Diag(Fun_NRC_Send_Len,ID,Send_Data);
        _TestResult(SendData,ID,"",Fun_NRC[i]);
      }
      testWaitForTimeout(100);
    }
  }
}
void _Serve23_04(dword ID,byte Session)/*NRC13*/
{
  int Serve_Pos,i,Len;
  byte Send_Data[100];
  Serve_Pos = _Check_Serve(0x23,0,0);
  if(_Check_Serve_IDAndSess(0x23,ID,Session) == 1)
  {
    GetInforMationFromVBF();
    if(StopForVBFTest == 1)
      return;
    Send_Data[0] = 0x23; Send_Data[1] = 0x24;
    for(i=0;i<4;i++) //默认地址占4个长度
      Send_Data[i+2] = (Struct_VBF_Addr[0].StartAddr[0]>>((4-i-1)*8)&0xFF);
    Send_Data[6] = 0;Send_Data[7] = 0x03;
    Len = _Check_CANFD_Flage();
    if(Len < Serve_Data[Serve_Pos].Serve_Fun_Len[0])
      Len = Serve_Data[Serve_Pos].Serve_Fun_Len[0]+1;
    _unlockECU();
    for(i=1;i<=Len;i++)
    {
      if(i==Serve_Data[Serve_Pos].Serve_Fun_Len[0])
        continue;
      _Send_Diag(i,ID,Send_Data);
      _TestResult(SendData,ID,"",NRC13);
      testWaitForTimeout(20);
    }
  }
}
void _Serve23_05(dword ID,byte Session)/*NRC31 地址和长度格式标识符*/
{
  int Serve_Pos,i;
  byte Send_Data[100];
  Serve_Pos = _Check_Serve(0x23,0,0);
  if(_Check_Serve_IDAndSess(0x23,ID,Session) == 1)
  {
    GetInforMationFromVBF();
    if(StopForVBFTest == 1)
      return;
    Send_Data[0] = 0x23; 
    for(i=0;i<4;i++) //默认地址占4个长度
      Send_Data[i+2] = (Struct_VBF_Addr[0].StartAddr[0]>>((4-i-1)*8)&0xFF);
    Send_Data[6] = 0;Send_Data[7] = 0x03;
    _unlockECU();
    for(i=0;i<=0xFF;i++)
    {
      Send_Data[1] = i;
      if(i==Serve_Data[Serve_Pos].Serve_Fun[0])
        continue;
      _Send_Diag(Serve_Data[Serve_Pos].Serve_Fun_Len[0],ID,Send_Data);
      _TestResult(SendData,ID,"",NRC31);
      testWaitForTimeout(20);
    }
  }
}
void _Serve23_06(dword ID,byte Session)/*请求报文中地址内存无效*/
{
  byte Send_Data[100];
  int Serve_Pos,i;
  Serve_Pos = _Check_Serve(0x23,0,0);
  if(_Check_Serve_IDAndSess(0x23,ID,Session) == 1)
  {
    Send_Data[0] = 0x23; Send_Data[1] = 0x24;
    Send_Data[6] = 0;    Send_Data[7] = 0x03;
    for(i=2;i<6;i++)
      Send_Data[i] = 0xFF;
    _unlockECU();
    _Send_Diag(Serve_Data[Serve_Pos].Serve_Fun_Len[0],ID,Send_Data);
    _TestResult(SendData,ID,"",NRC31);
  }
}
void _Serve23_07(dword ID,byte Session)/*请求报文中地址内存被限制*/
{
  byte Send_Data[100];
  int Serve_Pos,i;
  Serve_Pos = _Check_Serve(0x23,0,0);
  if(_Check_Serve_IDAndSess(0x23,ID,Session) == 1)
  {
    Send_Data[0] = 0x23; Send_Data[1] = 0x24;
    Send_Data[6] = 0;    Send_Data[7] = 0x03;
    GetInforMationFromVBF();
    if(StopForVBFTest == 1)
      return;
    for(i=0;i<4;i++) //默认地址占4个长度
      Send_Data[i+2] = (Struct_VBF_Addr[0].StartAddr[0]>>((4-i-1)*8)&0xFF);
    Send_Data[3] = Send_Data[3]+0x01;
    _unlockECU();
    _Send_Diag(Serve_Data[Serve_Pos].Serve_Fun_Len[0],ID,Send_Data);
    _TestResult(SendData,ID,"",NRC31);
  }
}
void _Serve23_08(dword ID,byte Session)/*请求报文中不支持的内存大小*/
{
  byte Send_Data[100];
  int Serve_Pos,i;
  Serve_Pos = _Check_Serve(0x23,0,0);
  if(_Check_Serve_IDAndSess(0x23,ID,Session) == 1)
  {
    Send_Data[0] = 0x23; Send_Data[1] = 0x24;
    Send_Data[6] = 0xFF;    Send_Data[7] = 0xFF;
    GetInforMationFromVBF();
    if(StopForVBFTest == 1)
      return;
    for(i=0;i<4;i++) //默认地址占4个长度
      Send_Data[i+2] = (Struct_VBF_Addr[0].StartAddr[0]>>((4-i-1)*8)&0xFF);
    _unlockECU();
    _Send_Diag(Serve_Data[Serve_Pos].Serve_Fun_Len[0],ID,Send_Data);
    _TestResult(SendData,ID,"",NRC31);
  }
}
void _Serve23_09(dword ID,byte Session)/*请求报文中内存大小参数值为0*/
{
  byte Send_Data[100];
  int Serve_Pos,i;
  Serve_Pos = _Check_Serve(0x23,0,0);
  if(_Check_Serve_IDAndSess(0x23,ID,Session) == 1)
  {
    Send_Data[0] = 0x23; Send_Data[1] = 0x24;
    Send_Data[6] = 0;    Send_Data[7] = 0;
    GetInforMationFromVBF();
    if(StopForVBFTest == 1)
      return;
    for(i=0;i<4;i++) //默认地址占4个长度
      Send_Data[i+2] = (Struct_VBF_Addr[0].StartAddr[0]>>((4-i-1)*8)&0xFF);
    _unlockECU();
    _Send_Diag(Serve_Data[Serve_Pos].Serve_Fun_Len[0],ID,Send_Data);
    _TestResult(SendData,ID,"",NRC31);
  }
}


// _27_Serve_01(dword ID,byte Session) /*7F>13*/
// {
//   byte Temp_0[2]={0x27,0x01};
//   int i,Serve_Pos;
//   Serve_Pos = _Check_Serve(0x27,0,0);
//   for(i=0;i<Serve_Data[Serve_Pos].Serve_Fun_Count;i++)
//   {
//     Temp_0[1]=Serve_Data[Serve_Pos].Serve_Fun[i];
//     if(_Check_Fun_IDAndSess(0x27,Temp_0[1],ID,Session)==0)
//     {
//       _Send_Diag(Serve_Data[Serve_Pos].Serve_Fun_Len[i]-1,ID,Temp_0);
//       _TestResult(SendData,ID,"",NRC7F);
//     }
//   }
// }
_27_Serve_02(dword ID,byte Session) /*支持的子功能*/
{
  byte Temp[2]={0x27,0x00};
  _WriteEx_and_Report("","检测安全访问");
  _unlockECU();
  if(APP_BT_27_Flage==1)
  {
    _WriteEx_and_Report("","BT与APP不一致，检测APP下请求BT支持的子功能");
    DiagSetPrimitiveByte(reqseed,1,BT_RequestSeed_27);
    DiagSetPrimitiveByte(sendkey,1,BT_SendKey_27);
    _SendAndWriteReport(reqseed,ID);
    if(diagGetLastResponseCode(reqseed) == 0x7E)
      _TestResult(reqseed,ID,"",NRC7E);
    else
      _TestResult(reqseed,ID,"",NRC12);
    _SendAndWriteReport(sendkey,ID);
    if(diagGetLastResponseCode(sendkey) == 0x7E)
      _TestResult(sendkey,ID,"",NRC7E);
    else
      _TestResult(sendkey,ID,"",NRC12);
  }
  DiagSetPrimitiveByte(reqseed,1,RequestSeed_27);
  DiagSetPrimitiveByte(sendkey,1,SendKey_27);
  Temp[1] = RequestSeed_27;
  if(_Check_Serve(0x27,RequestSeed_27,9)==1)
  {
    _WriteEx_and_Report("","当支持肯定响应抑制位时检测返回结果");
    DiagSetPrimitiveByte(reqseed,1,RequestSeed_27|0x80);
    DiagSetPrimitiveByte(sendkey,1,SendKey_27|0x80);
    _SendAndWriteReport(sendkey,ID);
    _TestResult(sendkey,ID,"",NRC24);
    _SendAndWriteReport(reqseed,ID);
    _Check_NoResponse(reqseed);
    _SendAndWriteReport(sendkey,ID);
    _TestResult(sendkey,ID,"",NRC24);
  }
  else if(_Check_Serve(0x27,RequestSeed_27,9)==0)
  {
    _WriteEx_and_Report("","不支持肯定响应抑制位时检测返回结果");
    DiagSetPrimitiveByte(reqseed,1,RequestSeed_27|0x80);
    DiagSetPrimitiveByte(sendkey,1,SendKey_27|0x80);
    _SendAndWriteReport(sendkey,ID);
    _TestResult(sendkey,ID,"",NRC12);
    _SendAndWriteReport(reqseed,ID);
    _TestResult(sendkey,ID,"",NRC12);
    _SendAndWriteReport(sendkey,ID);
    _TestResult(sendkey,ID,"",NRC12);
  }
}
// _27_Serve_05(dword ID,byte Session) /*已解锁状态-会话切换*/
// {
//   dword seed;
//   dword skey;
//   byte data[2]={0x10,0x02};
//   seed = _get_seed(ID);
//   _Send_Key(SendKey_Len,ID,seed,0);
//   Get_Seed_Flage = 1;
//   if(diagGetLastResponseCode(SendData)==-1)
//     testStepPass("","收到正响应");
//   else
//     testStepFail("","未收到正响应");
//   _WriteEx_and_Report("","切换会话由10 01->10 03");
//   _SetSession(defsession);
//   _SetSession(Session);
//   seed = _get_seed(ID);
//   _Send_Key(SendKey_Len,ID,seed,0);
//   if(diagGetLastResponseCode(SendData)==-1)
//     testStepPass("","收到正响应");
//   else
//     testStepFail("","未收到正响应");
//   _WriteEx_and_Report("","切换会话10 03");
//   _SetSession(exsession);
//   seed = _get_seed(ID);
//   _Send_Key(SendKey_Len,ID,seed,0);
//   if(diagGetLastResponseCode(SendData)==-1)
//     testStepPass("","收到正响应");
//   else
//     testStepFail("","未收到正响应");
//   if(_Check_Serve(0x10,0x02,4)!=-1)
//   {
//     _WriteEx_and_Report("","进入10 02");
//     if(Pre_Programmed_1002 == 1 )
//     {
//         _get_Arry("Pre_Programmed");
//         _Send_Diag(Arry_Len,phyreq_ID,Arry_Data);
//         _TestResult(SendData,phyreq_ID,"",-1);
//     }
//         _Send_Diag(2,phyreq_ID,data);
//         _TestResult(SendData,phyreq_ID,"",-1);
        
//         testWaitForTimeout(2000);
//         _WriteEx_and_Report("","切换会话由10 01->10 03");
//         _SetSession(defsession);
//         testWaitForTimeout(2000);
//         _SetSession(Session);
//         seed = _get_seed(ID);
//         _Send_Key(SendKey_Len,ID,seed,0);
//         if(diagGetLastResponseCode(SendData)==-1)
//           testStepPass("","收到正响应");
//         else
//           testStepFail("","未收到正响应");
    
//    _Check_Repeat(4,1);
//   }
//   else
//     _Check_Repeat(3,1);
// }

_27_Serve_06(dword ID,byte Session)   /*不正确的报文对错误计数影响测试*/
{
  byte Temp[2]={0x27,0x01};
  byte Temp_1[6]={0x27,0x01,0x11,0x11,0x11,0x11};
  byte i,seed;
  
  Temp[1] = RequestSeed_27+0x02;
  _Send_Diag(1,ID,Temp);
  _TestResult(SendData,ID,"",NRC13);
  Temp_1[1] = Temp[1] + 0x01;
  _Send_Diag(SendKey_Len+1,ID,Temp_1);
  _TestResult(SendData,ID,"",Response_Serve_NRC(0x27,6,0x12,0x13,0));
  
  Temp[1] = RequestSeed_27+0x02;
  if(RequestSeed_27==0x07)
    Temp[1] = 0x01;
  Temp_1[1] = Temp[1] + 0x01;
  _Send_Diag(2,ID,Temp);
  _TestResult(SendData,ID,"",NRC12);
  _Send_Diag(SendKey_Len,ID,Temp_1);
  _TestResult(SendData,ID,"",NRC12);
  
  _Check_Error_Count(ID,Error_Count-1);
  _Send_Key(SendKey_Len,ID,_get_seed(ID),0);
  _TestResult(SendData,ID,"",-1);
  if(diagGetLastResponseCode(SendData)!=-1)
  {
    diagStartTesterPresent(Cdd_Name);
    testWaitForTimeout(Error_Count_Delay*1.1+1000);
    _Send_Key(SendKey_Len,ID,_get_seed(ID),0);
    if(diagGetLastResponseCode(SendData)==-1)
      testStepPass("","收到正响应");
    else
    {
      testStepFail("","未收到正响应");
      testWaitForTimeout(10000);
    }
  }
}

_27_Serve_07(dword ID,byte Session)  /*连续请求种子*/
{
  dword seed;
  int i;
  diagStartTesterPresent(Cdd_Name);
  if(Request_Error_Count==1)
  {
    for(i=1;i<Error_Count+2;i++)
    {
      _get_seed(ID);
      if(ReqSeed_Count == 1 && i == Error_Count+1)
        _TestResult(SendData,ID,"",NRC36);
      else
        _TestResult(SendData,ID,"",-1);
      Get_Seed_Flage = 1;
    }
    _Check_Repeat(Error_Count+1);
    _get_seed(ID);
    _TestResult(SendData,ID,"",NRC37);
    if(Error_Count_Change==1)
    {
      testWaitForTimeout(Error_Count_Delay+3000);
      for(i=0;i<2;i++)
      {
        _get_seed(ID);
        _TestResult(SendData,ID,"",-1);
      }
      _Check_Repeat(2);
      _get_seed(ID);
      _TestResult(SendData,ID,"",NRC37);
    }
    else if(Error_Count_Change==0)
    {
       for(i=1;i<Error_Count+2;i++)
        {
          _get_seed(ID);
          if(ReqSeed_Count == 1 && i == Error_Count+1)
            _TestResult(SendData,ID,"",NRC36);
          else
            _TestResult(SendData,ID,"",-1);
        }
        _Check_Repeat(Error_Count+1);
        _get_seed(ID);
        _TestResult(SendData,ID,"",NRC37);
    }
    if(strncmp(ECU_project,"Seres",strlen(ECU_project)) == 0 && strlen(ECU_project) == strlen("Seres"))
      testWaitForTimeout(101000);
    else
      testWaitForTimeout(Error_Count_Delay+3000);
    _Send_Key(SendKey_Len,ID,_get_seed(ID),1);
    if(Error_Count_Change == 1)
      _TestResult(SendData,ID,"",NRC37);
    else
      _TestResult(SendData,ID,"",NRC35);
    if(strncmp(ECU_project,"Seres",strlen(ECU_project)) == 0 && strlen(ECU_project) == strlen("Seres"))
      testWaitForTimeout(1001000);
    else
      testWaitForTimeout(Error_Count_Delay+3000);
    _Send_Key(SendKey_Len,ID,_get_seed(ID),0);
    _TestResult(SendData,ID,"",-1);
  }
  else if(Request_Error_Count==0)
  {
    for(i=0;i<=Error_Count+3;i++)
    {
      _get_seed(ID);
      _TestResult(SendData,ID,"",-1);
      Get_Seed_Flage = 1;
    }
    _Check_Repeat(Error_Count+4);
    _Check_Error_Count(ID,Error_Count);
    testWaitForTimeout(Error_Count_Delay+3000);
    _Send_Key(SendKey_Len,ID,_get_seed(ID),0);
    _TestResult(SendData,ID,"",-1);
  }
}
_27_Serve_07_(dword ID,byte Session)  /*连续请求种子*/
{
  dword seed;
  int i;
  diagStartTesterPresent(Cdd_Name);
  if(Request_Error_Count==1)
  {
    /*连续请求*/
    {
      for(i=0;i<Error_Count;i++)
      {
        seed = _get_seed(ID);
        _TestResult(SendData,ID,"",-1);
        Get_Seed_Flage = 1;
      }
      _Check_Repeat(Error_Count);
      _Send_Key(SendKey_Len,ID,seed,1);
      _TestResult(SendData,ID,"",NRC36);
      _get_seed(ID);
      _TestResult(SendData,ID,"",NRC37);
      testWaitForTimeout(Error_Count_Delay+3000);
      _Send_Key(SendKey_Len,ID,_get_seed(ID),0);
      _TestResult(SendData,ID,"",-1);
    }
    _SetSession(defsession);
    testWaitForTimeout(100);
    _SetSession(exsession);
    /*不连续请求*/
    {
      for(i=0;i<Error_Count-1;i++)
      {
        seed = _get_seed(ID);
        _TestResult(SendData,ID,"",-1);
        Get_Seed_Flage = 1;
      }
      _Check_Repeat(Error_Count-1);
      _Send_Key(SendKey_Len,ID,seed,1);
      _TestResult(SendData,ID,"",NRC35);
      _get_seed(ID);
      _TestResult(SendData,ID,"",-1);
      _get_seed(ID);
      _TestResult(SendData,ID,"",-1);
      _get_seed(ID);
      _TestResult(SendData,ID,"",NRC37);
      testWaitForTimeout(Error_Count_Delay+3000);
      _Send_Key(SendKey_Len,ID,_get_seed(ID),0);
      _TestResult(SendData,ID,"",-1);
    }
  }
  else
    _WriteEx_and_Report("","连续请求种子错误计数器不累加，跳过测试");
}
_27_Serve_08(dword ID,byte Session)  /*延时时间*/
{
  double starttime;
  double endtime;
  double Change_Time;
  double CountTime;
  byte Temp[2] = {0x27,0x01};
  message * MSG;
  int i,re;
  i=0;
  Temp[1] = RequestSeed_27;
  do{
    _Send_Key(SendKey_Len,ID,_get_seed(ID),1);
    i++;
  }while((diagGetLastResponseCode(SendData)!=NRC36) && i<=Error_Count+10);
  Get_Seed_Flage = 1;
  starttime=(double)timeNow()/100;
  do
  {
    _get_seed_Send(ID);  /*用于屏蔽NRC78导致的时间错误*/
    re = testWaitForMessage(Response_ID,p2cmax);
    if(re>0)
      testGetWaitEventMsgData(MSG);
    CountTime = (double)timeNow()/100;
  }while(re>0 && MSG.byte(3)!=0x78 && MSG.byte(1)!=0x67 && MSG.byte(2)!=0x67 && (CountTime-starttime)<=Error_Count_Delay*1.5);
  endtime=(double)timeNow()/100;
  Change_Time = endtime-starttime;
  if((CountTime-starttime)>=Error_Count_Delay*1.5)
    _WriteEx_and_Report("","长时间未收到正响应,提前终止防止卡死");
  writeEx(-3,0," 当前从NRC36到正常响应种子时间为 %.2f ms ",Change_Time);
  if(Error_Count_Delay - Error_Count_Delay_Tolerance<=Change_Time && Change_Time<=Error_Count_Delay + Error_Count_Delay_Tolerance)
    testStepPass("","当前从NRC36到正常响应种子时间为 %.2f ms",Change_Time);
  else
    testStepFail("","当前从NRC36到正常响应种子时间为 %.2f ms",Change_Time);
  testWaitForTimeout(Error_Count_Delay+3000);
  _SetSession(exsession);
  _Send_Key(SendKey_Len,ID,_get_seed(ID),0);
}
_27_Serve_09(dword ID,byte Session)   /*延时时间执行规则*/
{
  int i;
  dword seed;
  if(strncmp(ECU_project,"Seres",strlen(ECU_project)) == 0 && strlen(ECU_project) == strlen("Seres"))
  {
    diagStartTesterPresent(Cdd_Name);
    for(i=1;i<=Error_Count;i++)
    {
      _Send_Key(SendKey_Len,ID,_get_seed(ID),1);
    }
    seed = _get_seed(ID);
    _TestResult(SendData,ID,"",NRC37);
    _Send_Key(SendKey_Len,ID,seed,1);
    _TestResult(SendData,ID,"",NRC24);
    testWaitForTimeout(10000*1.1);
    seed = _get_seed(ID);
    _TestResult(SendData,ID,"",-1);
    _Send_Key(SendKey_Len,ID,seed,1);
    _TestResult(SendData,ID,"",NRC36);
    testWaitForTimeout(85000);
    seed = _get_seed(ID);
    _TestResult(SendData,ID,"",NRC37);
    _Send_Key(SendKey_Len,ID,seed,1);
    _TestResult(SendData,ID,"",NRC24);
    testWaitForTimeout(20000);
    seed = _get_seed(ID);
    _TestResult(SendData,ID,"",-1);
    _Send_Key(SendKey_Len,ID,seed,1);
    _TestResult(SendData,ID,"",NRC36);
    testWaitForTimeout(850000);
    seed = _get_seed(ID);
    _TestResult(SendData,ID,"",NRC37);
    _Send_Key(SendKey_Len,ID,seed,1);
    _TestResult(SendData,ID,"",NRC24);
    testWaitForTimeout(160000);
    seed = _get_seed(ID);
    _TestResult(SendData,ID,"",-1);
    _Send_Key(SendKey_Len,ID,seed,1);
    _TestResult(SendData,ID,"",NRC36);
    testWaitForTimeout(850000);
    seed = _get_seed(ID);
    _TestResult(SendData,ID,"",NRC37);
    _Send_Key(SendKey_Len,ID,seed,1);
    _TestResult(SendData,ID,"",NRC24);
    testWaitForTimeout(160000);
    seed = _get_seed(ID);
    _TestResult(SendData,ID,"",-1);
    _Send_Key(SendKey_Len,ID,seed,0);
    _TestResult(SendData,ID,"",-1);
    _SetSession(exsession);
    for(i=1;i<Error_Count;i++)
    {
      _Send_Key(SendKey_Len,ID,_get_seed(ID),1);
      _TestResult(SendData,ID,"",NRC35);
    }
    _Send_Key(SendKey_Len,ID,_get_seed(ID),1);
    _TestResult(SendData,ID,"",NRC36);
    testWaitForTimeout(10000*1.1);
    _Send_Key(SendKey_Len,ID,_get_seed(ID),0);
    _TestResult(SendData,ID,"",-1);
  }
  else
  {
    _WriteEx_and_Report(ECU_project,"当前项目非赛力斯,跳过该条测试");
    testStepPass("","");
  }
}
_27_Serve_10(dword ID,byte Session)   /*延时时间届满-错误计数器处理*/
{
  int i;
  dword seed;
  diagStartTesterPresent(Cdd_Name);
  _Check_Error_Count(ID,Error_Count);
  seed = _get_seed(ID);
  _TestResult(SendData,ID,"",NRC37);
  testWaitForTimeout(Error_Count_Delay+3000);
  if(Error_Count_Change==1)
  {
    _Send_Key(SendKey_Len,ID,_get_seed(ID),1);
    _TestResult(SendData,ID,"",NRC36);
    seed = _get_seed(ID);
    _TestResult(SendData,ID,"",NRC37);
    _Send_Key(SendKey_Len,ID,seed,1);
    _TestResult(SendData,ID,"",NRC24);
  }
  else if(Error_Count_Change==0)
  {
    _Check_Error_Count(ID,Error_Count);
    seed = _get_seed(ID);
    _TestResult(SendData,ID,"",NRC37);
    _Send_Key(SendKey_Len,ID,seed,1);
    _TestResult(SendData,ID,"",NRC24);
  }
  if(strncmp(ECU_project,"Seres",strlen(ECU_project)) == 0 && strlen(ECU_project) == strlen("Seres"))
  {
    testWaitForTimeout(100000);
  }
//  testWaitForTimeout(Error_Count_Delay+3000);
//  if(Error_Count_Change == 1)
//  {
//    _Clear_Seed();
//    _get_seed(ID);
//    _get_seed(ID);
//    _get_seed(ID);
//    _TestResult(SendData,ID,"",NRC37);
//    if(Request_Seed_Consistency == 1)
//      _Check_Repeat(2);
//    else
//      _Check_Repeat(2,1);
//  }
  testWaitForTimeout(Error_Count_Delay+3000);
  _Send_Key(SendKey_Len,ID,_get_seed(ID),0);
  _TestResult(SendData,ID,"",-1);
}

_27_Serve_11(dword ID,byte Session)    /*未解锁状态-会话切换*/
{
  int i;
  dword seed;
  byte Data[2] = {0x10,0x02};
  byte Flage_;
  Flage_= 0;
  diagStartTesterPresent(Cdd_Name);
  if(Error_Count>=3)
  {
    _Send_Key(SendKey_Len,ID,_get_seed(ID),1);
    _TestResult(SendData,ID,"",NRC35);
    testWaitForTimeout(50);
    _SetSession(defsession);
    _SetSession(exsession);
    _Send_Key(SendKey_Len,ID,_get_seed(ID),1);
    _TestResult(SendData,ID,"",NRC35);
    testWaitForTimeout(100);
    if(Unlock_1002==1)
      _WriteEx_and_Report("","10 02有安全访问条件,跳过测试");
    else 
    {
      if(Pre_Programmed_1002 == 1 && Pre_Programmed_UnlockECU ==1)
        _WriteEx_and_Report("","10 02有预编程条件且需安全访问,跳过测试");
      else if(Pre_Programmed_1002 == 1 && Pre_Programmed_UnlockECU == 0)
      {
        Flage_ = 1;
        _get_Arry("Pre_Programmed");
        if(Arry_Len == 0)
          _WriteEx_and_Report("","未查询到对应预编程报文");
        else
        {
          _Send_Diag(Arry_Len,phyreq_ID,Arry_Data);
          _TestResult(SendData,phyreq_ID,"",-1);
        }
      }
      else if(Pre_Programmed_1002==0)
        Flage_ = 1;
      if(Flage_ == 1)
      {
        _Send_Diag(2,phyreq_ID,Data);
        _TestResult(SendData,phyreq_ID,"",-1);
        testWaitForTimeout(2000);
        _SetSession(defsession);
        testWaitForTimeout(1000);
      }
    }
    testWaitForTimeout(1000);
    _SetSession(exsession);
    for(i=3;i<=Error_Count;i++)
    {
      if(i==Error_Count)
      {
        _Send_Key(SendKey_Len,ID,_get_seed(ID),1);
        _TestResult(SendData,ID,"",NRC36);
      }
      else
      {
        _Send_Key(SendKey_Len,ID,_get_seed(ID),1);
        _TestResult(SendData,ID,"",NRC35);
      }
      testWaitForTimeout(50);
    }
    testWaitForTimeout(Error_Count_Delay*0.7);
    _SetSession(exsession);
    seed = _get_seed(ID);
    _TestResult(SendData,ID,"",NRC37);
    _Send_Key(SendKey_Len,ID,seed,1);
    _TestResult(SendData,ID,"",NRC24);
  }
  else if(Error_Count==2)
  {
    _Send_Key(SendKey_Len,ID,_get_seed(ID),1);
    _TestResult(SendData,ID,"",NRC35);
    testWaitForTimeout(50);
    _SetSession(defsession);
    _SetSession(exsession);
    _Send_Key(SendKey_Len,ID,_get_seed(ID),1);
    _TestResult(SendData,ID,"",NRC36);
    testWaitForTimeout(Error_Count_Delay*1.1);
    _Send_Key(SendKey_Len,ID,_get_seed(ID),0);
    _SetSession(exsession);
    _Send_Key(SendKey_Len,ID,_get_seed(ID),1);
    _TestResult(SendData,ID,"",NRC35);
    testWaitForTimeout(500);

    if(Unlock_1002==1)
    {
      _SetSession(exsession);
      _WriteEx_and_Report("","10 02有安全访问条件,跳过测试");
    }
    else 
    {
      if(Pre_Programmed_1002 == 1 && Pre_Programmed_UnlockECU ==1)
        _WriteEx_and_Report("","10 02有预编程条件且需安全访问,跳过测试");
      else if(Pre_Programmed_1002 == 1 && Pre_Programmed_UnlockECU == 0)
      {
        Flage_ = 1;
        _get_Arry("Pre_Programmed");
        if(Arry_Len == 0)
          _WriteEx_and_Report("","未查询到对应预编程报文");
        else
        {
          _Send_Diag(Arry_Len,phyreq_ID,Arry_Data);
          _TestResult(SendData,phyreq_ID,"",-1);
        }
      }
      else if(Pre_Programmed_1002==0)
        Flage_ = 1;
      if(Flage_ == 1)
      {
        _Send_Diag(2,phyreq_ID,Data);
        _TestResult(SendData,phyreq_ID,"",-1);
        testWaitForTimeout(2000);
        _SetSession(defsession);
        testWaitForTimeout(2000);
        _SetSession(exsession);
        if(Restoration_Error_Count == 1)
        {
          _Send_Key(SendKey_Len,ID,_get_seed(ID),1);
          _TestResult(SendData,ID,"",NRC35);
        }
      }
    }
    _SetSession(exsession);
    _Send_Key(SendKey_Len,ID,_get_seed(ID),1);
    _TestResult(SendData,ID,"",NRC36);
    seed = _get_seed(ID);
    _TestResult(SendData,ID,"",NRC37);
    _Send_Key(SendKey_Len,ID,seed,1);
    _TestResult(SendData,ID,"",NRC24);
  }
  if(strncmp(ECU_project,"Seres",strlen(ECU_project)) == 0 && strlen(ECU_project) == strlen("Seres"))
    testWaitForTimeout(100000);
  testWaitForTimeout(Error_Count_Delay+3000);
  _Send_Key(SendKey_Len,ID,_get_seed(ID),0);
  _TestResult(SendData,ID,"",-1);
}

_27_Serve_12(dword ID,byte Session)   /*解锁后计数器清零*/
{
  int i;
  dword seed;
  diagStartTesterPresent(Cdd_Name);
  
  _WriteEx_and_Report("","步骤1: 错误计数器累加");
  _Check_Error_Count(ID,Error_Count-1);
  _Send_Key(SendKey_Len,ID,_get_seed(ID),0);
  testWaitForTimeout(500);
  
  _WriteEx_and_Report("","步骤2: 会话切换");
  // _SetSession(defsession);
  _SetSession(exsession);
  _Check_Error_Count(ID,Error_Count-1);
  _Send_Key(SendKey_Len,ID,_get_seed(ID),0);
  _TestResult(SendData,ID,"",-1);
  testWaitForTimeout(500);
  
  _WriteEx_and_Report("","步骤3: 11复位");
  _Set_11_Restoration(0);
  testWaitForTimeout(3000);
  _SetSession(exsession);
  _Check_Error_Count(ID,Error_Count-1);
  _Send_Key(SendKey_Len,ID,_get_seed(ID),0);
  _TestResult(SendData,ID,"",-1);
  testWaitForTimeout(500);
  
  _WriteEx_and_Report("","步骤4: 正常上下电");
  _Power_Down();
  testWaitForTimeout(2000);
  _Power_Up();
  testWaitForTimeout(2000);
  _SetSession(exsession);
  _Check_Error_Count(ID,Error_Count);
  seed = _get_seed(ID);
  _TestResult(SendData,ID,"",NRC37);
  _Send_Key(SendKey_Len,ID,seed,1);
  _TestResult(SendData,ID,"",NRC24);
  testWaitForTimeout(500);
  testWaitForTimeout(Error_Count_Delay+3000);
  _Send_Key(SendKey_Len,ID,_get_seed(ID),0);
  _TestResult(SendData,ID,"",-1);
}

_27_Serve_13(dword ID,byte Session)   /*未解锁状态-上下电*/
{
  dword seed;
  int i;
  diagStartTesterPresent(Cdd_Name);
  _Set_CarSpd(0);
  _Set_Ready(0);
  if(Restoration_Error_Count == 0)
  {
    for(i=1;i<=Error_Count;i++)
    {
      if(i==Error_Count)
      {
        _Send_Key(SendKey_Len,ID,_get_seed(ID),1);
        _TestResult(SendData,ID,"",0x36);
      }
      else
      {
        _Send_Key(SendKey_Len,ID,_get_seed(ID),1);
        _TestResult(SendData,ID,"",0x35);
        _K15_OFF();
        testWaitForTimeout(K15_OFF_Time);
        _K15_ON();
        testWaitForTimeout(2000);
        _SetSession(exsession);
      }
    }
    testWaitForTimeout(Error_Count_Delay*0.5);
    _K15_OFF();
    testWaitForTimeout(K15_OFF_Time);
    _K15_ON();
    testWaitForTimeout(2000);
    testWaitForTimeout(Error_Count_Delay*0.6);
    _SetSession(exsession);
    if(Error_Count_Delay_Reset==1)
    {
      seed = _get_seed(ID);
      _TestResult(SendData,ID,"",NRC37);
      _Send_Key(SendKey_Len,ID,seed,1);
      _TestResult(SendData,ID,"",NRC24);
      testWaitForTimeout(Error_Count_Delay*0.6);
      _SetSession(exsession);
    }
    seed = _get_seed(ID);
    _TestResult(SendData,ID,"",-1);
    _Send_Key(SendKey_Len,ID,seed,0);
    _TestResult(SendData,ID,"",-1);
  }
  else if(Restoration_Error_Count == 1)/*Restoration_Error_Count 重启是否会重置错误计数器*/
  {
    int j;
    j = 1;
    for(i=1;i<=Error_Count;i++)
    {
      _Send_Key(SendKey_Len,ID,_get_seed(ID),1);
      if(i == Error_Count)
        _TestResult(SendData,ID,"",0x36);
      else
        _TestResult(SendData,ID,"",0x35);
      if(j==i && i!=Error_Count)
      {
        _K15_OFF();
        testWaitForTimeout(K15_OFF_Time+500);
        _K15_ON();
        testWaitForTimeout(500);
        _SetSession(exsession);
        testWaitForTimeout(1000);
        j++;
        i = 0;
      }
    }
  //  _Check_Error_Count(ID,Error_Count); 
  //  seed = _get_seed(ID);
  //  _TestResult(SendData,ID,"",NRC37);
   testWaitForTimeout(Error_Count_Delay*0.5);
   _K15_OFF();
   testWaitForTimeout(K15_OFF_Time);
   _K15_ON();
   testWaitForTimeout(1000);
   _SetSession(exsession);
   testWaitForTimeout(Error_Count_Delay*0.6);
   if(Error_Count_Delay_Reset==1)
   {
     seed = _get_seed(ID);
     _TestResult(SendData,ID,"",NRC37);
     testWaitForTimeout(Error_Count_Delay*0.6);
   }
   seed = _get_seed(ID);
   _TestResult(SendData,ID,"",-1);
   _Send_Key(SendKey_Len,ID,seed,0);
   _TestResult(SendData,ID,"",-1);
  }
}

_27_Serve_14(dword ID,byte Session)   /*下电对错误计数影响测试_错误计数器满*/
{
  dword seed;
  diagStartTesterPresent(Cdd_Name);
  _Set_CarSpd(0);
  _Set_Ready(0);
  testWaitForTimeout(1000);
  _Check_Error_Count(ID,Error_Count);
  seed = _get_seed(ID);
  _TestResult(SendData,ID,"",NRC37);
  testWaitForTimeout(Error_Count_Delay*0.3);
  _K15_OFF();
  testWaitForTimeout(K15_OFF_Time);
  _K15_ON();
  testWaitForTimeout(1000);
  _SetSession(exsession);
  testWaitForTimeout(Error_Count_Delay*0.7);
  if(Error_Count_Delay_Reset == 1)
  {
    seed = _get_seed(ID);
    _TestResult(SendData,ID,"",NRC37);
    testWaitForTimeout(Error_Count_Delay*0.3+1000);
  }
  if(Restoration_Error_Count == 1)
  {
    _Check_Error_Count(ID,Error_Count);
    seed = _get_seed(ID);
    _TestResult(SendData,ID,"",NRC37);
  }
  else
  {
    _Send_Key(SendKey_Len,ID,_get_seed(ID),1);
    _TestResult(SendData,ID,"",NRC36);
  }
  testWaitForTimeout(Error_Count_Delay+3000);
  _Send_Key(SendKey_Len,ID,_get_seed(ID),0);
  _TestResult(SendData,ID,"",-1);
}
_27_Serve_14_1(dword ID,byte Session)   /*下电对错误计数影响测试_错误计数器未满*/
{
  dword seed;
  diagStartTesterPresent(Cdd_Name);
  _Set_CarSpd(0);
  _Set_Ready(0);
  testWaitForTimeout(1000);
  for(i=1;i<=Error_Count-1;i++)
  {
    if(i==Error_Count)
    {
      _Send_Key(SendKey_Len,ID,_get_seed(ID),1);
      _TestResult(SendData,ID,"",0x36);
    }
    else
    {
      _Send_Key(SendKey_Len,ID,_get_seed(ID),1);
      _TestResult(SendData,ID,"",0x35);
    }
  }
  testWaitForTimeout(Error_Count_Delay*0.3);
  _K15_OFF();
  testWaitForTimeout(K15_OFF_Time);
  _K15_ON();
  testWaitForTimeout(1000);
  _SetSession(exsession);
  testWaitForTimeout(Error_Count_Delay*0.7+500);
  if(Error_Count_Delay_Reset == 1)
  {
    seed = _get_seed(ID);
    _TestResult(SendData,ID,"",NRC37);
    testWaitForTimeout(Error_Count_Delay*0.3+1000);
  }
    _Check_Error_Count(ID,Error_Count);
    seed = _get_seed(ID);
    _TestResult(SendData,ID,"",NRC37);
  testWaitForTimeout(Error_Count_Delay+3000);
  _Send_Key(SendKey_Len,ID,_get_seed(ID),0);
  _TestResult(SendData,ID,"",-1);
}
_27_Serve_14_2(dword ID,byte Session)   /*下电对错误计数影响测试_错误计数器为1*/
{
  dword seed;
  diagStartTesterPresent(Cdd_Name);
  _Set_CarSpd(0);
  _Set_Ready(0);
  testWaitForTimeout(1000);
      _Send_Key(SendKey_Len,ID,_get_seed(ID),1);
      _TestResult(SendData,ID,"",0x35);
  testWaitForTimeout(Error_Count_Delay*0.3);
  _K15_OFF();
  testWaitForTimeout(K15_OFF_Time);
  _K15_ON();
  testWaitForTimeout(1000);
  _SetSession(exsession);
  testWaitForTimeout(Error_Count_Delay*0.7+500);
  if(Error_Count_Delay_Reset == 1)
  {
    seed = _get_seed(ID);
    _TestResult(SendData,ID,"",NRC37);
    testWaitForTimeout(Error_Count_Delay*0.3+1000);
  }
    _Check_Error_Count(ID,Error_Count);
    seed = _get_seed(ID);
    _TestResult(SendData,ID,"",NRC37);
  testWaitForTimeout(Error_Count_Delay+3000);
  _Send_Key(SendKey_Len,ID,_get_seed(ID),0);
  _TestResult(SendData,ID,"",-1);
}
_27_Serve_15(dword ID,byte Session)  /*下电对错误计数影响测试_过安全访问*/
{
  dword seed;
  diagStartTesterPresent(Cdd_Name);
  _Set_CarSpd(0);
  _Set_Ready(0);
  testWaitForTimeout(1000);
  _Send_Key(SendKey_Len,ID,_get_seed(ID),0);
  _TestResult(SendData,ID,"",-1);
  _K15_OFF();
  testWaitForTimeout(K15_OFF_Time);
  _K15_ON();
  testWaitForTimeout(1000);
  _SetSession(exsession);
  testWaitForTimeout(Error_Count_Delay*0.7);
  if(Error_Count_Delay_Reset == 1)
  {
    _get_seed(ID);
    _TestResult(SendData,ID,"",NRC37);
    testWaitForTimeout(Error_Count_Delay*0.5);
  }
   _Check_Error_Count(ID,Error_Count);
   _get_seed(ID);
   _TestResult(SendData,ID,"",NRC37);
  testWaitForTimeout(Error_Count_Delay+3000);
  _Send_Key(SendKey_Len,ID,_get_seed(ID),0);
  _TestResult(SendData,ID,"",-1);
}
_27_Serve_16(dword ID,byte Session)   /*重启对错误计数影响测试_安全计数器满*/
{
  dword seed;
  byte Temp[2] ={0x11,0x01};
  int Serve_Pos;
  diagStartTesterPresent(Cdd_Name);
  Serve_Pos = _Check_Serve(0x11,0,0);
  Temp[1] = Serve_Data[Serve_Pos].Serve_Fun[0];
  if( Serve_Data[Serve_Pos].Security_Access[0]==1)
    _WriteEx_and_Report("","11复位需要安全访问条件，此条用例不适用");
  else
  {
    _Check_Error_Count(ID,Error_Count);
    testWaitForTimeout(Error_Count_Delay*0.4);
    seed = _get_seed(ID);
    _TestResult(SendData,ID,"",NRC37);
    testWaitForTimeout(100);
    _Send_Diag(2,phyreq_ID,Temp);
    _TestResult(SendData,ID,"",-1);
    testWaitForTimeout(2000);
    _SetSession(exsession);
    testWaitForTimeout(Error_Count_Delay*0.6);
    if(Error_Count_Delay_Reset == 1)
    {
      seed = _get_seed(ID);
      _TestResult(SendData,ID,"",NRC37);
      testWaitForTimeout(Error_Count_Delay*0.3+1000);
    }
    else
    {
      if(Restoration_Error_Count == 1)
      {
        _Check_Error_Count(ID,Error_Count);
        seed = _get_seed(ID);
        _TestResult(SendData,ID,"",NRC37);
      }
      else
      {
        if(Error_Count_Change == 1)
        {
          seed = _get_seed(ID);
          _TestResult(SendData,ID,"",NRC36);
        }
        else
        {
          _Check_Error_Count(ID,Error_Count);
          seed = _get_seed(ID);
          _TestResult(SendData,ID,"",NRC37);
        }
      }
    }
    testWaitForTimeout(Error_Count_Delay+3000);
    _Send_Key(SendKey_Len,ID,_get_seed(ID),0);
    _TestResult(SendData,ID,"",-1);
  }
}
_27_Serve_16_1(dword ID,byte Session)  /*重启对错误计数影响测试_安全计数器未满*/
{
  dword seed;
  byte Temp[2] ={0x11,0x01};
  int Serve_Pos;
  diagStartTesterPresent(Cdd_Name);
  Serve_Pos = _Check_Serve(0x11,0,0);
  Temp[1] = Serve_Data[Serve_Pos].Serve_Fun[0];
  if( Serve_Data[Serve_Pos].Security_Access[0]==1)
  {
    _WriteEx_and_Report("","11复位需要安全访问条件，此条用例不适用");
  }
  else
  {
    diagStartTesterPresent(Cdd_Name);
      for(i=1;i<=Error_Count-1;i++)
    {
      if(i==Error_Count)
      {
        _Send_Key(SendKey_Len,ID,_get_seed(ID),1);
        _TestResult(SendData,ID,"",0x36);
      }
      else
      {
        _Send_Key(SendKey_Len,ID,_get_seed(ID),1);
        _TestResult(SendData,ID,"",0x35);
      }
    }
    testWaitForTimeout(Error_Count_Delay*0.4);
    _Send_Diag(2,phyreq_ID,Temp);
    _TestResult(SendData,ID,"",-1);
    testWaitForTimeout(2000);
    _SetSession(exsession);
    testWaitForTimeout(Error_Count_Delay*0.7);
    if(Error_Count_Delay_Reset == 1)
    {
      _get_seed(ID);
      _TestResult(SendData,ID,"",NRC37);
      testWaitForTimeout(Error_Count_Delay*0.5);
    }
     _Check_Error_Count(ID,Error_Count);
     _get_seed(ID);
     _TestResult(SendData,ID,"",NRC37);
    testWaitForTimeout(Error_Count_Delay+3000);
    _Send_Key(SendKey_Len,ID,_get_seed(ID),0);
    _TestResult(SendData,ID,"",-1);
  }
}
_27_Serve_16_2(dword ID,byte Session)  /*重启对错误计数影响测试_安全计数器为1*/
{
  dword seed;
  int Serve_Pos;
  byte Temp[2] ={0x11,0x01};
  diagStartTesterPresent(Cdd_Name);
  Serve_Pos = _Check_Serve(0x11,0,0);
  Temp[1] = Serve_Data[Serve_Pos].Serve_Fun[0];
  if( Serve_Data[Serve_Pos].Security_Access[0]==1)
  {
    _WriteEx_and_Report("","11复位需要安全访问条件，此条用例不适用");
  }
  else
  {
    diagStartTesterPresent(Cdd_Name);
    _Send_Key(SendKey_Len,ID,_get_seed(ID),1);
    _TestResult(SendData,ID,"",0x35);
    testWaitForTimeout(Error_Count_Delay*0.4);
    _Send_Diag(2,phyreq_ID,Temp);
    _TestResult(SendData,ID,"",-1);
    testWaitForTimeout(2000);
    _SetSession(exsession);
    testWaitForTimeout(Error_Count_Delay*0.7);
    if(Error_Count_Delay_Reset == 1)
    {
      _get_seed(ID);
      _TestResult(SendData,ID,"",NRC37);
      testWaitForTimeout(Error_Count_Delay*0.5);
    }
     _Check_Error_Count(ID,Error_Count);
     _get_seed(ID);
     _TestResult(SendData,ID,"",NRC37);
    testWaitForTimeout(Error_Count_Delay+3000);
    _Send_Key(SendKey_Len,ID,_get_seed(ID),0);
    _TestResult(SendData,ID,"",-1);
  }
}
_27_Serve_17(dword ID,byte Session)  /*重启对错误计数影响测试_过安全访问*/
{
  dword seed;
  byte Temp[2] ={0x11,0x01};
  int Serve_Pos;
  Serve_Pos = _Check_Serve(0x11,0,0);
  Temp[1] = Serve_Data[Serve_Pos].Serve_Fun[0];
  if( Serve_Data[Serve_Pos].Security_Access[0]==1)
  {
    _WriteEx_and_Report("","11复位需要安全访问条件，此条用例不适用");
  }
  else
  {
    diagStartTesterPresent(Cdd_Name);
    _Send_Key(SendKey_Len,ID,_get_seed(ID),0);
    _TestResult(SendData,ID,"",-1);
    testWaitForTimeout(Error_Count_Delay*0.4);
    _Send_Diag(2,phyreq_ID,Temp);
    _TestResult(SendData,ID,"",-1);
    testWaitForTimeout(2000);
    _SetSession(exsession);
    testWaitForTimeout(Error_Count_Delay*0.7);
    if(Error_Count_Delay_Reset == 1)
    {
      _get_seed(ID);
      _TestResult(SendData,ID,"",NRC37);
      testWaitForTimeout(Error_Count_Delay*0.5);
    }
     _Check_Error_Count(ID,Error_Count);
     _get_seed(ID);
     _TestResult(SendData,ID,"",NRC37);
    testWaitForTimeout(Error_Count_Delay+3000);
    _Send_Key(SendKey_Len,ID,_get_seed(ID),0);
    _TestResult(SendData,ID,"",-1);
  }
}

_27_Serve_18(dword ID,byte Session)  /*未解锁状态-11重启*/
{
  dword seed;
  int i,j,max,x;
  int Serve_Pos;
  byte Temp[2] ={0x11,0x01};
  diagStartTesterPresent(Cdd_Name);
  Serve_Pos = _Check_Serve(0x11,0,0);
  Temp[1] = Serve_Data[Serve_Pos].Serve_Fun[0];
  if( Serve_Data[Serve_Pos].Security_Access[0]==1)
    _WriteEx_and_Report("","11复位需要安全访问条件，此条用例不适用");
  else
  {
    if(Serve_Data[Serve_Pos].RSP[0]==1)
      max = 2;
    else
      max = 1;
    for(j=0;j<max;j++)
    {
      if(j==1)
        Temp[1] = (Serve_Data[Serve_Pos].Serve_Fun[0]|0x80);
      if(Restoration_Error_Count == 0)
      {
        for(i=1;i<Error_Count;i++)
        {
          _Send_Key(SendKey_Len,ID,_get_seed(ID),1);
          _TestResult(SendData,ID,"",NRC35);
          testWaitForTimeout(200);
          _Send_Diag(2,phyreq_ID,Temp);
          if(j==0)
            _TestResult(SendData,ID,"",-1);
          else
            _TestResult(SendData,ID,"",0);
          testWaitForTimeout(2000);
          _SetSession(exsession);
          testWaitForTimeout(1000);
        }
        _Send_Key(SendKey_Len,ID,_get_seed(ID),1);
        _TestResult(SendData,ID,"",NRC36);
        testWaitForTimeout(Error_Count_Delay*0.6);
        _Send_Diag(2,phyreq_ID,Temp);
        if(j==0)
          _TestResult(SendData,ID,"",-1);
        else
          _TestResult(SendData,ID,"",0);
        testWaitForTimeout(2000);
        _SetSession(exsession);
        testWaitForTimeout(500);
        if(Error_Count_Delay_Reset==1)
        {
          testWaitForTimeout(Error_Count_Delay*0.6);
          seed = _get_seed(ID);
          _TestResult(SendData,ID,"",NRC37);
          _Send_Key(SendKey_Len,ID,seed,1);
          _TestResult(SendData,ID,"",NRC24);
        }
        testWaitForTimeout(Error_Count_Delay*0.6);
        _SetSession(exsession);
        _Send_Key(SendKey_Len,ID,_get_seed(ID),0);
        _TestResult(SendData,ID,"",-1);
        _SetSession(exsession);
      }
      else
      {
//        for(i=1;i<=Error_Count;i++)
//        {
//          _Send_Key(SendKey_Len,ID,_get_seed(ID),1);
//          _TestResult(SendData,ID,"",NRC35);
//          _Send_Diag(2,phyreq_ID,Temp);
//          _TestResult(SendData,ID,"",-1);
//          testWaitForTimeout(2000);
//          _SetSession(exsession);
//          testWaitForTimeout(1000);
//        }
//        _Check_Error_Count(ID,Error_Count);
//        seed = _get_seed(ID);
//        _TestResult(SendData,ID,"",NRC37);
//        testWaitForTimeout(Error_Count_Delay*0.6);
//        _Send_Diag(2,phyreq_ID,Temp);
//        if(j==0)
//          _TestResult(SendData,ID,"",-1);
//        else
//          _TestResult(SendData,ID,"",0);
//        testWaitForTimeout(2000);
//        _SetSession(exsession);
//        testWaitForTimeout(500);
//        if(Error_Count_Delay_Reset==1)
//        {
//          testWaitForTimeout(Error_Count_Delay*0.6);
//          seed = _get_seed(ID);
//          _TestResult(SendData,ID,"",NRC37);
//          _Send_Key(SendKey_Len,ID,seed,1);
//          _TestResult(SendData,ID,"",NRC24);
//        }
//        testWaitForTimeout(Error_Count_Delay*0.6);
//        _Send_Key(SendKey_Len,ID,_get_seed(ID),0);
//        _TestResult(SendData,ID,"",-1);
        
        x = 1;
        for(i=1;i<=Error_Count;i++)
        {
          _Send_Key(SendKey_Len,ID,_get_seed(ID),1);
          if(i == Error_Count)
            _TestResult(SendData,ID,"",0x36);
          else
            _TestResult(SendData,ID,"",0x35);
          if(x==i && i!=Error_Count)
          {
            _Send_Diag(2,phyreq_ID,Temp);
            if(j==0)
              _TestResult(SendData,ID,"",-1);
            else
              _TestResult(SendData,ID,"",0);
            testWaitForTimeout(500);
            _SetSession(exsession);
            testWaitForTimeout(1000);
            x++;
            i = 0;
          }
        }
        seed = _get_seed(ID);
        _TestResult(SendData,ID,"",NRC37);
        testWaitForTimeout(Error_Count_Delay*0.5);
        _Send_Diag(2,phyreq_ID,Temp);
        if(j==0)
          _TestResult(SendData,ID,"",-1);
        else
          _TestResult(SendData,ID,"",0);
        testWaitForTimeout(Wait_Time_11);
        _SetSession(exsession);
        testWaitForTimeout(Error_Count_Delay*0.5);
        if(Error_Count_Delay_Reset==1)
        {
          seed = _get_seed(ID);
          _TestResult(SendData,ID,"",NRC37);
          testWaitForTimeout(Error_Count_Delay*0.6);
        }
        seed = _get_seed(ID);
        _TestResult(SendData,ID,"",-1);
        _Send_Key(SendKey_Len,ID,seed,0);
        _TestResult(SendData,ID,"",-1);
        _SetSession(exsession);
      }
    }
  }
}

_27_Serve_19(dword ID,byte Session)  /*不连续重复请求种子验证重复率*/
{
  qword i;
  diagStartTesterPresent(Cdd_Name);
  _Set_Ready(0);
  testWaitForTimeout(2000);
  if(AES_128 != 0)      //AES-128算法要求请求种子具备随机性
  {
    for(i=0;i<Request_Seed_Count;i++)
    {
      _SetSession(Session);
      testWaitForTimeout(200);
      _get_seed(ID);
      Get_Seed_Flage = 1;
      writeEx(-3,0,"当前测试次数 %d 次",i+1);
      if(i%100==0 && i!=0)
      {
        _Power_Down();
        _Power_Up();
        testWaitForTimeout(1000);
      }
    }
  }
  else
  {
    for(i=0;i<Request_Seed_Count;i++)
    {
      writeEx(-3,0,"当前测试次数 %d 次",i+1);
      _SetSession(exsession);
      testWaitForTimeout(200);
      _get_seed(ID);
      Get_Seed_Flage = 1;
//    if(i==(word)random(Request_Seed_Count))
      if(i%100==0 && i!=0)
      {
        _Power_Down();
        _Power_Up();
        testWaitForTimeout(200);
      }
    }
  }
  testWaitForTimeout(2000);
  _Check_Repeat(Request_Seed_Count,1);
}
_27_Serve_19_1(dword ID,byte Session)  /*连续重复请求种子验证重复率*/
{
  qword i;
  diagStartTesterPresent(Cdd_Name);
  _Set_Ready(0);
  testWaitForTimeout(2000);
  if(Request_Error_Count == 0 && Request_Seed_Consistency == 0)
  {
    if(AES_128 != 0)      //AES-128算法要求请求种子具备随机性
    {
      for(i=0;i<Request_Seed_Count;i++)
      {
        _get_seed(ID);
        Get_Seed_Flage = 1;
        testWaitForTimeout(200);
        writeEx(-3,0,"当前测试次数 %d 次",i+1);
        if(i%100==0 && i!=0)
        {
          _Power_Down();
          testWaitForTimeout(1000);
          _Power_Up();
          _SetSession(Session);
        }
        testWaitForTimeout(200);
      }
      
    }
    else
    {
      for(i=0;i<Request_Seed_Count;i++)
      {
        writeEx(-3,0,"当前测试次数 %d 次",i+1);
        _get_seed(ID);
        Get_Seed_Flage = 1;
//        if(i==(word)random(Request_Seed_Count))
        if(i%100==0 && i!=0)
        {
          _Power_Down();
          testWaitForTimeout(1000);
          _Power_Up();
          _SetSession(exsession);
        }
        testWaitForTimeout(200);
      }
    }
    testWaitForTimeout(2000);
    _Check_Repeat(Request_Seed_Count,1);
  }
  else
    _WriteEx_and_Report("","连续请求种子错误计数器累加或种子一致,跳过测试");
}
_27_Serve_19_2(dword ID,byte Session)  /*多次过安全访问*/
{
  qword i;
  byte Seed[2] = {0x27,0x01};
  byte SeedKey[100];
  int Serve_Pos;
  Serve_Pos = _Check_Serve(0x27,0,0);
  Seed[1] = RequestSeed_27;
  SeedKey[0] = 0x27;
  SeedKey[1] = SendKey_27;
  _Set_Ready(0);
  testWaitForTimeout(2000);
  for(i=0;i<Request_Unlock_Count;i++)
  {
    _SetSession(exsession);
    _Send_Diag(2,ID,Seed);
    _TestResult(SendData,ID,"",-1);
    _Send_Diag(SendKey_Len,ID,SeedKey);
    _TestResult(SendData,ID,"",NRC35);
    if(diagGetLastResponseCode(SendData) == -1)
    {
      _WriteEx_and_Report("","当种子为全0时通过了安全访问");
      break;
    }
    _Send_Key(SendKey_Len,ID,_get_seed(ID),0);
    if(i%100==0 && i!=0)
    {
      _Power_Down();
      testWaitForTimeout(1000);
      _Power_Up();
      _SetSession(exsession);
    }
    testWaitForTimeout(50);
    
    Get_Seed_Flage = 1;
  }
  _Check_Repeat(Request_Unlock_Count,1);
}
_27_Serve_20(dword ID,byte Session) /*优先级*/
{
  byte Send_Data[100];
  int Serve_Pos,j;
  
  Serve_Pos = _Check_Serve(0x27,0,0);
  if(_Check_Serve_IDAndSess(0x27,ID,Session) == 1)
  {
    Send_Data[0] = 0x27;
    for(j=0;j<Serve_Data[Serve_Pos].Serve_Fun_Count;j++)
    {
      _Set_NRC_Step(0x27,Serve_Data[Serve_Pos].Serve_Fun[j],6,Send_Data);
      if(Fun_NRC_Count == 0)
      {
        _WriteEx_and_Report("","未输入NRC，跳过测试");
        return;
      }
      if(j==0)
        _WriteEx_and_Report("","测试请求种子NRC优先级");
      else
      {
        _WriteEx_and_Report("","测试发送秘钥NRC优先级");
        _SetSession(Session);
        testWaitForTimeout(200);
      }
      for(i=0;i<Fun_NRC_Count;i++)
      {
        if(i>0) //第一次反馈最高优先级不做处理,其余依次恢复
        {
          _Recover_NRC_Step(Fun_NRC[i-1],Serve_Pos,j,Send_Data);
        }
        if(i == Fun_NRC_Count)
        {
          _Send_Diag(Fun_NRC_Send_Len,ID,Send_Data);
          _TestResult(SendData,ID,"",-1);
        }
        else
        {
          _Send_Diag(Fun_NRC_Send_Len,ID,Send_Data);
          _TestResult(SendData,ID,"",Fun_NRC[i]);
        }
        testWaitForTimeout(100);
        if(Fun_NRC[i] == 0x24)
        {
          _get_seed(ID);
          testWaitForTimeout(200);
        }
      }
      if(Serve_Data[Serve_Pos].Serve_Fun[j] == RequestSeed_27)
      {
        _Send_Key(SendKey_Len,ID,_get_seed(ID),0);
      }
      else if(Serve_Data[Serve_Pos].Serve_Fun[j] == SendKey_27)
      {
        if(_Check_NRC_In_List(0x27,Serve_Data[Serve_Pos].Serve_Fun[j],0x24) != 1)
        {
          _Send_Key(SendKey_Len,ID,0,0);
          _TestResult(SendData,ID,"",NRC24);
        }
        _Send_Key(SendKey_Len,ID,_get_seed(ID),0);
      }
    }
  }
}
_27_Serve_22(dword ID,byte Session)  /*NRC13*/
{
  int i;
  byte Temp_Seed[2]={0x27,0x01};
  byte Temp_Key[2]={0x27,0x01};
  int Len;
  Temp_Seed[1] = RequestSeed_27;
  Temp_Key[1] = SendKey_27;
  Len = _Check_CANFD_Flage();
  if(SendKey_Len == 0x12)
    Len = 0x13;
  _WriteEx_and_Report("种子","遍历请求种子子功能长度");
  for(i=1;i<=Len;i++)
  {
    if(i==2)
    {
      _WriteEx_and_Report("","0x02 长度支持,跳过检测");
      continue;
    }
    _Send_Diag(i,ID,Temp_Seed);
    _TestResult(SendData,ID,"",NRC13);
    testWaitForTimeout(50);
  }
  testWaitForTimeout(1000);
  
  _SetSession(Session);
  _WriteEx_and_Report("密钥","遍历密钥子功能长度");
  for(i=1;i<=Len;i++)
  {
    if(i==SendKey_Len)
    {
      _WriteEx_and_Report("","长度支持,跳过检测");
      continue;
    }
//    if(Request_Error_Count == 0)
    {
      /*防止NRC24>NRC13*/
       _Send_Diag(2,ID,Temp_Seed);
    }
    _Send_Diag(i,ID,Temp_Key);
    _TestResult(SendData,ID,"",NRC13);
    testWaitForTimeout(50);
  }
}
_27_Serve_23(dword ID,byte Session)  /*NRC12*/
{
  word i;
  byte Temp_Seed[2]={0x27,0x01};
  int Serve_Pos;
  
  Serve_Pos = _Check_Serve(0x27,0,0);
  
  for(i=0;i<=0xff;i++)
  {
    Temp_Seed[1] = i;
    if(i==RequestSeed_27 || i==SendKey_27)
    {
      _WriteEx_and_Report("","跳过该子功能检测");
      continue;
    }
    if(Serve_Data[Serve_Pos].RSP[0]==1)
    {
      if(i == (Serve_Data[Serve_Pos].Serve_Fun[0]|0x80) || i == (Serve_Data[Serve_Pos].Serve_Fun[1]|0x80))
        continue;
    }
    if(APP_BT_27_Flage==1 &&(i==BT_RequestSeed_27 || i==BT_SendKey_27))
    {
      _WriteEx_and_Report("","BT支持该子功能,跳过该子功能检测");
      continue;
    }
    _Send_Diag(2,ID,Temp_Seed);
    _TestResult(SendData,ID,"",NRC12);
    testWaitForTimeout(100);
  }
}
_27_Serve_24(dword ID,byte Session)  /*NRC24*/
{
  dword seed;
  int i,flage=0;
  
  _Send_Key(SendKey_Len,ID,0,1);
  _TestResult(SendData,ID,"",NRC24);
  _Send_Key(SendKey_Len,ID,_get_seed(ID),0);
  _TestResult(SendData,ID,"",-1);
  Seed_Count = 0; /*用于重置种子存储位置,验证后续种子是否为全0*/
  seed = _get_seed(ID);
  if(AES_128==0)
  {
    if(seed==0)
      testStepPass("","通过安全访问后,返回种子为全0");
    else
      testStepFail("","通过安全访问后,返回种子不为0");
  }
  else if(AES_128 != 0)
  {
    for(i=0;i<16;i++)
    {
      if(Seed_Count_List_AES128[0][i]!=0)
        flage=1;
    }
    if(flage==0)
      testStepPass("","通过安全访问后,返回种子为全0");
    else
      testStepFail("","通过安全访问后,返回种子不为0");
  }
  _Send_Key(SendKey_Len,ID,seed,0);
  _TestResult(SendData,ID,"",NRC24);
}
_27_Serve_25(dword ID,byte Session)  /*NRC22*/
{
  byte Temp_Seed[2]={0x27,0x01};
  dword seed;
  int Serve_Pos;
  diagStartTesterPresent(Cdd_Name);
  Serve_Pos = _Check_Serve(0x27,0,0);
  Temp_Seed[1] = RequestSeed_27;
  if(Serve_Data[Serve_Pos].Serve_NRC22[0]&0x01 != 0)
  {
    _Set_CarSpd(NRC22_CarSpd+1);
    testWaitForTimeout(1000);
      seed = _get_seed(ID);
      _TestResult(SendData,ID,"",NRC22);
      _Send_Key(SendKey_Len,ID,seed,0);
      _TestResult(SendData,ID,"",NRC22);
      _Set_CarSpd(NRC22_CarSpd);
      testWaitForTimeout(1000);
      _Send_Key(SendKey_Len,ID,_get_seed(ID),0);
      _TestResult(SendData,ID,"",-1);
      _Set_CarSpd(NRC22_CarSpd+1);
      testWaitForTimeout(1000);
      _TestDisableMsg(Struct_CarSpd.Sig_Id);
      testWaitForTimeout(Struct_CarSpd.Lost_Time*1.1);
      _SetSession(exsession);
      _Send_Key(SendKey_Len,ID,_get_seed(ID),0);
      _TestResult(SendData,ID,"",-1);
      _TestEnableMsg(Struct_CarSpd.Sig_Id);
      testWaitForTimeout(Struct_CarSpd.Lost_Time*1.1);
      _Set_CarSpd_Invalid(Struct_CarSpd.Invalid_Value[0]);
      testWaitForTimeout(Struct_CarSpd.Invalid_Time*1.1);
      _SetSession(exsession);
      _Send_Key(SendKey_Len,ID,_get_seed(ID),0);
      _TestResult(SendData,ID,"",-1);
  }
  else
    _WriteEx_and_Report("","无NRC22车速条件");
}
_27_Serve_26(dword ID,byte Session)  /*无响应*/
{
  byte Temp_Seed[2]={0x27,0x01};
  Temp_Seed[1] = RequestSeed_27;
  _Send_Diag(2,ID,Temp_Seed);
  _TestResult(SendData,ID,"",0);
  Temp_Seed[1] = SendKey_27;
  _Send_Diag(SendKey_Len,ID,Temp_Seed);
  _TestResult(SendData,ID,"",0);
  if(APP_BT_27_Flage == 1)
  {
    Temp_Seed[1] = BT_RequestSeed_27;
    _Send_Diag(2,ID,Temp_Seed);
    _TestResult(SendData,ID,"",0);
    Temp_Seed[1] = BT_SendKey_27;
    _Send_Diag(SendKey_Len,ID,Temp_Seed);
    _TestResult(SendData,ID,"",0);
  }
}
_27_Serve_27(dword ID,byte Session)  /*F18C与请求种子顺序互换*/
{
  byte Get_F18C[3] = {0x22,0xF1,0x8C};
  dword seed;
  
  if(AES_128 != 2)
  {
    _WriteEx_and_Report("","此安全算法无需请求序列号操作，跳过测试");
  }
  else
  {
    _WriteEx_and_Report("","优先发送获取序列号测试");
    _Send_Key(SendKey_Len,ID,_get_seed(ID),0);
    _TestResult(SendData,ID,"",-1);
    _SetSession(defsession);
    testWaitForTimeout(200);
    _SetSession(Session);
    testWaitForTimeout(200);
    _WriteEx_and_Report("","优先发送获取种子测试");
    Get_Seed_Flage = 1;
    seed = _get_seed(ID);
    _WriteEx_and_Report(ECU_project,"当前采用AES-CBC算法");
    _WriteEx_and_Report("","获取序列号");
    _Send_Diag(3,ID,Get_F18C,500);
    {
      byte Falge_AES_CBC;
      int m;
      Falge_AES_CBC = 0;
      if(diagGetLastResponseCode(SendData) == -1)
      {
        if(DiagGetRespPrimitiveSize(SendData) == 22)
        {
          for(m=0;m<16;m++)
            Serial_number[m] = DiagGetRespPrimitiveByte(SendData,m+6);
          /*序列号移位*/
          LeftMove(Serial_number,3);
          /*用ECU KEY加密移位后的序列号 获取密钥KEY*/
          AES128_CBC_encrypt_buffer(Secret_KEY,Serial_number,KEY_Len,ECU_Key,Iv);
        }
        else
        {
          testStepFail("序列号长度错误");
          Falge_AES_CBC =1;
        }
      }
      else
      {
        testStepFail("获取序列号失败");
        Falge_AES_CBC =1;
      }
      if(Falge_AES_CBC == 0)
      {
        _Send_Key(SendKey_Len,ID,seed,0);
        _TestResult(SendData,ID,"",-1);
      }
    }
  }
}

_27_Serve_30(dword ID,byte Session)   /*已解锁状态-11重启&KL15*/
{
  int i;
  for(i=0;i<Serve_11_Unlock_Count;i++)
  {
    _WriteEx_and_Report("","当前测试次数 %d",i+1);
    _SetSession(exsession);
    _Send_Key(SendKey_Len,ID,_get_seed(ID),0);
    _TestResult(SendData,ID,"",-1);
    _Power_Down();
    testWaitForTimeout(1000);
    _Power_Up();
    testWaitForTimeout(1000);
    _SetSession(exsession);
    _Send_Key(SendKey_Len,ID,_get_seed(ID),0);
    _TestResult(SendData,ID,"",-1);
    _Set_11_Restoration(0);
    _SetSession(exsession);
    _Send_Key(SendKey_Len,ID,_get_seed(ID),0);
    _TestResult(SendData,ID,"",-1);
  }
  _Check_Repeat(Serve_11_Unlock_Count,1);
}
_27_Serve_30_(dword ID,byte Session) /*已解锁状态-会话切换*/
{
  dword seed;
  dword skey;
  byte data[2]={0x10,0x02};

  _Check_Error_Count(ID,Error_Count-1);
  _Send_Key(SendKey_Len,ID,_get_seed(ID),0);
  _TestResult(SendData,ID,"",-1);
  _WriteEx_and_Report("","切换会话由10 01->10 03");
  _SetSession(defsession);
  _SetSession(Session);
  _Check_Error_Count(ID,Error_Count-1);
  _Send_Key(SendKey_Len,ID,_get_seed(ID),0);
  _TestResult(SendData,ID,"",-1);
  _WriteEx_and_Report("","切换会话由10 02->10 03");
  if(Pre_Programmed_1002 == 1)
  {
    _get_Arry("Pre_Programmed");
    if(Arry_Len == 0)
      _WriteEx_and_Report("","未查询到对应预编程报文");
    else
    {
      _Send_Diag(Arry_Len,phyreq_ID,Arry_Data);
      _TestResult(SendData,phyreq_ID,"",-1);
    }
  }
  _Send_Diag(2,phyreq_ID,data);
  _TestResult(SendData,phyreq_ID,"",-1);
  testWaitForTimeout(2000);
  _SetSession(defsession);
  testWaitForTimeout(2000);
  _SetSession(exsession);
  _Check_Error_Count(ID,Error_Count-1);
  _Send_Key(SendKey_Len,ID,_get_seed(ID),0);
  _TestResult(SendData,ID,"",-1);
  _WriteEx_and_Report("","切换会话由10 03->10 03");
  _SetSession(exsession);
  _Check_Error_Count(ID,Error_Count-1);
  _Send_Key(SendKey_Len,ID,_get_seed(ID),0);
  _TestResult(SendData,ID,"",-1);
}

_27_Serve_31(dword ID,byte Session)   /*长度不对的正确秘钥*/
{
  int i;
  for(i=3;i<=SendKey_Len+1;i++)
  {
    if(i == SendKey_Len)
      continue;
    _Send_Key_(i,ID,_get_seed(ID),-1);
    _TestResult(SendData,ID,"",NRC13);
    testWaitForTimeout(100);
  }
  
  for(i=2;i<=4;i++)
  {
    _SetSession(exsession);
    _Send_Key_(i*(SendKey_Len-2)+2,ID,_get_seed(ID),-1);
    _TestResult(SendData,ID,"",NRC13);
    testWaitForTimeout(100);
  }
}
_27_Serve_32(dword ID,byte Session)   /*子功能错误的正确秘钥*/
{
  int i;
  int Pos;
  Pos = _Check_Serve(0x27,0,0);
  for(i=0;i<=0xFF;i++)
  {
    if(i==RequestSeed_27 || i==SendKey_27)
      continue;
    if(APP_BT_27_Flage == 1 && (i==BT_RequestSeed_27 || i==BT_SendKey_27))
      continue;
    if((Serve_Data[Pos].RSP[0] == 1) && ((i == (RequestSeed_27|0x80)) || (i == (SendKey_27|0x80))))
      continue;
    if((Serve_Data[Pos].RSP[0] == 1) && (APP_BT_27_Flage == 1) && ((i == (BT_RequestSeed_27|0x80)) || (i == (BT_SendKey_27|0x80))))
      continue;
    _SetSession(exsession);
    _Send_Key_(SendKey_Len,ID,_get_seed(ID),i);
    _TestResult(SendData,ID,"",NRC12);
    testWaitForTimeout(20);
  }
}
void _Serve27_33(dword ID,byte Session)/*肯定响应抑制位*/
{
  byte Data_Send_27[2]={0x27,0x00};
  int i,Serve_Pos;
  Serve_Pos = _Check_Serve(0x27,0,0);
  if(Serve_Data[Serve_Pos].RSP[0] == 1)
  {
    Data_Send_27[1]=Serve_Data[Serve_Pos].Serve_Fun[1]|0x80;
    _Send_Diag(Serve_Data[Serve_Pos].Serve_Fun_Len[1],ID,Data_Send_27);
    _TestResult(SendData,ID,"",NRC24);
    
    for(i=0;i<Error_Count;i++)
    {
      Data_Send_27[1]=Serve_Data[Serve_Pos].Serve_Fun[0]|0x80;
      _Send_Diag(Serve_Data[Serve_Pos].Serve_Fun_Len[0],ID,Data_Send_27);
      _TestResult(SendData,ID,"",0);
      
      Data_Send_27[1]=Serve_Data[Serve_Pos].Serve_Fun[1]|0x80;
      _Send_Diag(Serve_Data[Serve_Pos].Serve_Fun_Len[1],ID,Data_Send_27);
      if(i<Error_Count-1)
        _TestResult(SendData,ID,"",NRC35);
      else
        _TestResult(SendData,ID,"",NRC36);
      testWaitForTimeout(50);
    }
    Data_Send_27[1]=Serve_Data[Serve_Pos].Serve_Fun[0]|0x80;
    _Send_Diag(Serve_Data[Serve_Pos].Serve_Fun_Len[0],ID,Data_Send_27);
    _TestResult(SendData,ID,"",NRC37);
    
    Data_Send_27[1]=Serve_Data[Serve_Pos].Serve_Fun[1]|0x80;
    _Send_Diag(Serve_Data[Serve_Pos].Serve_Fun_Len[1],ID,Data_Send_27);
    _TestResult(SendData,ID,"",0x24);
    
    diagStartTesterPresent(Cdd_Name);
    testWaitForTimeout(Error_Count_Delay*1.1+1000);
    _Send_Key(SendKey_Len,ID,_get_seed(ID),0);
  }
  else
    _WriteEx_and_Report("","NRC12中已经测试，此处不再执行");
}
void _Serve27_34(dword ID,byte Session)/*肯定响应抑制位混合测试*/
{
  byte Data_Send_27[2]={0x27,0x00};
  byte Data_Res_27[20];
  int i,Serve_Pos;
  dword Seed;
  Serve_Pos = _Check_Serve(0x27,0,0);
  Data_Res_27[0] = 0x67;
  Data_Res_27[1] = Serve_Data[Serve_Pos].Serve_Fun[0];
  if(Serve_Data[Serve_Pos].RSP[0] == 1)
  {
    Data_Send_27[1]=Serve_Data[Serve_Pos].Serve_Fun[0]|0x80;
    _Send_Diag(Serve_Data[Serve_Pos].Serve_Fun_Len[0],ID,Data_Send_27);
    _TestResult(SendData,ID,"",0);
    testWaitForTimeout(600);
    Data_Send_27[1]=Serve_Data[Serve_Pos].Serve_Fun[1]|0x80;
    _Send_Diag(Serve_Data[Serve_Pos].Serve_Fun_Len[1],ID,Data_Send_27);
    _TestResult(SendData,ID,"",0x35);
    _Send_Key(SendKey_Len,ID,_get_seed(ID),0);
    _TestResult(SendData,ID,"",-1);

    _SetSession(exsession);
    Data_Send_27[1]=Serve_Data[Serve_Pos].Serve_Fun[0]|0x80;
    _Send_Diag(Serve_Data[Serve_Pos].Serve_Fun_Len[0],ID,Data_Send_27);
    _TestResult(SendData,ID,"",0);
    testWaitForTimeout(600);
    Data_Send_27[1]=Serve_Data[Serve_Pos].Serve_Fun[1];
    _Send_Diag(Serve_Data[Serve_Pos].Serve_Fun_Len[1],ID,Data_Send_27);
    _TestResult(SendData,ID,"",0x35);

    testWaitForTimeout(200);
    _Send_Key_(SendKey_Len,ID,_get_seed(ID),Serve_Data[Serve_Pos].Serve_Fun[1]|0x80);
    _TestResult(SendData,ID,"",0);
    _get_seed(ID);
    _Check_Response(SendData,Serve_Data[Serve_Pos].Serve_Fun_Len[1],Data_Res_27);
    testWaitForTimeout(1200);

    _SetSession(exsession);
    Data_Send_27[1]=Serve_Data[Serve_Pos].Serve_Fun[0];
    _Send_Diag(Serve_Data[Serve_Pos].Serve_Fun_Len[0],ID,Data_Send_27);
    _TestResult(SendData,ID,"",-1);
    testWaitForTimeout(600);
    Data_Send_27[1]=Serve_Data[Serve_Pos].Serve_Fun[1]|0x80;
    _Send_Diag(Serve_Data[Serve_Pos].Serve_Fun_Len[1],ID,Data_Send_27);
    _TestResult(SendData,ID,"",0x35);

    Data_Send_27[1]=Serve_Data[Serve_Pos].Serve_Fun[0]|0x80;
    _Send_Diag(Serve_Data[Serve_Pos].Serve_Fun_Len[0],ID,Data_Send_27);
    _TestResult(SendData,ID,"",0);
    testWaitForTimeout(600);
    Data_Send_27[1]=Serve_Data[Serve_Pos].Serve_Fun[1]|0x80;
    _Send_Diag(Serve_Data[Serve_Pos].Serve_Fun_Len[1],ID,Data_Send_27);
    if(Error_Count==2)
      _TestResult(SendData,ID,"",NRC36);
    else
      _TestResult(SendData,ID,"",NRC35);
    
    diagStartTesterPresent(Cdd_Name);
    testWaitForTimeout(Error_Count_Delay*1.1+1000);
    _Send_Key(SendKey_Len,ID,_get_seed(ID),0);
    testWaitForTimeout(600);
  }
  else
    _WriteEx_and_Report("","不支持肯定响应抑制位");
}

_Serve27_35(dword ID,byte Session)/*未解锁状态-上下电及11复位(重启会使计数器清0，且重置等待时间)*/
{
  dword seed;
  int i,j;
  byte Temp[2] ={0x11,0x01};
  diagStartTesterPresent(Cdd_Name);
  _Set_Ready(0);
  testWaitForTimeout(1000);
  for(j=0;j<3;j++)
  {
    for(i=0;i<Error_Count-1;i++)
    {
      _Send_Key(SendKey_Len,ID,_get_seed(ID),1);
      _TestResult(SendData,ID,"",NRC35);
      testWaitForTimeout(50);// 加入操作NV块时间，防止过短无法写入错误计数器
      Get_Seed_Flage = 1;
    }
    if(j==0)
    {
      _K15_OFF();
      testWaitForTimeout(3000);
      _K15_ON();
      testWaitForTimeout(3000);
    }
    else
    {
      if(j==2)
        Temp[1] = 0x81;
      _Send_Diag(2,phyreq_ID,Temp);
      if(j==1)
        _TestResult(SendData,ID,"",-1);
      else
        _TestResult(SendData,ID,"",0);
      testWaitForTimeout(2000);
    }
    
    for(i=0;i<Error_Count-1;i++)
    {
      _Send_Key(SendKey_Len,ID,_get_seed(ID),1);
      _TestResult(SendData,ID,"",NRC35);
      testWaitForTimeout(50);// 加入操作NV块时间，防止过短无法写入错误计数器
    }
    _Send_Key(SendKey_Len,ID,_get_seed(ID),1);
    _TestResult(SendData,ID,"",NRC36);
    testWaitForTimeout(Error_Count_Delay*0.6);
    if(j==0)
    {
      _K15_OFF();
      testWaitForTimeout(3000);
      _K15_ON();
      testWaitForTimeout(2000);
    }
    else
      _Set_11_Restoration(0);
    testWaitForTimeout(Error_Count_Delay*0.5);
    _SetSession(exsession);
    seed = _get_seed(ID);
    _TestResult(SendData,ID,"",NRC37);
    _Send_Key(SendKey_Len,ID,seed,1);
    _TestResult(SendData,ID,"",NRC24);
    testWaitForTimeout(Error_Count_Delay*0.6);
    _SetSession(exsession);
    _Send_Key(SendKey_Len,ID,_get_seed(ID),0);
    _SetSession(defsession);
    _SetSession(exsession);
  }
}

// _28_Serve_1(dword ID,byte Session)/*  7F>13 */
// {
//   byte Send_Data[5];
//   int Serve_Pos,i;
//   Serve_Pos = _Check_Serve(0x28,0,0);
//   Send_Data[0] = 0x28;
//   Send_Data[1] = Serve_Data[Serve_Pos].Serve_Fun[0];
//   if(_Check_Fun_IDAndSess(0x28,Send_Data[1],ID,Session) != -1)
//   {
//     for(i=0;i<Serve_Data[Serve_Pos].Serve_Fun_Count;i++)
//     {
//       if(Serve_Data[Serve_Pos].Serve_Fun_Len[i] > 2)
//         Send_Data[2] = Serve_Data[Serve_Pos].Serve_Para[i][0];
//       _Send_Diag(Serve_Data[Serve_Pos].Serve_Fun_Len[i]-1,ID,Send_Data);
//       _TestResult(SendData,ID,"",NRC7F);
//    }
//   }
// }

_28_Serve_2(dword ID,byte Session)/*  禁收禁发 */
{
  byte Temp_1[3] = {0x28,0x03,0x01};
  byte Temp_2[3] = {0x28,0x00,0x01};
  int Flage_Temp,Support_Flage;
  int Pos_Serve,Pos_Fun,Loop_Para,Loop_Rsp;
  char str[200];
  int j;
  Pos_Serve = _Check_Serve(0x28,0,0);
  Pos_Fun = _Check_Serve(0x28,0x03,4);
  if(Pos_Fun == -1)
    _WriteEx_and_Report("","该项目不支持03子功能,跳过检测");
  else
  {
    _get_28_Case();
    _get_Arry("Read_SigValue");
    Loop_Para = 1;
    Loop_Para = Serve_Data[Pos_Serve].Serve_Para_Count[Pos_Fun];
    Loop_Rsp = 1;
    if(Serve_Data[Pos_Serve].RSP[Pos_Fun] == 1)
      Loop_Rsp = 2;
    for(j=0;j<Loop_Para;j++)
    {
      snprintf(str,elCount(str),"%s","");
      Temp_1[2] = Serve_Data[Pos_Serve].Serve_Para[Pos_Fun][j];
      Temp_2[2] = Serve_Data[Pos_Serve].Serve_Para[Pos_Fun][j];
      for(i=0;i<Loop_Rsp;i++)
      {
        if(i==1)
        {
          Temp_1[1]=0x83; Temp_2[1]=0x80;
        }
        else
        {
          Temp_1[1]=0x03; Temp_2[1]=0x00;
        }
        if(j==0 && i==0)
        {}
        else
          _SetSession(Session);
        _Set_Sig(Sig_28_Set,DID28_Case_CarSpd_1);
        testWaitForTimeout(500);
        _Send_Diag(Arry_Len,phyreq_ID,Arry_Data);
        _Check_Return(1);
        _Check_EPS_TX(1,EPS_TxID_1);
        Flage_Temp = _Check_SendData_In_28H(Temp_1);
        _Send_Diag(3,ID,Temp_1);
        if(Flage_Temp>=0)
        {
          if(i==1)
            _TestResult(SendData,ID,"",0);
          else
            _TestResult(SendData,ID,"",-1);
          Support_Flage = 1;
        }
//        else if(Flage_Temp == -2)
//        {
//          Support_Flage = 0;
//          _TestResult(SendData,ID,"",NRC12);
//        }
//        else
//        {
//          Support_Flage = 0;
//          _TestResult(SendData,ID,"",NRC31);
//        }
        testWaitForTimeout(500);
        _Set_Sig(Sig_28_Set,DID28_Case_CarSpd_2);
        testWaitForTimeout(500);
        _Send_Diag(Arry_Len,phyreq_ID,Arry_Data);
        if(Support_Flage == 1)
        {
          _Check_Return(0);
          _Check_EPS_TX(0,EPS_TxID_1);
        }
//        else
//        {
//          _WriteEx_and_Report("","上一次指令未收到正响应");
//          _Check_Return(2);
//          _Check_EPS_TX(1,EPS_TxID_1);
//        }
        Flage_Temp = _Check_SendData_In_28H(Temp_2);
        testWaitForTimeout(500);
        _Send_Diag(3,ID,Temp_2);
        if(Flage_Temp>=0)
        {
          if(i==1)
            _TestResult(SendData,ID,"",0);
          else
            _TestResult(SendData,ID,"",-1);
          Support_Flage = 1;
        }
//        else if(Flage_Temp == -2)
//        {
//          Support_Flage = 0;
//          _TestResult(SendData,ID,"",NRC12);
//        }
//        else
//        {
//          Support_Flage = 0;
//          _TestResult(SendData,ID,"",NRC31);
//        }
        testWaitForTimeout(Wait_28H_Time);
        _Send_Diag(Arry_Len,phyreq_ID,Arry_Data);
        _Check_Return(2);
        _Check_EPS_TX(1,EPS_TxID_1);
        _Set_Sig(Sig_28_Set,0);
        _SetSession(defsession);
        snprintf(str,elCount(str),"%s  0x%02X  0x%02X","当前完成测试0x28",Temp_1[1],Temp_1[2]);
        _WriteEx_and_Report("",str);
      }
    }
  }
}
_28_Serve_3(dword ID,byte Session)/*  能收禁发 */
{
  byte Temp_1[3] = {0x28,0x01,0x01};
  byte Temp_2[3] = {0x28,0x00,0x01};
  int j;
  int Pos_Serve,Pos_Fun,Loop_Para,Loop_Rsp;
  char str[200];
  Pos_Serve = _Check_Serve(0x28,0,0);
  Pos_Fun = _Check_Serve(0x28,0x01,4);
  if(Pos_Fun == -1)
    _WriteEx_and_Report("","该项目不支持01子功能,跳过检测");
  else
  {  
    _get_28_Case();
    _get_Arry("Read_SigValue");
    Loop_Para = 1;
    Loop_Para = Serve_Data[Pos_Serve].Serve_Para_Count[Pos_Fun];
    Loop_Rsp = 1;
    if(Serve_Data[Pos_Serve].RSP[Pos_Fun] == 1)
      Loop_Rsp = 2;
    for(j=0;j<Loop_Para;j++)
    {
      snprintf(str,elCount(str),"%s","");
      Temp_1[2] = Serve_Data[Pos_Serve].Serve_Para[Pos_Fun][j];
      Temp_2[2] = Serve_Data[Pos_Serve].Serve_Para[Pos_Fun][j];
      {
        for(i=0;i<Loop_Rsp;i++)
        {
          if(i==1)
          {
            Temp_1[1]=Serve_Data[Pos_Serve].Serve_Fun[Pos_Fun]|0x80;
            Temp_2[1] = 0x80;
          }
          else if(i==0)
          {
            Temp_1[1]=Serve_Data[Pos_Serve].Serve_Fun[Pos_Fun] ;
            Temp_2[1] = 0x00;
          }
          
          if(j==0 && i==0)
          {}
          else
            _SetSession(Session);
          _Set_Sig(Sig_28_Set,DID28_Case_CarSpd_1);
          testWaitForTimeout(500);
          _Send_Diag(Arry_Len,phyreq_ID,Arry_Data);
          _Check_Return(1);
          _Check_EPS_TX(1,EPS_TxID_1);
          _Send_Diag(3,ID,Temp_1);
          if(i==1)
            _TestResult(SendData,ID,"",0);
          else
            _TestResult(SendData,ID,"",-1);
          _Set_Sig(Sig_28_Set,DID28_Case_CarSpd_2);
          testWaitForTimeout(500);
          _Send_Diag(Arry_Len,phyreq_ID,Arry_Data);
          _Check_Return(2);
          _Check_EPS_TX(0,EPS_TxID_1);
          /*新增28服务恢复相关测试*/
          _Send_Diag(3,ID,Temp_2);
          if(i==1)
            _TestResult(SendData,ID,"",0);
          else
            _TestResult(SendData,ID,"",-1);
          testWaitForTimeout(Wait_28H_Time);
          _Send_Diag(Arry_Len,phyreq_ID,Arry_Data);
          _Check_Return(2);
          _Check_EPS_TX(1,EPS_TxID_1);
          
          _Set_Sig(Sig_28_Set,0);
          _SetSession(defsession);
          snprintf(str,elCount(str),"%s  0x%02X  0x%02X","当前完成测试0x28",Temp_1[1],Temp_1[2]);
          _WriteEx_and_Report("",str);
        }
      }
    }
  }
}
_28_Serve_4(dword ID,byte Session)/*  禁收能发 */
{
  byte Temp_1[3] = {0x28,0x02,0x01};
  byte Temp_2[3] = {0x28,0x00,0x01};
  int j;
  int Pos_Serve,Pos_Fun,Loop_Para,Loop_Rsp;
  char str[200];
  Pos_Serve = _Check_Serve(0x28,0,0);
  Pos_Fun = _Check_Serve(0x28,0x02,4);
  if(Pos_Fun == -1)
    _WriteEx_and_Report("","该项目不支持02子功能,跳过检测");
  else
  {
    _get_28_Case();
    _get_Arry("Read_SigValue");
    Loop_Para = 1;
    Loop_Para = Serve_Data[Pos_Serve].Serve_Para_Count[Pos_Fun];
    Loop_Rsp = 1;
    if(Serve_Data[Pos_Serve].RSP[Pos_Fun] == 1)
      Loop_Rsp = 2;
    for(j=0;j<Loop_Para;j++)
    {
      snprintf(str,elCount(str),"%s","");
      Temp_1[2] = Serve_Data[Pos_Serve].Serve_Para[Pos_Fun][j];
      Temp_2[2] = Serve_Data[Pos_Serve].Serve_Para[Pos_Fun][j];
      {
        for(i=0;i<Loop_Rsp;i++)
        {
          if(i==1)
          {
            Temp_1[1]=Serve_Data[Pos_Serve].Serve_Fun[Pos_Fun]|0x80;
            Temp_2[1] = 0x80;
          }
          else if(i==0)
          {
            Temp_1[1]=Serve_Data[Pos_Serve].Serve_Fun[Pos_Fun] ;
            Temp_2[1] = 0x00;
          }
          
          if(j==0 && i==0)
          {}
          else
            _SetSession(Session);
          _Set_Sig(Sig_28_Set,DID28_Case_CarSpd_1);
          testWaitForTimeout(500);
          _Send_Diag(Arry_Len,phyreq_ID,Arry_Data);
          _Check_Return(1);
          _Check_EPS_TX(1,EPS_TxID_1);
          _Send_Diag(3,ID,Temp_1);
          if(i==1)
            _TestResult(SendData,ID,"",0);
          else
            _TestResult(SendData,ID,"",-1);
          testWaitForTimeout(500);
          _Set_Sig(Sig_28_Set,DID28_Case_CarSpd_2);
          testWaitForTimeout(500);
          _Send_Diag(Arry_Len,phyreq_ID,Arry_Data);
          _Check_Return(0);
          _Check_EPS_TX(1,EPS_TxID_1);
          /*新增28服务恢复相关测试*/
          _Send_Diag(3,ID,Temp_2);
          if(i==1)
            _TestResult(SendData,ID,"",0);
          else
            _TestResult(SendData,ID,"",-1);
          testWaitForTimeout(Wait_28H_Time);
          _Send_Diag(Arry_Len,phyreq_ID,Arry_Data);
          _Check_Return(2);
          _Check_EPS_TX(1,EPS_TxID_1);
          
          _Set_Sig(Sig_28_Set,0);
          _SetSession(defsession);
          snprintf(str,elCount(str),"%s  0x%02X  0x%02X","当前完成测试0x28",Temp_1[1],Temp_1[2]);
          _WriteEx_and_Report("",str);
        }
      }
    }
  }
}
_28_Serve_5(dword ID,byte Session)/*  S3Timeout */
{
  byte Temp_1[3] = {0x28,0x01,0x03};
  int j;
  char str[200];
  int Count;
  Count = 0;
  for(i=0;i<3;i++)  /*0:0x83/0x03  1:0x81/0x01  2:0x82/0x02*/
  {
    snprintf(str,elCount(str),"%s","");
    _get_28_Case();
    _get_Arry("Read_SigValue");
    if(i==0)
      Temp_1[1] =0x03;
    else if(i==1)
      Temp_1[1] =0x01;
    else
      Temp_1[1] =0x02;
    if(i==1 && _Check_Serve(0x28,0x01,4)==-1)
      _WriteEx_and_Report("","该项目不支持01子功能,跳过检测");
    else if(i==2 && _Check_Serve(0x28,0x02,4)==-1)
      _WriteEx_and_Report("","该项目不支持02子功能,跳过检测");
    else if(i==0 && _Check_Serve(0x28,0x03,4)==-1)
      _WriteEx_and_Report("","该项目不支持03子功能,跳过检测");
    else
    {
      for(j=0;j<2;j++)  /*0:03    1:83*/
      {
        if(j==1)
        {
          if(_Check_Serve(0x28,Temp_1[1],9) == 0)
          {
            _WriteEx_and_Report("","当前不支持肯定响应抑制位,跳过测试");
            continue;
          }
          Temp_1[1] = Temp_1[1]|0x80;
        }
        if(Count != 0)
          _SetSession(Session);
        Count++;
        _Set_Sig(Sig_28_Set,DID28_Case_CarSpd_1);
        testWaitForTimeout(500);
        _Send_Diag(Arry_Len,phyreq_ID,Arry_Data);
        _Check_Return(1);
        _Check_EPS_TX(1,EPS_TxID_1);
        _Send_Diag(3,ID,Temp_1);
        if(j==1)
          _TestResult(SendData,ID,"",0);
        else
          _TestResult(SendData,ID,"",-1);
        testWaitForTimeout(500);
        _Set_Sig(Sig_28_Set,DID28_Case_CarSpd_2);
        testWaitForTimeout(500);
        _Send_Diag(Arry_Len,phyreq_ID,Arry_Data);
        if(i==0 || i==2)
          _Check_Return(0);
        else
          _Check_Return(2);
        if(i==0 || i==1)
        {
          _Check_EPS_TX(0,EPS_TxID_1);
          testWaitForTimeout(S3_85_Time); /*此处存在外发报文检测时间1S*/
        }
        else
        {
          _Check_EPS_TX(1,EPS_TxID_1); 
          testWaitForTimeout(S3_85_Time+500);/*此处不存在外发报文检测时间*/
        }
        _Send_Diag(Arry_Len,phyreq_ID,Arry_Data);
        _Check_Return(2);
        _Check_EPS_TX(1,EPS_TxID_1); 
        _Set_Sig(Sig_28_Set,0);
        _SetSession(defsession);
        snprintf(str,elCount(str),"%s  0x%02X  0x%02X","当前完成测试0x28",Temp_1[1],Temp_1[2]);
        _WriteEx_and_Report("",str);
      }
    }
  }
}
_28_Serve_6(dword ID,byte Session)/*  会话切换 */
{
  byte Temp_1[3] = {0x28,0x01,0x03};
  int j;
  char str[200];
  int Count;
  Count = 0;
  for(i=0;i<3;i++)  /*0:0x83/0x03  1:0x81/0x01  2:0x82/0x02*/
  {
    snprintf(str,elCount(str),"%s","");
    _get_28_Case();
    _get_Arry("Read_SigValue");
    if(i==0)
      Temp_1[1] =0x03;
    else if(i==1)
      Temp_1[1] =0x01;
    else
      Temp_1[1] =0x02;
    if(i==1 && _Check_Serve(0x28,0x01,4)==-1)
      _WriteEx_and_Report("","该项目不支持01子功能,跳过检测");
    else if(i==2 && _Check_Serve(0x28,0x02,4)==-1)
      _WriteEx_and_Report("","该项目不支持02子功能,跳过检测");
    else if(i==0 && _Check_Serve(0x28,0x03,4)==-1)
      _WriteEx_and_Report("","该项目不支持03子功能,跳过检测");
    else
    {
      for(j=0;j<2;j++)  /*0:03    1:83*/
      {
        if(j==1)
        {
          if(_Check_Serve(0x28,Temp_1[1],9) == 0)
          {
            _WriteEx_and_Report("","当前不支持肯定响应抑制位,跳过测试");
            continue;
          }
          Temp_1[1] = Temp_1[1]|0x80;
        }
        if(Count != 0)
          _SetSession(Session);
        Count++;
        _Set_Sig(Sig_28_Set,DID28_Case_CarSpd_1);
        testWaitForTimeout(500);
        _Send_Diag(Arry_Len,phyreq_ID,Arry_Data);
        _Check_Return(1);
        _Check_EPS_TX(1,EPS_TxID_1);
        _Send_Diag(3,ID,Temp_1);
        if(j==1)
          _TestResult(SendData,ID,"",0);
        else
          _TestResult(SendData,ID,"",-1);
        testWaitForTimeout(500);
        _Set_Sig(Sig_28_Set,DID28_Case_CarSpd_2);
        testWaitForTimeout(500);
        _Send_Diag(Arry_Len,phyreq_ID,Arry_Data);
        if(i==0 || i==2)
          _Check_Return(0);
        else
          _Check_Return(2);
        if(i==0 || i==1)
          _Check_EPS_TX(0,EPS_TxID_1);
        else
          _Check_EPS_TX(1,EPS_TxID_1); 
        _SetSession(exsession);
        testWaitForTimeout(Wait_28H_Time);
        _Send_Diag(Arry_Len,phyreq_ID,Arry_Data);
        if(i==0 || i==2)
          _Check_Return(0);
        else
          _Check_Return(2);
        if(i==0 || i==1)
          _Check_EPS_TX(0,EPS_TxID_1);
        else
          _Check_EPS_TX(1,EPS_TxID_1); 
        _SetSession(defsession);
        testWaitForTimeout(Wait_28H_Time);
        _Send_Diag(Arry_Len,phyreq_ID,Arry_Data);
        _Check_Return(2);
        _Check_EPS_TX(1,EPS_TxID_1);
        _Set_Sig(Sig_28_Set,0);
        snprintf(str,elCount(str),"%s  0x%02X  0x%02X","当前完成测试0x28",Temp_1[1],Temp_1[2]);
        _WriteEx_and_Report("",str);
      }
    }
  }
}
_28_Serve_7(dword ID,byte Session)/*  rest */
{
  byte Temp_1[3] = {0x28,0x01,0x03};
  int j;
  char str[200];
  int Count;
  Count = 0;
  for(i=0;i<3;i++)  /*0:0x83/0x03  1:0x81/0x01  2:0x82/0x02*/
  {
    snprintf(str,elCount(str),"%s","");
    _get_28_Case();
    _get_Arry("Read_SigValue");
    if(i==0)
      Temp_1[1] =0x03;
    else if(i==1)
      Temp_1[1] =0x01;
    else
      Temp_1[1] =0x02;
    if(i==1 && _Check_Serve(0x28,0x01,4)==-1)
      _WriteEx_and_Report("","该项目不支持01子功能,跳过检测");
    else if(i==2 && _Check_Serve(0x28,0x02,4)==-1)
      _WriteEx_and_Report("","该项目不支持02子功能,跳过检测");
    else if(i==0 && _Check_Serve(0x28,0x03,4)==-1)
      _WriteEx_and_Report("","该项目不支持03子功能,跳过检测");
    else
    {
      for(j=0;j<2;j++)  /*0:03    1:83*/
      {
        if(j==1)
        {
          if(_Check_Serve(0x28,Temp_1[1],9) == 0)
          {
            _WriteEx_and_Report("","当前不支持肯定响应抑制位,跳过测试");
            continue;
          }
          Temp_1[1] = Temp_1[1]|0x80;
        }
        if(Count != 0)
          _SetSession(Session);
        Count++;
        _Set_Sig(Sig_28_Set,DID28_Case_CarSpd_1);
        testWaitForTimeout(500);
        _Send_Diag(Arry_Len,phyreq_ID,Arry_Data);
        _Check_Return(1);
        _Check_EPS_TX(1,EPS_TxID_1);
        _Send_Diag(3,ID,Temp_1);
        if(j==1)
          _TestResult(SendData,ID,"",0);
        else
          _TestResult(SendData,ID,"",-1);
        testWaitForTimeout(Wait_28H_Time);
        _Set_Sig(Sig_28_Set,DID28_Case_CarSpd_2);
        testWaitForTimeout(500);
        _Send_Diag(Arry_Len,phyreq_ID,Arry_Data);
        if(i==0 || i==2)
          _Check_Return(0);
        else
          _Check_Return(2);
        if(i==0 || i==1)
          _Check_EPS_TX(0,EPS_TxID_1);
        else
          _Check_EPS_TX(1,EPS_TxID_1); 
        _Set_11_Restoration();
        _SetSession(Session);
        _Send_Diag(Arry_Len,phyreq_ID,Arry_Data);
        _Check_Return(2);
        _Check_EPS_TX(1,EPS_TxID_1); 
        _Set_Sig(Sig_28_Set,0);
        snprintf(str,elCount(str),"%s  0x%02X  0x%02X","当前完成测试0x28",Temp_1[1],Temp_1[2]);
        _WriteEx_and_Report("",str);
      }
    }
  }
}
_28_Serve_8(dword ID,byte Session)/*  KL15 OFF->ON */
{
  byte Temp_1[3] = {0x28,0x01,0x03};
  int j;
  char str[200];
  int Count;
  Count = 0;
  for(i=0;i<3;i++)  /*0:0x83/0x03  1:0x81/0x01  2:0x82/0x02*/
  {
    snprintf(str,elCount(str),"%s","");
    _get_28_Case();
    _get_Arry("Read_SigValue");
    if(i==0)
      Temp_1[1] =0x03;
    else if(i==1)
      Temp_1[1] =0x01;
    else
      Temp_1[1] =0x02;
    if(i==1 && _Check_Serve(0x28,0x01,4)==-1)
      _WriteEx_and_Report("","该项目不支持01子功能,跳过检测");
    else if(i==2 && _Check_Serve(0x28,0x02,4)==-1)
      _WriteEx_and_Report("","该项目不支持02子功能,跳过检测");
    else if(i==0 && _Check_Serve(0x28,0x03,4)==-1)
      _WriteEx_and_Report("","该项目不支持03子功能,跳过检测");
    else
    {
      for(j=0;j<2;j++)  /*0:03    1:83*/
      {
        if(j==1)
        {
          if(_Check_Serve(0x28,Temp_1[1],9) == 0)
          {
            _WriteEx_and_Report("","当前不支持肯定响应抑制位,跳过测试");
            continue;
          }
          Temp_1[1] = Temp_1[1]|0x80;
        }
        if(Count != 0)
          _SetSession(Session);
        Count++;
        _Set_Sig(Sig_28_Set,DID28_Case_CarSpd_1);
        testWaitForTimeout(500);
        _Send_Diag(Arry_Len,phyreq_ID,Arry_Data);
        _Check_Return(1);
        _Check_EPS_TX(1,EPS_TxID_1);
        _Send_Diag(3,ID,Temp_1);
        if(j==1)
          _TestResult(SendData,ID,"",0);
        else
          _TestResult(SendData,ID,"",-1);
        testWaitForTimeout(500);
        _Set_Sig(Sig_28_Set,DID28_Case_CarSpd_2);
        testWaitForTimeout(500);
        _Send_Diag(Arry_Len,phyreq_ID,Arry_Data);
        if(i==0 || i==2)
          _Check_Return(0);
        else
          _Check_Return(2);
        if(i==0 || i==1)
          _Check_EPS_TX(0,EPS_TxID_1);
        else
          _Check_EPS_TX(1,EPS_TxID_1); 
        _Power_Down();
        testWaitForTimeout(1000);
        _Set_Sig(Sig_28_Set,DID28_Case_CarSpd_2);
        CarSpd_Now = DID28_Case_CarSpd_2;
        _Power_Up();
        _SetSession(Session);
        _Send_Diag(Arry_Len,phyreq_ID,Arry_Data);
        _Check_Return(2);
        _Check_EPS_TX(1,EPS_TxID_1); 
        _Set_Sig(Sig_28_Set,0);
        snprintf(str,elCount(str),"%s  0x%02X  0x%02X","当前完成测试0x28",Temp_1[1],Temp_1[2]);
        _WriteEx_and_Report("",str);
      }
    }
  }
}
_28_Serve_9(dword ID,byte Session)/*  优先级 */
{  
  int Serve_Pos,i;
  byte Send_Data[100];
  
  Serve_Pos = _Check_Serve(0x28,0,0);
  if(_Check_Serve_IDAndSess(0x28,ID,Session) == 1)
  {
    Send_Data[0] = 0x28;
    _Set_NRC_Step(0x28,Serve_Data[Serve_Pos].Serve_Fun[0],6,Send_Data);
    if(Fun_NRC_Count == 0)
    {
      _WriteEx_and_Report("","未输入NRC，跳过测试");
      return;
    }
    for(i=0;i<=Fun_NRC_Count;i++)
    {
      if(i>0) //第一次反馈最高优先级不做处理,其余依次恢复
      {
        _Recover_NRC_Step(Fun_NRC[i-1],Serve_Pos,0,Send_Data);
      }
      _Send_Diag(Fun_NRC_Send_Len,ID,Send_Data);
      if(i == Fun_NRC_Count)
        _TestResult(SendData,ID,"",-1);
      else
        _TestResult(SendData,ID,"",Fun_NRC[i]);
      testWaitForTimeout(100);
    }
  }
}
_28_Serve_10(dword ID,byte Session)/*  NRC13 */
{
  byte Temp_Data[3] ={0x28,0x00,0x03};
  int i,Len,Serve_Pos;
  Serve_Pos = _Check_Serve(0x28,0,0);
  Temp_Data[0] = 0x28;
  Temp_Data[1] = Serve_Data[Serve_Pos].Serve_Fun[0];
  Temp_Data[2] = Serve_Data[Serve_Pos].Serve_Para[0][0];
  Len = _Check_CANFD_Flage();
  if(Len < Serve_Data[Serve_Pos].Serve_Fun_Len[0])
    Len = Serve_Data[Serve_Pos].Serve_Fun_Len[0]+1;
  for(i=1;i<=Len;i++)
  {
    if(i==3)
      continue;
    _Send_Diag(i,ID,Temp_Data);
    _TestResult(SendData,ID,"",NRC13);
    testWaitForTimeout(50);
  }
}

_28_Serve_11(dword ID,byte Session)/*  NRC12 */
{
  byte Temp_Data[3] ={0x28,0x00,0x03};
  dword Byte1;
  int Serve_Pos;
  Serve_Pos = _Check_Serve(0x28,0,0);
  Temp_Data[2] = Serve_Data[Serve_Pos].Serve_Para[0][0];
  for(Byte1=0;Byte1<=0xFF;Byte1++)
  {
    Temp_Data[1] = Byte1;
    if(((_Check_Serve(0x28,(Byte1&0x7F),4)!= -1) && (_Check_Serve(0x28,(Byte1&0x7F),9)== 1)) || (_Check_Serve(0x28,Byte1,4)!= -1))
      continue;
    _Send_Diag(3,ID,Temp_Data);
    _TestResult(SendData,ID,"",NRC12);
    testWaitForTimeout(50);
  }
}

_28_Serve_12(dword ID,byte Session)/*  NRC31 */
{
  byte Temp_Data[3] ={0x28,0x00,0x03};
  dword Byte1;
  int Serve_Pos,i,Flage;
  Serve_Pos = _Check_Serve(0x28,0,0);
  
  snprintf(Fault_Data_Write,elCount(Fault_Data_Write),"%s","");
  testGetCurrentTestCaseTitle(Fault_Data_Write,400);
  snprintf(Fault_Data_Write,elCount(Fault_Data_Write),"\n %s: \n    遍历28服务NRC31数据时,异常响应: \n",Fault_Data_Write);
  File_Write(Error_File,Error_FileName,Fault_Data_Write,2);
  
  for(i=0;i<Serve_Data[Serve_Pos].Serve_Fun_Count;i++)
  {
    Temp_Data[1] = Serve_Data[Serve_Pos].Serve_Fun[i];
    for(Byte1=0;Byte1<=0xFF;Byte1++)
    {
      Temp_Data[2]=Byte1;
      if(_Check_SendData_In_28H(Temp_Data)!= -1)
        continue;
      _Send_Diag(3,ID,Temp_Data);
      Flage = _TestResult(SendData,ID,"",NRC31);
      if(Flage == -1)
      {
        char Str[50];
        snprintf(Str,elCount(Str),"[  0x%02X 0x%02X  ] \n",Temp_Data[1],Temp_Data[2]);
        File_Write(Error_File,Error_FileName,Str,2);
      }
    }
  }
}
_28_Serve_13(dword ID,byte Session)/*  工厂模式力矩-NRC22 */
{
  byte Temp_1[3] = {0x28,0x03,0x03};
  byte Temp_2[6] = {0x2E,0x01,0x00,0x00,0x00,0x00};
  char str[100];
  int Serve_Pos;
  Serve_Pos = _Check_Serve(0x28,0,0);
  if(strncmp(ECU_project,"ChangAn",strlen(ECU_project)) == 0 && strlen(ECU_project) == strlen("ChangAn"))
  {
    if((_Set_NRC22(0x28,Serve_Data[Serve_Pos].Serve_Fun[0],2)&0x04) != 0)
    {
      _SetSession(exsession);
      _unlockECU();
      _Send_Diag(6,phyreq_ID,Temp_2);
      _TestResult(SendData,phyreq_ID,"",-1);
      _get_28_Case();
      _get_Arry("Read_SigValue");
      for(i=0;i<2;i++)
      {
        _SetSession(Session);
        _Set_Sig(Sig_28_Set,DID28_Case_CarSpd_1);
        testWaitForTimeout(500);
        _Send_Diag(Arry_Len,phyreq_ID,Arry_Data);
        _Check_Return(1);
        _Check_EPS_TX(1,EPS_TxID_1);
        snprintf(str,elCount(str),"%s","");
        if(i==0)
          snprintf(str,elCount(str),"控制力矩满足工厂模式NRC22条件,大于 %.2f Nm,并保持",NRC22_TasTorque_Fac+0.2);
        else
          snprintf(str,elCount(str),"控制力矩满足工厂模式NRC22条件,大于 %.2f Nm,并保持",(NRC22_TasTorque_Fac+0.2)*(-1));
        testWaitForTesterConfirmation(str,30000);
        _Send_Diag(3,ID,Temp_1);
        _TestResult(SendData,ID,"",NRC22);
        testWaitForTimeout(500);
        _Set_Sig(Sig_28_Set,DID28_Case_CarSpd_2);
        testWaitForTimeout(500);
        _Send_Diag(Arry_Len,phyreq_ID,Arry_Data);
        _Check_Return(2);
        _Check_EPS_TX(1,EPS_TxID_1);
        snprintf(str,elCount(str),"%s","");
        if(i==0)
          snprintf(str,elCount(str),"控制力矩不满足工厂模式NRC22条件,小于 %.2f Nm,并保持",NRC22_TasTorque_Fac-0.2);
        else
          snprintf(str,elCount(str),"控制力矩不满足工厂模式NRC22条件,小于 %.2f Nm,并保持",(NRC22_TasTorque_Fac-0.2)*(-1));
        testWaitForTesterConfirmation(str,30000);
        _Send_Diag(3,ID,Temp_1);
        _TestResult(SendData,ID,"",-1);
        testWaitForTimeout(500);
        _Set_Sig(Sig_28_Set,DID28_Case_CarSpd_2+5);
        testWaitForTimeout(500);
        _Send_Diag(Arry_Len,phyreq_ID,Arry_Data);
        _Check_Return(2);
        _Check_EPS_TX(0,EPS_TxID_1);
        snprintf(str,elCount(str),"%s","");
        snprintf(str,elCount(str),"松开方向盘");
        _SetSession(defsession);
        _Set_Sig(Sig_28_Set,0);
      }
      _Factory_Mode(1);
    }
    else
      _WriteEx_and_Report("","无NRC22车速条件");
  }
  else
    _WriteEx_and_Report("","当前测试项目非长安,跳过检测NRC22工厂模式力矩条件");
}
_28_Serve_14(dword ID,byte Session)/*  工厂模式电压-NRC22 */
{
  byte Temp_1[3] = {0x28,0x03,0x03};
  byte Temp_2[6] = {0x2E,0x01,0x00,0x00,0x00,0x00};
  int Serve_Pos;
  Serve_Pos = _Check_Serve(0x28,0,0);
  if(strncmp(ECU_project,"ChangAn",strlen(ECU_project)) == 0 && strlen(ECU_project) == strlen("ChangAn"))
  {
    if((_Set_NRC22(0x28,Serve_Data[Serve_Pos].Serve_Fun[0],2)&0x02) != 0)
    {
      _SetSession(exsession);
      _unlockECU();
      _Send_Diag(6,phyreq_ID,Temp_2);
      _TestResult(SendData,phyreq_ID,"",-1);
      _get_28_Case();
      _get_Arry("Read_SigValue");
      for(i=0;i<2;i++)
      {
        _SetSession(Session);
        _Set_Sig(Sig_28_Set,DID28_Case_CarSpd_1);
        testWaitForTimeout(500);
        _Send_Diag(Arry_Len,phyreq_ID,Arry_Data);
        _Check_Return(1);
        _Check_EPS_TX(1,EPS_TxID_1);
        if(i==0)
          _Set_Battery(NRC22_Battery_Low-0.2);
        else
          _Set_Battery(NRC22_Battery_Hight+0.2);
        _Send_Diag(3,ID,Temp_1);
        _TestResult(SendData,ID,"",NRC22);
        testWaitForTimeout(500);
        _Set_Sig(Sig_28_Set,DID28_Case_CarSpd_2);
        testWaitForTimeout(500);
        _Send_Diag(Arry_Len,phyreq_ID,Arry_Data);
        _Check_Return(2);
        _Check_EPS_TX(1,EPS_TxID_1);
        if(i==0)
          _Set_Battery(NRC22_Battery_Low+0.2);
        else
          _Set_Battery(NRC22_Battery_Hight-0.2);
        _Send_Diag(3,ID,Temp_1);
        _TestResult(SendData,ID,"",-1);
        testWaitForTimeout(500);
        _Set_Sig(Sig_28_Set,DID28_Case_CarSpd_2+5);
        testWaitForTimeout(500);
        _Send_Diag(Arry_Len,phyreq_ID,Arry_Data);
        _Check_Return(2);
        _Check_EPS_TX(0,EPS_TxID_1);
        _Set_Battery(12);
        _SetSession(defsession);
         _Set_Sig(Sig_28_Set,0);
      }
      _Factory_Mode(1);
    }
    else
      _WriteEx_and_Report("","无NRC22电压条件");
  }
  else
    _WriteEx_and_Report("","当前测试项目非长安,跳过检测NRC22工厂模式电压条件");
}
_28_Serve_15(dword ID,byte Session)/*  力矩-NRC22 */
{
  byte Temp_1[3] = {0x28,0x03,0x03};
  byte Temp_2[6] = {0x2E,0x01,0x00,0x01,0x00,0x00};
  char str[100];
  int Serve_Pos;
  Serve_Pos = _Check_Serve(0x28,0,0);
  if(strncmp(ECU_project,"ChangAn",strlen(ECU_project)) == 0 && strlen(ECU_project) == strlen("ChangAn"))
  {
    if((_Set_NRC22(0x28,Serve_Data[Serve_Pos].Serve_Fun[0],2)&0x04) != 0)
    {
      _SetSession(exsession);
      _unlockECU();
      _Send_Diag(6,phyreq_ID,Temp_2);
      _TestResult(SendData,phyreq_ID,"",-1);
      _get_28_Case();
      _get_Arry("Read_SigValue");
      for(i=0;i<2;i++)
      {
        _SetSession(Session);
        _Set_Sig(Sig_28_Set,DID28_Case_CarSpd_1);
        testWaitForTimeout(500);
        _Send_Diag(Arry_Len,phyreq_ID,Arry_Data);
        _Check_Return(1);
        _Check_EPS_TX(1,EPS_TxID_1);
        snprintf(str,elCount(str),"%s","");
        if(i==0)
          snprintf(str,elCount(str),"控制力矩满足NRC22条件,大于 %.2f Nm,并保持",NRC22_TasTorque+0.2);
        else
          snprintf(str,elCount(str),"控制力矩满足NRC22条件,大于 %.2f Nm,并保持",(NRC22_TasTorque+0.2)*(-1));
        testWaitForTesterConfirmation(str,30000);
        _Send_Diag(3,ID,Temp_1);
        _TestResult(SendData,ID,"",NRC22);
        testWaitForTimeout(500);
        _Set_Sig(Sig_28_Set,DID28_Case_CarSpd_2);
        testWaitForTimeout(500);
        _Send_Diag(Arry_Len,phyreq_ID,Arry_Data);
        _Check_Return(2);
        _Check_EPS_TX(1,EPS_TxID_1);
        snprintf(str,elCount(str),"%s","");
        if(i==0)
          snprintf(str,elCount(str),"控制力矩不满足NRC22条件,小于 %.2f Nm,并保持",NRC22_TasTorque-0.2);
        else
          snprintf(str,elCount(str),"控制力矩不满足NRC22条件,小于 %.2f Nm,并保持",(NRC22_TasTorque-0.2)*(-1));
        testWaitForTesterConfirmation(str,30000);
        _Send_Diag(3,ID,Temp_1);
        _TestResult(SendData,ID,"",-1);
        testWaitForTimeout(500);
        _Set_Sig(Sig_28_Set,DID28_Case_CarSpd_2+5);
        testWaitForTimeout(500);
        _Send_Diag(Arry_Len,phyreq_ID,Arry_Data);
        _Check_Return(2);
        _Check_EPS_TX(0,EPS_TxID_1);
        snprintf(str,elCount(str),"%s","");
        snprintf(str,elCount(str),"松开方向盘");
        _SetSession(defsession);
        _Set_Sig(Sig_28_Set,0);
      }
    }
    else
      _WriteEx_and_Report("","无NRC22力矩条件");
  }
  else
    _WriteEx_and_Report("","当前测试项目非长安,跳过检测NRC22力矩条件");
}
_28_Serve_16(dword ID,byte Session)/*  电压-NRC22 */
{
  byte Temp_1[3] = {0x28,0x03,0x03};
  byte Temp_2[6] = {0x2E,0x01,0x00,0x01,0x00,0x00};
  int Serve_Pos;
  Serve_Pos = _Check_Serve(0x28,0,0);
  if(strncmp(ECU_project,"ChangAn",strlen(ECU_project)) == 0 && strlen(ECU_project) == strlen("ChangAn"))
  {
    if((_Set_NRC22(0x28,Serve_Data[Serve_Pos].Serve_Fun[0],2)&0x02) != 0)
    {
      _SetSession(exsession);
      _unlockECU();
      _Send_Diag(6,phyreq_ID,Temp_2);
      _TestResult(SendData,phyreq_ID,"",-1);
      _get_28_Case();
      _get_Arry("Read_SigValue");
      for(i=0;i<2;i++)
      {
        _SetSession(Session);
        _Set_Sig(Sig_28_Set,DID28_Case_CarSpd_1);
        testWaitForTimeout(500);
        _Send_Diag(Arry_Len,phyreq_ID,Arry_Data);
        _Check_Return(1);
        _Check_EPS_TX(1,EPS_TxID_1);
        if(i==0)
          _Set_Battery(NRC22_Battery_Low-0.2);
        else
          _Set_Battery(NRC22_Battery_Hight+0.2);
        _Send_Diag(3,ID,Temp_1);
        _TestResult(SendData,ID,"",NRC22);
        testWaitForTimeout(500);
        _Set_Sig(Sig_28_Set,DID28_Case_CarSpd_2);
        testWaitForTimeout(500);
        _Send_Diag(Arry_Len,phyreq_ID,Arry_Data);
        _Check_Return(2);
        _Check_EPS_TX(1,EPS_TxID_1);
        if(i==0)
          _Set_Battery(NRC22_Battery_Low+0.2);
        else
          _Set_Battery(NRC22_Battery_Hight-0.2);
        _Send_Diag(3,ID,Temp_1);
        _TestResult(SendData,ID,"",-1);
        testWaitForTimeout(500);
        _Set_Sig(Sig_28_Set,DID28_Case_CarSpd_2 +5);
        testWaitForTimeout(500);
        _Send_Diag(Arry_Len,phyreq_ID,Arry_Data);
        _Check_Return(2);
        _Check_EPS_TX(0,EPS_TxID_1);
        _Set_Battery(12);
        _SetSession(defsession);
        _Set_CarSpd(0);
      }
    }
    else
      _WriteEx_and_Report("","无NRC22电压条件");
  }
  else
    _WriteEx_and_Report("","当前测试项目非长安,跳过检测NRC22电压条件");
}
_28_Serve_17(dword ID,byte Session)/*  车速-NRC22 */
{
  byte Temp_1[3] = {0x28,0x03,0x03};
  int Serve_Pos,i,j;
  Serve_Pos = _Check_Serve(0x28,0,0);
  if(_Check_Serve_IDAndSess(0x28,ID,Session) == 1)
  {
    if((_Set_NRC22(0x28,Serve_Data[Serve_Pos].Serve_Fun[0],2) & 1 )!= 0)
    {
      for(j=0;j<2;j++)
      {
        for(i=0;i<2;i++)
        {
          if(i==0 && j==0)
          {}
          else
          {
            _SetSession(Session);
            testWaitForTimeout(500);
          }
          Temp_1[1] = 0x00;
          if(i == 0)
            Temp_1[1] = 0x03;
          if(j==1)
            Temp_1[1] = (Temp_1[1] | 0x80);
          _Set_CarSpd(NRC22_CarSpd+1);
          testWaitForTimeout(500);
          _Send_Diag(3,ID,Temp_1);
          _TestResult(SendData,ID,"",NRC22);
          _Set_CarSpd(NRC22_CarSpd);
          testWaitForTimeout(500);
          _Send_Diag(3,ID,Temp_1);
          if(j==0)
            _TestResult(SendData,ID,"",-1);
          else
            _TestResult(SendData,ID,"",0);
          _TestDisableMsg(Struct_CarSpd.Sig_Id);
          testWaitForTimeout(Struct_CarSpd.Lost_Time*1.2);
          _Send_Diag(3,ID,Temp_1);
          if(j==0)
            _TestResult(SendData,ID,"",-1);
          else
            _TestResult(SendData,ID,"",0);
          _TestEnableMsg(Struct_CarSpd.Sig_Id);
          testWaitForTimeout(1000);
          _Set_CarSpd_Invalid(Struct_CarSpd.Invalid_Value[0]);
          _Send_Diag(3,ID,Temp_1);
          if(j==0)
            _TestResult(SendData,ID,"",-1);
          else
            _TestResult(SendData,ID,"",0);
          _Reset_CarSpd_Invalid();
          _SetSession(defsession);
          testWaitForTimeout(1000);
        }
      }
    }
    else
      _WriteEx_and_Report("","NRC22无车速条件");
  }
  else
    _WriteEx_and_Report("","当前寻址或会话不支持该服务");
}
_28_Serve_18(dword ID,byte Session)/*  档位-NRC22 */
{
  byte Temp_1[3] = {0x28,0x03,0x03};
  int Serve_Pos,i,j;
  Serve_Pos = _Check_Serve(0x28,0,0);
  if(_Check_Serve_IDAndSess(0x28,ID,Session) == 1)
  {
    if((_Set_NRC22(0x28,Serve_Data[Serve_Pos].Serve_Fun[0],2) & 0x08 )!= 0)
    {
      for(i=0;i<2;i++)
      {
        if(i==1 && Session != defsession)
          _SetSession(Session);
        testWaitForTimeout(500);
        Temp_1[1] = 0x00;
        if(i == 0)
          Temp_1[1] = 0x03;
        if(strlen(Gears_Signal) == 0)
        {
          _WriteEx_and_Report("","未收到正确的档位信号,跳过测试");
          return;
        }
        if(NRC_22_Gears_Range[0]==0 && NRC_22_Gears_Range[1] == 0 && NRC_22_Gears_Normal==0)
        {
          _WriteEx_and_Report("","未收到正确的档位范围,跳过测试");
          return;
        }
        for(j=NRC_22_Gears_Range[0];j<=NRC_22_Gears_Range[1];j++)
        {
          _Set_Gears(j);
          testWaitForTimeout(500);
          if(j==NRC_22_Gears_Normal)
          {
            _Send_Diag(3,ID,Temp_1);
            _TestResult(SendData,ID,"",-1);
            _SetSession(defsession);
            testWaitForTimeout(500);
            if(Session != defsession)
            {
              _SetSession(Session);
              testWaitForTimeout(500);
            }
          }
          else
          {
            _Send_Diag(3,ID,Temp_1);
            _TestResult(SendData,ID,"",NRC22);
          }
        }
        _TestDisableMsg(Gears_ID);
        testWaitForTimeout(1000);
        _Send_Diag(3,ID,Temp_1);
        _TestResult(SendData,ID,"",-1);
        _TestEnableMsg(Gears_ID);
        testWaitForTimeout(1000);
        _SetSession(defsession);
        testWaitForTimeout(1000);
      }
      _Set_Gears(NRC_22_Gears_Normal);
    }
    else
      _WriteEx_and_Report("","NRC22无档位条件");
  }
  else
    _WriteEx_and_Report("","当前寻址或会话不支持该服务");
}
_28_Serve_19(dword ID,byte Session)/*  发动机-NRC22 */
{
  byte Temp_1[3] = {0x28,0x03,0x03};
  int Serve_Pos,i,j;
  Serve_Pos = _Check_Serve(0x28,0,0);
  if(_Check_Serve_IDAndSess(0x28,ID,Session) == 1)
  {
    if((_Set_NRC22(0x28,Serve_Data[Serve_Pos].Serve_Fun[0],2) & 0x20 )!= 0)
    {
      Temp_1[1] = Serve_Data[Serve_Pos].Serve_Fun[0];
      Temp_1[2] = Serve_Data[Serve_Pos].Serve_Para[0][0];
      _Set_Ready(Struct_Ready.Ready_Active);
      testWaitForTimeout(1000);
      _Send_Diag(3,ID,Temp_1);
      _TestResult(SendData,ID,"",NRC22);
      _TestDisableMsg(Struct_Ready.Sig_Id);
      testWaitForTimeout(Struct_Ready.Invalid_Time*1.5);
      _Send_Diag(3,ID,Temp_1);
      _TestResult(SendData,ID,"",-1);
      _TestEnableMsg(Struct_Ready.Sig_Id);
      testWaitForTimeout(Struct_Ready.Invalid_Time*1.5);
      _Set_Sig(Struct_Ready.ReadyInvalid_Sig,Struct_Ready.Invalid_Value[0]);
      testWaitForTimeout(Struct_Ready.Invalid_Time*1.5);
      _Send_Diag(3,ID,Temp_1);
      _TestResult(SendData,ID,"",-1);
      _Set_Sig(Struct_Ready.ReadyInvalid_Sig,Struct_Ready.Normal_Value[0]);
      testWaitForTimeout(Struct_Ready.Invalid_Time*1.5);
      _Set_Ready(0);
      testWaitForTimeout(1000);
    }
    else
      _WriteEx_and_Report("","NRC22无发动机条件");
  }
  else
    _WriteEx_and_Report("","当前寻址或会话不支持该服务");
}

_28_Serve_20(dword ID,byte Session)/* 通讯立即停止验证 */
{
  byte Send_Data[5];
  int Serve_Pos,i,j,max_count,Rsp;
  byte DataSave[2] = {0x01,0x03};
  Serve_Pos = _Check_Serve(0x28,0,0);
  if(_Check_Serve_IDAndSess(0x28,ID,Session)==1)
  {
    Send_Data[0] = 0x28;
    for(i=0;i<elcount(DataSave);i++)
    {
      if(_Check_Serve(0x28,DataSave[i],4) !=-1)
      {
        max_count = (_Check_Serve(0x28,DataSave[i],9)==0)?1:2;
        for(j=0;j<max_count;j++)
        {
          Rsp = (j==0)?-1:0;
          Send_Data[1] = (j==0) ? DataSave[i]:(DataSave[i]|0x80);
          Send_Data[2] = 0x03;
          _Send_Diag(3,ID,Send_Data);
          _TestResult(SendData,ID,"",Rsp);
          if(Wait_28H_Tx_Time != 0)
          {
            _WriteEx_and_Report("","等待 %d ms",Wait_28H_Tx_Time);
            testWaitForTimeout(Wait_28H_Tx_Time);
          }
          _Check_EPS_TX(0,EPS_TxID_1);
          testWaitForTimeout(1000);
          _SetSession(defsession);
          testWaitForTimeout(500);
          _SetSession(Session);
          testWaitForTimeout(1000);
        }
      }
    }
  }
  else
    _WriteEx_and_Report("","当前寻址或会话不支持");
}

_28_Serve_21(dword ID,byte Session)/* 异常断电后功能实现正常 */
{
  byte Send_Data[5];
  int Serve_Pos,i,j,max_count,Rsp;
  byte DataSave[3] = {0x01,0x02,0x03};
  char Str[200];
  byte Date_Fun;
  Serve_Pos = _Check_Serve(0x28,0,0);
  if(_Check_Serve_IDAndSess(0x28,ID,Session)==1)
  {
    _get_28_Case();
    _get_Arry("Read_SigValue");
    Send_Data[0] = 0x28;
    for(i=0;i<elcount(DataSave);i++)
    {
      if(_Check_Serve(0x28,DataSave[i],4) !=-1)
      {
        max_count = (_Check_Serve(0x28,DataSave[i],9)==0)?1:2;
        for(j=0;j<max_count;j++)
        {
          Rsp = (j==0)?-1:0;
          Send_Data[1] = (j==0) ? DataSave[i]:(DataSave[i]|0x80);
          Send_Data[2] = 0x03;
          snprintf(Str,elCount(Str),"/*---------当前测试：0x28 0x%02X 0x03---------*/",Send_Data[1]);
          _WriteEx_and_Report("",Str);
        
          _Set_Sig(Sig_28_Set,DID28_Case_CarSpd_1);
          testWaitForTimeout(500);
          _Send_Diag(Arry_Len,phyreq_ID,Arry_Data);
          _Check_Return(1);
          _Check_EPS_TX(1,EPS_TxID_1);
          _Send_Diag(3,ID,Send_Data);
          _TestResult(SendData,ID,"",Rsp);
          testWaitForTimeout(Wait_28H_Time);
          _Set_Sig(Sig_28_Set,DID28_Case_CarSpd_2);
          testWaitForTimeout(500);
          _Send_Diag(Arry_Len,phyreq_ID,Arry_Data);
          Date_Fun = (Send_Data[1]&0x0F) ;
          if(Date_Fun == 1)
          {
            _Check_Return(2);_Check_EPS_TX(0,EPS_TxID_1);
          }
          else if(Date_Fun == 2)
          {
            _Check_Return(1);_Check_EPS_TX(1,EPS_TxID_1);
          }
          else if(Date_Fun == 3)
          {
            _Check_Return(1);_Check_EPS_TX(0,EPS_TxID_1);
          }

          _K30_OFF();
          testWaitForTimeout(2000);
          _K30_ON();
          testWaitForTimeout(2000);
          _Send_Diag(Arry_Len,phyreq_ID,Arry_Data);
          _Check_Return(2);
          _Check_EPS_TX(1,EPS_TxID_1);

          _SetSession(Session);
          testWaitForTimeout(1000);
          _Send_Diag(3,ID,Send_Data);
          _TestResult(SendData,ID,"",Rsp);
          testWaitForTimeout(Wait_28H_Time);
          _Set_Sig(Sig_28_Set,DID28_Case_CarSpd_2+5);
          testWaitForTimeout(500);
          _Send_Diag(Arry_Len,phyreq_ID,Arry_Data);
          if(Date_Fun == 1)
          {
            _Check_Return(3);_Check_EPS_TX(0,EPS_TxID_1);
          }
          else if(Date_Fun == 2)
          {
            _Check_Return(2);_Check_EPS_TX(1,EPS_TxID_1);
          }
          else if(Date_Fun == 3)
          {
            _Check_Return(2);_Check_EPS_TX(0,EPS_TxID_1);
          }

          testWaitForTimeout(1000);
          _SetSession(defsession);
          testWaitForTimeout(500);
          _SetSession(Session);
          testWaitForTimeout(1000);
        }
      }
    }
  }
  else
    _WriteEx_and_Report("","当前寻址或会话不支持");
}

void _Serve28_21(dword ID,byte Session)/*  NRC22-吉利3.0*/
{
  byte Send_Data_01[3] = {0x28,0x00,0x01};
  char Serve_85_CarSpdQFTemp[10];
  byte Serve_85_CarSpdQF[10];
  int Serve_85_CarSpdQF_Count;
  int i,j;
  Serve_85_CarSpdQF_Count = getProfileArray(ECU_project,"Serve_85_CarSpdQF",Serve_85_CarSpdQFTemp,elCount(Serve_85_CarSpdQFTemp),file_name_1);
  for(i=0;i<Serve_85_CarSpdQF_Count;i++)
    Serve_85_CarSpdQF[i] = Serve_85_CarSpdQFTemp[i];
  
  diagStartTesterPresent(Cdd_Name);
  _Set_Ready(Struct_Ready.Ready_Active);
  testWaitForTimeout(6000);
  
  for(j=0;j<7;j++)
  {
    diagStartTesterPresent(Cdd_Name);
    if(j==1)
      _Set_CarSpd(NRC22_CarSpd+1);
    else 
      _Set_CarSpd(NRC22_CarSpd-1);
    
    _Set_Ready(0xB);
    _Set_CarSpd_Invalid(3);
    if(j==0 || j==1)  /*此用例测试VehSpdLgtQf=2或3能支持85服务，需要遍历VehSpdLgtQf值*/
    {
      _WriteEx_and_Report("","测试支持28服务的VehSpdLgtQf，需要遍历VehSpdLgtQf值");
      for(i=0;i<4;i++)
      {
        _Set_CarSpd_Invalid(i);
        testWaitForTimeout(1000);
        _Send_Diag(3,ID,Send_Data_01);
        if((_Check_Dword_in_Num(i,Serve_85_CarSpdQF,Serve_85_CarSpdQF_Count)!= -1) && j == 0)
          _TestResult(SendData,ID,"",-1);
        else
          _TestResult(SendData,ID,"",CarSpd_Invalid_NRC);
      }
      if(j==1)
      {
        _Set_CarSpd_Invalid(0);
        _TestDisableMsg(Struct_CarSpd.Sig_Id);
        testWaitForTimeout(Struct_CarSpd.Lost_Time*1.5);
        _Send_Diag(3,ID,Send_Data_01);
        _TestResult(SendData,ID,"",-1);
        _TestEnableMsg(Struct_CarSpd.Sig_Id);
        _WriteEx_and_Report("","步骤5-9测试结束");
      }
      else
        _WriteEx_and_Report("","步骤1-4测试结束");
    }
    else if(j==2)  /*此用例测试Usgmode≠0xD(driving)能支持85服务，需要遍历Usgmode值以及丢失*/
    {
      _WriteEx_and_Report("","此用例测试Usgmode≠0xD(driving)能支持28服务，需要遍历Usgmode值以及丢失");
      for(i=0;i<5;i++)
      {
        byte Temp[5]={0,1,2,0xB,0xD};
        _Set_Ready(Temp[i]);
        testWaitForTimeout(1000);
        _Send_Diag(3,ID,Send_Data_01);
        if(Temp[i]==0xD)
          _TestResult(SendData,ID,"",Ready_NRC);
        else
          _TestResult(SendData,ID,"",-1);
      }
      _Set_Ready(0xD);
      _TestDisableMsg(Struct_Ready.Sig_Id);
      testWaitForTimeout(3000);
      _Send_Diag(3,ID,Send_Data_01);
      _TestResult(SendData,ID,"",-1);
      _TestEnableMsg(Struct_Ready.Sig_Id);
      _WriteEx_and_Report("","步骤10-15测试结束");
    }
    else if(j==3)/*测试电压条件*/
    { 
      float Temp[4]={1,2,3,4};
      _WriteEx_and_Report("","测试电压条件");
      Temp[0]=NRC22_Battery_Low+0.2;
      Temp[1]=NRC22_Battery_Hight-0.2;
      Temp[2]=NRC22_Battery_Low-0.2;
      Temp[3]=NRC22_Battery_Hight+0.2;
      for(i=0;i<4;i++)
      {
        _Set_Battery(Temp[i]);
        _Send_Diag(3,ID,Send_Data_01);
        if(i<2)
          _TestResult(SendData,ID,"",-1);
        else if(i==2)
          _TestResult(SendData,ID,"",L_Battery_NRC);
        else if(i==3)
          _TestResult(SendData,ID,"",H_Battery_NRC);
      }
      _Set_Battery(12);
      _WriteEx_and_Report("","步骤16-19测试结束");
    }
    else if(j==4)/*Usgmode(0x2E0:VehModMngtGlbSafe1)=0xD，车速<3km/h，VehSpdLgtQf=3，电压为13.5V时丢失0xE0节点发送报文：*/
    {
      _WriteEx_and_Report("","Usgmode(0x2E0:VehModMngtGlbSafe1)=0xD，车速<3km/h，VehSpdLgtQf=3，电压为13.5V时丢失0xE0节点发送报文");
      _Set_Ready(0xD);
      _TestDisableMsg(Struct_CarSpd.Sig_Id);
      testWaitForTimeout(5000);
      _Send_Diag(3,ID,Send_Data_01);
      _TestResult(SendData,ID,"",Ready_NRC);
      _TestEnableMsg(Struct_CarSpd.Sig_Id);
      testWaitForTimeout(1000);
      _Set_Ready(0xB);
      _TestDisableMsg(Struct_CarSpd.Sig_Id);
      testWaitForTimeout(5000);
      _Send_Diag(3,ID,Send_Data_01);
      _TestResult(SendData,ID,"",-1);
      _TestEnableMsg(Struct_CarSpd.Sig_Id);
      testWaitForTimeout(1000);
      _WriteEx_and_Report("","步骤20-21测试结束");
    }
    else if(j==5)/*步骤22&23、VehSpdLgtQf不满足；步骤24、车速不满足；步骤25&26、VehSpdLgtQf满足取值遍历*/
    {
      int Qf[4] = {1,0,2,3};
      _Set_Ready(0xD);
      _WriteEx_and_Report("","步骤22&23：VehSpdLgtQf不满足。步骤24：车速不满足。步骤25&26：VehSpdLgtQf满足取值遍历");
      _WriteEx_and_Report("","步骤22，步骤23，步骤25，步骤26");
      for(i=0;i<4;i++)
      {
        _Set_CarSpd_Invalid(Qf[i]);
        testWaitForTimeout(500);
        _TestDisableMsg(Struct_Ready.Sig_Id);
        testWaitForTimeout(2000);
        _Send_Diag(3,ID,Send_Data_01);
        if(_Check_Dword_in_Num(Qf[i],Serve_85_CarSpdQF,Serve_85_CarSpdQF_Count)!= -1)
          _TestResult(SendData,ID,"",-1);
        else
          _TestResult(SendData,ID,"",CarSpd_Invalid_NRC);
        _TestEnableMsg(Struct_Ready.Sig_Id);
        testWaitForTimeout(2000);
      }
      _WriteEx_and_Report("","步骤24，放于循环外测试");
      _Set_CarSpd(NRC22_CarSpd+1);
      _Set_CarSpd_Invalid(2);
      _TestDisableMsg(Struct_Ready.Sig_Id);
      testWaitForTimeout(2000);
      _Send_Diag(3,ID,Send_Data_01);
      _TestResult(SendData,ID,"",CarSpd_NRC);
      _TestEnableMsg(Struct_Ready.Sig_Id);
      testWaitForTimeout(2000);
      _WriteEx_and_Report("","步骤22-26测试结束");
    }
    else if(j==6)/*在Usgmode不满足且Usgmode和车速均丢失的前提下设计以下电压临界值步骤情况*/
    {
      float Temp[4]={1,2,3,4};
      _WriteEx_and_Report("","在Usgmode不满足且Usgmode和车速均丢失的前提下设计以下电压临界值步骤情况");
      Temp[0]=NRC22_Battery_Low+0.2;
      Temp[1]=NRC22_Battery_Hight-0.2;
      Temp[2]=NRC22_Battery_Low-0.2;
      Temp[3]=NRC22_Battery_Hight+0.2;
      _Set_Ready(0xD);
      _Set_CarSpd_Invalid(3);
      _Set_CarSpd(NRC22_CarSpd-1);
      testWaitForTimeout(1000);
      for(i=0;i<4;i++)
      {
        _Set_Battery(Temp[i]);
        _TestDisableMsg(Struct_Ready.Sig_Id);
        _TestDisableMsg(Struct_CarSpd.Sig_Id);
        testWaitForTimeout(2000);
        _Send_Diag(3,ID,Send_Data_01);
        if(i<2)
          _TestResult(SendData,ID,"",-1);
        else if(i==2)
          _TestResult(SendData,ID,"",L_Battery_NRC);
        else if(i==3)
          _TestResult(SendData,ID,"",H_Battery_NRC);
        _TestEnableMsg(Struct_Ready.Sig_Id);
        _TestEnableMsg(Struct_CarSpd.Sig_Id);
        testWaitForTimeout(1000);
      }
      _Set_Battery(12);
      _WriteEx_and_Report("","步骤27-30测试结束");
    }
  }
  _Set_CarSpd(0);
  _Reset_CarSpd_Invalid();
}

_28_Serve_22(dword ID,byte Session)/* 静默时长 */
{
  byte Send_Data[5];
  int Serve_Pos,i;
  Serve_Pos = _Check_Serve(0x28,0,0);
  if(_Check_Serve_IDAndSess(0x28,ID,Session)==1)
  {
    _get_28_Case();
    _get_Arry("Read_SigValue");
    Send_Data[0] = 0x28;Send_Data[1] = 0x03;Send_Data[2] = 0x03;

    _Set_Sig(Sig_28_Set,DID28_Case_CarSpd_1);
    testWaitForTimeout(500);
    _Send_Diag(Arry_Len,phyreq_ID,Arry_Data);
    _Check_Return(1);
    _Check_EPS_TX(1,EPS_TxID_1);
    _Send_Diag(3,ID,Send_Data);
    _TestResult(SendData,ID,"",-1);
    testWaitForTimeout(500);
    _Set_Sig(Sig_28_Set,DID28_Case_CarSpd_2);
    testWaitForTimeout(500);
    for(i=0;i<=5*60;i+=4)
    {
      _Send_Diag(Arry_Len,phyreq_ID,Arry_Data);
      _Check_Return(0);
      _Check_EPS_TX(0,EPS_TxID_1);//此处存在1s检测报文是否停发
      testWaitForTimeout(3000);
      writeEx(-3,0,"第 %d s检测完毕",i+4);
    }
    testWaitForTimeout(2000); //等待时间结束，回到默认会话
    _Send_Diag(Arry_Len,phyreq_ID,Arry_Data);
    _Check_Return(2);
    _Check_EPS_TX(1,EPS_TxID_1);
    _Set_Sig(Sig_28_Set,0);
  }
  else
    _WriteEx_and_Report("","当前寻址或会话不支持");
}


_2E_Serve_1(dword ID,byte Session)/*  7F>13*/
{
  _get_Str_Traversal("DID_2E_Traversal");
  if(Traversal_Count>0)
    _get_2E_DID(Traversal_DID[0]);
  else
    _get_2E_DID("DID2E_Rx_NRC33");
  if(DID_2E_SendData_1_Len<3)
  {
    DID_2E_SendData_1_Len = 3;
    DID_2E_SendData_1[0] = 0x2E;
  }
  _Send_Diag(DID_2E_SendData_1_Len,ID,DID_2E_SendData_1);
  if(Geely3_Flage == 1 && ID == phyreq_ID)
    _TestResult(SendData,ID,"",NRC13);
  else
    _TestResult(SendData,ID,"",NRC7F);
}

_2E_Serve_2(dword ID,byte Session)/*  遍历*/
{
  int m;
  _get_Str_Traversal("DID_2E_Traversal");
  for(m=0;m<Traversal_Count;m++)
  {
    if(m>0)
    {
      _SetSession(defsession);
      testWaitForTimeout(200);
      _SetSession(exsession);
    }
    _get_2E_DID(Traversal_DID[m]);
    _Clear_Config(DID_2E_SendData_1,Session);
    _Check_DID_2E(ID,Session);
    testWaitForTimeout(100);
  }
}

_2E_Serve_3(dword ID,byte Session)/*  写入零件号*/
{
  char str1[200];
  byte Read_Data[200];
  int Read_Data_Len;
  int i,m,Flage_Read;
  _Get_Write_Part_number();
  if(DID_2E_SendData_1_Len==0)
    _WriteEx_and_Report("","未查询到零件号写入值,不执行后续操作");
  else
  {
    snprintf(str1,elCount(str1),"%s","");
    snprintf(str1,elCount(str1),"%s","获取第一次写入数据: ");
    if(Support_Read_2E_DID == 1)
    {
      for(i=0;i<DID_2E_SendData_1_Len;i++)
      {
        snprintf(str1,elCount(str1),"%s%02X",str1,DID_2E_SendData_1[i]);
        snprintf(str1,elCount(str1),"%s%s",str1,"  ");
      }
      _WriteEx_and_Report("",str1);
      _Send_Diag(Read_2E_DID_Len,phyreq_ID,Read_2E_DID);
      _TestResult(SendData,phyreq_ID,"",-1);
      {
        Flage_Read = 0;
        if(diagGetLastResponseCode(SendData) == -1)
        {
          Read_Data_Len =  DiagGetRespPrimitiveSize(SendData);
          Flage_Read = 1;
          for(m=0;m<Read_Data_Len;m++)
            Read_Data[m] = DiagGetRespPrimitiveByte(SendData,m);
        }
      }
      if(Part_number_Fac==1)
        _unlockFactory();
      else
        _unlockECU();
      if(DID_2E_SendData_1_Response == -1)
      {
        _Send_Diag(DID_2E_SendData_1_Len,ID,DID_2E_SendData_1);
        _TestResult(SendData,ID,"",-1);
        testWaitForTimeout(500);
        _Send_Diag(Read_2E_DID_Len,phyreq_ID,Read_2E_DID);
        _Check_Response_Part_number(SendData,DID_2E_SendData_1_Len,DID_2E_SendData_1);
        _WriteEx_and_Report("","第一次写入判断完成");
        _Power_Down();
        testWaitForTimeout(2000);
        _Power_Up();
        testWaitForTimeout(1000);
        _Send_Diag(Read_2E_DID_Len,phyreq_ID,Read_2E_DID);
        _Check_Response_Part_number(SendData,DID_2E_SendData_1_Len,DID_2E_SendData_1);
        _WriteEx_and_Report("","正常上下电读取判断完成");
        _Set_11_Restoration();
        _Send_Diag(Read_2E_DID_Len,phyreq_ID,Read_2E_DID);
        _Check_Response_Part_number(SendData,DID_2E_SendData_1_Len,DID_2E_SendData_1);
        _WriteEx_and_Report("","11复位读取判断完成");
        _K30_OFF();
        testWaitForTimeout(2000);
        _K30_ON();
        testWaitForTimeout(1000);
        _Send_Diag(Read_2E_DID_Len,phyreq_ID,Read_2E_DID);
        _Check_Response_Part_number(SendData,DID_2E_SendData_1_Len,DID_2E_SendData_1);
        _WriteEx_and_Report("","异常复位读取判断完成");
      }
      else
      {
        _WriteEx_and_Report("","期望结果不为正响应,验证异常写入后值不被改变");
        _Send_Diag(DID_2E_SendData_1_Len,ID,DID_2E_SendData_1);
        _TestResult(SendData,phyreq_ID,"",DID_2E_SendData_1_Response);
        if(Flage_Read == 0)
          _WriteEx_and_Report("","第一次读取时未获取到正确值,不再测试后续部分");
        else
        {
          _Send_Diag(Read_2E_DID_Len,phyreq_ID,Read_2E_DID);
          _Check_Response_2E(SendData,Read_Data_Len,Read_Data);
          _Power_Down();
          testWaitForTimeout(2000);
          _Power_Up();
          testWaitForTimeout(1000);
          _Send_Diag(Read_2E_DID_Len,phyreq_ID,Read_2E_DID);
          _Check_Response_2E(SendData,Read_Data_Len,Read_Data);
          _WriteEx_and_Report("","正常上下电读取判断完成");
          _Set_11_Restoration();
          _Send_Diag(Read_2E_DID_Len,phyreq_ID,Read_2E_DID);
          _Check_Response_2E(SendData,Read_Data_Len,Read_Data);
          _WriteEx_and_Report("","11复位读取判断完成");
          _K30_OFF();
          testWaitForTimeout(2000);
          _K30_ON();
          testWaitForTimeout(1000);
          _Send_Diag(Read_2E_DID_Len,phyreq_ID,Read_2E_DID);
          _Check_Response_2E(SendData,Read_Data_Len,Read_Data);
          _WriteEx_and_Report("","异常复位读取判断完成");
        }
      }
      if(Part_number_Fac==1)
        _unlockFactory();
      else
        _unlockECU();
      if(DID_2E_SendData_1_Response == -1 && DID_2E_SendData_2_Response == -1)
      {
        _Send_Diag(DID_2E_SendData_2_Len,ID,DID_2E_SendData_2);
        _TestResult(SendData,ID,"",-1);
        _Send_Diag(Read_2E_DID_Len,phyreq_ID,Read_2E_DID);
        _Check_Response_Part_number(SendData,DID_2E_SendData_2_Len,DID_2E_SendData_2);
        _WriteEx_and_Report("","第二次写入判断完成");
      }
      else if(DID_2E_SendData_1_Response != -1 && DID_2E_SendData_2_Response == -1)
      {
        _WriteEx_and_Report("","第一次写入值未成功,验证第二次写入");
        _Send_Diag(DID_2E_SendData_2_Len,ID,DID_2E_SendData_2);
        _TestResult(SendData,ID,"",-1);
        testWaitForTimeout(500);
        _Send_Diag(Read_2E_DID_Len,phyreq_ID,Read_2E_DID);
        _Check_Response_2E(SendData,DID_2E_SendData_2_Len,DID_2E_SendData_2);
        _WriteEx_and_Report("","第二次写入判断完成");
        _Power_Down();
        testWaitForTimeout(2000);
        _Power_Up();
        testWaitForTimeout(1000);
        _Send_Diag(Read_2E_DID_Len,phyreq_ID,Read_2E_DID);
        _Check_Response_2E(SendData,DID_2E_SendData_2_Len,DID_2E_SendData_2);
        _WriteEx_and_Report("","正常上下电读取判断完成");
        _Set_11_Restoration();
        _Send_Diag(Read_2E_DID_Len,phyreq_ID,Read_2E_DID);
        _Check_Response_2E(SendData,DID_2E_SendData_2_Len,DID_2E_SendData_2);
        _WriteEx_and_Report("","11复位读取判断完成");
        _K30_OFF();
        testWaitForTimeout(2000);
        _K30_ON();
        testWaitForTimeout(1000);
        _Send_Diag(Read_2E_DID_Len,phyreq_ID,Read_2E_DID);
        _Check_Response_2E(SendData,DID_2E_SendData_2_Len,DID_2E_SendData_2);
        _WriteEx_and_Report("","异常复位读取判断完成");
      }
      else if(DID_2E_SendData_2_Response != -1)
      {
        _Send_Diag(DID_2E_SendData_2_Len,ID,DID_2E_SendData_2);
        _TestResult(SendData,ID,"",DID_2E_SendData_2_Response);
      }
    }
    else
    {
      _WriteEx_and_Report("","不支持读取,仅验证写入后正响应");
      if(Part_number_Fac==1)
        _unlockFactory();
      else
        _unlockECU();
      _Send_Diag(DID_2E_SendData_1_Len,ID,DID_2E_SendData_1);
      _TestResult(SendData,ID,"",-1);
    }
  }
}
_2E_Serve_4(dword ID,byte Session)/*  NRC优先级*/
{  
  int Serve_Pos,i;
  byte Send_Data[100];
  
   Serve_Pos = _Check_Serve(0x2E,0,0);
  if(_Check_Serve_IDAndSess(0x2E,ID,Session) == 1)
  {
    Send_Data[0] = 0x2E;
     _Set_NRC_Step(0x2E,Serve_Data[Serve_Pos].Serve_Fun[0],6,Send_Data);
    if(Fun_NRC_Count == 0)
    {
      _WriteEx_and_Report("","未输入NRC，跳过测试");
      return;
    }
    for(i=0;i<Fun_NRC_Count;i++) 
    {
      if(i>0) //第一次反馈最高优先级不做处理,其余依次恢复
      {
        _Recover_NRC_Step(Fun_NRC[i-1],Serve_Pos,0,Send_Data);
      }
      _Send_Diag(Fun_NRC_Send_Len,ID,Send_Data);
      if(i == Fun_NRC_Count)
        _TestResult(SendData,ID,"",-1);
      else
        _TestResult(SendData,ID,"",Fun_NRC[i]);
      testWaitForTimeout(100);
    }
  }
}
_2E_Serve_5(dword ID,byte Session)/*  NRC33 */
{
  byte Data[500];
  byte Data2[500];
  char Temp_Str[30];
  int Clear_Config_Flage,SWhere;
  int i=0,j=0,Len=0,Len2=0,flage,Unlock_Flage;
  dword TempRead;
  snprintf(Temp_Str,elCount(Temp_Str),"%s","");
  _get_Str_Traversal("DID_2E_Traversal");
  Clear_Config_Flage = 0;
  if(strncmp(ECU_project,"BYD",strlen(ECU_project)) == 0 && strlen(ECU_project) == strlen("BYD"))
  {
    for(i=0;i<Traversal_Count;i++)
    {
      if((strncmp(Traversal_DID[i],"DID2E_F1A1",strlen(Traversal_DID[i])) == 0 && strlen(Traversal_DID[i]) == strlen("DID2E_F1A1")) || (strncmp(Traversal_DID[i],"DID2E_2100",strlen(Traversal_DID[i])) == 0 && strlen(Traversal_DID[i]) == strlen("DID2E_2100")))
      {
        Clear_Config_Flage = 1;
        break;
      }
    }
  }
  if(Clear_Config_Flage == 1)
  {
    byte Data_Send[11] = {0x2E,0xF1,0xA1,0,0,0,0,0,0,0,0x55};
    _unlockECU();
    _Send_Diag(11,phyreq_ID,Data_Send);
    _TestResult(SendData,ID,"",-1);
    _SetSession(Session);
  }
  for(i=0;i<Traversal_Count;i++)
  {
    _get_2E_DID(Traversal_DID[i]);
    snprintf(Temp_Str,elCount(Temp_Str),"%s","");
    snprintf(Temp_Str,elCount(Temp_Str),"  开始测试  %02X %02X",DID_2E_SendData_1[1],DID_2E_SendData_1[2]);
    _WriteEx_and_Report("","------------------------------------");
    _WriteEx_and_Report("",Temp_Str);
    _WriteEx_and_Report("","------------------------------------");
    if((DID_2E_SendData_1[1] == 0xF1 && DID_2E_SendData_1[2] == 0xA1) || (DID_2E_SendData_1[1] == 0x21 && DID_2E_SendData_1[2] == 0x00))
      SWhere = i;
    if(i>0)
      _SetSession(Session);
    if(Support_Read_2E_DID == 1)
    {
      TempRead = ((Read_2E_DID[1]<<8)|Read_2E_DID[2]);
      Unlock_Flage = _Check_Serve(0x22,TempRead,5);
      if(Unlock_Flage == 1)
        _unlockECU();
      _Send_Diag(Read_2E_DID_Len,ID,Read_2E_DID);
      _TestResult(SendData,ID,"",-1);
      if(diagGetLastResponseCode(SendData)==-1)
      {
        Len = DiagGetRespPrimitiveSize(SendData);
        for(j=0;j<Len;j++)
          Data[j] = DiagGetRespPrimitiveByte(SendData,j);
      }
      else
        testStepFail("22读取数据","未收到正响应");
      _SetSession(Session);
      _Send_Diag(DID_2E_SendData_1_Len,ID,DID_2E_SendData_1);
      _TestResult(SendData,ID,"",NRC33);
      
      if(Unlock_Flage == 1)
        _unlockECU();
      _Send_Diag(Read_2E_DID_Len,ID,Read_2E_DID);
      _TestResult(SendData,ID,"",-1);
      if(diagGetLastResponseCode(SendData)==-1)
      {
        Len2 = DiagGetRespPrimitiveSize(SendData);
        for(j=0;j<Len2;j++)
          Data2[j] = DiagGetRespPrimitiveByte(SendData,j);
      }
      else
        testStepFail("22读取数据","未收到正响应");
      if(Len!=Len2 )
        testStepFail(Traversal_DID[i],"两次接收到的数据长度不一致,第一次长度为%d,第二次长度为%d",Len,Len2);
      else
      {
        for(j=0;j<Len;j++)
        {
          if(Data[j]!=Data2[j])
            flage=1;
        }
        if(flage==1)
          testStepFail(Traversal_DID[i],"两次返回的数据不一致");
        else
          testStepPass(Traversal_DID[i],"两次返回的数据一致");
      }
      
      if(Unlock_Flage == 1)
        _Set_11_Restoration(0);
      else
        _Set_11_Restoration();
      if(Session != defsession)
        _SetSession(Session);
      
      if(Unlock_Flage == 1)
        _unlockECU();
      _Send_Diag(Read_2E_DID_Len,ID,Read_2E_DID);
      _TestResult(SendData,ID,"",-1);
      if(diagGetLastResponseCode(SendData)==-1)
      {
        Len2 = DiagGetRespPrimitiveSize(SendData);
        for(j=0;j<Len2;j++)
          Data2[j] = DiagGetRespPrimitiveByte(SendData,j);
      }
      else
        testStepFail("22读取数据","未收到正响应");
      if(Len!=Len2 )
        testStepFail(Traversal_DID[i],"第三次接收到的数据长度不一致,第一次长度为%d,第三次长度为%d",Len,Len2);
      else
      {
        for(j=0;j<Len;j++)
        {
          if(Data[j]!=Data2[j])
            flage=1;
        }
        if(flage==1)
          testStepFail(Traversal_DID[i],"第三次返回的数据不一致");
        else
          testStepPass(Traversal_DID[i],"第三次返回的数据一致");
      }
      
    }
    else
    {
      _WriteEx_and_Report(Traversal_DID[i],"不支持读取,仅验证返回NRC33");
      _Send_Diag(DID_2E_SendData_1_Len,ID,DID_2E_SendData_1);
      _TestResult(SendData,ID,"",NRC33);
    }
  }
  if(Clear_Config_Flage == 1)
  {
    _unlockECU();
    _get_2E_DID(Traversal_DID[SWhere]);
    _Send_Diag(DID_2E_SendData_1_Len,phyreq_ID,DID_2E_SendData_1);
    _TestResult(SendData,ID,"",-1);
  }
}
_2E_Serve_6(dword ID,byte Session)/*  NRC13 */
{
  byte Data[400];
  int Len,i,j;
  char Temp_Str[30];
  _get_Str_Traversal("DID_2E_Traversal");
  for(j=0;j<Traversal_Count;j++)
  {
    _get_2E_DID(Traversal_DID[j]);
    if(j==0)
      _unlockECU();

    snprintf(Temp_Str,elCount(Temp_Str),"%s","");
    snprintf(Temp_Str,elCount(Temp_Str),"  开始测试  %02X %02X",DID_2E_SendData_1[1],DID_2E_SendData_1[2]);
    _WriteEx_and_Report("","------------------------------------");
    _WriteEx_and_Report("",Temp_Str);
    _WriteEx_and_Report("","------------------------------------");
    for(i=0;i<DID_2E_SendData_1_Len;i++)
      Data[i] = DID_2E_SendData_1[i];
    if(DID_2E_SendData_1_Len<7)  
      Len = 7;
    else
      Len = DID_2E_SendData_1_Len+1;
    for(i=1;i<=Len;i++)
    {
      if(i==DID_2E_SendData_1_Len) 
        continue;
      _Send_Diag(i,ID,Data);
      _TestResult(SendData,ID,"",NRC13);
      testWaitForTimeout(20);
    }
  }
}
_2E_Serve_7(dword ID,byte Session)/*  NRC31 */
{  
  byte Send_Data[3]={0x2E,0xF1,0x80}; 
  dword byte1,byte2,Fun_Send;
  int Return_Va;
  int Flage,Serve_Pos;
  Return_Va = _Check_Serve_IDAndSess(0x2E,ID,Session);
  Serve_Pos = _Check_Serve(0x2E,0,0);
  snprintf(Fault_Data_Write,elCount(Fault_Data_Write),"%s","");
  testGetCurrentTestCaseTitle(Fault_Data_Write,400);
  snprintf(Fault_Data_Write,elCount(Fault_Data_Write),"\n %s: \n    遍历2E服务NRC31数据时,异常响应: \n",Fault_Data_Write);
  File_Write(Error_File,Error_FileName,Fault_Data_Write,2);
  _unlockECU();
  if(Return_Va == 1 || Serve_Data[Serve_Pos].Serve_Fun_Count == 0)
  {
    if(Traversal_2E==0)
    {
      for(byte1=0;byte1<=0xff;byte1++)
      {
        Send_Data[1]=byte1;
        for(byte2=0;byte2<=0xff;byte2++)
        {
          Send_Data[2]=byte2;
          Fun_Send = (byte1 << 8) ^ byte2;
          if(_Check_Serve(0x2E,Fun_Send,4) != -1)
          {
            _WriteEx_and_Report("","该子功能支持，跳过检测");
            continue;
          }
          else
          {
            _Send_Diag(4,ID,Send_Data);
            Flage = _TestResult(SendData,ID,"",NRC31);
            testWaitForTimeout(10);
            if(Flage == -1)
            {
              char Str[30];
              snprintf(Str,elCount(Str),"[  0x%02X 0x%02X  ] \n",byte1,byte2);
              File_Write(Error_File,Error_FileName,Str,2);
            }
          }
        }
      } 
    }
    if(Traversal_2E != 0)
    {
      Send_Data[1] = Traversal_2E;
      for(byte2=0;byte2<=0xff;byte2++)
      {
        Send_Data[2]=byte2;
        Fun_Send = (Traversal_2E << 8) ^ byte2;
        if(_Check_Serve(0x2E,Fun_Send,4) != -1)
        {
          _WriteEx_and_Report("","该子功能支持，跳过检测");
          continue;
        }
        else
        {
          _Send_Diag(4,ID,Send_Data);
          Flage = _TestResult(SendData,ID,"",NRC31);
          testWaitForTimeout(10);
          if(Flage == -1)
          {
            char Str[30];
            snprintf(Str,elCount(Str),"[  0x%02X 0x%02X  ] \n",byte1,byte2);
            File_Write(Error_File,Error_FileName,Str,2);
          }
        }
      }
    }
  }
  else if(Return_Va == -1)
    _WriteEx_and_Report("","当前寻址不支持该服务");
  else if(Return_Va == 0)
    _WriteEx_and_Report("","当前会话不支持该服务");
}


_Serve31_01(dword ID,byte Session) /*新31例程遍历*/
{
  byte Send_Data[100];
  int i,Flage;
  _Set_11_Restoration();
  _Set_Ready(0);
  testWaitForTimeout(1000);//11服务规避检测对中影响
  for(i=0;i<Serve_31_Hex_Count;i++)
  {
    writeEx(-3,0,"/*-----------0x%02X 0x%02X-----------*/",Serve_31_Hex[i].Routine[0],Serve_31_Hex[i].Routine[1]);
    testStep("","/*-----------0x%02X 0x%02X-----------*/",Serve_31_Hex[i].Routine[0],Serve_31_Hex[i].Routine[1]);
    if(_Check_Serve_IDAndSess(0x31,i,ID,Session)!=1)
    {
      writeEx(-3,0,"当前测试项次不支持当前寻址或会话");
      continue;
    }
    if(Session != defsession)
      _SetSession(defsession);
    _SetSession(Session);
    testWaitForTimeout(200);
    if(LoopServe_Search_SecurityAccess(0x31,i) == 1)
      _unlockECU();
    testWaitForTimeout(500);
    _Get_31_ServeData(i,Send_Data,0);
    Send_Data[1] = 0x03;
    Flage = _Check_SendData_In_31H(Send_Data);
    _Send_Diag(Serve_31_Hex[i].Routine_Len,ID,Send_Data);
    if(Flage == -1)
      _TestResult(SendData,ID,"",NRC12);
    else
      _TestResult(SendData,ID,"",NRC24);
    testWaitForTimeout(200);
    if(Serve_31_Hex[i].Control_Type_RSP[0] == 1)
    {
      Send_Data[1] = 0x83;
      _Send_Diag(Serve_31_Hex[i].Routine_Len,ID,Send_Data);
      if(Flage == -1)
        _TestResult(SendData,ID,"",NRC12);
      else
        _TestResult(SendData,ID,"",NRC24);
      testWaitForTimeout(200);
    }
    Send_Data[1] = 0x01;
    _Send_Diag(Serve_31_Hex[i].Routine_Len,ID,Send_Data);
    _Check_31Routine_Rx(Send_Data,1);
    testWaitForTimeout(200);
    if(Serve_31_Hex[i].Control_Type_RSP[0] == 1)
    {
      Send_Data[1] = 0x81;
      _Send_Diag(Serve_31_Hex[i].Routine_Len,ID,Send_Data);
      _TestResult(SendData,ID,"",0);
      testWaitForTimeout(200);
    }
    if(Flage != -1)
    {
      Send_Data[1] = 0x03;
      _Send_Diag(Serve_31_Hex[i].Routine_Len,ID,Send_Data);
      _Check_31Routine_Rx(Send_Data,1);
      if(Serve_31_Hex[i].Control_Type_RSP[0] == 1)
      {
        Send_Data[1] = 0x83;
        _Send_Diag(Serve_31_Hex[i].Routine_Len,ID,Send_Data);
        _TestResult(SendData,ID,"",0);
      }
    }
  }
  {
    _WriteEx_and_Report("","测试已完成,后续步骤为对中清除故障码");
    _SetSession(defsession);
    _Ang_Calibration_();
  }
}

_31_Serve_01(dword ID,byte Session) /*7F>13*/
{
   byte Send_Data[100];
  if(_Check_Serve_IDAndSess(0x31,ID,Session) == 1)
  {
    _WriteEx_and_Report("","当前寻址及服务会正响应，在其余用例中测试");
    return;
  }
  _Get_31_ServeData(0,Send_Data,0);
  
  _Send_Diag((Serve_31_Hex[0].Routine_Len-1),ID,Send_Data);
  _TestResult(SendData,ID,"",NRC7F);
}

_31_Serve_02(dword ID,byte Session) /*预编程*/
{
  _get_Arry("Pre_Programmed");
  if(Arry_Len>0)
  {
    if(Pre_Programmed_UnlockECU==1)
      _unlockECU();
    Arry_Data[1] = 0x03;
    _Send_Diag(Arry_Len,ID,Arry_Data);
    for(i=0;i<4;i++)
      Pre_Programmed[i] = Arry_Data[i];
    if(_Check_SendData_In_31H(Arry_Data)==-1)
      _TestResult(SendData,ID,"",NRC12);
    else
      _TestResult(SendData,ID,"",NRC24);
    Arry_Data[1] = 0x01;
    _Send_Diag(4,ID,Arry_Data);
    _Check_31Routine_Rx(Arry_Data,1);
    Arry_Data[1] = 0x03;
    _Send_Diag(4,ID,Arry_Data);
    for(i=0;i<4;i++)
      Pre_Programmed[i] = Arry_Data[i];
    if(_Check_SendData_In_31H(Arry_Data)==-1)
      _TestResult(SendData,ID,"",NRC12);
    else
      _Check_31Routine_Rx(Arry_Data,1);
  }
  else
    _WriteEx_and_Report("","未查询到预编程数据输入");
}

_31_Serve_03_CCAG(dword ID,byte Session) /*清除角度对中*/
{
  _get_Arry("Clear_Angle_Calibration");
  if(Arry_Len>0)
  {
    _unlockECU();
    _Send_Diag(Arry_Len,ID,Arry_Data);
    _Check_31Routine_Rx(Arry_Data,1);
  }
  else
    _WriteEx_and_Report("","未查询到清除角度对中数据输入");
}
_31_Serve_04_CCAG(dword ID,byte Session) /*角度对中*/
{
  _get_Arry("Angle_Calibration");
  if(Arry_Len>0)
  {
    _unlockECU();
    _Send_Diag(Arry_Len,ID,Arry_Data);
    _Check_31Routine_Rx(Arry_Data,1);
  }
  else
    _WriteEx_and_Report("","未查询到角度对中数据输入");
}
_31_Serve_05_BYD(dword ID,byte Session) /*角度对中*/
{
    _Set_11_Restoration();
    testWaitForTimeout(1000);
    _SetSession(Session);
    _Set_Ready(Struct_Ready.Ready_Active);
    _Set_CarSpd(10);
    testWaitForTimeout(1000);
    
    _unlockECU();
    _get_Arry("Angle_Calibration");
    Arry_Data[1] = 0X03;
    _Send_Diag(Arry_Len,ID,Arry_Data);
    if(_Check_SendData_In_31H(Arry_Data)!= -1)
      _TestResult(SendData,ID,"",NRC24);
    else
      _TestResult(SendData,ID,"",NRC12);
    Arry_Data[1] = 0X01;
    _Send_Diag(Arry_Len,ID,Arry_Data);
    _Check_31Routine_Rx(Arry_Data,1);
    Arry_Data[1] = 0X03;
    _Send_Diag(Arry_Len,ID,Arry_Data);
    if(_Check_SendData_In_31H(Arry_Data)!= -1)
      _Check_31Routine_Rx(Arry_Data,1);
    else
      _TestResult(SendData,ID,"",NRC12);
    
    _Set_Ready(0);
    _Set_CarSpd(0);
    testWaitForTimeout(2000);
}
_31_Serve_06_BYD(dword ID,byte Session) /*擦除角度对中*/
{
    _Set_11_Restoration();
    testWaitForTimeout(1000);
    _SetSession(Session);
    _Set_Ready(Struct_Ready.Ready_Active);
    _Set_CarSpd(10);
    testWaitForTimeout(1000);
    
    _unlockECU();
    _get_Arry("Clear_Angle_Calibration");
    Arry_Data[1] = 0X03;
    _Send_Diag(Arry_Len,ID,Arry_Data);
    if(_Check_SendData_In_31H(Arry_Data)!= -1)
      _TestResult(SendData,ID,"",NRC24);
    else
      _TestResult(SendData,ID,"",NRC12);
    Arry_Data[1] = 0X01;
    _Send_Diag(Arry_Len,ID,Arry_Data);
    _Check_31Routine_Rx(Arry_Data,1);
    Arry_Data[1] = 0X03;
    _Send_Diag(Arry_Len,ID,Arry_Data);
    if(_Check_SendData_In_31H(Arry_Data)!= -1)
      _Check_31Routine_Rx(Arry_Data,1);
    else
      _TestResult(SendData,ID,"",NRC12);
    
    _Set_Ready(0);
    _Set_CarSpd(0);
    testWaitForTimeout(2000);
}
_31_Serve_07_BYD(dword ID,byte Session) /*擦除软止点*/
{
    _unlockECU();
    _get_Arry("Clear_SoftStop");
    Arry_Data[1] = 0X03;
    _Send_Diag(Arry_Len,ID,Arry_Data);
    if(_Check_SendData_In_31H(Arry_Data)!= -1)
      _TestResult(SendData,ID,"",NRC24);
    else
      _TestResult(SendData,ID,"",NRC12);
    Arry_Data[1] = 0X01;
    _Send_Diag(Arry_Len,ID,Arry_Data);
    _Check_31Routine_Rx(Arry_Data,1);
    Arry_Data[1] = 0X03;
    _Send_Diag(Arry_Len,ID,Arry_Data);
    _Check_31Routine_Rx(Arry_Data,1);
}
_31_Serve_08_BYD(dword ID,byte Session) /*擦除偏移角度学习数据*/
{
    _unlockECU();
    _get_Arry("Clear_AngOffset");
    Arry_Data[1] = 0X03;
    _Send_Diag(4,ID,Arry_Data);
    if(_Check_SendData_In_31H(Arry_Data)!= -1)
      _TestResult(SendData,ID,"",NRC24);
    else
      _TestResult(SendData,ID,"",NRC12);
    Arry_Data[1] = 0X01;
    _Send_Diag(Arry_Len,ID,Arry_Data);
    _Check_31Routine_Rx(Arry_Data,1);
}
_31_Serve_09_BYD(dword ID,byte Session) /*擦除PDC学习数据*/
{
    _unlockECU();
    _get_Arry("Clear_PDC");
    Arry_Data[1] = 0X03;
    _Send_Diag(Arry_Len,ID,Arry_Data);
    if(_Check_SendData_In_31H(Arry_Data)!= -1)
      _TestResult(SendData,ID,"",NRC24);
    else
      _TestResult(SendData,ID,"",NRC12);
    Arry_Data[1] = 0X01;
    _Send_Diag(Arry_Len,ID,Arry_Data);
    _Check_31Routine_Rx(Arry_Data,1);
    Arry_Data[1] = 0X03;
    _Send_Diag(Arry_Len,ID,Arry_Data);
    if(_Check_SendData_In_31H(Arry_Data)!= -1)
       _Check_31Routine_Rx(Arry_Data,1);
    else
      _TestResult(SendData,ID,"",NRC12);
}
_31_Serve_10_BYD(dword ID,byte Session) /*功能开关MSP/Shimmy/PDC功能开关*/
{
    _unlockECU();
    _get_Arry("FUN_PDC");
    Arry_Data[1] = 0X03;
    _Send_Diag(4,ID,Arry_Data);
    _TestResult(SendData,ID,"",NRC13);
    Arry_Data[1] = 0X01;
    _Send_Diag(Arry_Len,ID,Arry_Data);
    _Check_31Routine_Rx(Arry_Data,1);
}
_31_Serve_11_YunDu(dword ID,byte Session) /*角度对中*/
{
  _unlockECU();
  _get_Arry("Angle_Calibration");
  Arry_Data[1] = 0X01;
  _Send_Diag(Arry_Len,ID,Arry_Data);
  _Check_31Routine_Rx(Arry_Data,1);
  Arry_Data[1] = 0X03;
  _Send_Diag(Arry_Len,ID,Arry_Data);
  _Check_31Routine_Rx(Arry_Data,1);
}
_31_Serve_12_YunDu(dword ID,byte Session) /*清除角度对中*/
{
  _unlockECU();
  _get_Arry("Clear_Angle_Calibration");
  Arry_Data[1] = 0X01;
  _Send_Diag(Arry_Len,ID,Arry_Data);
  _Check_31Routine_Rx(Arry_Data,1);
  Arry_Data[1] = 0X03;
  _Send_Diag(Arry_Len,ID,Arry_Data);
  _Check_31Routine_Rx(Arry_Data,1);
}
_31_Serve_13_YunDu(dword ID,byte Session) /*检查标定状态*/
{
  _unlockECU();
  _get_Arry("Check_Calibration");
  _Send_Diag(Arry_Len,ID,Arry_Data);
  _Check_31Routine_Rx(Arry_Data,1);
}
_31_Serve_14_DongFeng(dword ID,byte Session) /*角度对中*/
{
  _unlockECU();
  _get_Arry("Angle_Calibration");
  Arry_Data[1] = 0X03;
  _Send_Diag(Arry_Len,ID,Arry_Data);
  _TestResult(SendData,ID,"",NRC24);
  Arry_Data[1] = 0X01;
  _Send_Diag(Arry_Len,ID,Arry_Data);
  _Check_31Routine_Rx(Arry_Data,1);
  Arry_Data[1] = 0X03;
  _Send_Diag(Arry_Len,ID,Arry_Data);
  _TestResult(SendData,ID,"",NRC24);
  Arry_Data[1] = 0X01;
  _Send_Diag(Arry_Len,ID,Arry_Data);
  _Check_31Routine_Rx(Arry_Data,1);
  Arry_Data[1] = 0X02;
  _Send_Diag(Arry_Len,ID,Arry_Data);
  _Check_31Routine_Rx(Arry_Data,1);
  Arry_Data[1] = 0X03;
  _Send_Diag(Arry_Len,ID,Arry_Data);
  _Check_31Routine_Rx(Arry_Data,1);
}
_31_Serve_15_JAC(dword ID,byte Session) /*角度对中*/
{
  word i;
  diagStartTesterPresent("ABS_EPS");
  _unlockECU();
  _get_Arry("Angle_Calibration");
  Arry_Data[1] = 0X01;
  _Send_Diag(Arry_Len,ID,Arry_Data);
  _Check_31Routine_Rx(Arry_Data,1);
  Arry_Data[1] = 0X03;
  _Send_Diag(Arry_Len,ID,Arry_Data);
  _Check_31Routine_Rx(Arry_Data,1);
  for(i=0;i<=0xFF;i++)
  {
    Arry_Data[1] = i;
    if(i==1 || i==3)
      continue;
    _Send_Diag(Arry_Len,ID,Arry_Data);
    _TestResult(SendData,ID,"",NRC12);
  }
}
_31_Serve_16_JAC(dword ID,byte Session) /*清除角度对中*/
{
  word i;
  diagStartTesterPresent(Cdd_Name);
  _unlockECU();
  _get_Arry("Clear_Angle_Calibration");
  Arry_Data[1] = 0X01;
  _Send_Diag(Arry_Len,ID,Arry_Data);
  _Check_31Routine_Rx(Arry_Data,1);
  Arry_Data[1] = 0X03;
  _Send_Diag(Arry_Len,ID,Arry_Data);
  _Check_31Routine_Rx(Arry_Data,1);
  for(i=0;i<=0xFF;i++)
  {
    Arry_Data[1] = i;
    if(i==1 || i==3)
      continue;
    _Send_Diag(Arry_Len,ID,Arry_Data);
    _TestResult(SendData,ID,"",NRC12);
  }
}
_31_Serve_17_JAC(dword ID,byte Session) /*检查标定状态-角度信号无效*/
{
  char str[100];
  byte Temp[5];
  diagStartTesterPresent(Cdd_Name);
  snprintf(str,elCount(str),"%s","");
  snprintf(str,elCount(str),"断开传感器角度信号");
  testWaitForTesterConfirmation(str,30000);
  _get_Arry("Check_Calibration");
  Temp[0] = Arry_Data[0]^0x40;
  for(i=1;i<Arry_Len;i++)
  {
    Temp[i]= Arry_Data[i];
  }
  Temp[Arry_Len] = 0x05;
  _Send_Diag(Arry_Len,ID,Arry_Data);
  _Check_Response(SendData,5,Temp);
  snprintf(str,elCount(str),"%s","");
  snprintf(str,elCount(str),"恢复传感器角度信号");
  _Power_Down();
  testWaitForTimeout(1000);
  _Power_Up();
  testWaitForTesterConfirmation(str,30000);
}
_31_Serve_18_JAC(dword ID,byte Session) /*检查标定状态-电压限制*/
{
  byte Temp[5];
  diagStartTesterPresent(Cdd_Name);
  _Set_Battery(NRC22_Battery_Low-0.3);
  _get_Arry("Check_Calibration");
  Arry_Data[1] = 0x01;
  _Send_Diag(Arry_Len,ID,Arry_Data);
  _TestResult(SendData,ID,"",0x93);
  Arry_Data[1] = 0x03;
  Temp[0] = Arry_Data[0]^0x40;
  for(i=1;i<Arry_Len;i++)
  {
    Temp[i]= Arry_Data[i];
  }
  Temp[Arry_Len] = 0x01;
  _Send_Diag(Arry_Len,ID,Arry_Data);
  _Check_Response(SendData,5,Temp);
  _Set_Battery(NRC22_Battery_Hight+0.3);
  Arry_Data[1] = 0x01;
  _Send_Diag(Arry_Len,ID,Arry_Data);
  _TestResult(SendData,ID,"",0x92);
  Arry_Data[1] = 0x03;
  _Send_Diag(Arry_Len,ID,Arry_Data);
  _Check_Response(SendData,5,Temp);
  _Set_Battery(14);
}
_31_Serve_19_JAC(dword ID,byte Session) /*检查标定状态-车速限制*/
{
  byte Temp[5];
  diagStartTesterPresent(Cdd_Name);
  _Set_CarSpd(4);
  testWaitForTimeout(1000);
  _get_Arry("Check_Calibration");
  Arry_Data[1] = 0x01;
  _Send_Diag(Arry_Len,ID,Arry_Data);
  _TestResult(SendData,ID,"",0x88);
  Arry_Data[1] = 0x03;
  Temp[0] = Arry_Data[0]^0x40;
  for(i=1;i<Arry_Len;i++)
    Temp[i]= Arry_Data[i];
  Temp[Arry_Len] = 0x02;
  _Send_Diag(Arry_Len,ID,Arry_Data);
  _Check_Response(SendData,5,Temp);
  _Set_CarSpd(0);
}
_31_Serve_20_JAC(dword ID,byte Session) /*检查标定状态-扭矩限制*/
{
  char str[100];
  byte Temp[5];
  diagStartTesterPresent(Cdd_Name);
  snprintf(str,elCount(str),"%s","");
  snprintf(str,elCount(str),"保持方向盘扭矩大于1Nm");
  testWaitForTesterConfirmation(str,30000);
  _get_Arry("Check_Calibration");
  Arry_Data[1] = 0x01;
  _Send_Diag(Arry_Len,ID,Arry_Data);
  _TestResult(SendData,ID,"",0x95);
  Arry_Data[1] = 0x03;
  Temp[0] = Arry_Data[0]^0x40;
  for(i=1;i<Arry_Len;i++)
    Temp[i]= Arry_Data[i];
  Temp[Arry_Len] = 0x03;
  _Send_Diag(Arry_Len,ID,Arry_Data);
  _Check_Response(SendData,5,Temp);
  snprintf(str,elCount(str),"%s","");
  snprintf(str,elCount(str),"松开方向盘");
  testWaitForTesterConfirmation(str,30000);
}
_31_Serve_21_JAC(dword ID,byte Session) /*检查标定状态-转速限制*/
{
  char str[100];
  byte Temp[5];
  diagStartTesterPresent(Cdd_Name);
  snprintf(str,elCount(str),"%s","");
  snprintf(str,elCount(str),"保持方向盘转速大于36°/s");
  testWaitForTesterConfirmation(str,30000);
  _get_Arry("Check_Calibration");
  Arry_Data[1] = 0x01;
  _Send_Diag(Arry_Len,ID,Arry_Data);
  _TestResult(SendData,ID,"",0x94);
  Arry_Data[1] = 0x03;
  Temp[0] = Arry_Data[0]^0x40;
  for(i=1;i<Arry_Len;i++)
    Temp[i]= Arry_Data[i];
  Temp[Arry_Len] = 0x04;
  _Send_Diag(Arry_Len,ID,Arry_Data);
  _Check_Response(SendData,5,Temp);
  snprintf(str,elCount(str),"%s","");
  snprintf(str,elCount(str),"松开方向盘");
  testWaitForTesterConfirmation(str,30000);
}
_31_Serve_22_Chery(dword ID,byte Session) /*角度对中*/
{
  byte Temp[5];
  byte Temp1[3]={0x22,0x32,0x08};
  byte Temp2[5]={0x62,0x32,0x08,0x00,0x00};
  byte Temp3[4]={0x31,0x03,0x33,0x00};
  byte Temp4[5]={0x71,0x03,0x33,0x00,0x01};
  _get_Ang_Chery(ID);
  Temp[0]=Arry_Data[0]^0x40;
  for(i=1;i<Arry_Len;i++)
    Temp[i]= Arry_Data[i];
  Temp[Arry_Len] = 0x01;
  _unlockECU();
  _Send_Diag(7,ID,Arry_Data);
  _Check_Response(SendData,5,Temp);
  testWaitForTimeout(100);
  _Send_Diag(3,ID,Temp1);
  _Check_Response(SendData,5,Temp2);
  testWaitForTimeout(100);
  _Send_Diag(4,ID,Temp3);
  _Check_Response(SendData,5,Temp4);
}
_31_Serve_23_Chery(dword ID,byte Session) /*对中失败A+B!=0*/
{
  byte Temp[5];
  byte Temp1[3]={0x22,0x32,0x08};
  byte Temp2[5]={0x62,0x32,0x08,0x00,0x00};
  byte Temp3[4]={0x31,0x03,0x33,0x00};
  byte Temp4[5]={0x71,0x03,0x33,0x00,0x00};
  _get_Ang_Chery(ID);
  Arry_Data[5] = Arry_Data[5]+0x10;
  Temp[0]=Arry_Data[0]^0x40;
  for(i=1;i<Arry_Len;i++)
    Temp[i]= Arry_Data[i];
  Temp[Arry_Len] = 0x05;
  _unlockECU();
  _Send_Diag(7,ID,Arry_Data);
  _Check_Response(SendData,5,Temp);
  _Send_Diag(3,ID,Temp1);
  _Check_Response(SendData,5,Temp2);
  _Send_Diag(4,ID,Temp3);
  _Check_Response(SendData,5,Temp4);
}
_31_Serve_24_Chery(dword ID,byte Session) /*对中失败x3=1*/
{
  byte Temp[5];
  byte Temp1[3]={0x22,0x32,0x08};
  byte Temp2[5]={0x62,0x32,0x08,0x00,0x00};
  byte Temp3[4]={0x31,0x03,0x33,0x00};
  byte Temp4[5]={0x71,0x03,0x33,0x00,0x00};
  _get_Ang_Chery(ID);
  Arry_Data[6] = 1;
  Temp[0]=Arry_Data[0]^0x40;
  for(i=1;i<Arry_Len;i++)
    Temp[i]= Arry_Data[i];
  Temp[Arry_Len] = 0x05;
  _unlockECU();
  _Send_Diag(7,ID,Arry_Data);
  _Check_Response(SendData,5,Temp);
  testWaitForTimeout(100);
  _Send_Diag(3,ID,Temp1);
  _Check_Response(SendData,5,Temp2);
  testWaitForTimeout(100);
  _Send_Diag(4,ID,Temp3);
  _Check_Response(SendData,5,Temp4);
}
_31_Serve_25_Chery(dword ID,byte Session) /*对中失败A+B!=0 && x3=1*/
{
  byte Temp[5];
  byte Temp1[3]={0x22,0x32,0x08};
  byte Temp2[5]={0x62,0x32,0x08,0x00,0x00};
  byte Temp3[4]={0x31,0x03,0x33,0x00};
  byte Temp4[5]={0x71,0x03,0x33,0x00,0x00};
  _get_Ang_Chery(ID);
  Arry_Data[5] = Arry_Data[5]+0x10;
  Arry_Data[6] = 1;
  Temp[0]=Arry_Data[0]^0x40;
  for(i=1;i<Arry_Len;i++)
    Temp[i]= Arry_Data[i];
  Temp[Arry_Len] = 0x05;
  _unlockECU();
  _Send_Diag(7,ID,Arry_Data);
  _Check_Response(SendData,5,Temp);
  testWaitForTimeout(100);
  _Send_Diag(3,ID,Temp1);
  _Check_Response(SendData,5,Temp2);
  testWaitForTimeout(100);
  _Send_Diag(4,ID,Temp3);
  _Check_Response(SendData,5,Temp4);
}
_31_Serve_26_RC(dword ID,byte Session) /*角度对中*/
{
  _unlockECU();
  _get_Arry("Angle_Calibration");
  Arry_Data[1] = 0X03;
  _Send_Diag(Arry_Len,ID,Arry_Data);
  _TestResult(SendData,ID,"",NRC24);
  Arry_Data[1] = 0X01;
  _Send_Diag(Arry_Len,ID,Arry_Data);
  _Check_31Routine_Rx(Arry_Data,1);
  Arry_Data[1] = 0X03;
  _Send_Diag(Arry_Len,ID,Arry_Data);
  _Check_31Routine_Rx(Arry_Data,1);
}
_31_Serve_27_RC(dword ID,byte Session) /*清除角度对中*/
{
  _unlockECU();
  _get_Arry("Clear_Angle_Calibration");
  Arry_Data[1] = 0X03;
  _Send_Diag(Arry_Len,ID,Arry_Data);
  _TestResult(SendData,ID,"",NRC24);
  Arry_Data[1] = 0X01;
  _Send_Diag(Arry_Len,ID,Arry_Data);
  _Check_31Routine_Rx(Arry_Data,1);
  Arry_Data[1] = 0X03;
  _Send_Diag(Arry_Len,ID,Arry_Data);
  _Check_31Routine_Rx(Arry_Data,1);
}
_31_Serve_28_SGMW(dword ID,byte Session) /*角度对中*/
{
  _get_Arry("Angle_Calibration");
  Arry_Data[1] = 0X03;
  _Send_Diag(Arry_Len,ID,Arry_Data);
  _TestResult(SendData,ID,"",NRC24);
  Arry_Data[1] = 0X01;
  _Send_Diag(Arry_Len,ID,Arry_Data);
  _Check_31Routine_Rx(Arry_Data,1);
  Arry_Data[1] = 0X03;
  _Send_Diag(Arry_Len,ID,Arry_Data);
  _Check_31Routine_Rx(Arry_Data,1);
}
_31_Serve_29_SRM(dword ID,byte Session) /*角度对中*/
{
  _unlockECU();
  _get_Arry("Angle_Calibration");
  Arry_Data[1] = 0X03;
  _Send_Diag(Arry_Len,ID,Arry_Data);
  _TestResult(SendData,ID,"",NRC24);
  Arry_Data[1] = 0X01;
  _Send_Diag(Arry_Len,ID,Arry_Data);
  _Check_31Routine_Rx(Arry_Data,1);
  Arry_Data[1] = 0X03;
  _Send_Diag(Arry_Len,ID,Arry_Data);
  _TestResult(SendData,ID,"",NRC24);
  Arry_Data[1] = 0X01;
  _Send_Diag(Arry_Len,ID,Arry_Data);
  _Check_31Routine_Rx(Arry_Data,1);
  Arry_Data[1] = 0X02;
  _Send_Diag(Arry_Len,ID,Arry_Data);
  _Check_31Routine_Rx(Arry_Data,1);
  Arry_Data[1] = 0X03;
  _Send_Diag(Arry_Len,ID,Arry_Data);
  _Check_31Routine_Rx(Arry_Data,1);
}

_31_Serve_30(dword ID,byte Session)/*NRC12*/
{
  dword i,j,n,Flage_;
  byte Len;
  byte Send_Data[100];
  int Flag;
  snprintf(Fault_Data_Write,elCount(Fault_Data_Write),"%s","");
  testGetCurrentTestCaseTitle(Fault_Data_Write,400);
  snprintf(Fault_Data_Write,elCount(Fault_Data_Write),"\n %s: \n    遍历31服务NRC12数据时,异常响应: \n",Fault_Data_Write);
  File_Write(Error_File,Error_FileName,Fault_Data_Write,2);
  for(j=0;j<Serve_31_Hex_Count;j++)
  {
    writeEx(-3,0,"/*-----------0x%02X 0x%02X-----------*/",Serve_31_Hex[j].Routine[0],Serve_31_Hex[j].Routine[1]);
    testStep("","/*-----------0x%02X 0x%02X-----------*/",Serve_31_Hex[j].Routine[0],Serve_31_Hex[j].Routine[1]);
    if(_Check_Serve_IDAndSess(0x31,j,ID,Session)!=1)
    {
      writeEx(-3,0,"当前测试项次不支持当前寻址或会话");
      continue;
    }
    if(Session != defsession)
      _SetSession(defsession);
    _SetSession(Session);
    testWaitForTimeout(200);
    if(LoopServe_Search_SecurityAccess(0x31,j) == 1)
      _unlockECU();
    testWaitForTimeout(500);
    Send_Data[0] = 0x31;
    Send_Data[2] = Serve_31_Hex[j].Routine[0];
    Send_Data[3] = Serve_31_Hex[j].Routine[1];
    if(Serve_31_Hex[j].Routine_Len == 5)
      Send_Data[4] = Serve_31_Hex[j].Control_Option[0][0];
    Len = Serve_31_Hex[j].Routine_Len;
    for(i=0;i<=0xFF;i++)
    {
      Send_Data[1] =i;
      Flage_ = 0;
      for(n=0;n<Serve_31_Hex[j].Control_Type_Count;n++)
      {
        if((i == Serve_31_Hex[j].Control_Type[n]) || ((i&0xF0)==0X80 && (i&0x0F)==Serve_31_Hex[j].Control_Type[n] && Serve_31_Hex[j].Control_Type_RSP[n] == 1))
        {
          Flage_ = 1;
          break;
        }
      }
      if(Flage_ == 1)
        continue;
      _Send_Diag(Len,ID,Send_Data);
      Flag = _TestResult(SendData,ID,"",NRC12);
      if(Flag == -1)
      {
        char Str[50];
        if(Serve_31_Hex[j].Routine_Len == 5)
        {
          snprintf(Str,elCount(Str),"[  0x%02X 0x%02X 0x%02X 0x%02X 0x%02X  ] \n",Send_Data[0],Send_Data[1],Send_Data[2],Send_Data[3],Send_Data[4]);
          File_Write(Error_File,Error_FileName,Str,2);
        }
        else
        {
          snprintf(Str,elCount(Str),"[  0x%02X 0x%02X 0x%02X 0x%02X  ] \n",Send_Data[0],Send_Data[1],Send_Data[2],Send_Data[3]);
          File_Write(Error_File,Error_FileName,Str,2);
        }
      }
      testWaitForTimeout(20);
    }
  }
}
_31_Serve_31(dword ID,byte Session)/*NRC13*/
{
  dword i,j;
  byte Len;
  byte Send_Data[100];
  int Flag;
  snprintf(Fault_Data_Write,elCount(Fault_Data_Write),"%s","");
  testGetCurrentTestCaseTitle(Fault_Data_Write,400);
  snprintf(Fault_Data_Write,elCount(Fault_Data_Write),"\n %s: \n    遍历31服务NRC13数据时,异常响应: \n",Fault_Data_Write);
  File_Write(Error_File,Error_FileName,Fault_Data_Write,2);
  
  Len = _Check_CANFD_Flage();
  for(j=0;j<Serve_31_Hex_Count;j++)
  {
    writeEx(-3,0,"/*-----------0x%02X 0x%02X-----------*/",Serve_31_Hex[j].Routine[0],Serve_31_Hex[j].Routine[1]);
    testStep("","/*-----------0x%02X 0x%02X-----------*/",Serve_31_Hex[j].Routine[0],Serve_31_Hex[j].Routine[1]);
    if(_Check_Serve_IDAndSess(0x31,j,ID,Session)!=1)
    {
      writeEx(-3,0,"当前测试项次不支持当前寻址或会话");
      continue;
    }
    if(Session != defsession)
      _SetSession(defsession);
    _SetSession(Session);
    testWaitForTimeout(200);
    if(LoopServe_Search_SecurityAccess(0x31,j) == 1)
      _unlockECU();
    testWaitForTimeout(500);
    Send_Data[0] = 0x31;
    Send_Data[1] = Serve_31_Hex[j].Control_Type[0];
    Send_Data[2] = Serve_31_Hex[j].Routine[0];
    Send_Data[3] = Serve_31_Hex[j].Routine[1];
    if(Serve_31_Hex[j].Routine_Len == 5)
      Send_Data[4] = Serve_31_Hex[j].Control_Option_Count[0];
    for(i=1;i<=Len;i++)
    {
      if(i==Serve_31_Hex[j].Routine_Len)
        continue;
      _Send_Diag(i,ID,Send_Data);
      Flag = _TestResult(SendData,ID,"",NRC13);
      if(Flag == -1)
      {
        char Str[50];
        if(Serve_31_Hex[j].Routine_Len == 5)
        {
          snprintf(Str,elCount(Str),"[  0x%02X 0x%02X 0x%02X 0x%02X 0x%02X  ] \n",Send_Data[0],Send_Data[1],Send_Data[2],Send_Data[3],Send_Data[4]);
          File_Write(Error_File,Error_FileName,Str,2);
        }
        else
        {
          snprintf(Str,elCount(Str),"[  0x%02X 0x%02X 0x%02X 0x%02X  ] \n",Send_Data[0],Send_Data[1],Send_Data[2],Send_Data[3]);
          File_Write(Error_File,Error_FileName,Str,2);
        }
      }
      testWaitForTimeout(20);
    }
  }
}
_31_Serve_32(dword ID,byte Session)/*NRC31  RID*/
{
  byte Tem[4] = {0x31,0x01,0X00,0X00};
  word byte1;
  word byte2;
  int Flage;
  if(_Check_Serve_IDAndSess(0x31,ID,Session) != 1)
  {
    _WriteEx_and_Report("","当前寻址及服务不支持");
    return;
  }
  snprintf(Fault_Data_Write,elCount(Fault_Data_Write),"%s","");
  testGetCurrentTestCaseTitle(Fault_Data_Write,400);
  snprintf(Fault_Data_Write,elCount(Fault_Data_Write),"\n %s: \n    遍历31服务NRC31 RID数据时,异常响应: \n",Fault_Data_Write);
  File_Write(Error_File,Error_FileName,Fault_Data_Write,2);
  if(LoopServe_Search_SecurityAccess(0x31) == 1)
    _unlockECU();
  {
    for(byte1=0;byte1<=0XFF;byte1++)
    {
      Tem[2] =byte1;
      for(byte2=0;byte2<=0XFF;byte2++)
      {
        Tem[3] =byte2;
        if(_Check_SendData_In_31H(Tem)!=-1)
          continue;
        else
        {
          _Send_Diag(4,ID,Tem);
          Flage = _TestResult(SendData,ID,"",NRC31);
          if(Flage == -1)
          {
            char Str[30];
            snprintf(Str,elCount(Str),"[  0x%02X 0x%02X  ] \n",byte1,byte2);
            File_Write(Error_File,Error_FileName,Str,2);
          }
          testWaitForTimeout(20);
        }
      }
    }
  }
}
_31_Serve_32_(dword ID,byte Session)/*NRC31 例程控制选项*/
{
  byte Temp_Send[5] = {0x31,0x01,0x00,0x00,0x00};
  word byte1;
  int i,j,Flage,Flage_;
  snprintf(Fault_Data_Write,elCount(Fault_Data_Write),"%s","");
  testGetCurrentTestCaseTitle(Fault_Data_Write,400);
  snprintf(Fault_Data_Write,elCount(Fault_Data_Write),"\n %s: \n    遍历31服务NRC31 例程控制选项数据时,异常响应: \n",Fault_Data_Write);
  File_Write(Error_File,Error_FileName,Fault_Data_Write,2);
  for(i=0;i<Serve_31_Hex_Count;i++)
  {
    if(Serve_31_Hex[i].Routine_Len == 5)
    {
      Temp_Send[1] = Serve_31_Hex[i].Control_Type[0];
      Temp_Send[2] = Serve_31_Hex[i].Routine[0];
      Temp_Send[3] = Serve_31_Hex[i].Routine[1];    
      if(_Check_Serve_IDAndSess(0x31,i,ID,Session)!=1)
      {
        writeEx(-3,0,"当前测试项次不支持当前寻址或会话");
        continue;
      }
      if(i != 0)
      {
        _SetSession(defsession);
        if(Session != defsession)
          _SetSession(Session);
      }
      if(LoopServe_Search_SecurityAccess(0x31,i) == 1)
        _unlockECU();
      for(byte1=0;byte1<=0XFF;byte1++)
      {
        Temp_Send[4] =byte1;
        Flage = 0;
        for(j=0;j<Serve_31_Hex[i].Control_Option_Count[0];j++)
        {
          if(byte1 == Serve_31_Hex[i].Control_Option[0][j])
          {
            Flage = 1;
            break;
          }
        }
        if(Flage == 1)
          continue;
        else
        {
          _Send_Diag(5,ID,Temp_Send);
          Flage_ = _TestResult(SendData,ID,"",NRC31);
          if(Flage_ == -1)
          {
            char Str[50];
            snprintf(Str,elCount(Str),"[  0x31 0x%02X 0x%02X 0x%02X 0x%02X  ] \n",Temp_Send[1],Temp_Send[2],Temp_Send[3],Temp_Send[4]);
            File_Write(Error_File,Error_FileName,Str,2);
          }
        }
      }
    }
  }
  _WriteEx_and_Report("",Fault_Data_Report);
  write(Fault_Data_Write);
}

_31_Serve_33(dword ID,byte Session)/*NRC22*/
{
  dword RID;
  _get_Arry("Pre_Programmed");
  if(Arry_Len == 0)
    _WriteEx_and_Report("","未获取到相应数据,跳过");
  else
  {
    RID = (Arry_Data[2]<<8) + Arry_Data[3];
    if(_Check_Serve(Arry_Data[1],RID,10)&0x1==1)
    {
      _unlockECU();
      _Set_CarSpd(NRC22_CarSpd+1);
      testWaitForTimeout(1000);
      Arry_Data[1] = 0X01;
      _Send_Diag(Arry_Len,ID,Arry_Data);
      _TestResult(SendData,ID,"",NRC22);
      Arry_Data[1] = 0X03;
      _Send_Diag(Arry_Len,ID,Arry_Data);
      _TestResult(SendData,ID,"",NRC24);
      _Set_CarSpd(NRC22_CarSpd);
      testWaitForTimeout(1000);
      Arry_Data[1] = 0X01;
      _Send_Diag(Arry_Len,ID,Arry_Data);
      _Check_31Routine_Rx(Arry_Data,1);
      Arry_Data[1] = 0X03;
      _Send_Diag(Arry_Len,ID,Arry_Data);
      _Check_31Routine_Rx(Arry_Data,1);
      _Set_CarSpd(NRC22_CarSpd+1);
      testWaitForTimeout(1000);
      _TestDisableMsg(Struct_CarSpd.Sig_Id);
      _Set_CarSpd_Invalid(Struct_CarSpd.Invalid_Value[0]);
      testWaitForTimeout(_max(Struct_CarSpd.Invalid_Time,Struct_CarSpd.Lost_Time)+500);
      Arry_Data[1] = 0X01;
      _Send_Diag(Arry_Len,ID,Arry_Data);
      _Check_31Routine_Rx(Arry_Data,1);
      Arry_Data[1] = 0X03;
      _Send_Diag(Arry_Len,ID,Arry_Data);
      _Check_31Routine_Rx(Arry_Data,1);
      _TestEnableMsg(Struct_CarSpd.Sig_Id);
      _Reset_CarSpd_Invalid();
      _Set_CarSpd(0);
    }
    else
      _WriteEx_and_Report("","当前项目无NRC22车速条件,跳过检测");
  }
}
_31_Serve_33_Ready(dword ID,byte Session)/*NRC22-发动机*/
{
  dword RID;
  byte Flage_;
  byte Send_Data[100];
  byte Send_Len;
  Flage_ = 0;
  for(i=0;i<Serve_31_Hex_Count;i++)
  {
    Send_Data[0] = 0x31;
    if((Serve_31_Hex[i].Serve_NRC22[0] &0x20) > 0)
    {
      Flage_ = 1;
      _SetSession(defsession);
      testWaitForTimeout(100);
      _unlockECU();
      _Set_Ready(Struct_Ready.Ready_Active);
      testWaitForTimeout(1000);
      Send_Data[1] = Serve_31_Hex[i].Control_Type[0];
      Send_Data[2] = Serve_31_Hex[i].Routine[0];
      Send_Data[3] = Serve_31_Hex[i].Routine[1];
      Send_Len = Serve_31_Hex[i].Routine_Len;
      if(Send_Len>4)
        Send_Data[3] = Serve_31_Hex[i].Control_Option_Count[0];
      _Send_Diag(Send_Len,ID,Send_Data);
      _TestResult(SendData,ID,"",NRC22);
      _TestDisableMsg(Struct_Ready.Sig_Id);
      testWaitForTimeout(Struct_Ready.Invalid_Time*1.5);
      _Send_Diag(Send_Len,ID,Send_Data);
      _TestResult(SendData,ID,"",-1);
      _TestEnableMsg(Struct_Ready.Sig_Id);
      testWaitForTimeout(Struct_Ready.Invalid_Time*1.5);
      _Set_Sig(Struct_Ready.ReadyInvalid_Sig,Struct_Ready.Invalid_Value[0]);
      testWaitForTimeout(Struct_Ready.Invalid_Time*1.5);
      _Send_Diag(Send_Len,ID,Send_Data);
      _TestResult(SendData,ID,"",-1);
      _Set_Sig(Struct_Ready.ReadyInvalid_Sig,Struct_Ready.Normal_Value[0]);
      testWaitForTimeout(Struct_Ready.Invalid_Time*1.5);
      _Set_Ready(0);
      testWaitForTimeout(1000);
    }
  }
  if(Flage_ == 0)
    _WriteEx_and_Report("","当前31服务中，无NRC22发动机条件");
}
_31_Serve_34(dword ID,byte Session)/*NRC33*/
{
  dword RID;
  int i,j,k,MaxCount,n;
  byte Send_Data[100];
  Send_Data[0] = 0x31;
  for(i=0;i<Serve_31_Hex_Count;i++)
  {
    for(j=0;j<Serve_31_Hex[i].Control_Type_Count;j++)
    {
      Send_Data[1] = Serve_31_Hex[i].Control_Type[j];
      Send_Data[2] = Serve_31_Hex[i].Routine[0];
      Send_Data[3] = Serve_31_Hex[i].Routine[1];
      if(Serve_31_Hex[i].Control_Option_Count[j] == 0)
      {
        _Send_Diag(Serve_31_Hex[i].Routine_Len,ID,Send_Data);
        if( Serve_31_Hex[i].Security_Access[0] == 1)
          _TestResult(SendData,ID,"",NRC33);
        else
          _TestResult(SendData,ID,"",-1);
        if(Serve_31_Hex[i].Control_Type_RSP[j] == 1)
        {
          Send_Data[1] = Send_Data[1]|0x80;
          _Send_Diag(Serve_31_Hex[i].Routine_Len,ID,Send_Data);
          if( Serve_31_Hex[i].Security_Access[0] == 1)
            _TestResult(SendData,ID,"",NRC33);
          else
            _TestResult(SendData,ID,"",0);
        }
      }
      else
      {
        MaxCount = 1;
        if(Serve_31_Hex[i].Control_Type_RSP[j] == 1)
          MaxCount = 2;
        for(n=0;n<MaxCount;n++)
        {
          if(n == 0)
            Send_Data[1] = Serve_31_Hex[i].Control_Type[j];
          else
            Send_Data[1] = Serve_31_Hex[i].Control_Type[j]|0x80;
          for(k=0;k<Serve_31_Hex[i].Control_Option_Count[j];k++)
          {
            Send_Data[4] = Serve_31_Hex[i].Control_Option[j][k];
            _Send_Diag(Serve_31_Hex[i].Routine_Len,ID,Send_Data);
            if( Serve_31_Hex[i].Security_Access[0] == 1)
              _TestResult(SendData,ID,"",NRC33);
            else
            {
              if(n==0)
                _TestResult(SendData,ID,"",-1);
              else if(n == 1)
                _TestResult(SendData,ID,"",0);
            }
          }
        }
      }
    }
    _SetSession(defsession);
    testWaitForTimeout(500);
    if(Session != defsession)
    {
      _SetSession(Session);
      testWaitForTimeout(500);
    }
  }
}
_31_Serve_34_1(dword ID,byte Session)/*NRC33*/
{
  char str[100];
  dword RID;
  _unlockECU();
  _get_Arry("Angle_Calibration");
  _Send_Diag(Arry_Len,ID,Arry_Data);
  _TestResult(SendData,ID,"",-1);
  _SetSession(exsession);
  _get_Arry("Clear_Angle_Calibration");
  if(Arry_Len == 0)
    _WriteEx_and_Report("","未获取到相应数据,跳过");
  else
  {
    RID = (Arry_Data[2]<<8) + Arry_Data[3];
    if(_Check_Serve(Arry_Data[1],RID,11)==1)
    {
      _Send_Diag(Arry_Len,ID,Arry_Data);
      _TestResult(SendData,ID,"",NRC33);
      _Set_Ready(Struct_Ready.Ready_Active);
      _Set_CarSpd(10);
      testWaitForTimeout(1000);
      snprintf(str,elCount(str),"%s","");
      snprintf(str,elCount(str),"转动方向盘并查看回正状态，若有回正则点击YES,无回正则点击No,然后松开方向盘");
      if(testWaitForTesterConfirmation(str,60000)==1)
        testStepPass("","清除对中回NRC33情况下回正正常");
      else
        testStepFail("","清除对中回NRC33无回正");
      
      _Set_CarSpd(0);
      testWaitForTimeout(2000);
    }
    else
      _WriteEx_and_Report("","当前项目清除对中无NRC33条件,跳过检测");
  }
}
_31_Serve_34_2(dword ID,byte Session)/*NRC33*/
{
  char str[100];
  dword RID;
  _unlockECU();
  _get_Arry("Clear_Angle_Calibration");
  if(Arry_Len == 0)
  {
    _WriteEx_and_Report("","无清除中位DID,后续无法验证中位信息,跳过测试");
    return;
  }
  _Send_Diag(Arry_Len,ID,Arry_Data);
  _TestResult(SendData,ID,"",-1);
  _SetSession(exsession);
  _get_Arry("Angle_Calibration");
  if(Arry_Len == 0)
    _WriteEx_and_Report("","未获取到相应数据,跳过");
  else
  {
    RID = (Arry_Data[2]<<8) + Arry_Data[3];
    if(_Check_Serve(Arry_Data[1],RID,11)==1)
    {
      _Send_Diag(Arry_Len,ID,Arry_Data);
      _TestResult(SendData,ID,"",NRC33);
      _Set_Ready(Struct_Ready.Ready_Active);
      _Set_CarSpd(10);
      testWaitForTimeout(1000);
      snprintf(str,elCount(str),"%s","");
      snprintf(str,elCount(str),"转动方向盘并查看回正状态，若有回正则点击YES,无回正则点击No,然后松开方向盘");
      if(testWaitForTesterConfirmation(str,60000)==2)
        testStepPass("","对中回NRC33情况下无回正");
      else
        testStepFail("","对中回NRC33存在回正");
      
      _Set_CarSpd(0);
      testWaitForTimeout(2000);
    }
    else
      _WriteEx_and_Report("","当前项目对中无NRC33条件,跳过检测");
  }
  _unlockECU();
  _Send_Diag(Arry_Len,ID,Arry_Data);
  _TestResult(SendData,ID,"",-1);
}

_31_Serve_35(dword ID,byte Session)/*NRC22-工厂模式力矩*/
{
  char str[200];
  dword RID;
  byte Temp_1[6]={0x2E,0x01,0x00,0x00,0x00,0x00};
  int i;
  _SetSession(exsession);
  _unlockECU();
  _Send_Diag(6,ID,Temp_1);
  _TestResult(SendData,ID,"",-1);
  /*出现部分长安项目需要重启进入工厂模式才能生效*/
  _Set_11_Restoration();
  _SetSession(exsession);
  _unlockECU();
  if(NRC22_TasTorque_Fac_Flage!=1)
    _WriteEx_and_Report(ECU_project,"无工厂模式力矩不同导致回NRC22");
  else
  {
    for(i=0;i<2;i++)
    {
      _get_Arry("Pre_Programmed");
      snprintf(str,elCount(str),"%s","");
      if(i==0)
        snprintf(str,elCount(str),"控制力矩满足工厂模式NRC22条件,大于 %.2f Nm,并保持",NRC22_TasTorque_Fac+0.2);
      else
        snprintf(str,elCount(str),"控制力矩满足工厂模式NRC22条件,大于 %.2f Nm,并保持",(NRC22_TasTorque_Fac+0.2)*(-1));
      testWaitForTesterConfirmation(str,30000);
      _Send_Diag(Arry_Len,ID,Arry_Data);
      RID = (Arry_Data[2]<<8) + Arry_Data[3];
      if((_Check_Serve(Arry_Data[1],RID,10)&0x4)==4)
        _TestResult(SendData,ID,"",NRC22);
      else
        _Check_31Routine_Rx(Arry_Data,1);
      _get_Arry("Angle_Calibration");
      Arry_Data[4] = 0x02;
      _Send_Diag(Arry_Len,ID,Arry_Data);
      RID = (Arry_Data[2]<<8) + Arry_Data[3];
      if((_Check_Serve(Arry_Data[1],RID,10)&0x4)==4)
        _TestResult(SendData,ID,"",NRC22);
      else
      {
        _Check_31Routine_Rx(Arry_Data,1);
        TestStep_ReadDTC("",Ang_NotCal,1,0,1,0);
      }
      testWaitForTimeout(100);
      _get_Arry("Angle_Calibrationn");
      _Send_Diag(Arry_Len,ID,Arry_Data);
      RID = (Arry_Data[2]<<8) + Arry_Data[3];
      if((_Check_Serve(Arry_Data[1],RID,10)&0x4)==4)
      {
        _TestResult(SendData,ID,"",NRC22);
        TestStep_ReadDTC("",Ang_NotCal,1,0,1,0);
      }
      else
      {
        _Check_31Routine_Rx(Arry_Data,1);
        TestStep_ReadDTC("",Ang_NotCal,1,0,0,0);
      }
      snprintf(str,elCount(str),"%s","");
      if(i==0)
        snprintf(str,elCount(str),"控制力矩不满足工厂模式NRC22条件,小于 %.2f Nm,并保持",NRC22_TasTorque_Fac-0.2);
      else
        snprintf(str,elCount(str),"控制力矩不满足工厂模式NRC22条件,小于 %.2f Nm,并保持",(NRC22_TasTorque_Fac-0.2)*(-1));
      testWaitForTesterConfirmation(str,30000);
      _get_Arry("Pre_Programmed");
      _Send_Diag(Arry_Len,ID,Arry_Data);
      _Check_31Routine_Rx(Arry_Data,1);
      _get_Arry("Angle_Calibration");
      Arry_Data[4] = 0x02;
      _Send_Diag(Arry_Len,ID,Arry_Data);
      _Check_31Routine_Rx(Arry_Data,1);
      TestStep_ReadDTC("",Ang_NotCal,1,0,1,0);
      testWaitForTimeout(100);
      _get_Arry("Angle_Calibration");
      _Send_Diag(Arry_Len,ID,Arry_Data);
      _Check_31Routine_Rx(Arry_Data,1);
      TestStep_ReadDTC("",Ang_NotCal,1,0,0,0);
    }
    snprintf(str,elCount(str),"%s","");
    snprintf(str,elCount(str),"松开方向盘");
    testWaitForTesterConfirmation(str,30000);
  }
}
_31_Serve_36(dword ID,byte Session)/*NRC22-工厂模式电压*/
{
  char str[200];
  dword RID;
  byte Temp_1[6]={0x2E,0x01,0x00,0x00,0x00,0x00};
  int i;
  _SetSession(exsession);
  _unlockECU();
  _Send_Diag(6,ID,Temp_1);
  _TestResult(SendData,ID,"",-1);
  /*出现部分长安项目需要重启进入工厂模式才能生效*/
  _Set_11_Restoration();
  _SetSession(exsession);
  _unlockECU();
  
  _get_Arry("Pre_Programmed");
  _Set_Battery(NRC22_Battery_Low-0.2);
  _Send_Diag(Arry_Len,ID,Arry_Data);
  RID = (Arry_Data[2]<<8) + Arry_Data[3];
  if((_Check_Serve(Arry_Data[1],RID,10)&0x2)==2)
    _TestResult(SendData,ID,"",NRC22);
  else
    _TestResult(SendData,ID,"",-1);
  _get_Arry("Angle_Calibration");
  Arry_Data[4] = 0x02;
  _Send_Diag(Arry_Len,ID,Arry_Data);
  RID = (Arry_Data[2]<<8) + Arry_Data[3];
  if((_Check_Serve(Arry_Data[1],RID,10)&0x2)==2)
    _TestResult(SendData,ID,"",NRC22);
  else
  {
    _Check_31Routine_Rx(Arry_Data,1);
    TestStep_ReadDTC("",Ang_NotCal,1,0,1,0);
  }
  testWaitForTimeout(100);
  _get_Arry("Angle_Calibration");
  _Send_Diag(Arry_Len,ID,Arry_Data);
  RID = (Arry_Data[2]<<8) + Arry_Data[3];
  if((_Check_Serve(Arry_Data[1],RID,10)&0x2)==2)
    _TestResult(SendData,ID,"",NRC22);
  else
  {
    _Check_31Routine_Rx(Arry_Data,1);
     TestStep_ReadDTC("",Ang_NotCal,1,0,0,0);
  }
  _Set_Battery(NRC22_Battery_Low+0.2);
  _get_Arry("Pre_Programmed");
  _Send_Diag(Arry_Len,ID,Arry_Data);
  _Check_31Routine_Rx(Arry_Data,1);
  _get_Arry("Angle_Calibration");
  Arry_Data[4] = 0x02;
  _Send_Diag(Arry_Len,ID,Arry_Data);
  _Check_31Routine_Rx(Arry_Data,1);
  TestStep_ReadDTC("",Ang_NotCal,1,0,1,0);
  testWaitForTimeout(100);
  _get_Arry("Angle_Calibration");
  _Send_Diag(Arry_Len,ID,Arry_Data);
  _Check_31Routine_Rx(Arry_Data,1);
  TestStep_ReadDTC("",Ang_NotCal,1,0,0,0);
  
  
  _get_Arry("Pre_Programmed");
  _Set_Battery(NRC22_Battery_Hight+0.2);
  _Send_Diag(Arry_Len,ID,Arry_Data);
  RID = (Arry_Data[2]<<8) + Arry_Data[3];
  if((_Check_Serve(Arry_Data[1],RID,10)&0x2)==2)
    _TestResult(SendData,ID,"",NRC22);
  else
    _TestResult(SendData,ID,"",-1);
  _get_Arry("Angle_Calibration");
  Arry_Data[4] = 0x02;
  _Send_Diag(Arry_Len,ID,Arry_Data);
  RID = (Arry_Data[2]<<8) + Arry_Data[3];
  if((_Check_Serve(Arry_Data[1],RID,10)&0x2)==2)
    _TestResult(SendData,ID,"",NRC22);
  else
  {
    _Check_31Routine_Rx(Arry_Data,1);
    TestStep_ReadDTC("",Ang_NotCal,1,0,1,0);
  }
  testWaitForTimeout(100);
  _get_Arry("Angle_Calibration");
  _Send_Diag(Arry_Len,ID,Arry_Data);
  RID = (Arry_Data[2]<<8) + Arry_Data[3];
  if((_Check_Serve(Arry_Data[1],RID,10)&0x2)==2)
    _TestResult(SendData,ID,"",NRC22);
  else
  {
    _Check_31Routine_Rx(Arry_Data,1);
     TestStep_ReadDTC("",Ang_NotCal,1,0,0,0);
  }
  _Set_Battery(NRC22_Battery_Hight-0.2);
  _get_Arry("Pre_Programmed");
  _Send_Diag(Arry_Len,ID,Arry_Data);
  _Check_31Routine_Rx(Arry_Data,1);
  _get_Arry("Angle_Calibration");
  Arry_Data[4] = 0x02;
  _Send_Diag(Arry_Len,ID,Arry_Data);
  _Check_31Routine_Rx(Arry_Data,1);
  TestStep_ReadDTC("",Ang_NotCal,1,0,1,0);
  testWaitForTimeout(100);
  _get_Arry("Angle_Calibration");
  _Send_Diag(Arry_Len,ID,Arry_Data);
  _Check_31Routine_Rx(Arry_Data,1);
  TestStep_ReadDTC("",Ang_NotCal,1,0,0,0);
  
  _Set_Battery(12);
}
_31_Serve_37(dword ID,byte Session)/*NRC22-退工厂模式力矩*/
{
  char str[200];
  dword RID;
  byte Temp_1[6]={0x2E,0x01,0x00,0x01,0x00,0x00};
  int i;
  _SetSession(exsession);
  _unlockECU();
  _Send_Diag(6,ID,Temp_1);
  _TestResult(SendData,ID,"",-1);
  
  /*出现部分长安项目需要重启进入工厂模式才能生效*/
  _Set_11_Restoration();
  _SetSession(exsession);
  _unlockECU();
  
  for(i=0;i<2;i++)
  {
    _get_Arry("Pre_Programmed");
    snprintf(str,elCount(str),"%s","");
    if(i==0)
      snprintf(str,elCount(str),"控制力矩满足NRC22条件,大于 %.2f Nm,并保持",NRC22_TasTorque+0.2);
    else
      snprintf(str,elCount(str),"控制力矩满足NRC22条件,大于 %.2f Nm,并保持",(NRC22_TasTorque+0.2)*(-1));
    testWaitForTesterConfirmation(str,30000);
    _Send_Diag(Arry_Len,ID,Arry_Data);
    RID = (Arry_Data[2]<<8) + Arry_Data[3];
    if((_Check_Serve(Arry_Data[1],RID,10)&0x4)==4)
      _TestResult(SendData,ID,"",NRC22);
    else
      _TestResult(SendData,ID,"",-1);
    _get_Arry("Angle_Calibration");
    Arry_Data[4] = 0x02;
    _Send_Diag(Arry_Len,ID,Arry_Data);
    RID = (Arry_Data[2]<<8) + Arry_Data[3];
    if((_Check_Serve(Arry_Data[1],RID,10)&0x4)==4)
    {
      _TestResult(SendData,ID,"",NRC22);
      TestStep_ReadDTC("",Ang_NotCal,1,0,0,0);
    }
    else
    {
      _Check_31Routine_Rx(Arry_Data,1);
      TestStep_ReadDTC("",Ang_NotCal,1,0,1,0);
    }
    testWaitForTimeout(100);
    _get_Arry("Angle_Calibration");
    _Send_Diag(Arry_Len,ID,Arry_Data);
    RID = (Arry_Data[2]<<8) + Arry_Data[3];
    if((_Check_Serve(Arry_Data[1],RID,10)&0x4)==4)
      _TestResult(SendData,ID,"",NRC22);
    else
    {
      _Check_31Routine_Rx(Arry_Data,1);
      TestStep_ReadDTC("",Ang_NotCal,1,0,0,0);
    }
    snprintf(str,elCount(str),"%s","");
    if(i==0)
      snprintf(str,elCount(str),"控制力矩不满足NRC22条件,小于 %.2f Nm,并保持",NRC22_TasTorque-0.2);
    else
      snprintf(str,elCount(str),"控制力矩不满足NRC22条件,小于 %.2f Nm,并保持",(NRC22_TasTorque-0.2)*(-1));
    testWaitForTesterConfirmation(str,30000);
    _get_Arry("Pre_Programmed");
    _Send_Diag(Arry_Len,ID,Arry_Data);
    _Check_31Routine_Rx(Arry_Data,1);
    _get_Arry("Angle_Calibration");
    Arry_Data[4] = 0x02;
    _Send_Diag(Arry_Len,ID,Arry_Data);
    _Check_31Routine_Rx(Arry_Data,1);
    TestStep_ReadDTC("",Ang_NotCal,1,0,1,0);
    testWaitForTimeout(100);
    _get_Arry("Angle_Calibration");
    _Send_Diag(Arry_Len,ID,Arry_Data);
    _Check_31Routine_Rx(Arry_Data,1);
    TestStep_ReadDTC("",Ang_NotCal,1,0,0,0);
  }
  snprintf(str,elCount(str),"%s","");
  snprintf(str,elCount(str),"松开方向盘");
  testWaitForTesterConfirmation(str,30000);
}
_31_Serve_38(dword ID,byte Session)/*NRC22-退出工厂模式电压*/
{
  char str[200];
  dword RID;
  byte Temp_1[6]={0x2E,0x01,0x00,0x01,0x00,0x00};
  int i;
  _SetSession(exsession);
  _unlockECU();
  _Send_Diag(6,ID,Temp_1);
  _TestResult(SendData,ID,"",-1);
  
  /*出现部分长安项目需要重启进入工厂模式才能生效*/
  _Set_11_Restoration();
  _SetSession(exsession);
  _unlockECU();
  
  _get_Arry("Pre_Programmed");
  _Set_Battery(NRC22_Battery_Low-0.2);
  _Send_Diag(Arry_Len,ID,Arry_Data);
  RID = (Arry_Data[2]<<8) + Arry_Data[3];
  if((_Check_Serve(Arry_Data[1],RID,10)&0x2)==2)
    _TestResult(SendData,ID,"",NRC22);
  else
    _TestResult(SendData,ID,"",-1);
  _get_Arry("Angle_Calibration");
  Arry_Data[4] = 0x02;
  _Send_Diag(Arry_Len,ID,Arry_Data);
  RID = (Arry_Data[2]<<8) + Arry_Data[3];
  if((_Check_Serve(Arry_Data[1],RID,10)&0x2)==2)
    _TestResult(SendData,ID,"",NRC22);
  else
  {
    _Check_31Routine_Rx(Arry_Data,1);
    TestStep_ReadDTC("",Ang_NotCal,1,0,1,0);
  }
  testWaitForTimeout(100);
  _get_Arry("Angle_Calibration");
  _Send_Diag(Arry_Len,ID,Arry_Data);
  RID = (Arry_Data[2]<<8) + Arry_Data[3];
  if((_Check_Serve(Arry_Data[1],RID,10)&0x2)==2)
    _TestResult(SendData,ID,"",NRC22);
  else
  {
    _Check_31Routine_Rx(Arry_Data,1);
    TestStep_ReadDTC("",Ang_NotCal,1,0,0,0);
  }
  _Set_Battery(NRC22_Battery_Low+0.2);
  _get_Arry("Pre_Programmed");
  _Send_Diag(Arry_Len,ID,Arry_Data);
  _Check_31Routine_Rx(Arry_Data,1);
  _get_Arry("Angle_Calibration");
  Arry_Data[4] = 0x02;
  _Send_Diag(Arry_Len,ID,Arry_Data);
  _Check_31Routine_Rx(Arry_Data,1);
  TestStep_ReadDTC("",Ang_NotCal,1,0,1,0);
  testWaitForTimeout(100);
  _get_Arry("Angle_Calibration");
  _Send_Diag(Arry_Len,ID,Arry_Data);
  _Check_31Routine_Rx(Arry_Data,1);
  TestStep_ReadDTC("",Ang_NotCal,1,0,0,0);
  
  
  _get_Arry("Pre_Programmed");
  _Set_Battery(NRC22_Battery_Hight+0.2);
  _Send_Diag(Arry_Len,ID,Arry_Data);
  RID = (Arry_Data[2]<<8) + Arry_Data[3];
  if((_Check_Serve(Arry_Data[1],RID,10)&0x2)==2)
    _TestResult(SendData,ID,"",NRC22);
  else
    _TestResult(SendData,ID,"",-1);
  _get_Arry("Angle_Calibration");
  Arry_Data[4] = 0x02;
  _Send_Diag(Arry_Len,ID,Arry_Data);
  RID = (Arry_Data[2]<<8) + Arry_Data[3];
  if((_Check_Serve(Arry_Data[1],RID,10)&0x2)==2)
    _TestResult(SendData,ID,"",NRC22);
  else
  {
    _Check_31Routine_Rx(Arry_Data,1);
    TestStep_ReadDTC("",Ang_NotCal,1,0,1,0);
  }
  testWaitForTimeout(100);
  _get_Arry("Angle_Calibration");
  _Send_Diag(Arry_Len,ID,Arry_Data);
  RID = (Arry_Data[2]<<8) + Arry_Data[3];
  if((_Check_Serve(Arry_Data[1],RID,10)&0x2)==2)
    _TestResult(SendData,ID,"",NRC22);
  else
  {
    _Check_31Routine_Rx(Arry_Data,1);
    TestStep_ReadDTC("",Ang_NotCal,1,0,0,0);
  }
  _Set_Battery(NRC22_Battery_Hight-0.2);
  _get_Arry("Pre_Programmed");
  _Send_Diag(Arry_Len,ID,Arry_Data);
  _Check_31Routine_Rx(Arry_Data,1);
  _get_Arry("Angle_Calibration");
  Arry_Data[4] = 0x02;
  _Send_Diag(Arry_Len,ID,Arry_Data);
  _Check_31Routine_Rx(Arry_Data,1);
  TestStep_ReadDTC("",Ang_NotCal,1,0,1,0);
  testWaitForTimeout(100);
  _get_Arry("Angle_Calibration");
  _Send_Diag(Arry_Len,ID,Arry_Data);
  _Check_31Routine_Rx(Arry_Data,1);
  TestStep_ReadDTC("",0,1,0,1,0);
  
  _Set_Battery(12);
}
_31_Serve_39(dword ID,byte Session)/*NRC22-车速*/
{
  dword RID;
  _Set_Ready(Struct_Ready.Ready_Active);
  _Set_CarSpd(NRC22_CarSpd-1);
  testWaitForTimeout(1000);
  _unlockECU();
  _get_Arry("Pre_Programmed");
  _Send_Diag(Arry_Len,ID,Arry_Data);
  _Check_31Routine_Rx(Arry_Data,1);
  _get_Arry("Angle_Calibration");
  Arry_Data[4] = 0x02;
  RID = (Arry_Data[2]<<8) + Arry_Data[3];
  if((_Check_Serve(Arry_Data[1],RID,10)&0x1)==1)
  {
    _Send_Diag(Arry_Len,ID,Arry_Data);
    _Check_31Routine_Rx(Arry_Data,1);
    TestStep_ReadDTC("",Ang_NotCal,1,0,1,1);
    _Set_CarSpd(NRC22_CarSpd+1);
    testWaitForTimeout(1000);
    _get_Arry("Pre_Programmed");
    _Send_Diag(Arry_Len,ID,Arry_Data);
    RID = (Arry_Data[2]<<8) + Arry_Data[3];
    if((_Check_Serve(Arry_Data[1],RID,10)&0x1)==1)
       _TestResult(SendData,ID,"",NRC22);
    else
      _Check_31Routine_Rx(Arry_Data,1);
    
    _get_Arry("Angle_Calibration");
    _Send_Diag(Arry_Len,ID,Arry_Data);
    RID = (Arry_Data[2]<<8) + Arry_Data[3];
    if((_Check_Serve(Arry_Data[1],RID,10)&0x1)==1)
    {
       _TestResult(SendData,ID,"",NRC22);
       TestStep_ReadDTC("",Ang_NotCal,1,0,1,1);
    }
    else
      _Check_31Routine_Rx(Arry_Data,1);
    _Set_CarSpd(NRC22_CarSpd-1);
    testWaitForTimeout(1000);
    _get_Arry("Angle_Calibration");
    _Send_Diag(Arry_Len,ID,Arry_Data);
    _Check_31Routine_Rx(Arry_Data,1);
    TestStep_ReadDTC("",Ang_NotCal,1,0,0,1);
    
    _Set_CarSpd(NRC22_CarSpd+1);
    testWaitForTimeout(1000);
    _get_Arry("Angle_Calibration");
    Arry_Data[4] = 0x02;
    _Send_Diag(Arry_Len,ID,Arry_Data);
    _TestResult(SendData,ID,"",NRC22);
    TestStep_ReadDTC("",Ang_NotCal,1,0,0,1);
  }
  else
    _WriteEx_and_Report("","对中与清除对中无NRC22车速条件,跳过检测");
  _Set_CarSpd(0);
}
_31_Serve_40(dword ID,byte Session)/*NRC22-车速无效*/
{
  dword RID;
  _Set_Ready(Struct_Ready.Ready_Active);
  _get_Arry("Angle_Calibration");
  RID = (Arry_Data[2]<<8) + Arry_Data[3];
  if((_Check_Serve(Arry_Data[1],RID,10)&0x1)==1)
  {
    _Set_CarSpd(NRC22_CarSpd+1);
    testWaitForTimeout(1000);
    _TestDisableMsg(Struct_CarSpd.Sig_Id);
    testWaitForTimeout(Struct_CarSpd.Lost_Time+500);
    _unlockECU();
    _get_Arry("Angle_Calibration");
    Arry_Data[4] = 0x02;
    _Send_Diag(Arry_Len,ID,Arry_Data);
    _Check_31Routine_Rx(Arry_Data,1);
    TestStep_ReadDTC("",Ang_NotCal,1,0,1,0);
    testWaitForTimeout(100);
    _get_Arry("Angle_Calibration");
    _Send_Diag(Arry_Len,ID,Arry_Data);
    _Check_31Routine_Rx(Arry_Data,1);
    TestStep_ReadDTC("",Ang_NotCal,1,0,0,0);
    _TestEnableMsg(Struct_CarSpd.Sig_Id);
    _Set_CarSpd_Invalid(Struct_CarSpd.Invalid_Value[0]);
    testWaitForTimeout(Struct_CarSpd.Invalid_Time+500);
    _unlockECU();
    _get_Arry("Angle_Calibration");
    Arry_Data[4] = 0x02;
    _Send_Diag(Arry_Len,ID,Arry_Data);
    _Check_31Routine_Rx(Arry_Data,1);
    TestStep_ReadDTC("",Ang_NotCal,1,0,1,0);
    testWaitForTimeout(100);
    _get_Arry("Angle_Calibration");
    _Send_Diag(Arry_Len,ID,Arry_Data);
    _Check_31Routine_Rx(Arry_Data,1);
    TestStep_ReadDTC("",Ang_NotCal,1,0,0,0);
    _Reset_CarSpd_Invalid();
    _Set_CarSpd(0);
  }
  else
    _WriteEx_and_Report("","对中与清除对中无NRC22车速条件,跳过检测");
}

_31_Serve_41_NRC(dword ID,byte Session)  //NRC优先级
{  
  byte Send_Data[100];
  int j;
  int Flage_Error;
  dword Temp_DID;
  char Temp_Str[300];
  int _13_Count;
  
  {
    snprintf(Temp_Str,elCount(Temp_Str),"NRC优先级异常项次: ");
    Send_Data[0] = 0x31;
    for(j=0;j<Serve_31_Hex_Count;j++)
    {
      _13_Count = 0;
      Flage_Error = 0;
      if(Serve_31_Hex[j].Serve_NRC_Special_Count[0] != 0)
        Serve_31_NewNRC22 = 1;
      else
        Serve_31_NewNRC22 = 0;
      Temp_DID = ((Serve_31_Hex[j].Routine[0]<<8) | Serve_31_Hex[j].Routine[1]);
      if(Geely3_Flage == 1 && Session == defsession && Temp_DID != 0x307B && Temp_DID!= 0x0206)
        continue;
      _WriteEx_and_Report("","---------------------------------");
      _WriteEx_and_Report("","   开始测试 0x%04X 优先级",Temp_DID);
      _WriteEx_and_Report("","---------------------------------");
      _Set_NRC_Step(0x31,Temp_DID,Serve_31_Hex[j].Control_Type[0],Send_Data);
      if(Fun_NRC_Count == 0)
      {
        _WriteEx_and_Report("","未输入NRC，跳过测试");
        continue;
      }
      for(i=0;i<=Fun_NRC_Count;i++)
      {
        if(i>0) //第一次反馈最高优先级不做处理,其余依次恢复
        {
          _Recover_NRC_Step(Fun_NRC[i-1],j,Temp_DID,Send_Data);
        }
        if(i == Fun_NRC_Count)
        {
          _Send_Diag(Fun_NRC_Send_Len,ID,Send_Data);
          _TestResult(SendData,ID,"",-1);
        }
        else
        {
          if(Fun_NRC[i] == 0x24)  
            Send_Data[1] = 0x03;
          _Send_Diag(Fun_NRC_Send_Len,ID,Send_Data);
          if(Fun_NRC[i] == 0x31)
            _13_Count++;
          
          if(Serve_31_Len4_5 == 1 && NRC31_total == 2  &&  Fun_NRC[i] == 0x31 && NRC13_total == 1 && _13_Count==1)
            _TestResult(SendData,ID,"",0x13);
          else
            _TestResult(SendData,ID,"",Fun_NRC[i]);
          
          if(diagGetLastResponseCode(SendData) != Fun_NRC[i])
            Flage_Error = 1;
          if(Fun_NRC[i] == 0x24)  
            Send_Data[1] = Serve_31_Hex[j].Control_Type[0];
        }
        testWaitForTimeout(100);
      }
      _WriteEx_and_Report("","---------------------------------");
      _WriteEx_and_Report("","   0x%04X 优先级测试完成",Temp_DID);
      _WriteEx_and_Report("","---------------------------------");
      {
        _WriteEx_and_Report("","进行复位防止前面影响到后续测试");
        _Set_11_Restoration();
        _SetSession(Session);
      }
      if(Flage_Error == 1)
      {
        snprintf(Temp_Str,elCount(Temp_Str),"%s  [ 0x%04X ]",Temp_Str,Temp_DID);
      }
    }
    _WriteEx_and_Report("",Temp_Str);
    Serve_31_NewNRC22 = 0;
  }
}
_31_Serve_41_Chery(dword ID,byte Session)/* 13(min)>31(rid)>33>12>13(total)>22*/
{
  int Fun_Pos;
  _Set_CarSpd(NRC22_CarSpd+1);
  testWaitForTimeout(1000);
  _get_Arry("Pre_Programmed");
  Fun_Pos = _Check_Serve(Arry_Data[1],(Arry_Data[2]<<8)+Arry_Data[3],12);
  Arry_Data[1] = 0x02;
  _Send_Diag(1,ID,Arry_Data);
  _TestResult(SendData,ID,"",Serve_31_Hex[Fun_Pos].Serve_NRC[0][0]);
  _Send_Diag(6,ID,Arry_Data);
  _TestResult(SendData,ID,"",Serve_31_Hex[Fun_Pos].Serve_NRC[0][1]);
  _get_Arry("Angle_Calibration");
  Arry_Data[1] = 0x02;
  _Send_Diag(6,ID,Arry_Data);
  _TestResult(SendData,ID,"",Serve_31_Hex[Fun_Pos].Serve_NRC[0][2]);
  _unlockECU();
  _Send_Diag(6,ID,Arry_Data);
  _TestResult(SendData,ID,"",Serve_31_Hex[Fun_Pos].Serve_NRC[0][3]);
  Arry_Data[1] = 0x01;
  _Send_Diag(6,ID,Arry_Data);
  _TestResult(SendData,ID,"",Serve_31_Hex[Fun_Pos].Serve_NRC[0][4]);
  _Send_Diag(7,ID,Arry_Data);
  _TestResult(SendData,ID,"",Serve_31_Hex[Fun_Pos].Serve_NRC[0][5]);
  Arry_Data[1] = 0x03;
  _Send_Diag(7,ID,Arry_Data);
  _TestResult(SendData,ID,"",NRC24);
}
_31_Serve_41_YunDu(dword ID,byte Session)/* 13>12>33>92>93>88*/
{
  int Fun_Pos;
  _Set_CarSpd(NRC22_CarSpd+1);
  _Set_Battery(NRC22_Battery_Low-0.3);
  _get_Arry("Angle_Calibration");
  Fun_Pos = _Check_Serve(Arry_Data[1],(Arry_Data[2]<<8)+Arry_Data[3],12);
  Arry_Data[1] =0x02;
  _Send_Diag(2,ID,Arry_Data);
  _TestResult(SendData,ID,"",Serve_31_Hex[Fun_Pos].Serve_NRC[0][0]);
  _Send_Diag(4,ID,Arry_Data);
  _TestResult(SendData,ID,"",Serve_31_Hex[Fun_Pos].Serve_NRC[0][1]);
  Arry_Data[1] =0x01;
  _Send_Diag(4,ID,Arry_Data);
  _TestResult(SendData,ID,"",Serve_31_Hex[Fun_Pos].Serve_NRC[0][2]);
  _unlockECU();
  _Send_Diag(4,ID,Arry_Data);
  _TestResult(SendData,ID,"",0x93);
  _Set_Battery(NRC22_Battery_Hight+0.3);
  _Send_Diag(4,ID,Arry_Data);
  _TestResult(SendData,ID,"",0x92);
  _Set_Battery(12);
  _Send_Diag(4,ID,Arry_Data);
  _TestResult(SendData,ID,"",Serve_31_Hex[Fun_Pos].Serve_NRC[0][Serve_31_Hex[Fun_Pos].Serve_NRC_Count[0]-1]);
  _Set_CarSpd(0);
}
_31_Serve_42(dword ID,byte Session)/* 7F>13*/
{
  byte Send_Data[100];
  _Get_31_ServeData(0,Send_Data,0);
  
  _Send_Diag((Serve_31_Hex[0].Routine_Len-1),ID,Send_Data);
  _TestResult(SendData,ID,"",NRC7F);
}
_31_Serve_43(dword ID,byte Session,byte Serv_)/* 特殊优先级处理*/
{
  int Serve_Pos,i,j;
  char Temp_Str[200];
  char Temp_Str_[200];
  byte Send_Data[100];
  dword Fun_;
  int Send_Len,Step_Battery,Count_Battery;
  if(Serv_ != 0x31)
    Serve_Pos = _Check_Serve(Serv_,0,0);
  snprintf(Temp_Str,elCount(Temp_Str),"");
  snprintf(Temp_Str_,elCount(Temp_Str_),"");
  snprintf(Temp_Str,elCount(Temp_Str),"     开始测试%02X服务",Serv_);
  if(Serv_ != 0x31)
  {
    
  }
  else if(Serv_ == 0x31)
  {
    for(i=0;i<Serve_31_Hex_Count;i++)
    {
      if(Serve_31_Hex[i].Serve_NRC_Special_Count[0]!= 0)
      {
        snprintf(Temp_Str,elCount(Temp_Str),"     开始测试%02X服务%02X%02X例程,特殊NRC优先级测试",Serv_,Serve_31_Hex[i].Routine[0],Serve_31_Hex[i].Routine[1]);
        {
          _WriteEx_and_Report("","------------------------------------------------------");
          _WriteEx_and_Report("",Temp_Str);
          _WriteEx_and_Report("","------------------------------------------------------");
          Send_Data[0] = 0x31;
          Send_Data[1] = Serve_31_Hex[i].Control_Type[0];
          Send_Data[2] = Serve_31_Hex[i].Routine[0];
          Send_Data[3] = Serve_31_Hex[i].Routine[1];
          Fun_ = ((Send_Data[2]<<8)|(Send_Data[3]));
          Send_Len = Serve_31_Hex[i].Routine_Len;
          Step_Battery = 0;
          Count_Battery = 0;
          if(Send_Len==5)
            Send_Data[4] = Serve_31_Hex[i].Control_Option[0][0];
          _unlockECU();
          testWaitForTimeout(300);
          _Set_NRC_Special_Step(0x31,Fun_,Send_Data[1],Send_Data);
          if((_Check_NRC_In_31H(Fun_,0,0X92) != -1) && (_Check_NRC_In_31H(Fun_,0,0X93) != -1)) //两个电压同时存在
            Count_Battery = 2;
          for(j=0;j<Fun_NRC_Count;j++)
          {
            if(Fun_NRC[j] == 0x92 || Fun_NRC[j] == 0x93)
              _Geely_NewNRC22(Fun_NRC[j],1);           
            if(Fun_NRC[j] == 0xF2)
            {
              _Geely_NewNRC22(Fun_NRC[j],0);
              _Set_CarSpd(0);
              _Geely_NewNRC22(Fun_NRC[j],1);
            }
            if(j==Fun_NRC_Count)
            {
              _Send_Diag(Send_Len,ID,Send_Data);
              _TestResult(SendData,ID,"",-1);
            }
            else
            {
              _Send_Diag(Send_Len,ID,Send_Data);
              _TestResult(SendData,ID,"",Fun_NRC[j]);
            }
            testWaitForTimeout(200);
            if(Fun_NRC[j] == 0x92 || Fun_NRC[j] == 0x93)
            {
              Step_Battery++;
              if(Step_Battery == 2)
                _Set_Battery(12);
            }
            else
              _Recover_NRC_Special_Step(Fun_NRC[j],Send_Data);
          }
        }
        _WriteEx_and_Report("","---------------------------------");
        {
          _WriteEx_and_Report("","进行复位防止前面影响到后续测试");
          _Set_11_Restoration();
          _SetSession(Session);
        }
      }
      else
        _WriteEx_and_Report("","无特殊优先级输入,跳过测试");
    }
  }
}

_31_Serve_44_VX11(dword ID,byte Session)/* 特殊优先级处理Geely1.0*/
{
  byte Data[4] = {0x31,0x01,0x32,0xF0};
  int Pos,Type_Pos;
  dword Rid;
  Rid = 0x32F0;
  Pos = _Check_Serve(0x01,Rid,12);
  if(Pos != -1)
  {
    Type_Pos = _Check_SendData_In_31H(Data);
    if(Type_Pos != -1)
    {
      if(Serve_31_Hex[Pos].Serve_NRC_Special_Count[Type_Pos]!= 0)
      {
        _unlockECU();
        _Set_CarSpd(NRC22_CarSpd+1);
        _Set_Ready(0);
        _Set_Battery(NRC22_Battery_Hight+0.2);
        _Send_Diag(4,ID,Data);
        _TestResult(SendData,ID,"",0x92);
        _Set_Battery(NRC22_Battery_Low-0.2);
        _Send_Diag(4,ID,Data);
        _TestResult(SendData,ID,"",0x93);
        _Set_Battery(14);
        _Send_Diag(4,ID,Data);
        _TestResult(SendData,ID,"",0x88);
        _TestDisableMsg(Struct_CarSpd.Sig_Id);
        testWaitForTimeout(Struct_CarSpd.Lost_Time*1.3);
        _Send_Diag(4,ID,Data);
        _TestResult(SendData,ID,"",0x88);
        _TestEnableMsg(Struct_CarSpd.Sig_Id);
        testWaitForTimeout(Struct_CarSpd.Lost_Time*1.3);
        _Set_CarSpd_Invalid(Struct_CarSpd.Invalid_Value[0]);
        _Send_Diag(4,ID,Data);
        _TestResult(SendData,ID,"",0x88);
        _Reset_CarSpd_Invalid();
        _Set_CarSpd(0);
        testWaitForTimeout(200);
        _TestDisableMsg(Struct_CarSpd.Sig_Id);
        testWaitForTimeout(Struct_CarSpd.Lost_Time*1.3);
        _Send_Diag(4,ID,Data);
        _TestResult(SendData,ID,"",0xF2);
        _TestEnableMsg(Struct_CarSpd.Sig_Id);
        testWaitForTimeout(Struct_CarSpd.Lost_Time*1.3);
        _Set_CarSpd_Invalid(Struct_CarSpd.Invalid_Value[0]);
        _Send_Diag(4,ID,Data);
        _TestResult(SendData,ID,"",0xF2);
        _Reset_CarSpd_Invalid();
        _Set_CarSpd(0);
        if(_Check_Dword_in_Num(0x84,Serve_31_Hex[Pos].Serve_NRC_Special[Type_Pos],Serve_31_Hex[Pos].Serve_NRC_Special_Count[Type_Pos])!= -1)
        {
          _Send_Diag(4,ID,Data);
          _TestResult(SendData,ID,"",0x84);
          _TestDisableMsg(Struct_Ready.Sig_Id);
          testWaitForTimeout(1000);
          _Send_Diag(4,ID,Data);
          _TestResult(SendData,ID,"",0x84);
          _TestEnableMsg(Struct_Ready.Sig_Id);
          testWaitForTimeout(1000);
          if(strlen(Struct_Ready.ReadyInvalid_Sig) != 0)
          {
            _Set_Sig(Struct_Ready.ReadyInvalid_Sig,Struct_Ready.Invalid_Value[0]);
            testWaitForTimeout(Struct_Ready.Invalid_Time*1.2);
            _Send_Diag(4,ID,Data);
            _TestResult(SendData,ID,"",0x84);
            _Set_Sig(Struct_Ready.ReadyInvalid_Sig,Struct_Ready.Normal_Value[0]);
            testWaitForTimeout(Struct_Ready.Invalid_Time*1.2);
          }
          if(_Check_Dword_in_Num(0xF1,Serve_31_Hex[Pos].Serve_NRC_Special[Type_Pos],Serve_31_Hex[Pos].Serve_NRC_Special_Count[Type_Pos])!= -1)
          {
            _Set_Ready(Struct_Ready.Ready_Active);
            _TestDisableMsg(Struct_Ready.Sig_Id);
            testWaitForTimeout(1000);
            _Send_Diag(4,ID,Data);
            _TestResult(SendData,ID,"",0xF1);
            _TestEnableMsg(Struct_Ready.Sig_Id);
            testWaitForTimeout(1000);
            if(strlen(Struct_Ready.ReadyInvalid_Sig) != 0)
            {
              _Set_Sig(Struct_Ready.ReadyInvalid_Sig,Struct_Ready.Invalid_Value[0]);
              testWaitForTimeout(Struct_Ready.Invalid_Time*1.2);
              _Send_Diag(4,ID,Data);
              _TestResult(SendData,ID,"",0xF1);
              _Set_Sig(Struct_Ready.ReadyInvalid_Sig,Struct_Ready.Normal_Value[0]);
              testWaitForTimeout(Struct_Ready.Invalid_Time*1.2);
            }
          }
          _Set_Ready(0);
        }
      }
      else
        _WriteEx_and_Report("","无特殊NRC优先级输入");
    }
    else
      _WriteEx_and_Report("","未查询到31 01 32 F0数据");
  }
  else
    _WriteEx_and_Report("","未查询到0x32F0 RID数据");
}
_31_Serve_45(dword ID,byte Session)/* 更新条件查询 02 06*/
{
  byte SendData[6] = {0x31,0x01,0x02,0x06,0,0};
  int Send_Len,i;
  dword FunDID;
  int FunPos;
  
  Send_Len = 4;
  FunDID = 0x0206;
  _get_Arry("Pre_Programmed");
  if(Arry_Len>1)
  {
    FunDID = (Arry_Data[2]<<8)|Arry_Data[3];
    Send_Len = Arry_Len;
    for(i=0;i<Arry_Len;i++)
      SendData[i] = Arry_Data[i];
  }
  FunPos = _Check_Serve(0x01,FunDID,12);
  if(FunPos != -1)
  {
    _Set_CarSpd(0);
    testWaitForTimeout(1000);
    _Send_Diag(Send_Len,ID,SendData);
    _Check_31Routine_Rx(SendData,1);
    _Set_CarSpd(NRC22_CarSpd+1);
    testWaitForTimeout(1000);
    _Send_Diag(Send_Len,ID,SendData);
      
    if((Serve_31_Hex[FunPos].Serve_NRC22[0]&1) == 1)
      _Check_31Routine_Rx(SendData,0);
    else
      _Check_31Routine_Rx(SendData,1);
    _Set_CarSpd(NRC22_CarSpd-1);
    _TestDisableMsg(Struct_CarSpd.Sig_Id);
    testWaitForTimeout(1000);
    // _Set_CarSpd_Invalid(Struct_CarSpd.Invalid_Value[0]);
    _Send_Diag(Send_Len,ID,SendData);
    _Check_31Routine_Rx(SendData,1);
    // _Reset_CarSpd_Invalid();
    _TestEnableMsg(Struct_CarSpd.Sig_Id);
    testWaitForTimeout(500);
  }
}
_31_Serve_46(dword ID,byte Session)/* 对中 传感器，角度，扭矩正常*/
{
  byte Send_Data[6] = {0x31,0x01,0x30,0x7B,0,0};
  byte SendDataCheck[6] = {0x31,0x03,0x30,0x7B,0,0};
  int Send_Len,i,Flage_For_Unlock;
  dword FunDID;
  Send_Len = 4;
  FunDID = 0x307B;
  _get_Arry("Angle_Calibration");
  if(Arry_Len>1)
  {
    Send_Len = Arry_Len;
    FunDID = (Arry_Data[2]<<8)|Arry_Data[3];
    for(i=0;i<Arry_Len;i++)
      Send_Data[i] = Arry_Data[i];
    for(i=0;i<Arry_Len;i++)
      SendDataCheck[i] = Send_Data[i];
    SendDataCheck[1] = 0x03;
  }
  Flage_For_Unlock = _Check_Serve(0x01,FunDID,11);
  _Set_11_Restoration();
  
  diagStartTesterPresent(Cdd_Name);
  _ClearAngle(1);
  _SetSession(Session);
  _Set_Ready(0);
  StepByGeely3_0(0x19,1);
  if(Flage_For_Unlock == 1)
    _unlockECU();
  _Send_Diag(Send_Len,ID,SendDataCheck);
  _TestResult(SendData,ID,"",NRC24);
  testWaitForTimeout(50);
  _Send_Diag(Send_Len,ID,Send_Data);
  _Check_31Routine_Rx(Send_Data,1);
  testWaitForTimeout(50);
  _Send_Diag(Send_Len,ID,SendDataCheck);
  _Check_31Routine_Rx(SendDataCheck,1);
  testWaitForTimeout(200);
  _Check_DTC_Res(1,0,Ang_NotCal);
  
  _WriteEx_and_Report("","此处测试不转动方向盘验证外发角度");
  _Power_Down();
  testWaitForTimeout(2000);
  _Power_Up();
  _TestWaitForTesterConfirmation("检测外发角度是否趋近0°");
  if(Geely3_Flage == 1)
  {
    _Set_Ready(Struct_Ready.Ready_Active);
    testWaitForTimeout(6000);
  }
  if(Session != defsession)
    _SetSession(Session);
  _Check_DTC_Res(1,0,Ang_NotCal);
  if(Flage_For_Unlock == 1)
    _unlockECU();
  _Send_Diag(Send_Len,ID,Send_Data);
  _Check_31Routine_Rx(Send_Data,1);
  testWaitForTimeout(50);
  _Send_Diag(Send_Len,ID,SendDataCheck);
  _Check_31Routine_Rx(SendDataCheck,1);
  testWaitForTimeout(200);
  _Check_DTC_Res(1,0,Ang_NotCal);
  
  _TestWaitForTesterConfirmation("转动方向盘后点击Yes");
  _Check_DTC_Res(1,0,Ang_NotCal);
  if(Flage_For_Unlock == 1)
    _unlockECU();
  _Send_Diag(Send_Len,ID,Send_Data);
  _Check_31Routine_Rx(Send_Data,1);
  testWaitForTimeout(50);
  _Send_Diag(Send_Len,ID,SendDataCheck);
  _Check_31Routine_Rx(SendDataCheck,1);
  testWaitForTimeout(200);
  _Check_DTC_Res(1,0,Ang_NotCal);
  
  _TestWaitForTesterConfirmation("转动方向盘向另一个方向后点击Yes");
  _Check_DTC_Res(1,0,Ang_NotCal);
  if(Flage_For_Unlock == 1)
    _unlockECU();
  _Send_Diag(Send_Len,ID,Send_Data);
  _Check_31Routine_Rx(Send_Data,1);
  testWaitForTimeout(50);
  _Send_Diag(Send_Len,ID,SendDataCheck);
  _Check_31Routine_Rx(SendDataCheck,1);
  testWaitForTimeout(200);
  _Check_DTC_Res(1,0,Ang_NotCal);
}

_31_Serve_46_1(dword ID,byte Session)/* 对中 传感器，S信号异常，扭矩正常*/
{
  byte Send_Data[6] = {0x31,0x01,0x30,0x7B,0,0};
  byte SendDataCheck[6] = {0x31,0x03,0x30,0x7B,0,0};
  int Send_Len,i,Flage_For_Unlock;
  dword FunDID;
  Send_Len = 4;
  FunDID = 0x307B;
  _get_Arry("Angle_Calibration");
  if(Arry_Len>1)
  {
    Send_Len = Arry_Len;
    FunDID = (Arry_Data[2]<<8)|Arry_Data[3];
    for(i=0;i<Arry_Len;i++)
      Send_Data[i] = Arry_Data[i];
    for(i=0;i<Arry_Len;i++)
      SendDataCheck[i] = Send_Data[i];
    SendDataCheck[1] = 0x03;
  }
  Flage_For_Unlock = _Check_Serve(0x01,FunDID,11);

  diagStartTesterPresent(Cdd_Name);
  _ClearAngle(1);
  testWaitForTimeout(200);
  _TestWaitForTesterConfirmation("断开S角度传感器信号后点击Yes");
  _Set_Ready(Struct_Ready.Ready_Active);
  testWaitForTimeout(6000);
  _SetSession(Session);
  if(Flage_For_Unlock == 1)
    _unlockECU();
  _Send_Diag(Send_Len,ID,Send_Data);
  _TestResult(SendData,ID,"",NRC31);
  testWaitForTimeout(50);
  _Send_Diag(Send_Len,ID,SendDataCheck);
  _Check_31Routine_Rx(SendDataCheck,2);
  testWaitForTimeout(200);
  _Check_DTC_Res(1,Ang_NotCal,0);
  
  _TestWaitForTesterConfirmation("连接S角度传感器信号后点击Yes");
  _Power_Down();
  testWaitForTimeout(2000);
  _Power_Up();
  testWaitForTimeout(6000);
  _SetSession(Session);
  if(Flage_For_Unlock == 1)
    _unlockECU();

  _Send_Diag(Send_Len,ID,Send_Data);
  _Check_31Routine_Rx(Send_Data,1);
  testWaitForTimeout(50);
  _Send_Diag(Send_Len,ID,SendDataCheck);
  _Check_31Routine_Rx(SendDataCheck,1);
  testWaitForTimeout(200);
  _Check_DTC_Res(1,0,Ang_NotCal);
}

_31_Serve_46_2(dword ID,byte Session)/* 对中 角度超范围*/
{
  byte Send_Data[6] = {0x31,0x01,0x30,0x7B,0,0};
  byte SendDataCheck[6] = {0x31,0x03,0x30,0x7B,0,0};
  int Send_Len,i,Flage_For_Unlock;
  dword FunDID;
  Send_Len = 4;
  FunDID = 0x307B;
  _get_Arry("Angle_Calibration");
  if(Arry_Len>1)
  {
    Send_Len = Arry_Len;
    FunDID = (Arry_Data[2]<<8)|Arry_Data[3];
    for(i=0;i<Arry_Len;i++)
      Send_Data[i] = Arry_Data[i];
    for(i=0;i<Arry_Len;i++)
      SendDataCheck[i] = Send_Data[i];
    SendDataCheck[1] = 0x03;
  }
  Flage_For_Unlock = _Check_Serve(0x01,FunDID,11);
  _ClearAngle(1);
  testWaitForTimeout(1000);
  _Send_Diag(Send_Len,ID,Send_Data);
  _Check_31Routine_Rx(Send_Data,1);

  diagStartTesterPresent(Cdd_Name);
  _Set_Ready(Struct_Ready.Ready_Active);
  testWaitForTimeout(6000);
  _SetSession(Session);
  _TestWaitForTesterConfirmation("记录此时位置，转动角度超720°");
  if(Flage_For_Unlock == 1)
    _unlockECU();
  _Send_Diag(Send_Len,ID,Send_Data);
  _TestResult(SendData,ID,"",NRC31);
  testWaitForTimeout(50);
  _Send_Diag(Send_Len,ID,SendDataCheck);
  _Check_31Routine_Rx(SendDataCheck,3);
  testWaitForTimeout(200);
  _Check_DTC_Res_InHis_NotNowOrHis(9,Ang_NotCal,0);
  _TestWaitForTesterConfirmation("转动方向盘使角度恢复到正常范围内");
  {
    _Power_Down();
    testWaitForTimeout(2000);
    _Power_Up();
  }
  _SetSession(Session);
  if(Flage_For_Unlock == 1)
    _unlockECU();
  _Send_Diag(Send_Len,ID,Send_Data);
  _Check_31Routine_Rx(Send_Data,1);
  testWaitForTimeout(50);
  _Send_Diag(Send_Len,ID,SendDataCheck);
  _Check_31Routine_Rx(SendDataCheck,1);
  testWaitForTimeout(200);
  _Check_DTC_Res(1,0,Ang_NotCal);
}
_31_Serve_46_4(dword ID,byte Session)/* 对中 NVM等待中*/
{
  byte Send_Data[6] = {0x31,0x01,0x30,0x7B,0,0};
  byte SendDataCheck[6] = {0x31,0x03,0x30,0x7B,0,0};
  int Count;
  
  int Send_Len,i,Flage_For_Unlock;
  dword FunDID;
  Send_Len = 4;
  FunDID = 0x307B;
  _get_Arry("Angle_Calibration");
  if(Arry_Len>1)
  {
    Send_Len = Arry_Len;
    FunDID = (Arry_Data[2]<<8)|Arry_Data[3];
    for(i=0;i<Arry_Len;i++)
      Send_Data[i] = Arry_Data[i];
    for(i=0;i<Arry_Len;i++)
      SendDataCheck[i] = Send_Data[i];
    SendDataCheck[1] = 0x03;
  }
  Flage_For_Unlock = _Check_Serve(0x01,FunDID,11);

  Count = 0;
  diagStartTesterPresent(Cdd_Name);
  _ClearAngle(1);
  testWaitForTimeout(200);
  _Check_DTC_Res(1,Ang_NotCal,0);
  _SetSession(Session);
  _Set_Ready(Struct_Ready.Ready_Active);
  testWaitForTimeout(6000);
  if(Flage_For_Unlock == 1)
    _unlockECU();
  if(ID == phyreq_ID)
  {
    do{
      _Send_Diag(Send_Len,ID,Send_Data);
      Count++;
    }while(Count<=100 && diagGetLastResponseCode(SendData)!= 0x31);
    testWaitForTimeout(50);
  }
  else
  {
    message *Msg;
    Msg.dlc = 8;
    Msg.id = funreq_ID;
    Msg.byte(0) = Send_Len;
    if((Support_CAN & 2) != 0)
    {
      Msg.BRS = 1; Msg.FDF = 1;
    }
    for(i=0;i<Send_Len;i++)
      Msg.byte(i+1) = Send_Data[i];
    output(Msg);
    testWaitForTimeout(20);
    output(Msg);
    testWaitForTimeout(10);
  }
  _Send_Diag(Send_Len,ID,SendDataCheck);
  _Check_31Routine_Rx(SendDataCheck,5);
  testWaitForTimeout(200);
  
  _Send_Diag(Send_Len,ID,Send_Data);
  _Check_31Routine_Rx(Send_Data,1);
  testWaitForTimeout(50);
  _Send_Diag(Send_Len,ID,SendDataCheck);
  _Check_31Routine_Rx(SendDataCheck,1);
  testWaitForTimeout(200);
  _Check_DTC_Res(1,0,Ang_NotCal);
}

_31_Serve_46_3(dword ID,byte Session)/* 对中 扭矩超范围*/
{
  byte Send_Data[6] = {0x31,0x01,0x30,0x7B,0,0};
  byte SendDataCheck[6] = {0x31,0x03,0x30,0x7B,0,0};
  int Count;
  
  int Send_Len,i,Flage_For_Unlock;
  dword FunDID;
  Send_Len = 4;
  FunDID = 0x307B;
  _get_Arry("Angle_Calibration");
  if(Arry_Len>1)
  {
    Send_Len = Arry_Len;
    FunDID = (Arry_Data[2]<<8)|Arry_Data[3];
    for(i=0;i<Arry_Len;i++)
      Send_Data[i] = Arry_Data[i];
    for(i=0;i<Arry_Len;i++)
      SendDataCheck[i] = Send_Data[i];
    SendDataCheck[1] = 0x03;
  }
  Flage_For_Unlock = _Check_Serve(0x01,FunDID,11);
  
  diagStartTesterPresent(Cdd_Name);
  _ClearAngle(1);
  testWaitForTimeout(200);
  _Set_Ready(Struct_Ready.Ready_Active);
  _Set_CarSpd(150);
  testWaitForTimeout(6000);
  _SetSession(Session);

  if(Flage_For_Unlock == 1)
    _unlockECU();

  _TestWaitForTesterConfirmation("给予方向盘超过扭矩范围的力矩(1NM),并保持");
  _Send_Diag(Send_Len,ID,Send_Data);
  _TestResult(SendData,ID,"",NRC31);
  testWaitForTimeout(50);
  _Send_Diag(Send_Len,ID,SendDataCheck);
  _Check_31Routine_Rx(SendDataCheck,4);
  testWaitForTimeout(200);
  _Check_DTC_Res(1,Ang_NotCal,0);

  _TestWaitForTesterConfirmation("给予方向盘小于扭矩范围的力矩(1NM),并保持");
  _Send_Diag(Send_Len,ID,Send_Data);
  _Check_31Routine_Rx(Send_Data,1);
  testWaitForTimeout(50);
  _Send_Diag(Send_Len,ID,SendDataCheck);
  _Check_31Routine_Rx(SendDataCheck,1);
  testWaitForTimeout(200);
  _Check_DTC_Res(1,0,Ang_NotCal);

  _TestWaitForTesterConfirmation("松开方向盘");
}

_31_Serve_47(dword ID,byte Session)/* 清除角度中位标定*/
{
  byte Send_Data[6] = {0x31,0x01,0x30,0x7B,0,0};
  byte SendDataCheck[6] = {0x31,0x03,0x30,0x7B,0,0};
  byte Send_DataClear[4] = {0x31,0x01,0x30,0x80};
  
  int Count;
  
  int Send_Len,i,Flage_For_Unlock;
  dword FunDID;
  Send_Len = 4;
  FunDID = 0x307B;
  _get_Arry("Angle_Calibration");
  if(Arry_Len>1)
  {
    Send_Len = Arry_Len;
    FunDID = (Arry_Data[2]<<8)|Arry_Data[3];
    for(i=0;i<Arry_Len;i++)
      Send_Data[i] = Arry_Data[i];
    for(i=0;i<Arry_Len;i++)
      SendDataCheck[i] = Send_Data[i];
    SendDataCheck[1] = 0x03;
  }
  Flage_For_Unlock = _Check_Serve(0x01,FunDID,11);
  
  diagStartTesterPresent(Cdd_Name);
  _Set_Ready(Struct_Ready.Ready_Active);
  testWaitForTimeout(6000);
  _SetSession(Session);
  if(Flage_For_Unlock == 1)
    _unlockECU();
  _Send_Diag(Send_Len,ID,Send_Data);
  _Check_31Routine_Rx(Send_Data,1);
  _Send_Diag(Send_Len,ID,SendDataCheck);
  _Check_31Routine_Rx(SendDataCheck,1);
  testWaitForTimeout(1000);

  if(Flage_For_Unlock == 0)
    _unlockECU();
  _Send_Diag(4,ID,Send_DataClear);
  _Check_31Routine_Rx(Send_DataClear,1);
  testWaitForTimeout(1000);
  _Check_DTC_Res(1,Ang_NotCal,0);
  
  testWaitForTimeout(500);
  _WriteEx_and_Report("","测试结束，对中恢复状态");
  _Send_Diag(Send_Len,ID,Send_Data);
  _Check_31Routine_Rx(Send_Data,1);
}
// _31_Serve_48(dword ID,byte Session)/* 对中与清除对中*/
// {
//   byte Send_Data[4] = {0x31,0x01,0x30,0x7B};
//   byte SendDataCheck[4] = {0x31,0x03,0x30,0x7B};
//   byte Send_DataClear[4] = {0x31,0x01,0x30,0x80};
  
//   diagStartTesterPresent(Cdd_Name);
//   _Set_Ready(Struct_Ready.Ready_Active);
//   testWaitForTimeout(6000);
//   _unlockECU();
//   testWaitForTimeout(200);
//   _Send_Diag(4,ID,Send_DataClear);
//   _Check_31Routine_Rx(Send_DataClear,1);
//   testWaitForTimeout(1000);
//   _Check_DTC_Res(1,Ang_NotCal,0);
//   testWaitForTimeout(1000);
//   _Send_Diag(4,ID,Send_Data);
//   _Check_31Routine_Rx(Send_Data,1);
//   testWaitForTimeout(50);
//   _Send_Diag(4,ID,SendDataCheck);
//   _Check_31Routine_Rx(SendDataCheck,1);
//   testWaitForTimeout(200);
//   _Check_DTC_Res(1,0,Ang_NotCal);
//   testWaitForTimeout(1000);
  
//   _Send_Diag(4,ID,Send_DataClear);
//   _Check_31Routine_Rx(Send_DataClear,1);
//   testWaitForTimeout(1000);
//   _Check_DTC_Res(1,Ang_NotCal,0);
//   testWaitForTimeout(1000);
//   _Send_Diag(4,ID,Send_Data);
//   _Check_31Routine_Rx(Send_Data,1);
//   testWaitForTimeout(50);
//   _Send_Diag(4,ID,SendDataCheck);
//   _Check_31Routine_Rx(SendDataCheck,1);
//   testWaitForTimeout(200);
//   _Check_DTC_Res(1,0,Ang_NotCal);
//   testWaitForTimeout(1000);
  
//   _Power_Down();
//   testWaitForTimeout(2000);
//   _Power_Up();
//   _Set_Ready(Struct_Ready.Ready_Active);
//   testWaitForTimeout(6000);
//   _unlockECU();
//   testWaitForTimeout(200);
//   _Send_Diag(4,ID,Send_DataClear);
//   _Check_31Routine_Rx(Send_DataClear,1);
//   testWaitForTimeout(1000);
//   _Check_DTC_Res(1,Ang_NotCal,0);
//   testWaitForTimeout(1000);
//   _Send_Diag(4,ID,Send_Data);
//   _Check_31Routine_Rx(Send_Data,1);
//   testWaitForTimeout(50);
//   _Send_Diag(4,ID,SendDataCheck);
//   _Check_31Routine_Rx(SendDataCheck,1);
//   testWaitForTimeout(200);
//   _Check_DTC_Res(1,0,Ang_NotCal);
//   testWaitForTimeout(1000);
  
//   _TestWaitForTesterConfirmation("转动方向盘到一定角度，然后对中");
//   _Send_Diag(4,ID,Send_DataClear);
//   _Check_31Routine_Rx(Send_DataClear,1);
//   testWaitForTimeout(1000);
//   _Check_DTC_Res(1,Ang_NotCal,0);
//   testWaitForTimeout(1000);
//   _Send_Diag(4,ID,Send_Data);
//   _Check_31Routine_Rx(Send_Data,1);
//   testWaitForTimeout(50);
//   _Send_Diag(4,ID,SendDataCheck);
//   _Check_31Routine_Rx(SendDataCheck,1);
//   testWaitForTimeout(200);
//   _Check_DTC_Res(1,0,Ang_NotCal);
//   testWaitForTimeout(1000);
// }
_31_Serve_49(dword ID,byte Session)/* 角度中位自学习开关*/
{
  byte Send_DataOpen[5] = {0x31,0x01,0x30,0x82,0x01};
  byte Send_DataClose[5] = {0x31,0x01,0x30,0x82,0x00};
  int FunPos;
  FunPos = _Check_Serve(0x01,0x3082,12);
  if(FunPos != -1)
  {
    _unlockECU();
    _Send_Diag(5,ID,Send_DataClose);
    _Check_31Routine_Rx(Send_DataClose,1);
    testWaitForTimeout(500);
    _Send_Diag(5,ID,Send_DataOpen);
    _Check_31Routine_Rx(Send_DataOpen,1);
  }
}
// _31_Serve_49_2(dword ID,byte Session)/* 30 82*/
// {
//   byte Send_DataOpen[5] = {0x31,0x01,0x30,0x82,0x01};
//   byte Send_DataClose[5] = {0x31,0x01,0x30,0x82,0x00};
//   int FunPos;
  
//   diagStartTesterPresent(Cdd_Name);
//   /*第1次学习成功*/
//   _unlockECU();
//   _Send_Diag(5,ID,Send_DataClose);
//   _Check_31Routine_Rx(Send_DataClose,1);
//   testWaitForTimeout(1000);
//   /*第2次学习失败*/
//   _Power_Down();
//   testWaitForTimeout(1000);
//   _Power_Up();
//   _Set_Ready(Struct_Ready.Ready_Active);
//   testWaitForTimeout(6000);
//   /*第3次学习失败*/
//   _unlockECU();
//   _Send_Diag(5,ID,Send_DataOpen);
//   _Check_31Routine_Rx(Send_DataOpen,1);
//   testWaitForTimeout(1000);
//   /*第4次学习成功*/
//   _Power_Down();
//   testWaitForTimeout(1000);
//   _Power_Up();
//   _Set_Ready(Struct_Ready.Ready_Active);
//   testWaitForTimeout(6000);
//   /*第5次学习成功*/
//   _unlockECU();
//   _Send_Diag(5,ID,Send_DataClose);
//   _Check_31Routine_Rx(Send_DataClose,1);
//   /*第6次学习失败*/
//   _K30_OFF();
//   testWaitForTimeout(2000);
//   _K30_ON();
//   testWaitForTimeout(2000);
//   /*第7次学习失败*/
//   _unlockECU();
//   _Send_Diag(5,ID,Send_DataOpen);
//   _Check_31Routine_Rx(Send_DataOpen,1);
//   /*第8次学习成功*/
//   _K30_OFF();
//   testWaitForTimeout(2000);
//   _K30_ON();
//   testWaitForTimeout(2000);
//   /*第9次学习成功*/
// }

_31_Serve_50(dword ID,byte Session)/* 30 83清除PDC*/
{
  byte Send_DataOpen[6] = {0x31,0x01,0x30,0x83,0,0};
  int Send_Len,i,Flage_For_Unlock;
  dword FunDID;
  Send_Len = 4;
  FunDID = 0x3083;
  _get_Arry("Pull_Drift_Compensation_Clear");
  if(Arry_Len>1)
  {
    Send_Len = Arry_Len;
    FunDID = (Arry_Data[2]<<8)|Arry_Data[3];
    for(i=0;i<Arry_Len;i++)
      Send_DataOpen[i] = Arry_Data[i];
  }
  Flage_For_Unlock = _Check_Serve(0x01,FunDID,11);
  if(Flage_For_Unlock == 1)
    _unlockECU();
  _Send_Diag(Send_Len,ID,Send_DataOpen);
  _Check_31Routine_Rx(Send_DataOpen,1);
}

_31_Serve_51(dword ID,byte Session)/* 30 8B重置PSCM转向角度学习*/
{
  byte Send_DataOpen[6] = {0x31,0x01,0x30,0x8B,0,0};
  int Send_Len,i,Flage_For_Unlock;
  dword FunDID;
  Send_Len = 4;
  FunDID = 0x308B;
  _get_Arry("Reset_PSCM_steering_angle_learning");
  if(Arry_Len>1)
  {
    Send_Len = Arry_Len;
    FunDID = (Arry_Data[2]<<8)|Arry_Data[3];
    for(i=0;i<Arry_Len;i++)
      Send_DataOpen[i] = Arry_Data[i];
  }
  Flage_For_Unlock = _Check_Serve(0x01,FunDID,11);
  if(Flage_For_Unlock == 1)
    _unlockECU();
  _Send_Diag(Send_Len,ID,Send_DataOpen);
  _Check_31Routine_Rx(Send_DataOpen,1);
}
_31_Serve_52(dword ID,byte Session)/* 30 88重置末端学习*/
{
  byte Send_DataOpen[6] = {0x31,0x01,0x30,0x88,0,0};
  int Send_Len,i,Flage_For_Unlock;
  dword FunDID;
  Send_Len = 4;
  FunDID = 0x3088;
  _get_Arry("Reset_Rack_End_Learning");
  if(Arry_Len>1)
  {
    Send_Len = Arry_Len;
    FunDID = (Arry_Data[2]<<8)|Arry_Data[3];
    for(i=0;i<Arry_Len;i++)
      Send_DataOpen[i] = Arry_Data[i];
  }
  Flage_For_Unlock = _Check_Serve(0x01,FunDID,11);
  if(Flage_For_Unlock == 1)
    _unlockECU();
  _Send_Diag(Send_Len,ID,Send_DataOpen);
  _Check_31Routine_Rx(Send_DataOpen,1);
}
// _31_Serve_50(dword ID,byte Session)/* 30 83清除PDC*/
// {
//   byte Send_DataOpen[4] = {0x31,0x01,0x30,0x83};
  
//   diagStartTesterPresent(Cdd_Name);
//   _Set_Ready(Struct_Ready.Ready_Active);
//   testWaitForTimeout(6000);
//   /*学习到PDC值*/
//   _unlockECU();
//   _Send_Diag(4,ID,Send_DataOpen);
//   _Check_31Routine_Rx(Send_DataOpen,1);
//   /*PDC值清零*/
//   testWaitForTimeout(3000);
//   _Send_Diag(4,ID,Send_DataOpen);
//   _Check_31Routine_Rx(Send_DataOpen,1);
//   _Power_Down();
//   testWaitForTimeout(1000);
//   _Power_Up();
//   _Set_Ready(Struct_Ready.Ready_Active);
//   testWaitForTimeout(6000);
//   /*PDC值保持0*/
//   _unlockECU();
//   _Send_Diag(4,ID,Send_DataOpen);
//   _Check_31Routine_Rx(Send_DataOpen,1);
//   /*重新学习PDC*/
// }
// _31_Serve_51(dword ID,byte Session)/* 30 8B重置PSCM转向角度学习*/
// {
//   byte Send_DataOpen[4] = {0x31,0x01,0x30,0x8B};
  
//   diagStartTesterPresent(Cdd_Name);
//   _Set_Ready(Struct_Ready.Ready_Active);
//   testWaitForTimeout(6000);
//   _unlockECU();
//   _Send_Diag(4,ID,Send_DataOpen);
//   _Check_31Routine_Rx(Send_DataOpen,1);
//   testWaitForTimeout(1000);
//   /*角度自学习值为0*/
//   _Power_Down();
//   testWaitForTimeout(1000);
//   _Power_Up();
//   _Set_Ready(Struct_Ready.Ready_Active);
//   testWaitForTimeout(6000);
//   /*角度自学习成功*/
// }
// _31_Serve_52(dword ID,byte Session)/* 30 88重置末端学习*/
// {
//   byte Send_DataOpen[4] = {0x31,0x01,0x30,0x88};
  
//   diagStartTesterPresent(Cdd_Name);
//   _Set_Ready(Struct_Ready.Ready_Active);
//   testWaitForTimeout(6000);
// //  _TestWaitForTesterConfirmation("确保末端学习成功");
//   _unlockECU();
//   _Send_Diag(4,ID,Send_DataOpen);
//   _Check_31Routine_Rx(Send_DataOpen,1);
//   testWaitForTimeout(1000);
// //  _TestWaitForTesterConfirmation("转动到末端无末端保护");
//   _Send_Diag(4,ID,Send_DataOpen);
//   _Check_31Routine_Rx(Send_DataOpen,1);
// //  _TestWaitForTesterConfirmation("转动到另外一端末端无末端保护");
//   _Power_Down();
//   testWaitForTimeout(1000);
//   _Power_Up();
//   _Set_Ready(Struct_Ready.Ready_Active);
//   testWaitForTimeout(6000);
//   _unlockECU();
//   _Send_Diag(4,ID,Send_DataOpen);
//   _Check_31Routine_Rx(Send_DataOpen,1);
//   testWaitForTimeout(1000);
// }
_31_Serve_53(dword ID,byte Session)/*肯定响应抑制位*/
{
  int i,j,k,Len_Send;
  byte Send_Data31[10];
  Send_Data31[0] = 0x31;
  _unlockECU();
  for(i=0;i<Serve_31_Hex_Count;i++)
  {
    for(j=0;j<Serve_31_Hex[i].Control_Type_Count;j++)
    {
      for(k=0;k<Serve_31_Hex[i].Control_Option_Count[j];k++)
      {
        Send_Data31[1] = Serve_31_Hex[i].Control_Type[j];
        Send_Data31[2] = Serve_31_Hex[i].Routine[0];
        Send_Data31[3] = Serve_31_Hex[i].Routine[1];
        Len_Send = Serve_31_Hex[i].Routine_Len;
        if(Len_Send == 5)
          Send_Data31[4] = Serve_31_Hex[i].Control_Option[j][k];
        Send_Data31[1] = (Send_Data31[1]|0x80);
        _Send_Diag(Len_Send,ID,Send_Data31);
        _TestResult(SendData,ID,"",NRC12);
        testWaitForTimeout(200);
      }
    }
  }
}

_3E_Serve_1(dword ID,byte Session)/*  3E 00 */
{
  byte Tem[2] = {0x3E,0x00};
  int Flage;
  Flage = _Check_Fun_IDAndSess(0x3E,0x00,ID,Session);
  _Send_Diag(2,ID,Tem);
  if(Flage == 1)
    _TestResult(SendData,ID,"",-1);
  else if((Flage == -2) || (Flage == -1))
    _TestResult(SendData,ID,"",NRC12);
  else if(Flage == 0 )
    _TestResult(SendData,ID,"",NRC7F);
}

_3E_Serve_2(dword ID,byte Session)/*  3E 80 */
{
  byte Tem[2] = {0x3E,0x80};
  int Flage;
  Flage = _Check_Fun_IDAndSess(0x3E,0x00,ID,Session);
  _Send_Diag(2,ID,Tem);
  if(Flage == 1)
  {
    if(_Check_Serve(0x3E,0,9)==1)
      _TestResult(SendData,ID,"",0);
    else
      _TestResult(SendData,ID,"",NRC12);
  }
  else if((Flage == -2) || (Flage == -1))
    _TestResult(SendData,ID,"",NRC12);
  else if(Flage == 0 )
    _TestResult(SendData,ID,"",NRC7F);
}

_3E_Serve_3(dword ID,byte Session)/*  NRC */
{
  int Serve_Pos,i;
  byte Send_Data[100];
  
  Serve_Pos = _Check_Serve(0x3E,0,0);
  if(_Check_Serve_IDAndSess(0x3E,ID,Session) == 1)
  {
    _Set_CarSpd(NRC22_CarSpd + 1);
    Send_Data[0] = 0x3E;
    _Set_NRC_Step(0x3E,Serve_Data[Serve_Pos].Serve_Fun[0],6,Send_Data);
    if(Fun_NRC_Count == 0)
    {
      _WriteEx_and_Report("","未输入NRC，跳过测试");
      return;
    }
    for(i=0;i<=Fun_NRC_Count;i++)
    {
      if(i>0) //第一次反馈最高优先级不做处理,其余依次恢复
        _Recover_NRC_Step(Fun_NRC[i-1],Serve_Pos,0,Send_Data);
      if(i == Fun_NRC_Count)
      {
        _Send_Diag(Fun_NRC_Send_Len,ID,Send_Data);
        _TestResult(SendData,ID,"",-1);
      }
      else
      {
        _Send_Diag(Fun_NRC_Send_Len,ID,Send_Data);
        _TestResult(SendData,ID,"",Fun_NRC[i]);
      }
      testWaitForTimeout(100);
    }
  }
  else
    _WriteEx_and_Report("","当前寻址或会话不支持该子功能");
}
_3E_Serve_4(dword ID,byte Session)/*  NRC13 */
{
  byte Send_Data[2] = {0x3E,0x00};
  int Len;
  Len = _Check_CANFD_Flage();
  for(i=1;i<=Len;i++)
  {
    if(i==0x02)
      continue;
    _Send_Diag(i,ID,Send_Data);
    _TestResult(SendData,ID,"",NRC13);
    testWaitForTimeout(50);
  }
}
_3E_Serve_5(dword ID,byte Session)/*  NRC12 */
{
  byte Send_Data[2] = {0x3E,0x01};
  int Serve_Pos,i;
  
  Serve_Pos = _Check_Serve(0x3E,0,0);
  if(_Check_Serve_IDAndSess(0x3E,ID,Session) == 1)
  {
    for(i=0;i<=0xFF;i++)
    {
      if((_Check_Serve(0x3E,i,4)!=-1) || ((_Check_Serve(0x3E,(i&0x0F),4)!=-1) && ((i>>4)==0x08) && (_Check_Serve(0x3E,i&0x0F,9) == 1)))
        continue;
      Send_Data[1]=i;
      _Send_Diag(2,ID,Send_Data);
      _TestResult(SendData,ID,"",NRC12);
      testWaitForTimeout(50);
    }
  }
}
_3E_Serve_6(dword ID,byte Session)/*  3E 00 */
{
  byte Tem[2] = {0x3E,0x00};
  byte Tem_1[3] = {0x28,0x03,0x01};
  byte Tem_2[2] = {0x01,0x03};
  int Serve_Pos;
  int Check_Flag;
  Serve_Pos = _Check_Serve(0x28,0,0);
  Check_Flag = 1;
  for(i=0;i<2;i++)
  {
    if(_Check_Serve(0x28,Tem_2[i],4)!= -1)
    {
      Tem_1[1] = Tem_2[i];
      break;
    }
  }
  if(i==2)
  {
    Tem_1[1] = Serve_Data[Serve_Pos].Serve_Fun[0];
    Check_Flag = 0;
  }
  Tem_1[2] = Serve_Data[Serve_Pos].Serve_Para[0][0];
  
  _SetSession(Session);
  testWaitForTimeout(3000);
  _Send_Diag(2,ID,Tem);
  _TestResult(SendData,ID,"",-1);
  testWaitForTimeout(3000);;
  _Send_Diag(3,ID,Tem_1);
  _TestResult(SendData,ID,"",-1);
  testWaitForTimeout(50);
  if(Check_Flag == 1)
    _Check_EPS_TX(0,EPS_TxID_1);
  _SetSession(defsession);
}
_3E_Serve_7(dword ID,byte Session)/*  3E 80 */
{
  byte Tem[2] = {0x3E,0x80};
  byte Tem_1[3] = {0x28,0x03,0x01};
  byte Tem_2[2] = {0x01,0x03};
  int Serve_Pos;
  int Check_Flag;
  Serve_Pos = _Check_Serve(0x28,0,0);
  Check_Flag = 1;
  for(i=0;i<2;i++)
  {
    if(_Check_Serve(0x28,Tem_2[i],4)!= -1)
    {
      Tem_1[1] = Tem_2[i];
      break;
    }
  }
  if(i==2)
  {
    Tem_1[1] = Serve_Data[Serve_Pos].Serve_Fun[0];
    Check_Flag = 0;
  }
  Tem_1[2] = Serve_Data[Serve_Pos].Serve_Para[0][0];
  
  if(_Check_Serve(0x3E,0,9)==0)
  {
    _Send_Diag(2,ID,Tem);
    _TestResult(SendData,ID,"",NRC12);
  }
  else
  {
    _SetSession(Session);
    testWaitForTimeout(3000);
    _Send_Diag(2,ID,Tem);
    _Check_NoResponse(SendData);
    testWaitForTimeout(3000);;
    _Send_Diag(3,ID,Tem_1);
    _TestResult(SendData,ID,"",-1);
    testWaitForTimeout(50);
    if(Check_Flag == 1)
      _Check_EPS_TX(0,EPS_TxID_1);
    _SetSession(defsession);
  }
}

// _85_Serve_1(dword ID,byte Session)/*  7F>13 */
// {
//   byte Send_Data[2] = {0x85,0x01};
//   int Serve_Pos,i;
//   Serve_Pos = _Check_Serve(0x85,0,0);
//   for(i=0;i<Serve_Data[Serve_Pos].Serve_Fun_Count;i++)
//   {
//     Send_Data[1] = Serve_Data[Serve_Pos].Serve_Fun[i];
//     _Send_Diag(3,ID,Send_Data);
//     _TestResult(SendData,ID,"",NRC7F);
//   }
// }

_85_Serve_2(dword ID,byte Session)/*   85 01/02  */
{
  byte Send_Data_0[2] = {0x85,0x01};
  byte Send_Data[2] = {0x85,0x02};
  int Retu;
  dword  Wait_Time;
  Retu = _Check_Serve_IDAndSess(0x85,ID,Session);
  if(Retu == 1)
  {
    StepByGeely3_0(0x85,Active);
    _85_Check_DTC(1,0);
    StepByGeely3_0(0x85,Close);
    _Send_Diag(2,ID,Send_Data);
    _TestResult(SendData,ID,"",-1);
    StepByGeely3_0(0x85,Active);
    _TestDisableMsg(Struct_CarSpd.Sig_Id);
    testWaitForTimeout(Struct_CarSpd.Lost_Time*1.5);
    _85_Check_DTC(1,0);
    StepByGeely3_0(0x85,Close);
    _Send_Diag(2,ID,Send_Data_0);
    _TestResult(SendData,ID,"",-1);
    Wait_Time = Struct_CarSpd.Lost_Time*1.5;
    StepByGeely3_0(0x85,Active);
    if(strncmp(ECU_project,"BYD",strlen(ECU_project)) == 0 && strlen(ECU_project) == strlen("BYD"))  //仅BYD项目85服务需要加上CAN_Init_Time时间
      Wait_Time = Wait_Time + CAN_Init_Time;
    testWaitForTimeout(Wait_Time);
    _85_Check_DTC(1,Struct_CarSpd.Lost_DTC);
    _TestEnableMsg(Struct_CarSpd.Sig_Id);
  }
  else if(Retu == 0)
  {
    _Send_Diag(2,ID,Send_Data);
    _TestResult(SendData,ID,"",NRC7E);
  }
  else 
  {
    _Send_Diag(2,ID,Send_Data);
    _TestResult(SendData,ID,"",NRC7F);
  }
}
_85_Serve_3(dword ID,byte Session)/*  85 81/82 */
{
  byte Tem_0[2] = {0x85,0x01};
  byte Tem_1[2] = {0x85,0x02};
  int Serve_Pos;
  int Retu;
  dword  Wait_Time;
  Serve_Pos = _Check_Serve(0x85,0,0);
  Retu = _Check_Serve_IDAndSess(0x85,ID,Session);
  if(Retu == 1)
  {
    if(_Check_Serve(0x85,0x01,3)==1)
    {
      _WriteEx_and_Report("","肯定响应抑制位测试");
      Tem_0[1]=0x81;
      Tem_1[1]=0x82;
      StepByGeely3_0(0x85,Active);
      _85_Check_DTC(1,0);
      StepByGeely3_0(0x85,Close);
      _Send_Diag(2,ID,Tem_1);
      _TestResult(SendData,ID,"",0);
      StepByGeely3_0(0x85,Active);
      _TestDisableMsg(Struct_CarSpd.Sig_Id);
      testWaitForTimeout(Struct_CarSpd.Lost_Time*1.5);
      _85_Check_DTC(1,0);
      StepByGeely3_0(0x85,Close);
      _Send_Diag(2,ID,Tem_0);
      _TestResult(SendData,ID,"",0);
      StepByGeely3_0(0x85,Active);
      Wait_Time = Struct_CarSpd.Lost_Time*1.5;
      if(strncmp(ECU_project,"BYD",strlen(ECU_project)) == 0 && strlen(ECU_project) == strlen("BYD")) //仅BYD项目85服务需要加上CAN_Init_Time时间
        Wait_Time = Wait_Time + CAN_Init_Time;
      testWaitForTimeout(Wait_Time);
      _85_Check_DTC(1,Struct_CarSpd.Lost_DTC);
      _TestEnableMsg(Struct_CarSpd.Sig_Id);
    }
    else
    {
      Tem_0[1]=0x81;
      Tem_1[1]=0x82;
      StepByGeely3_0(0x85,Close);
      _Send_Diag(2,ID,Tem_1);
      _TestResult(SendData,ID,"",NRC12);
      _Send_Diag(2,ID,Tem_0);
      _TestResult(SendData,ID,"",NRC12);
    }
  }
  else if(Retu == 0)
  {
    _Send_Diag(2,ID,Tem_0);
    _TestResult(SendData,ID,"",NRC7E);
  }
  else 
  {
    _Send_Diag(2,ID,Tem_0);
    _TestResult(SendData,ID,"",NRC7F);
  }
}

_85_Serve_4(dword ID,byte Session)/*  S3Timeout*/
{
  byte Tem_0[2] = {0x85,0x02};
  byte Tem_1[2] = {0x85,0x82};
  diagStopTesterPresent(Cdd_Name);
  StepByGeely3_0(0x85,Active);
  _Clear_DTC(phyreq_ID);
  _85_Check_DTC(1,0);
  if(_Check_Fun_IDAndSess(0x85,0x02,ID,Session) == 1)
  {
    StepByGeely3_0(0x85,Close);
    _Send_Diag(2,ID,Tem_0);
    _TestResult(SendData,ID,"",-1);
    StepByGeely3_0(0x85,Active);
    _TestDisableMsg(Struct_CarSpd.Sig_Id);
    testWaitForTimeout(Struct_CarSpd.Lost_Time*1.5);
    _85_Check_DTC(1,0);
    testWaitForTimeout(Struct_CarSpd.Lost_Time*1.5+S3_85_Time);
    _85_Check_DTC(1,Struct_CarSpd.Lost_DTC);
    _TestEnableMsg(Struct_CarSpd.Sig_Id);
    testWaitForTimeout(1000);
    _SetSession(Session);
    if(_Check_Serve(0x85,0x02,9)==1) /*肯定响应抑制位测试*/
    {
      _WriteEx_and_Report("","肯定响应抑制位测试");
      _Clear_DTC(phyreq_ID);
      _85_Check_DTC(1,0);
      StepByGeely3_0(0x85,Close);
      _Send_Diag(2,ID,Tem_1);
      _TestResult(SendData,ID,"",0);
      StepByGeely3_0(0x85,Active);
      _TestDisableMsg(Struct_CarSpd.Sig_Id);
      testWaitForTimeout(Struct_CarSpd.Lost_Time*1.5);
      _85_Check_DTC(1,0);
      testWaitForTimeout(Struct_CarSpd.Lost_Time*1.5+S3_85_Time);
      _85_Check_DTC(1,Struct_CarSpd.Lost_DTC);
      _TestEnableMsg(Struct_CarSpd.Sig_Id);
      testWaitForTimeout(1000);
    }
    else
      _WriteEx_and_Report("","当前项目不支持肯定响应抑制位,跳过检测");
  }
}
_85_Serve_5(dword ID,byte Session)/*  会话切换*/
{
  byte Tem_0[2] = {0x85,0x02};
  byte Tem_1[2] = {0x85,0x82};
  diagStopTesterPresent(Cdd_Name);
  if(_Check_Fun_IDAndSess(0x85,0x02,ID,Session) == 1)
  {
    StepByGeely3_0(0x85,Active);
    _Clear_DTC(phyreq_ID);
    _85_Check_DTC(1,0);
    StepByGeely3_0(0x85,Close);
    _Send_Diag(2,ID,Tem_0);
    _TestResult(SendData,ID,"",-1);
    StepByGeely3_0(0x85,Active);
    _TestDisableMsg(Struct_CarSpd.Sig_Id);
    testWaitForTimeout(Struct_CarSpd.Lost_Time*1.5);
    _85_Check_DTC(1,0);
    _SetSession(exsession);
    testWaitForTimeout(Struct_CarSpd.Lost_Time*1.5);
    _85_Check_DTC(1,0);
    _SetSession(defsession);
    testWaitForTimeout(200);
    testWaitForTimeout(Struct_CarSpd.Lost_Time*1.5);
    _85_Check_DTC(1,Struct_CarSpd.Lost_DTC);
    _TestEnableMsg(Struct_CarSpd.Sig_Id);
    testWaitForTimeout(1000);
    _SetSession(Session);
    if(_Check_Serve(0x85,0x02,9)==1) /*肯定响应抑制位测试*/
    {
      _WriteEx_and_Report("","肯定响应抑制位测试");
      _Clear_DTC(phyreq_ID);
      StepByGeely3_0(0x85,Active);
      _85_Check_DTC(1,0);
      StepByGeely3_0(0x85,Close);
      _Send_Diag(2,ID,Tem_1);
      _TestResult(SendData,ID,"",0);
      StepByGeely3_0(0x85,Active);
      _TestDisableMsg(Struct_CarSpd.Sig_Id);
      testWaitForTimeout(Struct_CarSpd.Lost_Time*1.5);
      _85_Check_DTC(1,0);
      _SetSession(exsession);
      testWaitForTimeout(Struct_CarSpd.Lost_Time*1.5);
      _85_Check_DTC(1,0);
      _SetSession(defsession);
      testWaitForTimeout(200);
      testWaitForTimeout(Struct_CarSpd.Lost_Time*1.5);
      _85_Check_DTC(1,Struct_CarSpd.Lost_DTC);
      _TestEnableMsg(Struct_CarSpd.Sig_Id);
      testWaitForTimeout(1000);
    }
    else
      _WriteEx_and_Report("","当前项目不支持肯定响应抑制位,跳过检测");
  }
}
_85_Serve_6(dword ID,byte Session)/*  11重置*/
{
  byte Tem_0[2] = {0x85,0x02};
  byte Tem_1[2] = {0x85,0x82};
  if(_Check_Fun_IDAndSess(0x85,0x02,ID,Session) == 1)
  {
    _Clear_DTC(phyreq_ID);
    StepByGeely3_0(0x85,Active);
    _85_Check_DTC(1,0);
    StepByGeely3_0(0x85,Close);
    _Send_Diag(2,ID,Tem_0);
    _TestResult(SendData,ID,"",-1);
    StepByGeely3_0(0x85,Active);
    _TestDisableMsg(Struct_CarSpd.Sig_Id);
    testWaitForTimeout(Struct_CarSpd.Lost_Time*1.5);
    _85_Check_DTC(1,0);
    _Set_11_Restoration();
    testWaitForTimeout(Struct_CarSpd.Lost_Time*1.5+CAN_Init_Time-Wait_Time_11); //减去11复位所有时间
    _85_Check_DTC(1,Struct_CarSpd.Lost_DTC);
    _TestEnableMsg(Struct_CarSpd.Sig_Id);
    testWaitForTimeout(2000);
    
    if(_Check_Serve(0x85,0x02,9)==1) /*肯定响应抑制位测试*/
    {
      _WriteEx_and_Report("","肯定响应抑制位测试");
      _SetSession(Session);
      StepByGeely3_0(0x85,Active);
      _Clear_DTC(phyreq_ID);
      _85_Check_DTC(1,0);
      StepByGeely3_0(0x85,Close);
      _Send_Diag(2,ID,Tem_1);
      _TestResult(SendData,ID,"",0);
      StepByGeely3_0(0x85,Active);
      _TestDisableMsg(Struct_CarSpd.Sig_Id);
      testWaitForTimeout(Struct_CarSpd.Lost_Time*1.5);
      _85_Check_DTC(1,0);
      
      _Set_11_Restoration();
      testWaitForTimeout(Struct_CarSpd.Lost_Time*1.5+CAN_Init_Time-Wait_Time_11); //减去11复位所有时间
      _85_Check_DTC(1,Struct_CarSpd.Lost_DTC);
      _TestEnableMsg(Struct_CarSpd.Sig_Id);
      testWaitForTimeout(1000);
    }
    else
      _WriteEx_and_Report("","当前项目不支持肯定响应抑制位,跳过检测");
  }
}
_85_Serve_7(dword ID,byte Session)/* KL15 OFF->ON*/
{
  byte Tem_0[2] = {0x85,0x02};
  byte Tem_1[2] = {0x85,0x82};
  if(_Check_Fun_IDAndSess(0x85,0x02,ID,Session) == 1)
  {
    _Clear_DTC(phyreq_ID);
    StepByGeely3_0(0x85,Active);
    _85_Check_DTC(1,0);
    StepByGeely3_0(0x85,Close);
    _Send_Diag(2,ID,Tem_0);
    _TestResult(SendData,ID,"",-1);
    StepByGeely3_0(0x85,Active);
    _TestDisableMsg(Struct_CarSpd.Sig_Id);
    testWaitForTimeout(Struct_CarSpd.Lost_Time*1.5);
    _85_Check_DTC(1,0);
    _Power_Down();
    _Power_Up();
    testWaitForTimeout(Struct_CarSpd.Lost_Time*1.5+CAN_Init_Time-2100); //减去上电等待时间
    _85_Check_DTC(1,Struct_CarSpd.Lost_DTC);
    _TestEnableMsg(Struct_CarSpd.Sig_Id);
    testWaitForTimeout(1000);
    
    if(_Check_Serve(0x85,0x02,9)==1) /*肯定响应抑制位测试*/
    {
      _WriteEx_and_Report("","肯定响应抑制位测试");
      _SetSession(Session);
      _Clear_DTC(phyreq_ID);
      StepByGeely3_0(0x85,Active);
      _85_Check_DTC(1,0);
      StepByGeely3_0(0x85,Close);
      _Send_Diag(2,ID,Tem_1);
      _TestResult(SendData,ID,"",0);
      StepByGeely3_0(0x85,Active);
      _TestDisableMsg(Struct_CarSpd.Sig_Id);
      testWaitForTimeout(Struct_CarSpd.Lost_Time*1.5);
      _85_Check_DTC(1,0);
      _Power_Down();
      _Power_Up();
      testWaitForTimeout(Struct_CarSpd.Lost_Time*1.5+CAN_Init_Time-2100);
      _85_Check_DTC(1,Struct_CarSpd.Lost_DTC);
      _TestEnableMsg(Struct_CarSpd.Sig_Id);
      testWaitForTimeout(1000);
    }
    else
      _WriteEx_and_Report("","当前项目不支持肯定响应抑制位,跳过检测");
  }
}

_85_Serve_8(dword ID,byte Session)/* NRC优先级*/
{
  int Serve_Pos,i;
  byte Send_Data[100];
  
  Serve_Pos = _Check_Serve(0x85,0,0);
  
  if(_Check_Serve_IDAndSess(0x85,ID,Session) == 1)
  {
    Send_Data[0] = 0x85;
    _Set_NRC_Step(0x85,Serve_Data[Serve_Pos].Serve_Fun[0],6,Send_Data);
    if(Fun_NRC_Count == 0)
    {
      _WriteEx_and_Report("","未输入NRC，跳过测试");
      return;
    }
    for(i=0;i<=Fun_NRC_Count;i++)
    {
      if(i>0) //第一次反馈最高优先级不做处理,其余依次恢复
      {
        _Recover_NRC_Step(Fun_NRC[i-1],Serve_Pos,0,Send_Data);
      }
      if(i == Fun_NRC_Count)
      {
        _Send_Diag(Fun_NRC_Send_Len,ID,Send_Data);
        _TestResult(SendData,ID,"",-1);
      }
      else
      {
        _Send_Diag(Fun_NRC_Send_Len,ID,Send_Data);
        _TestResult(SendData,ID,"",Fun_NRC[i]);
      }
      testWaitForTimeout(100);
    }
  }
}
_85_Serve_9_CarSpd(dword ID,byte Session)/*  NRC22车速*/
{
  byte Tem_0[2] = {0x85,0x01};
  byte Tem_1[2] = {0x85,0x02};
  int Serve_Pos,NRC22_Flage;
  
  Serve_Pos = _Check_Serve(0x85,0,0);
  if(_Check_Serve_IDAndSess(0x85,ID,Session) == 1)
  {
    NRC22_Flage = _Set_NRC22(0x85,Serve_Data[Serve_Pos].Serve_Fun[0],2);
    if(NRC22_Flage == -1)
      _WriteEx_and_Report("","无NRC22条件");
    else if((NRC22_Flage &0x01) != 0)
    {
      _Set_CarSpd(NRC22_CarSpd+1);
      _Send_Diag(2,ID,Tem_0);
      _TestResult(SendData,ID,"",CarSpd_NRC);
      _Send_Diag(2,ID,Tem_1);
      _TestResult(SendData,ID,"",CarSpd_NRC);
      
      if(_Check_Serve(0x85,0x01,9)==1)
      {
        Tem_0[1]=0X81;
        _Send_Diag(2,ID,Tem_0);
        _TestResult(SendData,ID,"",CarSpd_NRC);
        Tem_0[1]=0X01;
      }  
      if(_Check_Serve(0x85,0x02,9)==1)
      {
        Tem_0[1]=0X82;
        _Send_Diag(2,ID,Tem_0);
        _TestResult(SendData,ID,"",CarSpd_NRC);
        Tem_0[1]=0X02;
      }
      _TestDisableMsg(Struct_CarSpd.Sig_Id);
      testWaitForTimeout(Struct_CarSpd.Lost_Time*1.5);
      _Send_Diag(2,ID,Tem_0);
      _TestResult(SendData,ID,"",-1);
      _Send_Diag(2,ID,Tem_1);
      _TestResult(SendData,ID,"",-1);
      _TestEnableMsg(Struct_CarSpd.Sig_Id);
      _Set_CarSpd_Invalid(Struct_CarSpd.Invalid_Value[0]);
      testWaitForTimeout(Struct_CarSpd.Invalid_Time*1.5);
      if(Geely3_Flage == 1)
      {
        _Send_Diag(2,ID,Tem_0);
        _TestResult(SendData,ID,"",CarSpd_Invalid_NRC);
        _Send_Diag(2,ID,Tem_1);
        _TestResult(SendData,ID,"",CarSpd_Invalid_NRC);
      }
      else
      {
        _Send_Diag(2,ID,Tem_0);
        _TestResult(SendData,ID,"",-1);
        _Send_Diag(2,ID,Tem_1);
        _TestResult(SendData,ID,"",-1);
      }
      _Reset_CarSpd_Invalid();
      _Set_CarSpd(0);
    }
    else
      _WriteEx_and_Report("","无NRC22车速条件");
  }
}
_85_Serve_9_Ready(dword ID,byte Session)/*  NRC22-发动机*/
{
  byte Tem_0[2] = {0x85,0x01};
  int Serve_Pos,NRC22_Flage;
  
  Serve_Pos = _Check_Serve(0x85,0,0);
  if(_Check_Serve_IDAndSess(0x85,ID,Session) == 1)
  {
    NRC22_Flage = _Set_NRC22(0x85,Serve_Data[Serve_Pos].Serve_Fun[0],2);
    if(NRC22_Flage == -1)
      _WriteEx_and_Report("","无NRC22条件");
    else if((NRC22_Flage &0x20) != 0)
    {
      Tem_0[1] = Serve_Data[Serve_Pos].Serve_Fun[0];
      _Set_Ready(Ready_NRC22);
      testWaitForTimeout(1000);
      _Send_Diag(2,ID,Tem_0);
      _TestResult(SendData,ID,"",Ready_NRC);
      _TestDisableMsg(Struct_Ready.Sig_Id);
      testWaitForTimeout(Struct_Ready.Invalid_Time*1.5);
      _Send_Diag(2,ID,Tem_0);
      _TestResult(SendData,ID,"",-1);
      _TestEnableMsg(Struct_Ready.Sig_Id);
      testWaitForTimeout(Struct_Ready.Invalid_Time*1.5);
      _Set_Sig(Struct_Ready.ReadyInvalid_Sig,Struct_Ready.Invalid_Value[0]);
      testWaitForTimeout(Struct_Ready.Invalid_Time*1.5);
      _Send_Diag(2,ID,Tem_0);
      _TestResult(SendData,ID,"",-1);
      _Set_Sig(Struct_Ready.ReadyInvalid_Sig,Struct_Ready.Normal_Value[0]);
      testWaitForTimeout(Struct_Ready.Invalid_Time*1.5);
      _Set_Ready(0);
      testWaitForTimeout(1000);
    }
    else
      _WriteEx_and_Report("","无NRC22发动机条件");
  }
}


_85_Serve_10(dword ID,byte Session)/*  NRC22-吉利3.0*/
{
  byte Tem_0[2] = {0x85,0x01};
  byte Tem_1[2] = {0x85,0x02};
  char Serve_85_CarSpdQFTemp[10];
  byte Serve_85_CarSpdQF[10];
  int Serve_85_CarSpdQF_Count;
  int i,j;
  Serve_85_CarSpdQF_Count = getProfileArray(ECU_project,"Serve_85_CarSpdQF",Serve_85_CarSpdQFTemp,elCount(Serve_85_CarSpdQFTemp),file_name_1);
  for(i=0;i<Serve_85_CarSpdQF_Count;i++)
    Serve_85_CarSpdQF[i] = Serve_85_CarSpdQFTemp[i];
  diagStartTesterPresent(Cdd_Name);
  _Set_Ready(Struct_Ready.Ready_Active);
  testWaitForTimeout(6000);
  
  for(j=0;j<7;j++)
  {
    diagStartTesterPresent(Cdd_Name);
    if(j==1)
      _Set_CarSpd(NRC22_CarSpd+1);
    else 
      _Set_CarSpd(NRC22_CarSpd-1);
    
    _Set_Ready(0xB);
    _Set_CarSpd_Invalid(3);
    if(j==0 || j==1)  /*此用例测试VehSpdLgtQf=2或3能支持85服务，需要遍历VehSpdLgtQf值*/
    {
      _WriteEx_and_Report("","测试支持85服务的VehSpdLgtQf，需要遍历VehSpdLgtQf值");
      for(i=0;i<4;i++)
      {
        _Set_CarSpd_Invalid(i);
        testWaitForTimeout(1000);
        if((_Check_Dword_in_Num(i,Serve_85_CarSpdQF,Serve_85_CarSpdQF_Count)!= -1) && j == 0)
        {
          _Send_Diag(2,ID,Tem_0);
          _TestResult(SendData,ID,"",-1);
          _Send_Diag(2,ID,Tem_1);
          _TestResult(SendData,ID,"",-1);
        }
        else
        {
          _Send_Diag(2,ID,Tem_0);
          _TestResult(SendData,ID,"",CarSpd_Invalid_NRC);
          _Send_Diag(2,ID,Tem_1);
          _TestResult(SendData,ID,"",CarSpd_Invalid_NRC);
        }
      }
      if(j==1)
      {
        _Set_CarSpd_Invalid(0);
        _TestDisableMsg(Struct_CarSpd.Sig_Id);
        testWaitForTimeout(Struct_CarSpd.Lost_Time*1.5);
        _Send_Diag(2,ID,Tem_0);
        _TestResult(SendData,ID,"",-1);
        _Send_Diag(2,ID,Tem_1);
        _TestResult(SendData,ID,"",-1);
        _TestEnableMsg(Struct_CarSpd.Sig_Id);
        _WriteEx_and_Report("","步骤5-9测试结束");
      }
      else
        _WriteEx_and_Report("","步骤1-4测试结束");
    }
    else if(j==2)  /*此用例测试Usgmode≠0xD(driving)能支持85服务，需要遍历Usgmode值以及丢失*/
    {
      _WriteEx_and_Report("","此用例测试Usgmode≠0xD(driving)能支持85服务，需要遍历Usgmode值以及丢失");
      for(i=0;i<5;i++)
      {
        byte Temp[5]={0,1,2,0xB,0xD};
        _Set_Ready(Temp[i]);
        testWaitForTimeout(1000);
        _Send_Diag(2,ID,Tem_0);
        if(Temp[i]==0xD)
          _TestResult(SendData,ID,"",Ready_NRC);
        else
          _TestResult(SendData,ID,"",-1);
        _Send_Diag(2,ID,Tem_1);
        if(Temp[i]==0xD)
          _TestResult(SendData,ID,"",Ready_NRC);
        else
          _TestResult(SendData,ID,"",-1);
      }
      _Set_Ready(0xD);
      _TestDisableMsg(Struct_Ready.Sig_Id);
      testWaitForTimeout(3000);
      _Send_Diag(2,ID,Tem_0);
      _TestResult(SendData,ID,"",-1);
      _Send_Diag(2,ID,Tem_1);
      _TestResult(SendData,ID,"",-1);
      _TestEnableMsg(Struct_Ready.Sig_Id);
      _WriteEx_and_Report("","步骤10-15测试结束");
    }
    else if(j==3)/*测试电压条件*/
    { 
      float Temp[4]={1,2,3,4};
      _WriteEx_and_Report("","测试电压条件");
      Temp[0]=NRC22_Battery_Low+0.2;
      Temp[1]=NRC22_Battery_Hight-0.2;
      Temp[2]=NRC22_Battery_Low-0.2;
      Temp[3]=NRC22_Battery_Hight+0.2;
      for(i=0;i<4;i++)
      {
        _Set_Battery(Temp[i]);
        if(i<2)
        {
          _Send_Diag(2,ID,Tem_0);
          _TestResult(SendData,ID,"",-1);
          _Send_Diag(2,ID,Tem_1);
          _TestResult(SendData,ID,"",-1);
        }
        else if(i==2)
        {
          _Send_Diag(2,ID,Tem_0);
          _TestResult(SendData,ID,"",L_Battery_NRC);
          _Send_Diag(2,ID,Tem_1);
          _TestResult(SendData,ID,"",L_Battery_NRC);
        }
        else if(i==3)
        {
          _Send_Diag(2,ID,Tem_0);
          _TestResult(SendData,ID,"",H_Battery_NRC);
          _Send_Diag(2,ID,Tem_1);
          _TestResult(SendData,ID,"",H_Battery_NRC);
        }
      }
      _Set_Battery(12);
      _WriteEx_and_Report("","步骤16-19测试结束");
    }
    else if(j==4)/*Usgmode(0x2E0:VehModMngtGlbSafe1)=0xD，车速<3km/h，VehSpdLgtQf=3，电压为13.5V时丢失0xE0节点发送报文：*/
    {
      _WriteEx_and_Report("","Usgmode(0x2E0:VehModMngtGlbSafe1)=0xD，车速<3km/h，VehSpdLgtQf=3，电压为13.5V时丢失0xE0节点发送报文");
      _Set_Ready(0xD);
      _TestDisableMsg(Struct_CarSpd.Sig_Id);
      testWaitForTimeout(5000);
      _Send_Diag(2,ID,Tem_0);
      _TestResult(SendData,ID,"",Ready_NRC);
      _Send_Diag(2,ID,Tem_1);
      _TestResult(SendData,ID,"",Ready_NRC);
      _TestEnableMsg(Struct_CarSpd.Sig_Id);
      testWaitForTimeout(1000);
      _Set_Ready(0xB);
      _TestDisableMsg(Struct_CarSpd.Sig_Id);
      testWaitForTimeout(5000);
      _Send_Diag(2,ID,Tem_0);
      _TestResult(SendData,ID,"",-1);
      _Send_Diag(2,ID,Tem_1);
      _TestResult(SendData,ID,"",-1);
      _TestEnableMsg(Struct_CarSpd.Sig_Id);
      testWaitForTimeout(1000);
      _WriteEx_and_Report("","步骤20-21测试结束");
    }
    else if(j==5)/*步骤22&23、VehSpdLgtQf不满足；步骤24、车速不满足；步骤25&26、VehSpdLgtQf满足取值遍历*/
    {
      int Qf[4] = {1,0,2,3};
      _Set_Ready(0xD);
      _WriteEx_and_Report("","步骤22&23：VehSpdLgtQf不满足。步骤24：车速不满足。步骤25&26：VehSpdLgtQf满足取值遍历");
      _WriteEx_and_Report("","步骤22，步骤23，步骤25，步骤26");
      for(i=0;i<4;i++)
      {
        _Set_CarSpd_Invalid(Qf[i]);
        testWaitForTimeout(500);
        _TestDisableMsg(Struct_Ready.Sig_Id);
        testWaitForTimeout(2000);
        if(_Check_Dword_in_Num(Qf[i],Serve_85_CarSpdQF,Serve_85_CarSpdQF_Count)!= -1)
        {
          _Send_Diag(2,ID,Tem_0);
          _TestResult(SendData,ID,"",-1);
          _Send_Diag(2,ID,Tem_1);
          _TestResult(SendData,ID,"",-1);
        }
        else
        {
          _Send_Diag(2,ID,Tem_0);
          _TestResult(SendData,ID,"",CarSpd_Invalid_NRC);
          _Send_Diag(2,ID,Tem_1);
          _TestResult(SendData,ID,"",CarSpd_Invalid_NRC);
        }
        _TestEnableMsg(Struct_Ready.Sig_Id);
        testWaitForTimeout(2000);
      }
      _WriteEx_and_Report("","步骤24，放于循环外测试");
      _Set_CarSpd(NRC22_CarSpd+1);
      _Set_CarSpd_Invalid(2);
      _TestDisableMsg(Struct_Ready.Sig_Id);
      testWaitForTimeout(2000);
      _Send_Diag(2,ID,Tem_0);
      _TestResult(SendData,ID,"",CarSpd_NRC);
      _Send_Diag(2,ID,Tem_1);
      _TestResult(SendData,ID,"",CarSpd_NRC);
      _TestEnableMsg(Struct_Ready.Sig_Id);
      testWaitForTimeout(2000);
      _WriteEx_and_Report("","步骤22-26测试结束");
    }
    else if(j==6)/*在Usgmode不满足且Usgmode和车速均丢失的前提下设计以下电压临界值步骤情况*/
    {
      float Temp[4]={1,2,3,4};
      _WriteEx_and_Report("","在Usgmode不满足且Usgmode和车速均丢失的前提下设计以下电压临界值步骤情况");
      Temp[0]=NRC22_Battery_Low+0.2;
      Temp[1]=NRC22_Battery_Hight-0.2;
      Temp[2]=NRC22_Battery_Low-0.2;
      Temp[3]=NRC22_Battery_Hight+0.2;
      _Set_Ready(0xD);
      _Set_CarSpd_Invalid(3);
      _Set_CarSpd(NRC22_CarSpd-1);
      testWaitForTimeout(1000);
      for(i=0;i<4;i++)
      {
        _Set_Battery(Temp[i]);
        _TestDisableMsg(Struct_Ready.Sig_Id);
        _TestDisableMsg(Struct_CarSpd.Sig_Id);
        testWaitForTimeout(2000);
        if(i<2)
        {
          _Send_Diag(2,ID,Tem_0);
          _TestResult(SendData,ID,"",-1);
          _Send_Diag(2,ID,Tem_1);
          _TestResult(SendData,ID,"",-1);
        }
        else if(i==2)
        {
          _Send_Diag(2,ID,Tem_0);
          _TestResult(SendData,ID,"",L_Battery_NRC);
          _Send_Diag(2,ID,Tem_1);
          _TestResult(SendData,ID,"",L_Battery_NRC);
        }
        else if(i==3)
        {
          _Send_Diag(2,ID,Tem_0);
          _TestResult(SendData,ID,"",H_Battery_NRC);
          _Send_Diag(2,ID,Tem_1);
          _TestResult(SendData,ID,"",H_Battery_NRC);
        }
        _TestEnableMsg(Struct_Ready.Sig_Id);
        _TestEnableMsg(Struct_CarSpd.Sig_Id);
        testWaitForTimeout(1000);
      }
      _Set_Battery(12);
      _WriteEx_and_Report("","步骤27-30测试结束");
    }
  }
  _Set_CarSpd(0);
  _Reset_CarSpd_Invalid();
}
_85_Serve_11(dword ID,byte Session)/*  NRC13*/
{
  byte Tem[2] = {0x85,0x01};
  int i,len;
  len = _Check_CANFD_Flage();
  StepByGeely3_0(0x85,Close);
  if(_Check_Serve_IDAndSess(0x85,ID,Session) == 1)
  {
    for(i=1;i<=len;i++)
    {
      if(i==2)
        continue;
      _Send_Diag(i,ID,Tem);
      _TestResult(SendData,ID,"",NRC13);
      testWaitForTimeout(50);
    }
  }
}
_85_Serve_12(dword ID,byte Session)/*  NRC12*/
{
  byte Tem[2] = {0x85,0x01};
  int Serve_Pos,i;
  byte Send_Data[100];
  
  Serve_Pos = _Check_Serve(0x85,0,0);
  StepByGeely3_0(0x85,Close);
  if(_Check_Serve_IDAndSess(0x85,ID,Session) == 1)
  {
    for(i=0;i<=0xFF;i++)
    {
      if((_Check_Serve(0x85,i,4)!=-1) || ((_Check_Serve(0x85,(i&0x0F),4)!=-1) && ((i>>4)==0x08) && (_Check_Serve(0x85,i&0x0F,9) == 1)))
        continue;
      Tem[1]=i;
      _Send_Diag(2,ID,Tem);
      _TestResult(SendData,ID,"",NRC12);
      testWaitForTimeout(50);
    }
  }
}
_85_Serve_13(dword ID,byte Session)/*  85服务禁止前的当前故障在85禁止后14清除读取不到*/
{
  byte Send85_1[2] = {0x85,0x01};
  byte Send85_2[2] = {0x85,0x02};
  int i;
  for(i=0;i<5;i++)
  {
    if(i != 0)
    {
      _SetSession(Session);
      testWaitForTimeout(300);
    }
    StepByGeely3_0(0x85,Active);
    _TestDisableMsg(Struct_CarSpd.Sig_Id);
    testWaitForTimeout(Struct_CarSpd.Lost_Time*1.5);
    _Clear_DTC(phyreq_ID);
    testWaitForTimeout(Struct_CarSpd.Lost_Time*1.5);
    _Check_DTC_Res(1,Struct_CarSpd.Lost_DTC,0);
    StepByGeely3_0(0x85,Close);
    _Send_Diag(2,ID,Send85_2);
    _TestResult(SendData,ID,"",-1);
    _Check_DTC_Res(1,Struct_CarSpd.Lost_DTC,0);
    StepByGeely3_0(0x85,Active);
    _Clear_DTC(phyreq_ID);
    testWaitForTimeout(Struct_CarSpd.Lost_Time*1.5);
    _Check_DTC_Res(1,0,Struct_CarSpd.Lost_DTC);
    if(i == 0)
    {
      _WriteEx_and_Report("","/*--------------11复位------------*/");
      _Set_11_Restoration();
      testWaitForTimeout(CAN_Init_Time + Struct_CarSpd.Lost_Time*1.5);
    }
    else if(i == 1)
    {
      _WriteEx_and_Report("","/*--------------正常上下电------------*/");
      _Set_Ready(0);
      testWaitForTimeout(200);
      _Power_Down();
      testWaitForTimeout(2000);
      _Power_Up();
      StepByGeely3_0(0x85,Active);
      testWaitForTimeout( Struct_CarSpd.Lost_Time*1.5);
    }
    else if(i == 2)
    {
      _WriteEx_and_Report("","/*--------------异常断电------------*/");
      _K30_OFF();
      testWaitForTimeout(2000);
      _K30_ON();
      testWaitForTimeout(CAN_Init_Time);
      StepByGeely3_0(0x85,Active);
      if(Geely3_Flage == 1 && CAN_Init_Time<5000)
        testWaitForTimeout(5000);
      testWaitForTimeout( Struct_CarSpd.Lost_Time*1.5);
    }
    else if(i == 3)
    {
      _WriteEx_and_Report("","/*--------------S3Time超时------------*/");
      testWaitForTimeout(6000);
      testWaitForTimeout( Struct_CarSpd.Lost_Time*1.5);
    }
    else if(i == 4)
    {
      _WriteEx_and_Report("","/*--------------会话切换------------*/");
      _SetSession(exsession);
      testWaitForTimeout(200);
      testWaitForTimeout( Struct_CarSpd.Lost_Time*1.5);
      _Check_DTC_Res(1,0,Struct_CarSpd.Lost_DTC);
      _SetSession(defsession);
      testWaitForTimeout(200);
      testWaitForTimeout( Struct_CarSpd.Lost_Time*1.5);
    }
    _Check_DTC_Res(1,Struct_CarSpd.Lost_DTC,0);
    _TestEnableMsg(Struct_CarSpd.Sig_Id);
    testWaitForTimeout( Struct_CarSpd.Lost_Time*1.1);
    _WriteEx_and_Report("","/*---------------------------*/");
  }
}

_85_Serve_14(dword ID,byte Session)/*  K30 OFF->ON异常断电后功能实现正常*/
{
  byte Send85_2[2];
  int i,Res;
  Send85_2[0] = 0x85;
  for(i=0;i<2;i++)
  {
    if(i == 0)
    {
      Send85_2[1] = 0x02;
      Res = -1;
    }
    else
    {
      Send85_2[1] = 0x82;
      Res = 0;
    }
    StepByGeely3_0(0x85,Active);
    _Clear_DTC(phyreq_ID);
    _Check_DTC_Res(9,0,Struct_CarSpd.Lost_DTC);
    StepByGeely3_0(0x85,Close);
    _Send_Diag(2,ID,Send85_2);
    _TestResult(SendData,ID,"",Res);
    StepByGeely3_0(0x85,Active);
    _TestDisableMsg(Struct_CarSpd.Sig_Id);
    testWaitForTimeout(Struct_CarSpd.Lost_Time*1.5);
    _Check_DTC_Res(9,0,Struct_CarSpd.Lost_DTC);
    _K30_OFF();
    testWaitForTimeout(2000);
    _K30_ON();
    testWaitForTimeout(CAN_Init_Time);
    if(Geely3_Flage == 1 && CAN_Init_Time<5000)
      testWaitForTimeout(6000-CAN_Init_Time);
    testWaitForTimeout(Struct_CarSpd.Lost_Time*1.5);
    _Check_DTC_Res(1,Struct_CarSpd.Lost_DTC,0);
    _SetSession(Session);
    StepByGeely3_0(0x85,Close);
    _Send_Diag(2,ID,Send85_2);
    _TestResult(SendData,ID,"",Res);
    testWaitForTimeout(100);
    _Clear_DTC(phyreq_ID);
    StepByGeely3_0(0x85,Active);
    testWaitForTimeout(Struct_CarSpd.Lost_Time*1.5);
    _Check_DTC_Res(9,0,Struct_CarSpd.Lost_DTC);
    _TestEnableMsg(Struct_CarSpd.Sig_Id);
    testWaitForTimeout(Struct_CarSpd.Lost_Time*1.5);
    _SetSession(defsession);
    testWaitForTimeout(500);
    _SetSession(Session);
    testWaitForTimeout(500);
  }
}

_85_Serve_15(dword ID,byte Session)/*85服务禁止和启用时的故障码检测*/
{
  byte Send85_2[2];
  int Res;
  Send85_2[0] = 0x85; Send85_2[1] = 0x02;
  Res = -1;

  StepByGeely3_0(0x85,Active);
  _Clear_DTC(phyreq_ID);
  _TestDisableMsg(Struct_CarSpd.Sig_Id);
  testWaitForTimeout(Struct_CarSpd.Lost_Time*1.5);
  _Check_DTC_InNow_NotInNowAndHis(0x09,Struct_CarSpd.Lost_DTC,0);
  _SetSession(Session);
  testWaitForTimeout(200);
  StepByGeely3_0(0x85,Close);
  _Send_Diag(2,ID,Send85_2);
  _TestResult(SendData,ID,"",Res);
  StepByGeely3_0(0x85,Active);
  _Check_DTC_InNow_NotInNowAndHis(0x09,Struct_CarSpd.Lost_DTC,0);
  _Clear_DTC(phyreq_ID);
  testWaitForTimeout(Struct_CarSpd.Lost_Time*1.5);
  _Check_DTC_InNow_NotInNowAndHis(0x09,0,Struct_CarSpd.Lost_DTC);
  _WriteEx_and_Report("","步骤1-2测试完成");

  Send85_2[1] = 0x01;
  StepByGeely3_0(0x85,Close);
  _Send_Diag(2,ID,Send85_2);
  _TestResult(SendData,ID,"",Res);
  if(Geely3_Flage == 1)
  {
    diagStartTesterPresent(Cdd_Name);
    _Set_Ready(Struct_Ready.Ready_Active);
    testWaitForTimeout(5000);
  }
  testWaitForTimeout((word)Struct_CarSpd.Lost_Time*0.2);
  _Check_DTC_InNow_NotInNowAndHis(0x09,0,Struct_CarSpd.Lost_DTC);
  testWaitForTimeout(Struct_CarSpd.Lost_Time*1.2);
  _Check_DTC_InNow_NotInNowAndHis(0x09,Struct_CarSpd.Lost_DTC,0);
  _WriteEx_and_Report("","步骤3-4测试完成");
  _SetSession(defsession);
  testWaitForTimeout(500);
}


_Abnormal_NRC_1() /*10h-NRC13*/
{
  int i,len;
  byte data[2]={0x10,0x01};
  byte Send_Seed[2] = {0x27,0x00};
  byte Send_Data[10];
  len = _Get_Tx_Len();
  Send_Seed[1] = RequestSeed_27;
  testStep("步骤1","---------------------");
  _SetSession(exsession);
  testWaitForTimeout(500);
  _Send_Key(SendKey_Len+1,phyreq_ID,_get_seed(phyreq_ID),1);
  _TestResult(SendData,phyreq_ID,"",NRC13);
  for(i=1;i<=len;i++)
  {
    if(i==2)
      continue;
    _Send_Diag(i,phyreq_ID,data);
    _TestResult(SendData,phyreq_ID,"",NRC13);
    testWaitForTimeout(50);
  }
  
  testStep("步骤2","---------------------");
  _Set_11_Restoration();
  testWaitForTimeout(2000);
  _SetSession(exsession);
  _Send_Diag(7,phyreq_ID,Send_Seed);
  _TestResult(SendData,phyreq_ID,"",NRC13);
  for(i=1;i<=len;i++)
  {
    if(i==2)
      continue;
    _Send_Diag(i,phyreq_ID,data);
    _TestResult(SendData,phyreq_ID,"",NRC13);
    testWaitForTimeout(50);
  }
  
  testStep("步骤3","---------------------");
  _K30_OFF();
  testWaitForTimeout(1000);
  _K30_ON();
  testWaitForTimeout(2000);
  _get_Str_Traversal("DID_2E_Traversal");
  _unlockECU();
  _get_2E_DID(Traversal_DID[0]);
  _Send_Diag(DID_2E_SendData_1_Len+1,phyreq_ID,DID_2E_SendData_1);
  _TestResult(SendData,phyreq_ID,"",NRC13);
  for(i=1;i<=len;i++)
  {
    if(i==2)
      continue;
    _Send_Diag(i,phyreq_ID,data);
    _TestResult(SendData,phyreq_ID,"",NRC13);
    testWaitForTimeout(50);
  }
  
  testStep("步骤4","---------------------");
  _Power_Down();
  testWaitForTimeout(2000);
  _Power_Up();
  _unlockECU();
  _Get_31_ServeData(0,Send_Data,0);
//  _get_Arry("Angle_Calibration");
  _Send_Diag(Len_31H + 1,phyreq_ID,Send_Data);
  _TestResult(SendData,phyreq_ID,"",NRC13);
  for(i=1;i<=len;i++)
  {
    if(i==2)
      continue;
    _Send_Diag(i,phyreq_ID,data);
    _TestResult(SendData,phyreq_ID,"",NRC13);
    testWaitForTimeout(50);
  }
}

_Abnormal_NRC_2() /*11h-NRC13*/
{
  int i,len,Serve_Pos_1;
  byte data[2]={0x11,0x01};
  byte Send_Seed[2] = {0x27,0x00};
  byte Send_Data[10];
  len = _Get_Tx_Len();
  Send_Seed[1] = RequestSeed_27;
  Serve_Pos_1 = _Check_Serve(0x11,0,0);
  data[1] = Serve_Data[Serve_Pos_1].Serve_Fun[0];
  testStep("步骤1","---------------------");
  _SetSession(exsession);
  testWaitForTimeout(500);
  _Send_Key(SendKey_Len+1,phyreq_ID,_get_seed(phyreq_ID),1);
  _TestResult(SendData,phyreq_ID,"",NRC13);
  for(i=1;i<=len;i++)
  {
    if(i==2)
      continue;
    _Send_Diag(i,phyreq_ID,data);
    if( Serve_Data[Serve_Pos_1].Security_Access[0] == 1)
      _TestResult(SendData,phyreq_ID,"",NRC33);
    else
      _TestResult(SendData,phyreq_ID,"",NRC13);
    testWaitForTimeout(50);
  }
  
  testStep("步骤2","---------------------");
  _Set_11_Restoration();
  testWaitForTimeout(2000);
  _SetSession(exsession);
  _Send_Diag(7,phyreq_ID,Send_Seed);
  _TestResult(SendData,phyreq_ID,"",NRC13);
  for(i=1;i<=len;i++)
  {
    if(i==2)
      continue;
    _Send_Diag(i,phyreq_ID,data);
    if( Serve_Data[Serve_Pos_1].Security_Access[0] == 1)
      _TestResult(SendData,phyreq_ID,"",NRC33);
    else
      _TestResult(SendData,phyreq_ID,"",NRC13);
    testWaitForTimeout(50);
  }
  
  testStep("步骤3","---------------------");
  _K30_OFF();
  testWaitForTimeout(1000);
  _K30_ON();
  testWaitForTimeout(2000);
  _get_Str_Traversal("DID_2E_Traversal");
  _unlockECU();
  _get_2E_DID(Traversal_DID[0]);
  _Send_Diag(DID_2E_SendData_1_Len+1,phyreq_ID,DID_2E_SendData_1);
  _TestResult(SendData,phyreq_ID,"",NRC13);
  for(i=1;i<=len;i++)
  {
    if(i==2)
      continue;
    _Send_Diag(i,phyreq_ID,data);
    if( Serve_Data[Serve_Pos_1].Security_Access[0] == 1)
      _TestResult(SendData,phyreq_ID,"",NRC33);
    else
      _TestResult(SendData,phyreq_ID,"",NRC13);
    testWaitForTimeout(50);
  }
  
  testStep("步骤4","---------------------");
  _Power_Down();
  testWaitForTimeout(2000);
  _Power_Up();
  _unlockECU();
  _Get_31_ServeData(0,Send_Data,0);
  _Send_Diag(Len_31H + 1,phyreq_ID,Send_Data);
  _TestResult(SendData,phyreq_ID,"",NRC13);
  for(i=1;i<=len;i++)
  {
    if(i==2)
      continue;
    _Send_Diag(i,phyreq_ID,data);
    _TestResult(SendData,phyreq_ID,"",NRC13);
    testWaitForTimeout(50);
  }
}
_Abnormal_NRC_3() /*14h-NRC13*/
{
  int i,len;
  byte data[4]={0x14,0xff,0xff,0xff};
  byte Send_Seed[2] = {0x27,0x00};
  byte Send_Data[10];
  len = _Get_Tx_Len();
  Send_Seed[1] = RequestSeed_27;
  testStep("步骤1","---------------------");
  _SetSession(exsession);
  testWaitForTimeout(500);
  _Send_Key(SendKey_Len+1,phyreq_ID,_get_seed(phyreq_ID),1);
  _TestResult(SendData,phyreq_ID,"",NRC13);
  for(i=1;i<=len;i++)
  {
    if(i==4)
      continue;
    _Send_Diag(i,phyreq_ID,data);
    _TestResult(SendData,phyreq_ID,"",NRC13);
    testWaitForTimeout(50);
  }
  
  testStep("步骤2","---------------------");
  _Set_11_Restoration();
  testWaitForTimeout(2000);
  _SetSession(exsession);
  _Send_Diag(7,phyreq_ID,Send_Seed);
  _TestResult(SendData,phyreq_ID,"",NRC13);
  for(i=1;i<=len;i++)
  {
    if(i==4)
      continue;
    _Send_Diag(i,phyreq_ID,data);
    _TestResult(SendData,phyreq_ID,"",NRC13);
    testWaitForTimeout(50);
  }
  
  testStep("步骤3","---------------------");
  _K30_OFF();
  testWaitForTimeout(1000);
  _K30_ON();
  testWaitForTimeout(2000);
  _get_Str_Traversal("DID_2E_Traversal");
  _unlockECU();
  _get_2E_DID(Traversal_DID[0]);
  _Send_Diag(DID_2E_SendData_1_Len+1,phyreq_ID,DID_2E_SendData_1);
  _TestResult(SendData,phyreq_ID,"",NRC13);
  for(i=1;i<=len;i++)
  {
    if(i==4)
      continue;
    _Send_Diag(i,phyreq_ID,data);
    _TestResult(SendData,phyreq_ID,"",NRC13);
    testWaitForTimeout(50);
  }
  
  testStep("步骤4","---------------------");
  _Power_Down();
  testWaitForTimeout(2000);
  _Power_Up();
  _unlockECU();
  _Get_31_ServeData(0,Send_Data,0);
  _Send_Diag(Len_31H + 1,phyreq_ID,Send_Data);
  _TestResult(SendData,phyreq_ID,"",NRC13);
  for(i=1;i<=len;i++)
  {
    if(i==4)
      continue;
    _Send_Diag(i,phyreq_ID,data);
    _TestResult(SendData,phyreq_ID,"",NRC13);
    testWaitForTimeout(50);
  }
}
_Abnormal_NRC_4() /*19h-NRC13*/
{
  int i,len,Count,Pos,j;
  byte data[10];
  byte Send_Seed[2] = {0x27,0x00};
  byte Send_Data[10];
  byte Data_Support_Len[100][2];
  
  Pos = _Check_Serve(0x19,0,0);
  Count = 0;
  for(i=0;i<Serve_Data[Pos].Serve_Fun_Count;i++)
  {
    if(_Check_Dword_in_Num(Serve_Data[Pos].Serve_Fun_Len[i],Data_Support_Len,Count) == -1)
    {
      Data_Support_Len[Count][0] = Serve_Data[Pos].Serve_Fun_Len[i];
      Data_Support_Len[Count][1] = Serve_Data[Pos].Serve_Fun[i];
      Count++;
    }
  } //长度+子功能
  data[0] = 0x19;
  len = _Get_Tx_Len();
  Send_Seed[1] = RequestSeed_27;
  testStep("步骤1","---------------------");
  _SetSession(exsession);
  testWaitForTimeout(500);
  _Send_Key(SendKey_Len+1,phyreq_ID,_get_seed(phyreq_ID),1);
  _TestResult(SendData,phyreq_ID,"",NRC13);
  for(j=0;j<Count;j++)
  {
    data[1] = Data_Support_Len[j][1];
    if(Data_Support_Len[j][0] == 3)
    {
      data[1] = 0x02;
      data[2] = 0x01;
      data[3] = 0;data[4] = 0;data[5] = 0;
    }
    else if(Data_Support_Len[j][0] == 2)
    {
      data[1] = 0x0A;data[2] = 0;
      data[3] = 0;data[4] = 0;data[5] = 0;
    }
    else if(Data_Support_Len[j][0] == 6)
    {
      int Pos_1904;
      data[2] = 0;
      data[3] = 0;data[4] = 0;data[5] = 0xFF;
      
      Pos_1904 = Get_Node_Pos(Node_1904,1);
      data[2] = (DTC_19[Pos_1904][1]>>16);
      data[3] = (DTC_19[Pos_1904][1]>>8);
      data[4] = (DTC_19[Pos_1904][1]&0xFF);
    }
    for(i=1;i<=len;i++)
    {
      if(i==Data_Support_Len[j][0])
        continue;
      _Send_Diag(i,phyreq_ID,data);
      _TestResult(SendData,phyreq_ID,"",NRC13);
      testWaitForTimeout(50);
    }
  }
  
  testStep("步骤2","---------------------");
  _Set_11_Restoration();
  testWaitForTimeout(2000);
  _SetSession(exsession);
  _Send_Diag(7,phyreq_ID,Send_Seed);
  _TestResult(SendData,phyreq_ID,"",NRC13);

  for(j=0;j<Count;j++)
  {
    data[1] = Data_Support_Len[j][1];
    if(Data_Support_Len[j][0] == 3)
    {
      data[1] = 0x02;
      data[2] = 0x01;
      data[3] = 0;data[4] = 0;data[5] = 0;
    }
    else if(Data_Support_Len[j][0] == 2)
    {
      data[1] = 0x0A;data[2] = 0;
      data[3] = 0;data[4] = 0;data[5] = 0;
    }
    else if(Data_Support_Len[j][0] == 6)
    {
      int Pos_1904;
      data[2] = 0;
      data[3] = 0;data[4] = 0;data[5] = 0xFF;
      
      Pos_1904 = Get_Node_Pos(Node_1904,1);
      data[2] = (DTC_19[Pos_1904][1]>>16);
      data[3] = (DTC_19[Pos_1904][1]>>8);
      data[4] = (DTC_19[Pos_1904][1]&0xFF);
    }
    for(i=1;i<=len;i++)
    {
      if(i==Data_Support_Len[j][0])
        continue;
      _Send_Diag(i,phyreq_ID,data);
      _TestResult(SendData,phyreq_ID,"",NRC13);
      testWaitForTimeout(50);
    }
  }
  
  testStep("步骤3","---------------------");
  _K30_OFF();
  testWaitForTimeout(1000);
  _K30_ON();
  testWaitForTimeout(2000);
  _get_Str_Traversal("DID_2E_Traversal");
  _unlockECU();
  _get_2E_DID(Traversal_DID[0]);
  _Send_Diag(DID_2E_SendData_1_Len+1,phyreq_ID,DID_2E_SendData_1);
  _TestResult(SendData,phyreq_ID,"",NRC13);

  for(j=0;j<Count;j++)
  {
    data[1] = Data_Support_Len[j][1];
    if(Data_Support_Len[j][0] == 3)
    {
      data[1] = 0x02;
      data[2] = 0x01;
      data[3] = 0;data[4] = 0;data[5] = 0;
    }
    else if(Data_Support_Len[j][0] == 2)
    {
      data[1] = 0x0A;data[2] = 0;
      data[3] = 0;data[4] = 0;data[5] = 0;
    }
    else if(Data_Support_Len[j][0] == 6)
    {
      int Pos_1904;
      data[2] = 0;
      data[3] = 0;data[4] = 0;data[5] = 0xFF;
      
      Pos_1904 = Get_Node_Pos(Node_1904,1);
      data[2] = (DTC_19[Pos_1904][1]>>16);
      data[3] = (DTC_19[Pos_1904][1]>>8);
      data[4] = (DTC_19[Pos_1904][1]&0xFF);
    }
    for(i=1;i<=len;i++)
    {
      if(i==Data_Support_Len[j][0])
        continue;
      _Send_Diag(i,phyreq_ID,data);
      _TestResult(SendData,phyreq_ID,"",NRC13);
      testWaitForTimeout(50);
    }
  }
  
  testStep("步骤4","---------------------");
  _Power_Down();
  testWaitForTimeout(2000);
  _Power_Up();
  _unlockECU();
  _Get_31_ServeData(0,Send_Data,0);
  _Send_Diag(Len_31H + 1,phyreq_ID,Send_Data);
  _TestResult(SendData,phyreq_ID,"",NRC13);

  for(j=0;j<Count;j++)
  {
    data[1] = Data_Support_Len[j][1];
    if(Data_Support_Len[j][0] == 3)
    {
      data[1] = 0x02;
      data[2] = 0x01;
      data[3] = 0;data[4] = 0;data[5] = 0;
    }
    else if(Data_Support_Len[j][0] == 2)
    {
      data[1] = 0x0A;data[2] = 0;
      data[3] = 0;data[4] = 0;data[5] = 0;
    }
    else if(Data_Support_Len[j][0] == 6)
    {
      int Pos_1904;
      data[2] = 0;
      data[3] = 0;data[4] = 0;data[5] = 0xFF;
      
      Pos_1904 = Get_Node_Pos(Node_1904,1);
      data[2] = (DTC_19[Pos_1904][1]>>16);
      data[3] = (DTC_19[Pos_1904][1]>>8);
      data[4] = (DTC_19[Pos_1904][1]&0xFF);
    }
    for(i=1;i<=len;i++)
    {
      if(i==Data_Support_Len[j][0])
        continue;
      _Send_Diag(i,phyreq_ID,data);
      _TestResult(SendData,phyreq_ID,"",NRC13);
      testWaitForTimeout(50);
    }
  }
}

_Abnormal_NRC_5() /*22h-NRC13*/
{
  byte Send_Seed[2] = {0x27,0x00};
  byte Send_Data[10];
  Send_Seed[1] = RequestSeed_27;
  
  testStep("步骤1","---------------------");
  _SetSession(exsession);
  testWaitForTimeout(500);
  _Send_Key(SendKey_Len+1,phyreq_ID,_get_seed(phyreq_ID),1);
  _TestResult(SendData,phyreq_ID,"",NRC13);
  _Serve22_04(phyreq_ID,defsession);
  
  testStep("步骤2","---------------------");
  _Set_11_Restoration();
  _SetSession(exsession);
  
  _Send_Diag(7,phyreq_ID,Send_Seed);
  _TestResult(SendData,phyreq_ID,"",NRC13);
  
  _Serve22_04(phyreq_ID,defsession);
  
  testStep("步骤3","---------------------");
  _K30_OFF();
  testWaitForTimeout(1000);
  _K30_ON();
  testWaitForTimeout(2000);
  _get_Str_Traversal("DID_2E_Traversal");
  _unlockECU();
  _get_2E_DID(Traversal_DID[0]);
  _Send_Diag(DID_2E_SendData_1_Len+1,phyreq_ID,DID_2E_SendData_1);
  _TestResult(SendData,phyreq_ID,"",NRC13);
  _Serve22_04(phyreq_ID,defsession);
  
  testStep("步骤4","---------------------");
  _Power_Down();
  testWaitForTimeout(2000);
  _Power_Up();
  _unlockECU();
  _Get_31_ServeData(0,Send_Data,0);
  _Send_Diag(Len_31H + 1,phyreq_ID,Send_Data);
  _TestResult(SendData,phyreq_ID,"",NRC13);
  _Serve22_04(phyreq_ID,defsession);
}

_Abnormal_NRC_6() /*2Eh-NRC13*/
{
  int i,len;
  byte Send_Seed[2] = {0x27,0x00};
  byte Send_Data[10];
  Send_Seed[1] = RequestSeed_27;
  _get_Str_Traversal("DID_2E_Traversal");
  if(Traversal_Count>0)
    _get_2E_DID(Traversal_DID[0]);
  else
     _get_2E_DID("DID2E_Rx_NRC33");
  
  if(DID_2E_SendData_1_Len < 7)
    len = 7;
  else
    len =DID_2E_SendData_1_Len+1;
  testStep("步骤1","---------------------");
  _SetSession(exsession);
  testWaitForTimeout(500);
  _Send_Key(SendKey_Len+1,phyreq_ID,_get_seed(phyreq_ID),1);
  _TestResult(SendData,phyreq_ID,"",NRC13);
  _unlockECU();/*防止出现NRC33*/
  for(i=1;i<=len;i++)
  {
    if(i==DID_2E_SendData_1_Len)
      continue;
    _Send_Diag(i,phyreq_ID,DID_2E_SendData_1);
    if(Geely3_Flage == 1 && i>=4)
      _TestResult(SendData,phyreq_ID,"",0x31);
    else
      _TestResult(SendData,phyreq_ID,"",0x13);
    testWaitForTimeout(50);
  }
  
  testStep("步骤2","---------------------");
  _Set_11_Restoration();
  
  _SetSession(exsession);
  _Send_Diag(7,phyreq_ID,Send_Seed);
  _TestResult(SendData,phyreq_ID,"",NRC13);
  _unlockECU();
  for(i=1;i<=len;i++)
  {
    if(i==DID_2E_SendData_1_Len)
      continue;
    _Send_Diag(i,phyreq_ID,DID_2E_SendData_1);
    if(Geely3_Flage == 1 && i>=4)
      _TestResult(SendData,phyreq_ID,"",0x31);
    else
      _TestResult(SendData,phyreq_ID,"",0x13);
    testWaitForTimeout(50);
  }
  
  testStep("步骤3","---------------------");
  _K30_OFF();
  testWaitForTimeout(1000);
  _K30_ON();
  testWaitForTimeout(2000); 
  _unlockECU();
  _get_2E_DID(Traversal_DID[0]);
  _Send_Diag(DID_2E_SendData_1_Len+1,phyreq_ID,DID_2E_SendData_1);
  _TestResult(SendData,phyreq_ID,"",NRC13);
  
  for(i=1;i<=len;i++)
  {
    if(i==DID_2E_SendData_1_Len)
      continue;
    _Send_Diag(i,phyreq_ID,DID_2E_SendData_1);
    if(Geely3_Flage == 1 && i>=4)
      _TestResult(SendData,phyreq_ID,"",0x31);
    else
      _TestResult(SendData,phyreq_ID,"",0x13);
    testWaitForTimeout(50);
  }
  
  testStep("步骤4","---------------------");
  _Power_Down();
  testWaitForTimeout(2000);
  _Power_Up();
  _unlockECU();
  _Get_31_ServeData(0,Send_Data,0);
//  _get_Arry("Angle_Calibration");
  _Send_Diag(Len_31H + 1,phyreq_ID,Send_Data);
  _TestResult(SendData,phyreq_ID,"",NRC13);
  for(i=1;i<=len;i++)
  {
    if(i==DID_2E_SendData_1_Len)
      continue;
    _Send_Diag(i,phyreq_ID,DID_2E_SendData_1);
    if(Geely3_Flage == 1 && i>=4)
      _TestResult(SendData,phyreq_ID,"",0x31);
    else
      _TestResult(SendData,phyreq_ID,"",0x13);
    testWaitForTimeout(50);
  }
}

_Abnormal_NRC_7() /*27h-NRC13*/
{
  byte Send_Seed[2] = {0x27,0x00};
  byte Send_Data[10];
  Send_Seed[1] = RequestSeed_27;
  testStep("步骤1","---------------------");
  _SetSession(exsession);
  testWaitForTimeout(500);
  _Send_Key(SendKey_Len+1,phyreq_ID,_get_seed(phyreq_ID),1);
  _TestResult(SendData,phyreq_ID,"",NRC13);
  _27_Serve_22(phyreq_ID,exsession);
  testStep("步骤2","---------------------");
  _Set_11_Restoration();
  _SetSession(exsession);
  _Send_Diag(SendKey_Len+1,phyreq_ID,Send_Seed);
  _TestResult(SendData,phyreq_ID,"",NRC13);
  
  _27_Serve_22(phyreq_ID,exsession);
  testStep("步骤3","---------------------");
  _K30_OFF();
  testWaitForTimeout(1000);
  _K30_ON();
  testWaitForTimeout(2000);
  _get_Str_Traversal("DID_2E_Traversal");
  _unlockECU();
  _get_2E_DID(Traversal_DID[0]);
  _Send_Diag(DID_2E_SendData_1_Len+1,phyreq_ID,DID_2E_SendData_1);
  _TestResult(SendData,phyreq_ID,"",NRC13);
  _SetSession(exsession);
  _27_Serve_22(phyreq_ID,exsession);
  testStep("步骤4","---------------------");
  _Power_Down();
  testWaitForTimeout(2000);
  _Power_Up();
  _unlockECU();
  _Get_31_ServeData(0,Send_Data,0);
//  _get_Arry("Angle_Calibration");
  _Send_Diag(Len_31H + 1,phyreq_ID,Send_Data);
  _TestResult(SendData,phyreq_ID,"",NRC13);
  _27_Serve_22(phyreq_ID,exsession);
}
_Abnormal_NRC_8() /*28h-NRC13*/
{
  byte Send_Seed[2] = {0x27,0x00};
  byte Send_Data[10];
  Send_Seed[1] = RequestSeed_27;
  testStep("步骤1","---------------------");
  _SetSession(exsession);
  testWaitForTimeout(500);
  _Send_Key(SendKey_Len+1,phyreq_ID,_get_seed(phyreq_ID),1);
  _TestResult(SendData,phyreq_ID,"",NRC13);
  _28_Serve_10(phyreq_ID,defsession);
  
  testStep("步骤2","---------------------");
  _Set_11_Restoration();
  _SetSession(exsession);
  _Send_Diag(7,phyreq_ID,Send_Seed);
  _TestResult(SendData,phyreq_ID,"",NRC13);
  _28_Serve_10(phyreq_ID,defsession);
  
  testStep("步骤3","---------------------");
  _K30_OFF();
  testWaitForTimeout(1000);
  _K30_ON();
  testWaitForTimeout(2000);
  _get_Str_Traversal("DID_2E_Traversal");
  _unlockECU();
  _get_2E_DID(Traversal_DID[0]);
  _Send_Diag(DID_2E_SendData_1_Len+1,phyreq_ID,DID_2E_SendData_1);
  _TestResult(SendData,phyreq_ID,"",NRC13);
  
  _28_Serve_10(phyreq_ID,defsession);
  
  testStep("步骤4","---------------------");
  _Power_Down();
  testWaitForTimeout(2000);
  _Power_Up();
  _unlockECU();
  _Get_31_ServeData(0,Send_Data,0);
//  _get_Arry("Angle_Calibration");
  _Send_Diag(Len_31H + 1,phyreq_ID,Send_Data);
  _TestResult(SendData,phyreq_ID,"",NRC13);
  _28_Serve_10(phyreq_ID,defsession);
}
_Abnormal_NRC_9() /*31h-NRC13*/
{
  int i,len,Pos,Count,j;
  byte Send_Data[60];
  byte Send_Seed[2] = {0x27,0x00};
  byte Send_Data_1[10];
  byte Data_Support_Len[10];
  byte Data_Support[10][10];
  
  Send_Seed[1] = RequestSeed_27;
  len = _Check_CANFD_Flage();
  _Get_31_ServeData(0,Send_Data,0);
  testStep("步骤1","---------------------");
  _SetSession(exsession);
  testWaitForTimeout(500);
  _Send_Key(SendKey_Len+1,phyreq_ID,_get_seed(phyreq_ID),1);
  _TestResult(SendData,phyreq_ID,"",NRC13);
  _unlockECU();
  
  Count = 0;
  for(i=0;i<Serve_31_Hex_Count;i++)
  {
    if(_Check_Dword_in_Num(Serve_31_Hex[i].Routine_Len,Data_Support_Len,Count) == -1)
    {
      Data_Support[Count][0] = 0x31;
      Data_Support[Count][1] = Serve_31_Hex[i].Control_Type[0];
      Data_Support[Count][2] = Serve_31_Hex[i].Routine[0];
      Data_Support[Count][3] = Serve_31_Hex[i].Routine[1];
      if(Serve_31_Hex[i].Control_Option_Count[0] != 0)
        Data_Support[Count][4] = Serve_31_Hex[i].Control_Option[0][0];
      Data_Support_Len[Count] = Serve_31_Hex[i].Routine_Len;
      Count++;
    }
  } //长度+子功能
  for(j=0;j<Count;j++)
  {
    for(i=0;i<10;i++)
      Send_Data[i] = Data_Support[j][i];
    for(i=1;i<=len;i++)
    {
      if(i==Data_Support_Len[j])
        continue;
      _Send_Diag(i,phyreq_ID,Send_Data);
      _TestResult(SendData,phyreq_ID,"",NRC13);
      testWaitForTimeout(50);
    }
  }
  
  testStep("步骤2","---------------------");
  _Set_11_Restoration();
  _SetSession(exsession);
  _Send_Diag(7,phyreq_ID,Send_Seed);
  _TestResult(SendData,phyreq_ID,"",NRC13);
  _unlockECU();
  for(j=0;j<Count;j++)
  {
    for(i=0;i<10;i++)
      Send_Data[i] = Data_Support[j][i];
    for(i=1;i<=len;i++)
    {
      if(i==Data_Support_Len[j])
        continue;
      _Send_Diag(i,phyreq_ID,Send_Data);
      _TestResult(SendData,phyreq_ID,"",NRC13);
      testWaitForTimeout(50);
    }
  }
  
  testStep("步骤3","---------------------");
  _K30_OFF();
  testWaitForTimeout(1000);
  _K30_ON();
  testWaitForTimeout(2000);
  _get_Str_Traversal("DID_2E_Traversal");
  _unlockECU();
  _get_2E_DID(Traversal_DID[0]);
  _Send_Diag(DID_2E_SendData_1_Len+1,phyreq_ID,DID_2E_SendData_1);
  _TestResult(SendData,phyreq_ID,"",NRC13);
  _unlockECU();
  for(j=0;j<Count;j++)
  {
    for(i=0;i<10;i++)
      Send_Data[i] = Data_Support[j][i];
    for(i=1;i<=len;i++)
    {
      if(i==Data_Support_Len[j])
        continue;
      _Send_Diag(i,phyreq_ID,Send_Data);
      _TestResult(SendData,phyreq_ID,"",NRC13);
      testWaitForTimeout(50);
    }
  }
  
  testStep("步骤4","---------------------");
  _Power_Down();
  testWaitForTimeout(2000);
  _Power_Up();
  _unlockECU();
  _Get_31_ServeData(1,Send_Data,0);
//  _get_Arry("Angle_Calibration");
  _Send_Diag(Len_31H + 1,phyreq_ID,Send_Data);
  _TestResult(SendData,phyreq_ID,"",NRC13);
  _Get_31_ServeData(0,Send_Data,0);
  for(j=0;j<Count;j++)
  {
    for(i=0;i<10;i++)
      Send_Data[i] = Data_Support[j][i];
    for(i=1;i<=len;i++)
    {
      if(i==Data_Support_Len[j])
        continue;
      _Send_Diag(i,phyreq_ID,Send_Data);
      _TestResult(SendData,phyreq_ID,"",NRC13);
      testWaitForTimeout(50);
    }
  }
}
_Abnormal_NRC_10() /*3Eh-NRC13*/
{
  int i,len;
  byte data[2]={0x3E,0x80};
  byte Send_Seed[2] = {0x27,0x00};
  byte Send_Data[10];
  Send_Seed[1] = RequestSeed_27;
  len = _Check_CANFD_Flage();
  testStep("步骤1","---------------------");
  _SetSession(exsession);
  testWaitForTimeout(500);
  _Send_Key(SendKey_Len+1,phyreq_ID,_get_seed(phyreq_ID),1);
  _TestResult(SendData,phyreq_ID,"",NRC13);
  for(i=1;i<=len;i++)
  {
    if(i==2)
      continue;
    _Send_Diag(i,phyreq_ID,data);
    _TestResult(SendData,phyreq_ID,"",NRC13);
    testWaitForTimeout(50);
  }
  
  testStep("步骤2","---------------------");
  _Set_11_Restoration();
  _SetSession(exsession);
  _Send_Diag(7,phyreq_ID,Send_Seed);
  _TestResult(SendData,phyreq_ID,"",NRC13);
  for(i=1;i<=len;i++)
  {
    if(i==2)
      continue;
    _Send_Diag(i,phyreq_ID,data);
    _TestResult(SendData,phyreq_ID,"",NRC13);
    testWaitForTimeout(50);
  }
  
  testStep("步骤3","---------------------");
  _K30_OFF();
  testWaitForTimeout(1000);
  _K30_ON();
  testWaitForTimeout(2000);
  _get_Str_Traversal("DID_2E_Traversal");
  _unlockECU();
  _get_2E_DID(Traversal_DID[0]);
  _Send_Diag(DID_2E_SendData_1_Len+1,phyreq_ID,DID_2E_SendData_1);
  _TestResult(SendData,phyreq_ID,"",NRC13);
  for(i=1;i<=len;i++)
  {
    if(i==2)
      continue;
    _Send_Diag(i,phyreq_ID,data);
    _TestResult(SendData,phyreq_ID,"",NRC13);
    testWaitForTimeout(50);
  }
  
  testStep("步骤4","---------------------");
  _Power_Down();
  testWaitForTimeout(2000);
  _Power_Up();
  _unlockECU();
  _Get_31_ServeData(0,Send_Data,0);
//  _get_Arry("Angle_Calibration");
  _Send_Diag(Len_31H + 1,phyreq_ID,Send_Data);
  _TestResult(SendData,phyreq_ID,"",NRC13);
  for(i=1;i<=len;i++)
  {
    if(i==2)
      continue;
    _Send_Diag(i,phyreq_ID,data);
    _TestResult(SendData,phyreq_ID,"",NRC13);
    testWaitForTimeout(50);
  }
}
_Abnormal_NRC_11() /*85h-NRC13*/
{
  int i,len;
  byte data[2]={0x85,0x01};
  byte Send_Seed[2] = {0x27,0x00};
  byte Send_Data[10];
  Send_Seed[1] = RequestSeed_27;
  len = _Check_CANFD_Flage();
  StepByGeely3_0(0x85,Close);
  testStep("步骤1","---------------------");
  _SetSession(exsession);
  testWaitForTimeout(500);
  _Send_Key(SendKey_Len+1,phyreq_ID,_get_seed(phyreq_ID),1);
  _TestResult(SendData,phyreq_ID,"",NRC13);
  for(i=1;i<=len;i++)
  {
    if(i==2)
      continue;
    _Send_Diag(i,phyreq_ID,data);
    _TestResult(SendData,phyreq_ID,"",NRC13);
    testWaitForTimeout(50);
  }
  
  testStep("步骤2","---------------------");
  _Set_11_Restoration();
  _SetSession(exsession);
  _Send_Diag(7,phyreq_ID,Send_Seed);
  _TestResult(SendData,phyreq_ID,"",NRC13);
  for(i=1;i<=len;i++)
  {
    if(i==2)
      continue;
    _Send_Diag(i,phyreq_ID,data);
    _TestResult(SendData,phyreq_ID,"",NRC13);
    testWaitForTimeout(50);
  }
  
  testStep("步骤3","---------------------");
  _K30_OFF();
  testWaitForTimeout(1000);
  _K30_ON();
  testWaitForTimeout(2000);
  _get_Str_Traversal("DID_2E_Traversal");
  _unlockECU();
  _get_2E_DID(Traversal_DID[0]);
  _Send_Diag(DID_2E_SendData_1_Len+1,phyreq_ID,DID_2E_SendData_1);
  _TestResult(SendData,phyreq_ID,"",NRC13);
  for(i=1;i<=len;i++)
  {
    if(i==2)
      continue;
    _Send_Diag(i,phyreq_ID,data);
    _TestResult(SendData,phyreq_ID,"",NRC13);
    testWaitForTimeout(50);
  }
  
  testStep("步骤4","---------------------");
  _Power_Down();
  testWaitForTimeout(2000);
  _Power_Up();
  _unlockECU();
  _Get_31_ServeData(0,Send_Data,0);
//  _get_Arry("Angle_Calibration");
  _Send_Diag(Len_31H + 1,phyreq_ID,Send_Data);
  _TestResult(SendData,phyreq_ID,"",NRC13);
  for(i=1;i<=len;i++)
  {
    if(i==2)
      continue;
    _Send_Diag(i,phyreq_ID,data);
    _TestResult(SendData,phyreq_ID,"",NRC13);
    testWaitForTimeout(50);
  }
}
_Not_Support_Fun(dword ID,dword session)
{
  int i;
  byte data_[1]={0x01};
  _Power_Down();
  testWaitForTimeout(2000);
  _Power_Up();
  if(session == exsession)
  {
    _SetSession(exsession);
    testWaitForTimeout(200);
  }
  if(strncmp(ECU_project,"BYD",strlen(ECU_project)) == 0 && strlen(ECU_project) == strlen("BYD"))
  {
    for(i=0;i<=0xFF;i++)
    {
      if(i==0x10 || i==0x11 || i==0x14 || i==0x19 || i==0x22 || i==0x27 || i==0x28 || i==0x2e || i==0x31 || i==0x3e || i==0x85 || i==0x34 || i==0x36 || i==0x37)
        continue;
      data_[0] = i;
      _Send_Diag_NoTime(1,ID,data_);
      _get_NRC11(ID);
      testWaitForTimeout(200);
    }
  }
  else
  {
    for(i=0;i<=0xFF;i++)
    {
      if(_Check_Serve(i,0,0) != -1 || i== 0x31)
        continue;
      data_[0] = i;
      _Send_Diag_NoTime(1,ID,data_);
      _get_NRC11(ID);
      testWaitForTimeout(200);
    }
  }
}

_High_BUS_loader_H_1(byte type,dword Time)/*对中*//*0:干扰报文优先级高于发送ID，1:干扰报文优先级低于发送ID*/
{
  byte data[4] = {0x14,0xff,0xff,0xff};
  dword Seed;
  int x;
  diagSetTarget(Cdd_Name);
  _get_Arry("Angle_Calibration");
  Time_Count_Time = 20*60*1000;
  setTimer(Time_Count,Time_Count_Time);
  if(type==0 )
    setTimer(CAN_BUS_loader_H,8);
  else 
    setTimer(CAN_BUS_loader_L,8);
  testWaitForTimeout(10000);
  do{
    _WriteEx_and_Report("","/*------------第 %d 次测试------------*/",x);
    _SetSession(defsession,Time);
    testWaitForTimeout(50);
    _SetSession(exsession,Time);
    testWaitForTimeout(50);
    Seed = _get_seed(phyreq_ID,Time);
    Get_Seed_Flage = 1;
    testWaitForTimeout(50);
    _Send_Key(SendKey_Len,phyreq_ID,Seed,0);
    if(diagGetLastResponseCode(SendData) == 0)
      testWaitForDiagResponse(SendData,Time);
    _TestResult(SendData,phyreq_ID,"",-1);
    Get_Seed_Flage = 1;
    testWaitForTimeout(50);
    _Send_Diag(Arry_Len,phyreq_ID,Arry_Data,Time);
    _Check_31Routine_Rx(Arry_Data,1);
    testWaitForTimeout(100);
    _Send_Diag(4,phyreq_ID,data);
    if(diagGetLastResponseCode(SendData) == 0)
      testWaitForDiagResponse(SendData,Time);
    _TestResult(SendData,phyreq_ID,"",-1);
    testWaitForTimeout(100);
    _Set_11_Restoration(Time,0);
    
    testWaitForTimeout(CAN_Init_Time-Wait_Time_11+500);
    _85_Check_DTC(1,0);
    x++;
//    ChkCreate_ErrorFramesOccured(0,0,500);
  }while(Time_Flage==0);
  
  if(type==0 )
    cancelTimer(CAN_BUS_loader_H);
  else 
    cancelTimer(CAN_BUS_loader_L);
  cancelTimer(Time_Count);
}
_High_BUS_loader_H_2(byte type,dword Time)/*写DID*//*0:干扰报文优先级高于发送ID，1:干扰报文优先级低于发送ID*/
{
  int i,x;
  dword Seed;
  diagSetTarget(Cdd_Name);
  _get_Str_Traversal("DID_2E_Traversal");
  _get_2E_DID(Traversal_DID[0]);
  if(strncmp(ECU_project,"BYD",strlen(ECU_project)) == 0 && strlen(ECU_project) == strlen("BYD"))
  {
    if((DID_2E_SendData_1[0] == 0x2E) && ((DID_2E_SendData_1[1] == 0xF1 && DID_2E_SendData_1[2] == 0xA1) || (DID_2E_SendData_1[1] == 0x21 && DID_2E_SendData_1[1] == 0x00)))
    {
      _Clear_BYD_Config_(0);
      _SetSession(defsession);
      _WriteEx_and_Report("","当前写入为BYD配置字，未防止返回NRC22故写入值为全0");
      DID_2E_SendData_1[1] = 0xF1;
      DID_2E_SendData_1[2] = 0xA1;
      for(i=3;i<DID_2E_SendData_1_Len;i++)
      {
        DID_2E_SendData_1[i] = 0x00;
      }
      DID_2E_SendData_1[DID_2E_SendData_1_Len-1] = 0x55;
      _get_2E_DID(Traversal_DID[0]);
    }
  }
  Time_Count_Time = 20*60*1000;
  setTimer(Time_Count,Time_Count_Time);  
  if(type==0 )
    setTimer(CAN_BUS_loader_H,8);
  else 
    setTimer(CAN_BUS_loader_L,8);
  testWaitForTimeout(10000);
  do{
    _WriteEx_and_Report("","/*------------第 %d 次测试------------*/",x);
    _SetSession(exsession,Time);
    Seed = _get_seed(phyreq_ID,Time);
    testWaitForTimeout(50);
    _Send_Key(SendKey_Len,phyreq_ID,Seed,0);
    Get_Seed_Flage = 1;
    testWaitForTimeout(50);
    _Send_Diag(DID_2E_SendData_1_Len,phyreq_ID,DID_2E_SendData_1,Time);
    _TestResult(SendData,phyreq_ID,"",DID_2E_SendData_1_Response);
    testWaitForTimeout(100);
    if(DID_2E_SendData_1_Response == -1 && Support_Read_2E_DID == 1)
    {
      _Send_Diag(Read_2E_DID_Len,phyreq_ID,Read_2E_DID,Time);
      _Check_Response_2E(SendData,DID_2E_SendData_1_Len,DID_2E_SendData_1);
    }
    else
      _WriteEx_and_Report("","期望结果为非正响应,不检测写入数据");
    testWaitForTimeout(100);
    
    _Send_Diag(DID_2E_SendData_2_Len,phyreq_ID,DID_2E_SendData_2,Time);
    _TestResult(SendData,phyreq_ID,"",DID_2E_SendData_2_Response);
    testWaitForTimeout(100);
    if(DID_2E_SendData_2_Response == -1 && Support_Read_2E_DID == 1)
    {
      _Send_Diag(Read_2E_DID_Len,phyreq_ID,Read_2E_DID,Time);
      _Check_Response_2E(SendData,DID_2E_SendData_2_Len,DID_2E_SendData_2);
    }
    else
      _WriteEx_and_Report("","期望结果为非正响应,不检测写入数据");
    testWaitForTimeout(100);
    _Set_11_Restoration(Time,0);
    if(DID_2E_SendData_2_Response == -1 && Support_Read_2E_DID == 1)
    {
      _Send_Diag(Read_2E_DID_Len,phyreq_ID,Read_2E_DID,Time);
      _Check_Response_2E(SendData,DID_2E_SendData_2_Len,DID_2E_SendData_2);
    }
    x++;
  }while(Time_Flage==0);
  
  if(type==0 )
    cancelTimer(CAN_BUS_loader_H);
  else 
    cancelTimer(CAN_BUS_loader_L);
  cancelTimer(Time_Count);
}
_High_BUS_loader_H_3(byte type,dword Time)/*写DID_对中*//*0:干扰报文优先级高于发送ID，1:干扰报文优先级低于发送ID*/
{
  int i,x;
  dword Seed;
  byte data[4] = {0x14,0xff,0xff,0xff};
  Time_Count_Time = 20*60*1000;
  diagSetTarget(Cdd_Name);
  _get_Str_Traversal("DID_2E_Traversal");
  _get_2E_DID(Traversal_DID[0]);
  if(strncmp(ECU_project,"BYD",strlen(ECU_project)) == 0 && strlen(ECU_project) == strlen("BYD"))
  {
    if(AES_128 == 2)
      
    if((DID_2E_SendData_1[0] == 0x2E) && ((DID_2E_SendData_1[1] == 0xF1 && DID_2E_SendData_1[2] == 0xA1) || (DID_2E_SendData_1[1] == 0x21 && DID_2E_SendData_1[1] == 0x00)))
    {
      _Clear_BYD_Config_(0);
      _SetSession(defsession);
      _WriteEx_and_Report("","当前写入为BYD配置字，未防止返回NRC22故写入值为全0");
      DID_2E_SendData_1[1] = 0xF1;
      DID_2E_SendData_1[2] = 0xA1;
      for(i=3;i<DID_2E_SendData_1_Len;i++)
      {
        DID_2E_SendData_1[i] = 0x00;
      }
      DID_2E_SendData_1[DID_2E_SendData_1_Len-1] = 0x55;
      _get_2E_DID(Traversal_DID[0]);
    }
  }
  _get_Arry("Angle_Calibration");
  setTimer(Time_Count,Time_Count_Time);  
  if(type==0 )
    setTimer(CAN_BUS_loader_H,8);
  else 
    setTimer(CAN_BUS_loader_L,8);
  testWaitForTimeout(10000);
  x = 1;
  do{
    _WriteEx_and_Report("","/*------------第 %d 次测试------------*/",x);
    _SetSession(exsession,Time);
    testWaitForTimeout(50);
    Seed = _get_seed(phyreq_ID,Time);
    testWaitForTimeout(50);
    _Send_Key(SendKey_Len,phyreq_ID,Seed,0);
    Get_Seed_Flage = 1;
    testWaitForTimeout(50);
    _Send_Diag(DID_2E_SendData_1_Len,phyreq_ID,DID_2E_SendData_1,Time);
    _TestResult(SendData,phyreq_ID,"",DID_2E_SendData_1_Response);
    testWaitForTimeout(100);
    if(DID_2E_SendData_1_Response == -1 && Support_Read_2E_DID == 1)
    {
      _Send_Diag(Read_2E_DID_Len,phyreq_ID,Read_2E_DID,Time);
      _Check_Response_2E(SendData,DID_2E_SendData_1_Len,DID_2E_SendData_1);
    }
    else
      _WriteEx_and_Report("","期望结果为非正响应,不检测写入数据");
    testWaitForTimeout(100);
    
    _Send_Diag(Arry_Len,phyreq_ID,Arry_Data,Time);
    _Check_31Routine_Rx(Arry_Data,1);
    testWaitForTimeout(100);
    _Send_Diag(4,phyreq_ID,data);
    if(diagGetLastResponseCode(SendData) == 0)
      testWaitForDiagResponse(SendData,Time);
    _TestResult(SendData,phyreq_ID,"",-1);
    testWaitForTimeout(50);
    _Send_Diag(DID_2E_SendData_2_Len,phyreq_ID,DID_2E_SendData_2,Time);
    _TestResult(SendData,phyreq_ID,"",DID_2E_SendData_2_Response);
    testWaitForTimeout(100);
    if(DID_2E_SendData_2_Response == -1 && Support_Read_2E_DID == 1)
    {
      _Send_Diag(Read_2E_DID_Len,phyreq_ID,Read_2E_DID,Time);
      _Check_Response_2E(SendData,DID_2E_SendData_2_Len,DID_2E_SendData_2);
    }
    else
      _WriteEx_and_Report("","期望结果为非正响应,不检测写入数据");
    testWaitForTimeout(100);
    _Set_11_Restoration(Time,0);
    if(DID_2E_SendData_2_Response == -1 && Support_Read_2E_DID == 1)
    {
      _Send_Diag(Read_2E_DID_Len,phyreq_ID,Read_2E_DID,Time);
      _Check_Response_2E(SendData,DID_2E_SendData_2_Len,DID_2E_SendData_2);
    }
    testWaitForTimeout(CAN_Init_Time-Wait_Time_11+500);
    _85_Check_DTC(1,0);
    x++;
  }while(Time_Flage==0);
  
  if(type==0 )
    cancelTimer(CAN_BUS_loader_H);
  else 
    cancelTimer(CAN_BUS_loader_L);
  cancelTimer(Time_Count);
}
_High_BUS_loader_H_4(byte type,dword Time)/*写DID_对中   负载率波动*//*0:干扰报文优先级高于发送ID，1:干扰报文优先级低于发送ID */
{
  int i,x,m;
  dword Seed;
  byte data[4] = {0x14,0xff,0xff,0xff};
  Time_Count_Time = 20*60*1000;
  diagSetTarget(Cdd_Name);
  _get_Str_Traversal("DID_2E_Traversal");
  _get_2E_DID(Traversal_DID[0]);
  if(strncmp(ECU_project,"BYD",strlen(ECU_project)) == 0 && strlen(ECU_project) == strlen("BYD"))
  {
    if((DID_2E_SendData_1[0] == 0x2E) && ((DID_2E_SendData_1[1] == 0xF1 && DID_2E_SendData_1[2] == 0xA1) || (DID_2E_SendData_1[1] == 0x21 && DID_2E_SendData_1[1] == 0x00)))
    {
      _Clear_BYD_Config_(0);
      _SetSession(defsession);
      _WriteEx_and_Report("","当前写入为BYD配置字，未防止返回NRC22故写入值为全0");
      DID_2E_SendData_1[1] = 0xF1;
      DID_2E_SendData_1[2] = 0xA1;
      for(i=3;i<DID_2E_SendData_1_Len;i++)
      {
        DID_2E_SendData_1[i] = 0x00;
      }
      DID_2E_SendData_1[DID_2E_SendData_1_Len-1] = 0x55;
      _get_2E_DID(Traversal_DID[0]);
    }
  }
  _get_Arry("Angle_Calibration");
  setTimer(Time_Count,Time_Count_Time);  
  if(type==0 )
    setTimer(CAN_BUS_loader_H,8);
  else 
    setTimer(CAN_BUS_loader_L,8);
  testWaitForTimeout(10000);
  x = 1;m = 0;
  do{
    _WriteEx_and_Report("","/*------------第 %d 次测试------------*/",x);
    m = x/30;
    if(m%2 != 0 && m!=0)
      Change_Load = 1;
    else
      Change_Load = 0;
    _SetSession(exsession,Time);
    testWaitForTimeout(50);
    Seed = _get_seed(phyreq_ID,Time);
    testWaitForTimeout(50);
    _Send_Key(SendKey_Len,phyreq_ID,Seed,0);
    Get_Seed_Flage = 1;
    testWaitForTimeout(50);
    _Send_Diag(DID_2E_SendData_1_Len,phyreq_ID,DID_2E_SendData_1,Time);
    _TestResult(SendData,phyreq_ID,"",DID_2E_SendData_1_Response);
    testWaitForTimeout(100);
    if(DID_2E_SendData_1_Response == -1 && Support_Read_2E_DID == 1)
    {
      _Send_Diag(Read_2E_DID_Len,phyreq_ID,Read_2E_DID,Time);
      _Check_Response_2E(SendData,DID_2E_SendData_1_Len,DID_2E_SendData_1);
    }
    else
      _WriteEx_and_Report("","期望结果为非正响应,不检测写入数据");
    testWaitForTimeout(100);
    
    _Send_Diag(Arry_Len,phyreq_ID,Arry_Data,Time);
    _Check_31Routine_Rx(Arry_Data,1);
    testWaitForTimeout(100);
    _Send_Diag(4,phyreq_ID,data);
    if(diagGetLastResponseCode(SendData) == 0)
      testWaitForDiagResponse(SendData,Time);
    _TestResult(SendData,phyreq_ID,"",-1);
    testWaitForTimeout(50);
    
    _Send_Diag(DID_2E_SendData_2_Len,phyreq_ID,DID_2E_SendData_2,Time);
    _TestResult(SendData,phyreq_ID,"",DID_2E_SendData_2_Response);
    testWaitForTimeout(100);
    if(DID_2E_SendData_2_Response == -1 && Support_Read_2E_DID == 1)
    {
      _Send_Diag(Read_2E_DID_Len,phyreq_ID,Read_2E_DID,Time);
      _Check_Response_2E(SendData,DID_2E_SendData_2_Len,DID_2E_SendData_2);
    }
    else
      _WriteEx_and_Report("","期望结果为非正响应,不检测写入数据");
    testWaitForTimeout(100);
    _Set_11_Restoration(Time,0);
    if(DID_2E_SendData_2_Response == -1 && Support_Read_2E_DID == 1)
    {
      _Send_Diag(Read_2E_DID_Len,phyreq_ID,Read_2E_DID,Time);
      _Check_Response_2E(SendData,DID_2E_SendData_2_Len,DID_2E_SendData_2);
    }
    testWaitForTimeout(CAN_Init_Time-Wait_Time_11+500);
    _85_Check_DTC(1,0);
    x++;
  }while(Time_Flage==0);
  
  if(type==0 )
    cancelTimer(CAN_BUS_loader_H);
  else 
    cancelTimer(CAN_BUS_loader_L);
  cancelTimer(Time_Count);
}

_High_BUS_loader_H_5(dword Time)/*写DID_对中/负载由外部IG模块输入*/
{
  int i,x;
  dword Seed;
  byte data[4] = {0x14,0xff,0xff,0xff};
  _TestWaitForTesterConfirmation("此用例为高负载测试，负载率由人为输入IG模块控制");
  _get_Str_Traversal("DID_2E_Traversal");
  _get_2E_DID(Traversal_DID[0]);
  if(strncmp(ECU_project,"BYD",strlen(ECU_project)) == 0 && strlen(ECU_project) == strlen("BYD"))
  {
    if((DID_2E_SendData_1[0] == 0x2E) && ((DID_2E_SendData_1[1] == 0xF1 && DID_2E_SendData_1[2] == 0xA1) || (DID_2E_SendData_1[1] == 0x21 && DID_2E_SendData_1[1] == 0x00)))
    {
      _Clear_BYD_Config_(0);
      _SetSession(defsession);
      _WriteEx_and_Report("","当前写入为BYD配置字，未防止返回NRC22故写入值为全0");
      DID_2E_SendData_1[1] = 0xF1;
      DID_2E_SendData_1[2] = 0xA1;
      for(i=3;i<DID_2E_SendData_1_Len;i++)
      {
        DID_2E_SendData_1[i] = 0x00;
      }
      DID_2E_SendData_1[DID_2E_SendData_1_Len-1] = 0x55;
      _get_2E_DID(Traversal_DID[0]);
    }
  }
  _get_Arry("Angle_Calibration");
  
  Time_Count_Time = 20*60*1000;
  setTimer(Time_Count,Time_Count_Time);  
  testWaitForTimeout(1000);
  x = 1;
  do{
    _WriteEx_and_Report("","/*------------第 %d 次测试------------*/",x);
    _SetSession(exsession,Time);
    testWaitForTimeout(50);
    Seed = _get_seed(phyreq_ID,Time);
    testWaitForTimeout(50);
    _Send_Key(SendKey_Len,phyreq_ID,Seed,0);
    Get_Seed_Flage = 1;
    testWaitForTimeout(50);
    _Send_Diag(DID_2E_SendData_1_Len,phyreq_ID,DID_2E_SendData_1,Time);
    _TestResult(SendData,phyreq_ID,"",DID_2E_SendData_1_Response);
    testWaitForTimeout(100);
    if(DID_2E_SendData_1_Response == -1 && Support_Read_2E_DID == 1)
    {
      _Send_Diag(Read_2E_DID_Len,phyreq_ID,Read_2E_DID,Time);
      _Check_Response_2E(SendData,DID_2E_SendData_1_Len,DID_2E_SendData_1);
    }
    else
      _WriteEx_and_Report("","期望结果为非正响应,不检测写入数据");
    testWaitForTimeout(100);
    
    _Send_Diag(Arry_Len,phyreq_ID,Arry_Data,Time);
    _Check_31Routine_Rx(Arry_Data,1);
    testWaitForTimeout(100);
    _Send_Diag(4,phyreq_ID,data);
    if(diagGetLastResponseCode(SendData) == 0)
      testWaitForDiagResponse(SendData,Time);
    _TestResult(SendData,phyreq_ID,"",-1);
    testWaitForTimeout(50);
    _Send_Diag(DID_2E_SendData_2_Len,phyreq_ID,DID_2E_SendData_2,Time);
    _TestResult(SendData,phyreq_ID,"",DID_2E_SendData_2_Response);
    testWaitForTimeout(100);
    if(DID_2E_SendData_2_Response == -1 && Support_Read_2E_DID == 1)
    {
      _Send_Diag(Read_2E_DID_Len,phyreq_ID,Read_2E_DID,Time);
      _Check_Response_2E(SendData,DID_2E_SendData_2_Len,DID_2E_SendData_2);
    }
    else
      _WriteEx_and_Report("","期望结果为非正响应,不检测写入数据");
    testWaitForTimeout(100);
    _Set_11_Restoration(Time,0);
    if(DID_2E_SendData_2_Response == -1 && Support_Read_2E_DID == 1)
    {
      _Send_Diag(Read_2E_DID_Len,phyreq_ID,Read_2E_DID,Time);
      _Check_Response_2E(SendData,DID_2E_SendData_2_Len,DID_2E_SendData_2);
    }
    testWaitForTimeout(CAN_Init_Time-Wait_Time_11+500);
    _85_Check_DTC(1,0);
    x++;
  }while(Time_Flage==0);
  cancelTimer(Time_Count);
}
_19_Serve_01(dword ID,byte Session)  /*19 01*/
{
  byte Data_1[3]={0x19,0x01,0x01};
  byte Data_2[3]={0x19,0x01,0x09};
  byte Data_3[3]={0x19,0x02,0x01};
  byte Data_4[3]={0x19,0x02,0x09};
  byte Data_5[3]={0x19,0x01,0x02};
  byte Data_6[3]={0x19,0x02,0x02};
  int i,count;
  count = 0;
  if(ID==funreq_ID && Fun_19==0)
  {
    _WriteEx_and_Report("","19服务不支持功能寻址");
    _Send_Diag(3,ID,Data_3);
    _TestResult(SendData,ID,"",NRC7F);
  }
  else
  {
    int Count_0101;
    diagStartTesterPresent(Cdd_Name);
    StepByGeely3_0(0x19,1);
    _Close_All();
    testWaitForTimeout(5000);
    _Open_All();
    testWaitForTimeout(5000);
    _Close_One_Node(DTC_19[0]);
    _Send_Diag(3,ID,Data_1);
    Count_0101 =_Check_1901(SendData);
    _Send_Diag(3,ID,Data_3);
    _Check_190201(SendData,DTC_19[0][1],DTC_19[0][2],Count_0101);
    
    _Send_Diag(3,ID,Data_2);
    Count_0101 = _Check_1901(SendData);
    _Send_Diag(3,ID,Data_4);
    _Check_1902(SendData,Count_0101);
    
    _Send_Diag(3,ID,Data_5);
    Count_0101 =_Check_1901(SendData);
    _Send_Diag(3,ID,Data_6);
    if(diagGetLastResponseCode(SendData)>0)
      _TestResult(SendData,ID,"",NRC12);
    else
      _Check_1902(SendData,Count_0101);
    _Open_One_Node(DTC_19[0]);
  }
}

_19_Serve_02(dword ID,byte Session)  /*19 02*/
{
  byte Data_1[3]={0x19,0x02,0x01};
  byte Data_2[3]={0x19,0x02,0x08};
  byte Data_3[3]={0x19,0x02,0x09};
  byte Data_4[3]={0x19,0x02,0x02};
  if(ID==funreq_ID && Fun_19==0)
    _WriteEx_and_Report("","19服务不支持功能寻址");
  else
  {
    diagStartTesterPresent(Cdd_Name);
    StepByGeely3_0(0x19,1);
    _Close_All();
    testWaitForTimeout(5000);
    _Open_All();
    testWaitForTimeout(5000);
    _Close_One_Node(DTC_19[1]);
    _Send_Diag(3,ID,Data_1);
    _Check_190201(SendData,DTC_19[1][1],DTC_19[1][2]);
    
    _Send_Diag(3,ID,Data_2);
    _Check_1902(SendData);
    _Send_Diag(3,ID,Data_3);
    _Check_1902(SendData);
    
    _Send_Diag(3,ID,Data_4);
    if(diagGetLastResponseCode(SendData)>0)
      _TestResult(SendData,ID,"",NRC12);
    else
      _Check_1902(SendData);
    _Open_One_Node(DTC_19[1]);
  }
}

// _19_Serve_03(dword ID,byte Session) /*长安平台化使用此用例 19 04*/
// {
//   int Pos_1904;
//   if(ID==funreq_ID && Fun_19==0)
//     _WriteEx_and_Report("","19服务不支持功能寻址");
//   else
//   {
//     if(strncmp(ECU_project,"ChangAn",strlen(ECU_project)) == 0 && strlen(ECU_project) == strlen("ChangAn") && ChangAn_New==1)
//     {
//       byte DTC_H,DTC_M,DTC_L;
//       byte mask;
//       byte Data_Send[6] = {0x19,0x04,0,0,0,0};
//       char Check_Str[100] = "ALL";
//       diagStartTesterPresent(Cdd_Name);
//       Pos_1904 = Get_Node_Pos(Node_1904,1);
//       DTC_H = (DTC_19[Pos_1904][1]>>16);
//       DTC_M = (DTC_19[Pos_1904][1]>>8);
//       DTC_L = (DTC_19[Pos_1904][1]&0xFF);
//       Data_Send[2] = DTC_H;
//       Data_Send[3] = DTC_M;
//       Data_Send[4] = DTC_L;
//       Data_Send[5] = Freeze_Frame_Number[0];
      
//       _Power_Down();
//       testWaitForTimeout(1000);
//       _Close_All();
//       mask = DTC_19[Pos_1904][2];
//       testWaitForTimeout(1000);
//       _Power_Up();
//       testWaitForTimeout(3000);
//       _Send_Diag(6,ID,Data_Send);
//       _Check_1904_ChangAn_New(SendData,mask);
//       Data_Send[5] = 0xFF;
//       _Send_Diag(6,ID,Data_Send);
//       _Check_1904_ChangAn_New(SendData,mask);
//       _Open_All();
//     }
//     else
//       _WriteEx_and_Report(ECU_project,"当前项目非长安新平台,此条用例不适用");
//   }
// }

_19_Serve_04(dword ID,byte Session) /*19 04*/
{
  int Pos_1904;
  if(ID==funreq_ID && Fun_19==0)
    _WriteEx_and_Report("","19服务不支持功能寻址");
  else
  {
    // if(strncmp(ECU_project,"ChangAn",strlen(ECU_project)) == 0 && strlen(ECU_project) == strlen("ChangAn") && ChangAn_New==1)
    //   _WriteEx_and_Report("","长安新平台,此用例不适用");
    // else
    {
      byte DTC_H,DTC_M,DTC_L;
      byte mask;
      byte Data_Send[6] = {0x19,0x04,0,0,0,0};
      char comment[100];
      int i;
      byte Pos_;
      byte Did_Res[500];
      dword Did_Res_Len;
      byte Did_Res2[500];
      dword Did_Res_Len2;
      Pos_ = 1;
      diagStartTesterPresent(Cdd_Name);
      snprintf(comment,elCount(comment),"%s","");
      Pos_1904 = Get_Node_Pos(Node_1904,1);
      DTC_H = (DTC_19[Pos_1904][1]>>16);
      DTC_M = (DTC_19[Pos_1904][1]>>8);
      DTC_L = (DTC_19[Pos_1904][1]&0xFF);
      Data_Send[2] = DTC_H;
      Data_Send[3] = DTC_M;
      Data_Send[4] = DTC_L;
      Data_Send[5] = Freeze_Frame_Number[0];
      Did_Res_Len = 0;
      _Send_Diag(6,ID,Data_Send);
      mask = DTC_19[Pos_1904][2];
      _Check_19_NoFreeze(SendData,"ALL");
      for(i=0;i<mixArray_Len;i++)
        _Step_1904(mixArray[i].Str_DID_1904,0);
      _Close_One_Node(DTC_19[Pos_1904]);
      _Send_Diag(6,ID,Data_Send);
      _Check_1904(SendData,mask,"ALL",0,0);//第2步
      for(i=0;i<DiagGetRespPrimitiveSize(SendData);i++)
      {
        Did_Res[i] = diagGetRespPrimitiveByte(SendData,i);
        Did_Res_Len++;
      }
      if(Freeze_Frame_Number_Count > 2)
      {
        Did_Res_Len2 = (Did_Res_Len - 6)*2+6;
        for(i=0;i<Did_Res_Len;i++)
          Did_Res2[i] = Did_Res[i];
        Did_Res2[Did_Res_Len] = Freeze_Frame_Number[1];
        for(i=0;i<Did_Res_Len-7;i++)
          Did_Res2[Did_Res_Len+1+i] = Did_Res[i+7];
        Data_Send[5] = 0xFF;
        _Send_Diag(6,ID,Data_Send);
        _Check_Response_(SendData,Did_Res_Len,Did_Res,0);
      }
      else
      {
        Data_Send[5] = 0xFF;
        _Send_Diag(6,ID,Data_Send);
        _Check_Response_(SendData,Did_Res_Len,Did_Res,0);
      }
      if(Freeze_Frame_Number_Count > 2)
      {
        Data_Send[5] = Freeze_Frame_Number[1];
        Did_Res[6] = Freeze_Frame_Number[1];
        _Send_Diag(6,ID,Data_Send);
        _Check_Response_(SendData,Did_Res_Len,Did_Res,0);
        Data_Send[5] = 0xFF; //装载全部到Did_Res进行判断
        Did_Res_Len = Did_Res_Len2;
        for(i=0;i<Did_Res_Len;i++)
          Did_Res[i] = Did_Res2[i];
      }
      if(Pos_1904 == 1)
        Pos_ = 0;
      DTC_H = (DTC_19[Pos_][1]>>16);
      DTC_M = (DTC_19[Pos_][1]>>8);
      DTC_L = (DTC_19[Pos_][1]&0xFF);
      Data_Send[2] = DTC_H;
      Data_Send[3] = DTC_M;
      Data_Send[4] = DTC_L;
      _Send_Diag(6,ID,Data_Send);
      _Check_19_NoFreeze(SendData,"ALL");
      DTC_H = (DTC_19[Pos_1904][1]>>16);
      DTC_M = (DTC_19[Pos_1904][1]>>8);
      DTC_L = (DTC_19[Pos_1904][1]&0xFF);
      Data_Send[2] = DTC_H;
      Data_Send[3] = DTC_M;
      Data_Send[4] = DTC_L;
      _Open_One_Node(DTC_19[Pos_1904]);
      testWaitForTimeout(2000);
      _Send_Diag(6,ID,Data_Send);
      _Check_Response_(SendData,Did_Res_Len,Did_Res,0);
      for(i=0;i<mixArray_Len;i++)
        _Step_1904(mixArray[i].Str_DID_1904,1);
      testWaitForTimeout(2000);
      _Close_One_Node(DTC_19[Pos_1904]);
      _Send_Diag(6,ID,Data_Send);
      if(Clear_1904==0)
      {
        _Check_1904(SendData,mask,"ALL",0,0);//第5步
      }
      else
        _Check_Response_(SendData,Did_Res_Len,Did_Res,0);
      _Open_One_Node(DTC_19[Pos_1904]);
      testWaitForTimeout(2000);
      for(i=0;i<mixArray_Len;i++)
        _Step_1904(mixArray[i].Str_DID_1904,2);
      _K15_OFF();
      testWaitForTimeout(K15_OFF_Time);
      _Close_One_Node(DTC_19[Pos_1904]);
      _K15_ON();
      testWaitForTimeout(CAN_Init_Time + 1000);
      _Open_One_Node(DTC_19[Pos_1904]);
      testWaitForTimeout(1000);
      _Send_Diag(6,ID,Data_Send);
      if(Clear_1904==0)
      {
        _Check_1904(SendData,mask,"ALL",0,0);//  第6步
      }
      else
        _Check_Response_(SendData,Did_Res_Len,Did_Res,0);
      _Close_One_Node(DTC_19[Pos_1904]);
      _Send_Diag(6,ID,Data_Send);
      if(Clear_1904==0)
      {
        _Check_1904(SendData,mask,"ALL",0,0);//   第7步
      }
      else
        _Check_Response_(SendData,Did_Res_Len,Did_Res,0);
      _Open_One_Node(DTC_19[Pos_1904]);
      testWaitForTimeout(1000);
      _Clear_DTC(phyreq_ID);
      for(i=0;i<mixArray_Len;i++)
        _Step_1904(mixArray[i].Str_DID_1904,3);
      _Close_One_Node(DTC_19[Pos_1904]);
      _Send_Diag(6,ID,Data_Send);
      _Check_1904(SendData,mask,"ALL",0,0);//  第9步
      _Open_One_Node(DTC_19[Pos_1904]);
      testWaitForTimeout(1000);
      _Clear_DTC(phyreq_ID);
      testWaitForTimeout(1000);
      _Send_Diag(6,ID,Data_Send);
      _Check_19_NoFreeze(SendData,"ALL");
      _Set_Battery(12);
    }
   }
}

_19_Serve_05(dword ID,byte Session) /*19 04单个快照信息*/
{
  int Pos_1904;
  char Check_Str[100];
  char Temp_Value_1[1000];
  char Temp_Value_2[1000];
  char Data_Str_[100][50];
  int i,j,len_Read;
  snprintf(Temp_Value_1,elCount(Temp_Value_1),"%s","");
  snprintf(Temp_Value_2,elCount(Temp_Value_2),"%s","");

  if(ID==funreq_ID && Fun_19==0)
    _WriteEx_and_Report("","19服务不支持功能寻址");
  else
  {
    GlbHandlefile = OpenFileRead (file_name_1,0);
    getProfileString(ECU_project,"Freeze_Frame","Null",Temp_Value_2, 1000, file_name_1);
    fileClose(GlbHandlefile);
    for(i=0;i<elcount(Temp_Value_2);i++)
    {
      if(Temp_Value_2[i]==91)
      {
        for(j=i+1;j<500;j++)
        {
          if(Temp_Value_2[j]==93)
          {
            snprintf(Data_Str_[len_Read],elcount(Temp_Value_1),"%s",Temp_Value_1);
            len_Read++;
            snprintf(Temp_Value_1,elCount(Temp_Value_1),"%s","");
            break;
          }
          else
            snprintf(Temp_Value_1,elCount(Temp_Value_1),"%s%c",Temp_Value_1,Temp_Value_2[j]);
        }
      }
    }
    if(Session != defsession)
      diagStartTesterPresent(Cdd_Name);
    for(i=0;i<mixArray_Len;i++)
    {
      snprintf(Check_Str,elCount(Check_Str),"%s","");
      snprintf(Check_Str,elCount(Check_Str),"%s",Data_Str_[i]);
      writeEx(-3,0,"----------------------------------------------");
      _WriteEx_and_Report("开始测试 : ",Check_Str);
      writeEx(-3,0,"----------------------------------------------");
      _Fun_1904(Check_Str,ID,Session);
    }
    diagStopTesterPresent(Cdd_Name);
  }
}
_19_Serve_06(dword ID,byte Session) /*19 06*/
{
  int Pos_1904;
  byte DTC_H,DTC_M,DTC_L;
  byte mask;
  byte Data_Send[6] = {0x19,0x06,0,0,0,0xFF};
  if(ID==funreq_ID && Fun_19==0)
    _WriteEx_and_Report("","19服务不支持功能寻址");
  else if(_Check_Serve(0x19,0x06,4)==-1)
    _WriteEx_and_Report("","19服务不支持06子功能");
  else
  {
    byte Pos_;
    Pos_ = 1;
    Pos_1904 = Get_Node_Pos(Node_1904,1);
    DTC_H = (DTC_19[Pos_1904][1]>>16);
    DTC_M = (DTC_19[Pos_1904][1]>>8);
    DTC_L = (DTC_19[Pos_1904][1]&0xFF);
    Data_Send[2] = DTC_H;
    Data_Send[3] = DTC_M;
    Data_Send[4] = DTC_L;
    if(Pos_1904 == 1)
      Pos_ = 0;
    _Send_Diag(6,ID,Data_Send);
    _Check_19_NoFreeze(SendData,"0x19 0x06");
    _Close_One_Node(DTC_19[Pos_1904]);
    _Send_Diag(6,ID,Data_Send);
    _Check_1906(SendData,"All",0);
    DTC_H = (DTC_19[Pos_][1]>>16);
    DTC_M = (DTC_19[Pos_][1]>>8);
    DTC_L = (DTC_19[Pos_][1]&0xFF);
    Data_Send[2] = DTC_H;
    Data_Send[3] = DTC_M;
    Data_Send[4] = DTC_L;
    _Send_Diag(6,ID,Data_Send);
    _Check_19_NoFreeze(SendData,"0x19 0x06");
    _Open_One_Node(DTC_19[Pos_1904]);
    DTC_H = (DTC_19[Pos_1904][1]>>16);
    DTC_M = (DTC_19[Pos_1904][1]>>8);
    DTC_L = (DTC_19[Pos_1904][1]&0xFF);
    Data_Send[2] = DTC_H;
    Data_Send[3] = DTC_M;
    Data_Send[4] = DTC_L;
    _Send_Diag(6,ID,Data_Send);
    _Check_1906(SendData,"All",0);
  }
}
_19_Serve_07(dword ID,byte Session) /*故障发生计数器更新机制*/
{
  int Pos_1904;
  byte DTC_H,DTC_M,DTC_L;
  byte mask;
  int i;
  byte Data_Send[6] = {0x19,0x06,0,0,0,0xFF};
  if(ID==funreq_ID && Fun_19==0)
    _WriteEx_and_Report("","19服务不支持功能寻址");
  else if(_Check_Serve(0x19,0x06,4)==-1)
    _WriteEx_and_Report("","19服务不支持06子功能");
  else
  {
    Pos_1904 = Get_Node_Pos(Node_1904,1);
    DTC_H = (DTC_19[Pos_1904][1]>>16);
    DTC_M = (DTC_19[Pos_1904][1]>>8);
    DTC_L = (DTC_19[Pos_1904][1]&0xFF);
    Data_Send[2] = DTC_H;
    Data_Send[3] = DTC_M;
    Data_Send[4] = DTC_L;
    if(_Check_StrPossion_Res("Fault_Occurrence_counter",3)!= -1)
    {
      _85_Check_DTC(1,0);
      _Close_One_Node(DTC_19[Pos_1904]);
      _Open_One_Node(DTC_19[Pos_1904]);
      mask = DTC_19[Pos_1904][2];
      _Send_Diag(6,ID,Data_Send);
      _Check_1906(SendData,"Fault_Occurrence_counter",1);
      for(i=0;i<254;i++)
      {
        _Close_One_Node(DTC_19[Pos_1904]);
        _Open_One_Node(DTC_19[Pos_1904]);
      }
      _Send_Diag(6,ID,Data_Send);
      _Check_1906(SendData,"Fault_Occurrence_counter",0xff);
      _Close_One_Node(DTC_19[Pos_1904]);
      _Open_One_Node(DTC_19[Pos_1904]);
      _Send_Diag(6,ID,Data_Send);
      if(Fault_Occurrence_counter_Full==0)
        _Check_1906(SendData,"Fault_Occurrence_counter",0xff);
      else
        _Check_1906(SendData,"Fault_Occurrence_counter",0);
      _Close_One_Node(DTC_19[Pos_1904]);
      _Open_One_Node(DTC_19[Pos_1904]);
      _Send_Diag(6,ID,Data_Send);
      if(Fault_Occurrence_counter_Full==0)
        _Check_1906(SendData,"Fault_Occurrence_counter",0xff);
      else
        _Check_1906(SendData,"Fault_Occurrence_counter",1);
    }
    else
      _WriteEx_and_Report("Fault_Occurrence_counter","该项目内无此测试项");
  }
}
_19_Serve_08(dword ID,byte Session) /*故障发生计数器被14服务清零*/
{
  int Pos_1904;
  byte DTC_H,DTC_M,DTC_L;
  byte mask;
  int i;
  byte Data_Send[6] = {0x19,0x06,0,0,0,0xFF};
  if(ID==funreq_ID && Fun_19==0)
    _WriteEx_and_Report("","19服务不支持功能寻址");
  else if(_Check_Serve(0x19,0x06,4)==-1)
    _WriteEx_and_Report("","19服务不支持06子功能");
  else
  {
    Pos_1904 = Get_Node_Pos(Node_1904,1);
    DTC_H = (DTC_19[Pos_1904][1]>>16);
    DTC_M = (DTC_19[Pos_1904][1]>>8);
    DTC_L = (DTC_19[Pos_1904][1]&0xFF);
    Data_Send[2] = DTC_H;
    Data_Send[3] = DTC_M;
    Data_Send[4] = DTC_L;
    if(_Check_StrPossion_Res("Fault_Occurrence_counter",3)!= -1)
    {
        _85_Check_DTC(1,0);
        for(i=0;i<10;i++)
        {
          _Close_One_Node(DTC_19[Pos_1904]);
          _Open_One_Node(DTC_19[Pos_1904]);
        }
        mask = DTC_19[Pos_1904][2];
        _Send_Diag(6,ID,Data_Send);
        _Check_1906(SendData,"Fault_Occurrence_counter",0x0A);
        _Set_Ready(0);_K15_OFF();
        testWaitForTimeout(K15_OFF_Time);
        _K15_ON();_Set_Ready(Struct_Ready.Ready_Active);
        testWaitForTimeout(1000);
        testWaitForTimeout(CAN_Init_Time);
        _Send_Diag(6,ID,Data_Send);
        _Check_1906(SendData,"Fault_Occurrence_counter",0x0A);
        _85_Check_DTC(9,DTC_19[Pos_1904][1]);
        _Clear_DTC(phyreq_ID);
        _Close_One_Node(DTC_19[Pos_1904]);
        _Open_One_Node(DTC_19[Pos_1904]);
        _Send_Diag(6,ID,Data_Send);
        _Check_1906(SendData,"Fault_Occurrence_counter",0x01);
    }
    else
      _WriteEx_and_Report("Fault_Occurrence_counter","该项目内无此测试项");
  }
}
_19_Serve_09(dword ID,byte Session) /*老化计数器更新机制*/
{
  int Pos_1904;
  byte DTC_H,DTC_M,DTC_L;
  byte mask;
  int i;
  byte Data_Send[6] = {0x19,0x06,0,0,0,0xFF};
  if(ID==funreq_ID && Fun_19==0)
    _WriteEx_and_Report("","19服务不支持功能寻址");
  else if(_Check_Serve(0x19,0x06,4)==-1)
    _WriteEx_and_Report("","19服务不支持06子功能");
  else
  {
    Pos_1904 = Get_Node_Pos(Node_1904,1);
    DTC_H = (DTC_19[Pos_1904][1]>>16);
    DTC_M = (DTC_19[Pos_1904][1]>>8);
    DTC_L = (DTC_19[Pos_1904][1]&0xFF);
    Data_Send[2] = DTC_H;
    Data_Send[3] = DTC_M;
    Data_Send[4] = DTC_L;
    
    if(_Check_StrPossion_Res("DTC_Aging_counter",3)!= -1)
    {
      if(DTC_Aging_Counter_Clear == 1)
      {
        _85_Check_DTC(1,0);
        _Close_One_Node(DTC_19[Pos_1904]);
        _Send_Diag(6,ID,Data_Send);
        _Check_1906(SendData,"DTC_Aging_counter",0);
        _Open_One_Node(DTC_19[Pos_1904]);
        _Send_Diag(6,ID,Data_Send);
        _Check_1906(SendData,"DTC_Aging_counter",0);
        _Set_Ready(0);_K15_OFF();
        testWaitForTimeout(K15_OFF_Time);
        _K15_ON();_Set_Ready(Struct_Ready.Ready_Active);
        testWaitForTimeout(1000);
        testWaitForTimeout(CAN_Init_Time);
        _Send_Diag(6,ID,Data_Send);
        _Check_1906(SendData,"DTC_Aging_counter",0);
        _K15_OFF();_Set_Ready(0);
        testWaitForTimeout(K15_OFF_Time);
        _K15_ON();_Set_Ready(Struct_Ready.Ready_Active);
        testWaitForTimeout(1000);
        testWaitForTimeout(CAN_Init_Time);
        _Send_Diag(6,ID,Data_Send);
        _Check_1906(SendData,"DTC_Aging_counter",1);
        _Close_One_Node(DTC_19[Pos_1904]);
        _Send_Diag(6,ID,Data_Send);
        _Check_1906(SendData,"DTC_Aging_counter",0);
        _Open_One_Node(DTC_19[Pos_1904]);
        _Send_Diag(6,ID,Data_Send);
        _Check_1906(SendData,"DTC_Aging_counter",0);
        _K15_OFF();_Set_Ready(0);
        testWaitForTimeout(K15_OFF_Time);
        _K15_ON();_Set_Ready(Struct_Ready.Ready_Active);
        testWaitForTimeout(1000);
        testWaitForTimeout(CAN_Init_Time);
        _Send_Diag(6,ID,Data_Send);
        _Check_1906(SendData,"DTC_Aging_counter",0);
        _K15_OFF();_Set_Ready(0);
        testWaitForTimeout(K15_OFF_Time);
        _K15_ON();_Set_Ready(Struct_Ready.Ready_Active);
        testWaitForTimeout(1000);
        testWaitForTimeout(CAN_Init_Time);
        _Send_Diag(6,ID,Data_Send);
        _Check_1906(SendData,"DTC_Aging_counter",1);
        _Set_Ready(0);
        for(i=1;i<DTC_Aging_counter_max;i++)
        {
          _WriteEx_and_Report("","当前已上下电次数 %d",i);
          _K15_OFF();
          testWaitForTimeout(K15_OFF_Time);
          _K15_ON();
          testWaitForTimeout(CAN_Init_Time);
          _Send_Diag(6,ID,Data_Send);
          _Check_1906(SendData,"DTC_Aging_counter",i+1);
        }
        _K15_OFF();
        testWaitForTimeout(K15_OFF_Time);
        _K15_ON();
        testWaitForTimeout(1000);
        testWaitForTimeout(CAN_Init_Time);
        _Send_Diag(6,ID,Data_Send);
        _Check_19_NoFreeze(SendData,"DTC_Aging_counter");
      }
      else
      {
        dword Value;
        _WriteEx_and_Report("","老化计数器无法被14服务清零,此处验证次数能够正常叠加");
        _85_Check_DTC(1,0);
        _Close_One_Node(DTC_19[Pos_1904]);
        _Send_Diag(6,ID,Data_Send);
        Value = _Get_1906_(SendData,"DTC_Aging_counter");
        _Open_One_Node(DTC_19[Pos_1904]);
        _Send_Diag(6,ID,Data_Send);
        _Check_1906(SendData,"DTC_Aging_counter",Value);
        _K15_OFF();_Set_Ready(0);
        testWaitForTimeout(K15_OFF_Time);
        _K15_ON();_Set_Ready(Struct_Ready.Ready_Active);
        testWaitForTimeout(1000);
        testWaitForTimeout(CAN_Init_Time);
        _Send_Diag(6,ID,Data_Send);
        _Check_1906(SendData,"DTC_Aging_counter",Value);
        _Set_Ready(0);
        _K15_OFF();
        testWaitForTimeout(K15_OFF_Time);
        _K15_ON();
        testWaitForTimeout(1000);
        testWaitForTimeout(CAN_Init_Time);
        _Send_Diag(6,ID,Data_Send);
        _Check_1906(SendData,"DTC_Aging_counter",Value);
        _Close_One_Node(DTC_19[Pos_1904]);
        _Send_Diag(6,ID,Data_Send);
        _Check_1906(SendData,"DTC_Aging_counter",Value+2); //仅当故障重新制造后计算才变化
        _Open_One_Node(DTC_19[Pos_1904]);
        _Send_Diag(6,ID,Data_Send);
        _Check_1906(SendData,"DTC_Aging_counter",Value+2);
        _K15_OFF();
        testWaitForTimeout(K15_OFF_Time);
        _K15_ON();
        testWaitForTimeout(1000);
        testWaitForTimeout(CAN_Init_Time);
        _Send_Diag(6,ID,Data_Send);
        _Check_1906(SendData,"DTC_Aging_counter",Value+2);
        _K15_OFF();
        testWaitForTimeout(K15_OFF_Time);
        _K15_ON();
        testWaitForTimeout(1000);
        testWaitForTimeout(CAN_Init_Time);
        _Close_One_Node(DTC_19[Pos_1904]);
        _Open_One_Node(DTC_19[Pos_1904]);
        _Send_Diag(6,ID,Data_Send);
        _Check_1906(SendData,"DTC_Aging_counter",Value+4);
        _Clear_DTC(phyreq_ID);
        _Close_One_Node(DTC_19[Pos_1904]);
        _Open_One_Node(DTC_19[Pos_1904]);
        _Send_Diag(6,ID,Data_Send);
        _Check_1906(SendData,"DTC_Aging_counter",Value+4);
        _K15_OFF();
        testWaitForTimeout(K15_OFF_Time);
        _K15_ON();
        testWaitForTimeout(1000);
        testWaitForTimeout(CAN_Init_Time);
        _Close_One_Node(DTC_19[Pos_1904]);
        _Open_One_Node(DTC_19[Pos_1904]);
        _Send_Diag(6,ID,Data_Send);
        _Check_1906(SendData,"DTC_Aging_counter",Value+5);
      }
    }
    else
      _WriteEx_and_Report("DTC_Aging_counter","该项目内无此测试项");
  }
}
_19_Serve_10(dword ID,byte Session) /*老化计数器被14服务清零*/
{
  int Pos_1904;
  byte DTC_H,DTC_M,DTC_L;
  byte mask;
  int i;
  byte Data_Send[6] = {0x19,0x06,0,0,0,0xFF};
  if(ID==funreq_ID && Fun_19==0)
    _WriteEx_and_Report("","19服务不支持功能寻址");
  else if(_Check_Serve(0x19,0x06,4)==-1)
    _WriteEx_and_Report("","19服务不支持06子功能");
  else
  {
    Pos_1904 = Get_Node_Pos(Node_1904,1);
    DTC_H = (DTC_19[Pos_1904][1]>>16);
    DTC_M = (DTC_19[Pos_1904][1]>>8);
    DTC_L = (DTC_19[Pos_1904][1]&0xFF);
    Data_Send[2] = DTC_H;
    Data_Send[3] = DTC_M;
    Data_Send[4] = DTC_L;
    if(_Check_StrPossion_Res("DTC_Aging_counter",3)!= -1)
    {
      if(DTC_Aging_Counter_Clear == 1)
      {
      _Set_Ready(Struct_Ready.Ready_Active);
      _85_Check_DTC(1,0);
      _Close_One_Node(DTC_19[Pos_1904]);
      _Open_One_Node(DTC_19[Pos_1904]);
      _Send_Diag(6,ID,Data_Send);
      _Check_1906(SendData,"DTC_Aging_counter",0);
        _Set_Ready(0);
      for(i=0;i<10;i++)
      {
        _K15_OFF();
        testWaitForTimeout(K15_OFF_Time);
        _K15_ON();
        testWaitForTimeout(1000);
      }
      testWaitForTimeout(CAN_Init_Time);
      _Send_Diag(6,ID,Data_Send);
      _Check_1906(SendData,"DTC_Aging_counter",0x0a);
      _Clear_DTC(phyreq_ID);
      _Close_One_Node(DTC_19[Pos_1904]);
      _Open_One_Node(DTC_19[Pos_1904]);
      _Send_Diag(6,ID,Data_Send);
      _Check_1906(SendData,"DTC_Aging_counter",0);
      for(i=0;i<2;i++)
      {
        _K15_OFF();
        testWaitForTimeout(K15_OFF_Time);
        _K15_ON();
        testWaitForTimeout(1000);
      }
      testWaitForTimeout(CAN_Init_Time);
      _Send_Diag(6,ID,Data_Send);
      _Check_1906(SendData,"DTC_Aging_counter",1);
      }
      else
        _WriteEx_and_Report("","老化计数器无法被14服务清除");
    }
    else
      _WriteEx_and_Report("DTC_Aging_counter","该项目内无此测试项");
  }
}
_19_Serve_11(dword ID,byte Session) /*已老化计数器更新机制(时间较长)*/
{
  int Pos_1904;
  byte DTC_H,DTC_M,DTC_L;
  byte mask;
  int i,m;
  byte Data_Send[6] = {0x19,0x06,0,0,0,0xFF};
  if(ID==funreq_ID && Fun_19==0)
    _WriteEx_and_Report("","19服务不支持功能寻址");
  else if(_Check_Serve(0x19,0x06,4)==-1)
    _WriteEx_and_Report("","19服务不支持06子功能");
  else
  {
    Pos_1904 = Get_Node_Pos(Node_1904,1);
    DTC_H = (DTC_19[Pos_1904][1]>>16);
    DTC_M = (DTC_19[Pos_1904][1]>>8);
    DTC_L = (DTC_19[Pos_1904][1]&0xFF);
    Data_Send[2] = DTC_H;
    Data_Send[3] = DTC_M;
    Data_Send[4] = DTC_L;
    if(_Check_StrPossion_Res("DTC_Aged_counter",3)!= -1)
    {
      _Set_Ready(0);
      _K15_OFF();
      testWaitForTimeout(K15_OFF_Time);
      _K15_ON();
      testWaitForTimeout(1000);
      _Set_Ready(Struct_Ready.Ready_Active);
      if(Session != defsession)
        _SetSession(Session);
      _85_Check_DTC(1,0);
      _Close_One_Node(DTC_19[Pos_1904]);
      _Open_One_Node(DTC_19[Pos_1904]);
      _Send_Diag(6,ID,Data_Send);
      _Check_1906(SendData,"DTC_Aged_counter",0);
      _Set_Ready(0);
      for(i=0;i<DTC_Aging_counter_max+1;i++)
      {
        _K15_OFF();
        testWaitForTimeout(K15_OFF_Time);
        _K15_ON();
        testWaitForTimeout(1000);
      }
      testWaitForTimeout(CAN_Init_Time);
      _Send_Diag(6,ID,Data_Send);
      _Check_19_NoFreeze(SendData,"0x19 0x06");
      _Close_One_Node(DTC_19[Pos_1904]);
      _Open_One_Node(DTC_19[Pos_1904]);
      _Send_Diag(6,ID,Data_Send);
      _Check_1906(SendData,"DTC_Aged_counter",1);
      for(i=0;i<DTC_Aging_counter_max+1;i++)
      {
        _K15_OFF();
        testWaitForTimeout(K15_OFF_Time);
        _K15_ON();
        testWaitForTimeout(1000);
      }
      testWaitForTimeout(CAN_Init_Time);
      _Close_One_Node(DTC_19[Pos_1904]);
      _Send_Diag(6,ID,Data_Send);
      _Check_1906(SendData,"DTC_Aged_counter",2);
      _Open_One_Node(DTC_19[Pos_1904]);
      for(i=0;i<DTC_Aging_counter_max;i++)
      {
        _K15_OFF();
        testWaitForTimeout(K15_OFF_Time);
        _K15_ON();
        testWaitForTimeout(1000);
      }
      testWaitForTimeout(CAN_Init_Time);
      _Send_Diag(6,ID,Data_Send);
      _Check_19_NoFreeze(SendData,"0x19 0x06");
//      _Check_1906(SendData,"DTC_Aged_counter",2);
      
      for(i=0;i<255;i++)
      {
        _Close_One_Node(DTC_19[Pos_1904]);
        _Open_One_Node(DTC_19[Pos_1904]);
        for(m=0;m<DTC_Aging_counter_max+1;m++)
        {
          _K15_OFF();
          testWaitForTimeout(K15_OFF_Time);
          _K15_ON();
          testWaitForTimeout(1000);
        }
        testWaitForTimeout(CAN_Init_Time);
        _Close_One_Node(DTC_19[Pos_1904]);
        _Send_Diag(6,ID,Data_Send);
        if(i+2<=255)
          _Check_1906(SendData,"DTC_Aged_counter",i+2);
        else
        {
          if(DTC_Aged_counter_Full == 0)
            _Check_1906(SendData,"DTC_Aged_counter",255);
          else
            _Check_1906(SendData,"DTC_Aged_counter",i+2-255-1);
        }
      }
      _Open_One_Node(DTC_19[Pos_1904]);
    }
    else
      _WriteEx_and_Report("DTC_Aged_counter","该项目内无此测试项");
  }
}
_19_Serve_12(dword ID,byte Session) /*已老化计数器被14服务清零*/
{
  int Pos_1904;
  byte DTC_H,DTC_M,DTC_L;
  byte mask;
  int i,m;
  byte Data_Send[6] = {0x19,0x06,0,0,0,0xFF};
  if(ID==funreq_ID && Fun_19==0)
    _WriteEx_and_Report("","19服务不支持功能寻址");
  else if(_Check_Serve(0x19,0x06,4)==-1)
    _WriteEx_and_Report("","19服务不支持06子功能");
  else
  {
    Pos_1904 = Get_Node_Pos(Node_1904,1);
    DTC_H = (DTC_19[Pos_1904][1]>>16);
    DTC_M = (DTC_19[Pos_1904][1]>>8);
    DTC_L = (DTC_19[Pos_1904][1]&0xFF);
    Data_Send[2] = DTC_H;
    Data_Send[3] = DTC_M;
    Data_Send[4] = DTC_L;
    if(_Check_StrPossion_Res("DTC_Aged_counter",3)!= -1)
    {
      _Set_Ready(0);
      _K15_OFF();
      testWaitForTimeout(K15_OFF_Time);
      _K15_ON();
      testWaitForTimeout(1000);
      _Set_Ready(Struct_Ready.Ready_Active);
      if(Session != defsession)
        _SetSession(Session);
      _85_Check_DTC(1,0);
      _Close_One_Node(DTC_19[Pos_1904]);
      _Open_One_Node(DTC_19[Pos_1904]);
      _Set_Ready(0);
      for(i=0;i<10;i++)
      {
  	    testWaitForTimeout(CAN_Init_Time);
  	    _Close_One_Node(DTC_19[Pos_1904]);
  	  	_Open_One_Node(DTC_19[Pos_1904]);
        for(m=0;m<DTC_Aging_counter_max+1;m++)
        {
          _K15_OFF();
          testWaitForTimeout(K15_OFF_Time);
          _K15_ON();
          testWaitForTimeout(1000);
        }
      }
        _Close_One_Node(DTC_19[Pos_1904]);
        _Send_Diag(6,ID,Data_Send);
        _Check_1906(SendData,"DTC_Aged_counter",0x0A);
        _Clear_DTC(phyreq_ID);
         testWaitForTimeout(1000);
        _Send_Diag(6,ID,Data_Send);
        _Check_1906(SendData,"DTC_Aged_counter",0);
  	  	_Open_One_Node(DTC_19[Pos_1904]);
        for(m=0;m<DTC_Aging_counter_max+1;m++)
        {
          _K15_OFF();
          testWaitForTimeout(K15_OFF_Time);
          _K15_ON();
          testWaitForTimeout(1000);
        }
      _Close_One_Node(DTC_19[Pos_1904]);
      _Send_Diag(6,ID,Data_Send);
      _Check_1906(SendData,"DTC_Aged_counter",0x01);
      _Open_One_Node(DTC_19[Pos_1904]);
    }
    else
      _WriteEx_and_Report("DTC_Aged_counter","该项目内无此测试项");
  }
}
_19_Serve_13(dword ID,byte Session) /*故障发生时间*/
{
  int Pos_1904;
  byte DTC_H,DTC_M,DTC_L;
  byte mask;
  int i,m;
  char Time_First[50];
  byte Data_Send[6] = {0x19,0x06,0,0,0,0xFF};
  if(ID==funreq_ID && Fun_19==0)
    _WriteEx_and_Report("","19服务不支持功能寻址");
  else if(_Check_Serve(0x19,0x06,4)==-1)
    _WriteEx_and_Report("","19服务不支持06子功能");
  else
  {
    Pos_1904 = Get_Node_Pos(Node_1904,1);
    DTC_H = (DTC_19[Pos_1904][1]>>16);
    DTC_M = (DTC_19[Pos_1904][1]>>8);
    DTC_L = (DTC_19[Pos_1904][1]&0xFF);
    Data_Send[2] = DTC_H;
    Data_Send[3] = DTC_M;
    Data_Send[4] = DTC_L;
//    _Set_Ready(0);
    if(_Check_StrPossion_Res("First_Time_Fault_Occurrence_Time",3)!= -1 && _Check_StrPossion_Res("Latest_Time_Fault_Occurrence_Time",3)!= -1)
    {
      int Sw_temp;
      _Set_Ready(Struct_Ready.Ready_Active);
      snprintf(Time_First,elCount(Time_First),"%s","");
      Sw_temp = _Check_StrPossion_Res("LocalTime",1);
      _85_Check_DTC(1,0);
      _Send_Diag(6,ID,Data_Send);
      _Check_19_NoFreeze(SendData,"First_Time_Fault_Occurrence_Time");
      _Set_Ready(0);
      _Step_1904("LocalTime",0); //取第0-3组数据
      snprintf(Time_First,elCount(Time_First),"%s%s",Time_First,mixArray[Sw_temp].LocalTime_Value);
      _Close_One_Node(DTC_19[Pos_1904]);
      _Send_Diag(6,ID,Data_Send);
      _Check_1906_Time(SendData,mixArray[Sw_temp].LocalTime_Value,mixArray[Sw_temp].LocalTime_Value);
      _Open_One_Node(DTC_19[Pos_1904]);
      _Send_Diag(6,ID,Data_Send);
      _Check_1906_Time(SendData,mixArray[Sw_temp].LocalTime_Value,mixArray[Sw_temp].LocalTime_Value);
      _Step_1904("LocalTime",1); //取第0-3组数据
      _Close_One_Node(DTC_19[Pos_1904]);
      _Send_Diag(6,ID,Data_Send);
      _Check_1906_Time(SendData,Time_First,mixArray[Sw_temp].LocalTime_Value);
      _Open_One_Node(DTC_19[Pos_1904]);
      _Send_Diag(6,ID,Data_Send);
      _Check_1906_Time(SendData,Time_First,mixArray[Sw_temp].LocalTime_Value);
      _Step_1904("LocalTime",2); //取第0-3组数据
      _Close_One_Node(DTC_19[Pos_1904]);
      _Send_Diag(6,ID,Data_Send);
      _Check_1906_Time(SendData,Time_First,mixArray[Sw_temp].LocalTime_Value);
      _Open_One_Node(DTC_19[Pos_1904]);
    }
    else
      _WriteEx_and_Report("First_Time_Fault_Occurrence_Time","该项目内无此测试项");
  }
}
_19_Serve_14(dword ID,byte Session) /*19 0A*/
{
  byte Data_Send[2] = {0x19,0x0a};
  dword DTC_Rx[500];
  dword DTC_in_ALL_DTC[500];
  dword DTC_Repeat[200][2];
  int DTC_Rx_Num;
  dword Byte_H,Byte_M,Byte_L;
  int LenRx,m,SWhere;
  DTC_Rx_Num=0;
  m = 0;
  
  if(ID==funreq_ID && Fun_19==0)
    _WriteEx_and_Report("","19服务不支持功能寻址");
  else
  {
    _Send_Diag_NoTime(2,ID,Data_Send);
    if(testWaitForMessage(Response_ID,50)==1)
      testStepPass("","收到首帧响应时间在50ms内");
    else
      testStepfail("","收到首帧响应时间在50ms外");
    testWaitForDiagResponse(SendData,4000);
    if(diagGetLastResponseCode(SendData)==-1)
    {
      LenRx = DiagGetRespPrimitiveSize(SendData);
      DTC_Rx_Num = (LenRx -3 )/4;
      if(DTC_Rx_Num != ALL_DTC_Num)
        testStepfail("","预期DTC个数与实际DTC个数不等，预期为%d个，实际为%d个",ALL_DTC_Num,DTC_Rx_Num);
      else
        testStepPass("","预期DTC个数与实际DTC个数一致，实际为%d个",ALL_DTC_Num);
      for(i=0;i<DTC_Rx_Num;i++)
      {
        Byte_H = (dword)diagGetRespPrimitiveByte(SendData,i*4 + 3 + 0);
        Byte_M = (dword)diagGetRespPrimitiveByte(SendData,i*4 + 3 + 1);
        Byte_L = (dword)diagGetRespPrimitiveByte(SendData,i*4 + 3 + 2);
        DTC_Rx[i] = Byte_H<<16 | Byte_M<<8 | Byte_L ;
      }
      for(i=0;i<DTC_Rx_Num;i++)
      {
        SWhere = _Check_Dword_in_Num(DTC_Rx[i],ALL_DTC,ALL_DTC_Num);
        DTC_Repeat[i][0] = DTC_Rx[i]; /*装载所有DTC用于重复验证*/
        DTC_Repeat[i][1] = 0;
        if(SWhere == -1)
           testStepFail("","DTC = 0x%X 为非预期DTC",DTC_Rx[i]);
      }
      for(i=0;i<DTC_Rx_Num;i++)
      {
        SWhere = _Check_Dword_in_Num(DTC_Rx[i],DTC_Repeat,DTC_Rx_Num);
        if(SWhere != -1)
          DTC_Repeat[SWhere][1]+=1;
      }
      for(i=0;i<DTC_Rx_Num;i++)
      {
        if(DTC_Repeat[i][1]>1)
        {
          writeEx(-3,0,"DTC 0x%06X 重复",DTC_Repeat[i][0]);
          testStepFail("","获取到重复的DTC 0x%06X",DTC_Repeat[i][0]);
        }
      }
      for(i=0;i<ALL_DTC_Num;i++)
      {
        SWhere = _Check_Dword_in_Num(ALL_DTC[i],DTC_Rx,DTC_Rx_Num);
        if(SWhere == -1)
           testStepFail("","DTC = 0x%X 预期DTC未获取到",ALL_DTC[i]);
        else
          testStepPass("","0x%X 已获取到",ALL_DTC[i]);
      }
    }
    else
      testStepfail("","收到响应时间在4s外");
  }
}
_19_Serve_15(dword ID,byte Session) /*SuppressBit*/
{
  byte Data_Send_1[100];
  int Len;
  int Return_Len;
  int i,Serve_Pos,Pos;
  Serve_Pos = _Check_Serve(0x19,0,0);
  if(ID==funreq_ID && Fun_19==0)
    _WriteEx_and_Report("","19服务不支持功能寻址");
  else
  {
    Pos = Get_Node_Pos(Node_1904,1);
    StepByGeely3_0(0x19,1);
    _Close_One_Node(DTC_19[Pos]);
    for(i=0;i<Serve_Data[Serve_Pos].Serve_Fun_Count;i++)
    {
      Return_Len = _Get_19_ServeData(Data_Send_1,Serve_Data[Serve_Pos].Serve_Fun[i]);
      Data_Send_1[1] = Serve_Data[Serve_Pos].Serve_Fun[i] |0x80;
      _Send_Diag(Return_Len,ID,Data_Send_1);
      if(Serve_Data[Serve_Pos].RSP[i]==0)
        _TestResult(SendData,ID,"",NRC12);
      else
        _TestResult(SendData,ID,"",0);
    }
    _Open_One_Node(DTC_19[Pos]);
  }
}
_19_Serve_16(dword ID,byte Session) /*NRC12*/
{
  byte Data_Send_1[2] = {0x19,0x01};
  int i,Serve_Pos;
  int Len;
  if(ID==funreq_ID && Fun_19==0)
    _WriteEx_and_Report("","19服务不支持功能寻址");
  else
  {
    Serve_Pos = _Check_Serve(0x19,0,0);
    for(i=0;i<=0xff;i++)
    {
      Data_Send_1[1] = i;
      testWaitForTimeout(100);
      if(_Check_Serve(0x19,i,4)!= -1)
        continue;
      else if(_Check_Serve(0x19,(i&0x7F),4)!= -1 && _Check_Serve(0x19,(i&0x7F),9)==1)
        continue;
      Len =6;
      if(i==0x81 || i==0x82 )
        Len = 3;
      else if(i==0x8A)
        Len = 2;
      _Send_Diag(Len,ID,Data_Send_1);
      _TestResult(SendData,ID,"",NRC12);
    }
  }
}
_19_Serve_17(dword ID,byte Session) /*NRC13*/
{
  byte Data_Send_1[3] = {0x19,0x01,0x09};
  byte Data_Send_2[6] = {0x19,0x04,0x0,0x0,0x0,0xFF};
  byte DTC_H,DTC_M,DTC_L;
  int i,j,Len,Serve_Pos;
  Len = _Check_CANFD_Flage();
  if(ID==funreq_ID && Fun_19==0)
    _WriteEx_and_Report("","19服务不支持功能寻址");
  else
  {
    Serve_Pos = _Check_Serve(0x19,0,0);
    DTC_H = (DTC_19[1][1]>>16);
    DTC_M = (DTC_19[1][1]>>8);
    DTC_L = (DTC_19[1][1]&0xFF);
    Data_Send_2[2] = DTC_H;
    Data_Send_2[3] = DTC_M;
    Data_Send_2[4] = DTC_L;
    
    for(j=0;j<Serve_Data[Serve_Pos].Serve_Fun_Count;j++)
    {
      Data_Send_1[1] = Serve_Data[Serve_Pos].Serve_Fun[j];
      Data_Send_2[1] = Serve_Data[Serve_Pos].Serve_Fun[j];
      for(i=1;i<=Len;i++)
      {
        if(Data_Send_1[1] == 0x01 || Data_Send_1[1] == 0x02)
        {
          if(i==3)
            continue;
          _Send_Diag(i,ID,Data_Send_1);
          _TestResult(SendData,ID,"",NRC13);
        }
        else if(Data_Send_1[1] == 0x04 || Data_Send_1[1] == 0x06)
        {
          if(i==6)
            continue;
          _Send_Diag(i,ID,Data_Send_2);
          _TestResult(SendData,ID,"",NRC13);
        }
        else
        {
          if(i==2)
            continue;
          _Send_Diag(i,ID,Data_Send_2);
          _TestResult(SendData,ID,"",NRC13);
        }
      }
    }
  }
}
_19_Serve_18(dword ID,byte Session) /*NRC31*/
{
  byte Data_Send_1[6] = {0x19,0x04,0x0,0x0,0x0,0xFF};
  qword Ex_Data_Record_Num[30];
  byte DTC_H,DTC_M,DTC_L;
  dword Range;
  dword i,j,m,n;
  int k,Serve_Pos,Fun_Pos;
  if(ID==funreq_ID && Fun_19==0)
    _WriteEx_and_Report("","19服务不支持功能寻址");
  else
  {
    DTC_H = (DTC_19[0][1]>>16);
    DTC_M = (DTC_19[0][1]>>8);
    DTC_L = (DTC_19[0][1]&0xFF);
    _Close_One_Node(DTC_19[0]);
    Serve_Pos = _Check_Serve(0x19,0x06,0);
    Fun_Pos = _Check_Serve(0x19,0x06,4);
    if(Fun_Pos == -1)
      k = 1;
    else
      k = 2;
    for(j=0;j<k;j++)
    {
      if(j==0)
        Data_Send_1[1] = 0x04;
      else
        Data_Send_1[1] = 0x06;
      for(i=0;i<=255;i++)
      {
        do{
          Range = random(0xFFFFFE);
        }while(Range<(DTC_H) || ( _Check_Dword_in_Num(Range,ALL_DTC,ALL_DTC_Num)!=-1));
        Data_Send_1[2] = (Range>>16);
        Data_Send_1[3] = (Range>>8);
        Data_Send_1[4] = (Range&0xFF);
        if(j==0)
        {
          Data_Send_1[5] = 0x01;
          _Send_Diag(6,ID,Data_Send_1);
          _TestResult(SendData,ID,"",NRC31);
          testWaitForTimeout(20);
        }
        Data_Send_1[5] = 0xff;
        _Send_Diag(6,ID,Data_Send_1);
        _TestResult(SendData,ID,"",NRC31);
        testWaitForTimeout(20);
      }
      Data_Send_1[2] = DTC_H;
      Data_Send_1[3] = DTC_M;
      Data_Send_1[4] = DTC_L;
      if(j==1)
      {
        n=1;
        for(m=0;m<Serve_Data[Serve_Pos].Serve_Para_Count[Fun_Pos];m++)
        {
          if(Serve_Data[Serve_Pos].Serve_Para[Fun_Pos][m]==1)
            continue;
          Ex_Data_Record_Num[n] = Serve_Data[Serve_Pos].Serve_Para[Fun_Pos][m];
          n++;
        }
        Ex_Data_Record_Num[0] = 1;
      }
      for(i=0;i<0xff;i++)
      {
        if(j==0)
        {
          if(_Check_Dword_in_Num(i,Freeze_Frame_Number,Freeze_Frame_Number_Count)!=-1)
            continue;
        }
        else
        {
          if(_Check_Dword_in_Num(i,Ex_Data_Record_Num,n)!=-1)
            continue;
        }
        Data_Send_1[5] = i;
        _Send_Diag(6,ID,Data_Send_1);
        _TestResult(SendData,ID,"",NRC31);
      }
      _Open_One_Node(DTC_19[0]);
    }
  }
}
_19_Serve_19(dword ID,byte Session) /*19 01/02*/
{
  byte Data_Send_1[3] = {0x19,0x01,0x0};
  byte Data_Send_2[3] = {0x19,0x02,0x0};
  int i;
  int DTC_01_Count;
  int Pos;
  if(ID==funreq_ID && Fun_19==0)
    _WriteEx_and_Report("","19服务不支持功能寻址");
  else
  {
    Pos = _Check_Serve(0x19,1,4);
    StepByGeely3_0(0x19,1);
    _Close_One_Node(DTC_19[0]);
    Get_DTC_FromRequest(0x09);//装载所有能够报出来的DTC
    for(i=0;i<=0xff;i++)
    {
      Data_Send_1[2] = i;
      Data_Send_2[2] = i;
      if(Pos != -1)
      {
        _Send_Diag(3,ID,Data_Send_1);
        DTC_01_Count = _Check_1901(SendData);
        _Send_Diag(3,ID,Data_Send_2);
        DTC_Check_For_bit(SendData,DTC_01_Count);
      }
      else
      {
        _Send_Diag(3,ID,Data_Send_2);
        DTC_Check_For_bit(SendData,-1);
      }
      // if( (i & DTC_19[0][2])>0)
      // {
      //   if(Pos != -1)
      //   {
      //     _Send_Diag(3,ID,Data_Send_1);
      //     DTC_01_Count = _Check_1901(SendData);
      //     _Send_Diag(3,ID,Data_Send_2);
      //     DTC_Check_For_bit(SendData,DTC_01_Count);
      //     // _Check_190201(SendData,DTC_19[0][1],DTC_19[0][2],DTC_01_Count);
      //   }
      //   else
      //   {
      //     _Send_Diag(3,ID,Data_Send_2);
      //     DTC_Check_For_bit(SendData,-1);
      //     // _Check_190201(SendData,DTC_19[0][1],DTC_19[0][2],-1);
      //   }
      // }
      // else
      // {
      //   if(Pos != -1)
      //   {
      //     _Send_Diag(3,ID,Data_Send_1);
      //     DTC_01_Count = _Check_1901(SendData);
      //     _Send_Diag(3,ID,Data_Send_2);
      //     DTC_Check_For_bit(SendData,DTC_01_Count);
      //     // _Check_190201(SendData,0,0,DTC_01_Count);
      //   }
      //   else
      //   {
      //     _Send_Diag(3,ID,Data_Send_2);
      //     DTC_Check_For_bit(SendData,-1);
      //     // _Check_190201(SendData,DTC_19[0][1],DTC_19[0][2],-1);
      //   }
      // }
    }
    _Open_One_Node(DTC_19[0]);
  }
}

_19_Serve_20(dword ID,byte Session) /*NRC优先级*/
{
  int Serve_Pos,i,j;
  byte Send_Data[100];
  char Check_Str[100];
  
  Serve_Pos = _Check_Serve(0x19,0,0);
  if(_Check_Serve_IDAndSess(0x19,ID,Session) == 1)
  {
    Send_Data[0] = 0x19;
    for(j=0;j<Serve_Data[Serve_Pos].Serve_Fun_Count;j++)
    {
      _Set_NRC_Step(0x19,Serve_Data[Serve_Pos].Serve_Fun[j],6,Send_Data);
      if(Fun_NRC_Count == 0)
      {
        _WriteEx_and_Report("","未输入NRC，跳过测试");
        continue;
      }
      snprintf(Check_Str,elCount(Check_Str),"%s","");
      snprintf(Check_Str,elCount(Check_Str),"开始测试19服务NRC优先级 : 0x19 0x%02X",Serve_Data[Serve_Pos].Serve_Fun[j]);
      writeEx(-3,0,"----------------------------------------------");
      _WriteEx_and_Report("",Check_Str);
      writeEx(-3,0,"----------------------------------------------");
      for(i=0;i<=Fun_NRC_Count;i++)
      {
        if(i>0) //第一次反馈最高优先级不做处理,其余依次恢复
        {
          _Recover_NRC_Step(Fun_NRC[i-1],Serve_Pos,j,Send_Data);
          if((Serve_Data[Serve_Pos].Serve_Fun[j] == 0x04 || Serve_Data[Serve_Pos].Serve_Fun[j]==0x06) && Fun_NRC[i-1]==0x31 && NRC31_total==1)
          {
            _Send_Diag(Fun_NRC_Send_Len,ID,Send_Data);
            _TestResult(SendData,ID,"",NRC31);
            Send_Data[5] = Serve_Data[Serve_Pos].Serve_Para[j][0];
          }
        }
        if(i==Fun_NRC_Count)
        {
          if(Serve_Data[Serve_Pos].Serve_Fun[j] == 0x01 || Serve_Data[Serve_Pos].Serve_Fun[j]==0x02)
            Send_Data[Fun_NRC_Send_Len -1] = 0x09;
          else if(Serve_Data[Serve_Pos].Serve_Fun[j] == 0x04 || Serve_Data[Serve_Pos].Serve_Fun[j]==0x06)
            Send_Data[Fun_NRC_Send_Len -1] = Serve_Data[Serve_Pos].Serve_Para[j][0];
        }
        if(i<Fun_NRC_Count)
          _WriteEx_and_Report("","/----- 测试NRC = 0x%02X -----/",Fun_NRC[i]);
        _Send_Diag(Fun_NRC_Send_Len,ID,Send_Data);
        if(i == Fun_NRC_Count)
        {
          if(Send_Data[1] == 0x0A)
          {
            if(diagGetLastResponseCode(SendData)==0)
              testWaitForDiagResponse(SendData,3000);
          }
          _TestResult(SendData,ID,"",-1);
        }
        else
          _TestResult(SendData,ID,"",Fun_NRC[i]);
        testWaitForTimeout(100);
      }
      testWaitForTimeout(1000);
    }
  }
}

_19_Serve_21(dword ID,byte Session) /*故障老化验证*/
{
  byte Data_3[3]={0x19,0x02,0x01};
  byte Data_0[3]={0x19,0x02,0x89};
  if(ID==funreq_ID && Fun_19==0)
  {
    _WriteEx_and_Report("","19服务不支持功能寻址");
    _Send_Diag(3,ID,Data_3);
    _TestResult(SendData,ID,"",NRC7F);
  }
  else
  {
    dword Ex[2];
    int i;
    _Set_Ready(Struct_Ready.Ready_Active);
    if(Geely3_Flage == 1)
      testWaitForTimeout(6000);
    _85_Check_DTC(9,0);
    _Close_One_Node(DTC_19[1]);
    _85_Check_DTC(1,DTC_19[1][1]);
    _Open_One_Node(DTC_19[1]);
    _85_Check_DTC(9,DTC_19[1][1]);
    _Set_Ready(0);
    for(i=0;i<DTC_Aging_counter_max;i++)
    {
      _K15_OFF();
      testWaitForTimeout(K15_OFF_Time);
      _K15_On();
      _WriteEx_and_Report("","  第%d次上下电  ",i+1);
      if(strncmp(ECU_project,"Geely3.0",strlen(ECU_project)) == 0 && strlen(ECU_project) == strlen("Geely3.0"))
      {
        _Set_Ready(Struct_Ready.Ready_Active);
        testWaitForTimeout(7000);      
        _85_Check_DTC(9,DTC_19[1][1]);
         testWaitForTimeout(500);
        _Set_Ready(0);
         testWaitForTimeout(2000);
      }
      else
      {
        testWaitForTimeout(CAN_Init_Time);
        _85_Check_DTC(9,DTC_19[1][1]);
        testWaitForTimeout(500);
      }
    }
    _K15_OFF();
    testWaitForTimeout(K15_OFF_Time);
    _K15_On();
    if(strncmp(ECU_project,"Geely3.0",strlen(ECU_project)) == 0 && strlen(ECU_project) == strlen("Geely3.0"))
    {
      _Set_Ready(Struct_Ready.Ready_Active);
      testWaitForTimeout(7000);      
      _85_Check_DTC(9,0);
       testWaitForTimeout(500);
      _Set_Ready(0);
       testWaitForTimeout(2000);
    }
    else
    {
      testWaitForTimeout(CAN_Init_Time);
      _85_Check_DTC(9,0);
      testWaitForTimeout(500);
    }
  }
}
_19_Serve_22(dword ID,byte Session) /*19 02读取故障_上下电*/
{ 
  byte Data_3[3]={0x19,0x02,0x09};
  if(ID==funreq_ID && Fun_19==0)
    _WriteEx_and_Report("","19服务不支持功能寻址");
  else
  {
    _Power_Down();
    testWaitForTimeout(2000);
    _Power_Up();
    if(Session!=defsession)
      _SetSession(Session);
    StepByGeely3_0(0x19,1);
    diagStartTesterPresent(Cdd_Name);
    _Open_All();
    testWaitForTimeout(5000);
    _85_Check_DTC(9,0);
    _Close_One_Node(DTC_19[1]);
    _Send_Diag(3,ID,Data_3);
    _Check_190201(SendData,DTC_19[1][1],DTC_19[1][2]);
    
    _Open_One_Node(DTC_19[1]);
    testWaitForTimeout(1000);
    _Send_Diag(3,ID,Data_3);
    _Check_190201(SendData,DTC_19[1][1],DTC_19[1][2]);
    
    _Power_Down();
    testWaitForTimeout(2000);
    _Power_Up();
    testWaitForTimeout(CAN_Init_Time-500);
    if(Session!=defsession)
      _SetSession(Session);
    _Send_Diag(3,ID,Data_3);
    _Check_190201(SendData,DTC_19[1][1],DTC_19[1][2]);
    
    _Clear_DTC(phyreq_ID);
    testWaitForTimeout(500);
    _85_Check_DTC(9,0);
    
    _Power_Down();
    testWaitForTimeout(2000);
    _Power_Up();
    testWaitForTimeout(CAN_Init_Time);
    _85_Check_DTC(9,0);
  }
}
_19_Serve_22_1(dword ID,byte Session) /*19 02读取故障_11复位*/
{ 
  byte Data_3[3]={0x19,0x02,0x09};
  if(ID==funreq_ID && Fun_19==0)
    _WriteEx_and_Report("","19服务不支持功能寻址");
  else
  {
    _Power_Down();
    testWaitForTimeout(2000);
    _Power_Up();
    if(Session!=defsession)
      _SetSession(Session);
    StepByGeely3_0(0x19,1);
    diagStartTesterPresent(Cdd_Name);
    _Open_All();
    testWaitForTimeout(5000);
    _85_Check_DTC(9,0);
    _Close_One_Node(DTC_19[1]);
    _Send_Diag(3,ID,Data_3);
    _Check_190201(SendData,DTC_19[1][1],DTC_19[1][2]); //当前
    
    _Open_One_Node(DTC_19[1]);
    testWaitForTimeout(1000);
    _Send_Diag(3,ID,Data_3);
    _Check_190201(SendData,DTC_19[1][1],DTC_19[1][2]); //历史
    
    _Set_11_Restoration();
    testWaitForTimeout(CAN_Init_Time);
    if(Session!=defsession)
      _SetSession(Session);
    _Send_Diag(3,ID,Data_3);
    _Check_190201(SendData,DTC_19[1][1],DTC_19[1][2]); //历史
    
    _Clear_DTC(phyreq_ID);
    testWaitForTimeout(500);
    _85_Check_DTC(9,0);
    
    _Set_11_Restoration();
    testWaitForTimeout(CAN_Init_Time);
    _85_Check_DTC(9,0);
  }
}
_19_Serve_22_2(dword ID,byte Session) /*19 02读取故障*/
{ 
  byte Data_1[3]={0x19,0x02,0x01};
  byte Data_2[3]={0x19,0x02,0x08};
  byte Data_3[3]={0x19,0x02,0x09};
  byte Data_4[3]={0x19,0x02,0xFF};
  if(ID==funreq_ID && Fun_19==0)
    _WriteEx_and_Report("","19服务不支持功能寻址");
  else
  {
    diagStartTesterPresent(Cdd_Name);
    _Power_Down();
    _K15_ON();
    testWaitForTimeout(CAN_Init_Time*0.5);
    _85_Check_DTC(9,0);
    testWaitForTimeout(CAN_Init_Time);
    StepByGeely3_0(0x19,1);
    _Close_One_Node(DTC_19[1]);
    _Send_Diag(3,ID,Data_3);
    _Check_190201(SendData,DTC_19[1][1],DTC_19[1][2]);
    _Send_Diag(3,ID,Data_1);
    _Check_190201(SendData,DTC_19[1][1],DTC_19[1][2]);
    _Open_One_Node(DTC_19[1]);
    testWaitForTimeout(1000);
    _Send_Diag(3,ID,Data_2);
    _Check_190201(SendData,DTC_19[1][1],DTC_19[1][2]);
    _Power_Down();
    testWaitForTimeout(2000);
    _Power_Up();
    testWaitForTimeout(CAN_Init_Time-500);
    _Send_Diag(3,ID,Data_4);
    _Check_190201(SendData,DTC_19[1][1],DTC_19[1][2]);
    
    _Clear_DTC(phyreq_ID);
    testWaitForTimeout(500);
    _Power_Down();
    testWaitForTimeout(2000);
    _Power_Up();
    testWaitForTimeout(CAN_Init_Time);
    _85_Check_DTC(9,0);
  }
}

void General_31_AngCal()
{
  byte AngCal[10],AngCal_Check[10];
  int i,RID_Pos,Send_Len,Check_Flage,Ready_Flage;
  dword RID;
  float AngNow;
  char Common[50];
  _get_Arry("Angle_Calibration");
  _Get_AngleSig();
  if(Arry_Len>1)
  {
    Check_Flage = 0;Ready_Flage = 0;
    RID = (Arry_Data[2]<<8)|Arry_Data[3];
    Send_Len = Arry_Len;
    for(i=0;i<Arry_Len;i++)
    {
      AngCal[i] = Arry_Data[i];
      AngCal_Check[i] = Arry_Data[i];
    }
    RID_Pos = _Check_Serve(AngCal[1],RID,12);
    if(Serve_31_Hex[RID_Pos].Control_Type_Count >=2)
    {
      Check_Flage = 1;
      AngCal_Check[1] = Serve_31_Hex[RID_Pos].Control_Type[1];
    }
    if((Serve_31_Hex[RID_Pos].Serve_NRC22[0]&0x20) == 1)
      Ready_Flage = 1;
  }
  else
  {
    _WriteEx_and_Report("","Angle_Calibration数组为空");
    return;
  }
  for(i=0;i<3;i++)
  {
    if(getSignal(Struct_Ready.Ready_Sig) == 0)
      _Set_Ready(Struct_Ready.Ready_Active);
    testWaitForTimeout(1000);
    if(i == 0)
      _TestWaitForTesterConfirmation("向左侧转动方向盘，使其角度不为0");
    else
      _TestWaitForTesterConfirmation("向右侧转动方向盘，使其角度不为0");
    _unlockECU();
    if(Ready_Flage == 1)
      _Set_Ready(0);
    _Send_Diag(Send_Len,phyreq_ID,AngCal);
    _Check_31Routine_Rx(AngCal,1);
    if(Check_Flage == 1)
    {
      testWaitForTimeout(200);
      _Send_Diag(Send_Len,phyreq_ID,AngCal_Check);
      _Check_31Routine_Rx(AngCal_Check,1);
    }
    AngNow = getSignal(Tx_AngleSig);
    if(AngNow>1 || AngNow<-1)
      testStepfail("","对中完毕后角度误差过大，期望为0 ± 1°,实际为 %.1f°",AngNow);
    else
      testSteppass("","对中完毕后角度误差在0 ± 1°范围内");
    if(i==0)
    {
      snprintf(Common,elCount(Common),"正常上下电");
      _Set_Ready(0);
      testWaitForTimeout(1000);
      _K15_OFF();
      testWaitForTimeout(3000);
      _K15_ON();
      testWaitForTimeout(2000);
      _Set_Ready(Struct_Ready.Ready_Active);
    }
    else if(i ==1)
    {
      snprintf(Common,elCount(Common),"11复位");
      _Set_11_Restoration(0);
    }
    else if(i ==2)
    {
      snprintf(Common,elCount(Common),"异常断电");
      _K30_OFF();
      testWaitForTimeout(3000);
      _K30_ON();
      testWaitForTimeout(2000);
    }
    AngNow = getSignal(Tx_AngleSig);
    if(AngNow>1 || AngNow<-1)
      testStepfail("","%s后，角度误差过大，期望为0 ± 1°,实际为 %.1f°",Common,AngNow);
    else
      testSteppass("","%s后，角度误差在0 ± 1°范围内",Common);
  }
  _Set_Ready(Struct_Ready.Ready_Active);
  _Set_CarSpd(10);
  testWaitForTimeout(1000);
  _TestWaitForTesterConfirmation("左右打方向盘，验证回正功能是否正常");
  _Set_CarSpd(0);
}

void General_31_AngCal_Clear()
{
  byte AngCal_Clear[10],AngCal_Check[10],Ang_Cal[10];
  int i,RID_Pos,Send_Len,Check_Flage,Ready_Flage,Send_Len_Cail;
  dword RID;
  float AngNow;
  char Common[50];

  diagStartTesterPresent(Cdd_Name);
  _get_Arry("Angle_Calibration");
  {
    Send_Len_Cail = Arry_Len;
    for(i=0;i<Arry_Len;i++)
      Ang_Cal[i] = Arry_Data[i];
  }
  _get_Arry("Clear_Angle_Calibration");
  _Get_AngleSig();
  if(Arry_Len>1)
  {
    Check_Flage = 0;Ready_Flage = 0;
    RID = (Arry_Data[2]<<8)|Arry_Data[3];
    Send_Len = Arry_Len;
    for(i=0;i<Arry_Len;i++)
    {
      AngCal_Clear[i] = Arry_Data[i];
      AngCal_Check[i] = Arry_Data[i];
    }
    RID_Pos = _Check_Serve(AngCal_Clear[1],RID,12);
    if(Serve_31_Hex[RID_Pos].Control_Type_Count >=2)
    {
      Check_Flage = 1;
      AngCal_Check[1] = Serve_31_Hex[RID_Pos].Control_Type[1];
    }
    if((Serve_31_Hex[RID_Pos].Serve_NRC22[0]&0x20) == 1)
      Ready_Flage = 1;
  }
  else
  {
    _WriteEx_and_Report("","Clear_Angle_Calibration数组为空");
    return;
  }
  for(i=0;i<3;i++)
  {
    _unlockECU();
    _Send_Diag(Send_Len_Cail,phyreq_ID,Ang_Cal);
    _Check_31Routine_Rx(Ang_Cal,1);
    testWaitForTimeout(200);
    _Check_DTC_Res(1,0,Ang_NotCal);
    if(getSignal(Struct_Ready.Ready_Sig) == 0)
      _Set_Ready(Struct_Ready.Ready_Active);
    testWaitForTimeout(1000);
    if(i == 0)
      _TestWaitForTesterConfirmation("向左侧转动方向盘，使其角度不为0");
    else
      _TestWaitForTesterConfirmation("向右侧转动方向盘，使其角度不为0");
    if(Ready_Flage == 1)
      _Set_Ready(0);
    _Send_Diag(Send_Len,phyreq_ID,AngCal_Clear);
    _Check_31Routine_Rx(AngCal_Clear,1);
    if(Check_Flage == 1)
    {
      testWaitForTimeout(200);
      _Send_Diag(Send_Len,phyreq_ID,AngCal_Check);
      _Check_31Routine_Rx(AngCal_Check,1);
    }
    testWaitForTimeout(200);
    _Check_DTC_Res(1,Ang_NotCal,0);
    AngNow = getSignal(Tx_AngleSig);
    if(AngNow != 0 && (AngNow < 740 || AngNow > -740))
      testStepfail("","清除对中后期望角度保持为0或无效值,实际为 %.1f°",AngNow);
    else
      testSteppass("","清除对中后角度为0或者无效值,当前为 %.1f°",AngNow);
    if(i==0)
    {
      snprintf(Common,elCount(Common),"正常上下电");
      _Set_Ready(0);
      testWaitForTimeout(1000);
      _K15_OFF();
      testWaitForTimeout(3000);
      _K15_ON();
      testWaitForTimeout(2000);
      _Set_Ready(Struct_Ready.Ready_Active);
    }
    else if(i ==1)
    {
      snprintf(Common,elCount(Common),"11复位");
      _Set_11_Restoration(0);
    }
    else if(i ==2)
    {
      snprintf(Common,elCount(Common),"异常断电");
      _K30_OFF();
      testWaitForTimeout(3000);
      _K30_ON();
      testWaitForTimeout(2000);
    }
    AngNow = getSignal(Tx_AngleSig);
    if(AngNow != 0 && (AngNow < 740 || AngNow > -740))
      testStepfail("","%s后，清除对中后期望角度保持为0或无效值,实际为 %.1f°",Common,AngNow);
    else
      testSteppass("","%s后，清除对中后角度保持为0或无效值",Common);
  }
  _Set_Ready(Struct_Ready.Ready_Active);
  _Set_CarSpd(10);
  testWaitForTimeout(1000);
  _TestWaitForTesterConfirmation("左右打方向盘，验证是否无回正功能");
  _Set_CarSpd(0);
  _unlockECU();
  _Send_Diag(Send_Len_Cail,phyreq_ID,Ang_Cal);
  _Check_31Routine_Rx(Ang_Cal,1);
  testWaitForTimeout(200);
  _SetSession(defsession);
}


void Geely_31_0206()
{
  byte SendData[6] = {0x31,0x01,0x02,0x06,0,0};
  int Send_Len,i;
  dword FunDID;
  int FunPos;
  dword Send_ID;
  
  Send_Len = 4;
  FunDID = 0x0206;
  _get_Arry("Pre_Programmed");
  if(Arry_Len>1)
  {
    FunDID = (Arry_Data[2]<<8)|Arry_Data[3];
    Send_Len = Arry_Len;
    for(i=0;i<Arry_Len;i++)
      SendData[i] = Arry_Data[i];
  }
  FunPos = _Check_Serve(0x01,FunDID,12);
  if(FunPos != -1)
  {
    _Set_Ready(0);
    _unlockECU();
    for(i=0;i<2;i++)
    {
      if(i == 0)
        Send_ID = phyreq_ID;
      else
        Send_ID = funreq_ID;
      _Set_CarSpd(NRC22_CarSpd-1);
      testWaitForTimeout(1000);
      _Send_Diag(Send_Len,Send_ID,SendData);
      _Check_31Routine_Rx(SendData,1);
      _Set_CarSpd(NRC22_CarSpd+1);
      testWaitForTimeout(1000);
      _Send_Diag(Send_Len,Send_ID,SendData);
      if((Serve_31_Hex[FunPos].Serve_NRC22[0]&1) == 1)
        _Check_31Routine_Rx(SendData,0);
      else
        _Check_31Routine_Rx(SendData,1);
      _Set_CarSpd(NRC22_CarSpd-1);
      testWaitForTimeout(500);
      _TestDisableMsg(Struct_CarSpd.Sig_Id);
      testWaitForTimeout(Struct_CarSpd.Lost_Time*1.5);
      _Send_Diag(Send_Len,Send_ID,SendData);
      _Check_31Routine_Rx(SendData,1);
      _TestEnableMsg(Struct_CarSpd.Sig_Id);
      testWaitForTimeout(2000);
    }
  }
}
void Geely_31_3080()
{
  byte SendData[6] = {0x31,0x01,0x30,0x80,0,0};
  int Send_Len,i;
  dword FunDID;
  int FunPos;
  dword Send_ID;
  
  Send_Len = 4;
  FunDID = 0x3080;
  _get_Arry("Clear_Angle_Calibration");
  if(Arry_Len>1)
  {
    FunDID = (Arry_Data[2]<<8)|Arry_Data[3];
    Send_Len = Arry_Len;
    for(i=0;i<Arry_Len;i++)
      SendData[i] = Arry_Data[i];
  }
  FunPos = _Check_Serve(0x01,FunDID,12);
  if(FunPos != -1)
  {
    _Set_Ready(Struct_Ready.Ready_Active);
    testWaitForTimeout(6000);
    _unlockECU();
    diagStartTesterPresent(Cdd_Name);
    for(i=0;i<2;i++)
    {
      if(i == 0)
        Send_ID = phyreq_ID;
      else
        Send_ID = funreq_ID;
      _TestWaitForTesterConfirmation("进行中位标定和角度自学习，查看外发角度以及自学习");
      _Send_Diag(Send_Len,Send_ID,SendData);
      _Check_31Routine_Rx(SendData,1);
      testWaitForTimeout(500);
      _Check_DTC_Res(1,Ang_NotCal,0);
      _TestWaitForTesterConfirmation("检测当前中位标定值以及角度自学习值情况");
      _get_Arry("Angle_Calibration");
      _Send_Diag(Arry_Len,Send_ID,Arry_Data);
      _Check_31Routine_Rx(Arry_Data,1);
      testWaitForTimeout(500);
      _Check_DTC_Res(1,0,Ang_NotCal);
      testWaitForTimeout(1000);
    }
  }
}

void Geely_31_3080_307B()
{
  byte SendData_Clear[6] = {0x31,0x01,0x30,0x80,0,0};
  byte SendData_Cail[6] = {0x31,0x01,0x30,0x7B,0,0};
  byte SendData_Check[6] = {0x31,0x03,0x30,0x7B,0,0};
  int Send_Len_Clear,Send_Len_Cail,i,j;
  dword Send_ID;
  
  Send_Len_Clear = 4;
  Send_Len_Cail = 4;
  _get_Arry("Clear_Angle_Calibration");
  if(Arry_Len>1)
  {
    Send_Len_Clear = Arry_Len;
    for(i=0;i<Arry_Len;i++)
      SendData_Clear[i] = Arry_Data[i];
  }
  _get_Arry("Angle_Calibration");
  if(Arry_Len>1)
  {
    Send_Len_Cail = Arry_Len;
    for(i=0;i<Arry_Len;i++)
      SendData_Cail[i] = Arry_Data[i];
    for(i=0;i<Arry_Len;i++)
      SendData_Check[i] = Arry_Data[i];
    SendData_Check[1] = 0x03;
  }

  {
    _Set_Ready(Struct_Ready.Ready_Active);
    testWaitForTimeout(6000);
    _unlockECU();
    diagStartTesterPresent(Cdd_Name);
    for(i=0;i<2;i++)
    {
      if(i == 0)
        Send_ID = phyreq_ID;
      else
        Send_ID = funreq_ID;
      _Send_Diag(Send_Len_Clear,Send_ID,SendData_Clear);
      _Check_31Routine_Rx(SendData_Clear,1);
      testWaitForTimeout(500);
      _Check_DTC_Res(1,Ang_NotCal,0);
      _Send_Diag(Send_Len_Cail,Send_ID,SendData_Cail);
      _Check_31Routine_Rx(SendData_Cail,1);
      testWaitForTimeout(200);
      _Send_Diag(Send_Len_Cail,Send_ID,SendData_Check);
      _Check_31Routine_Rx(SendData_Check,1);
      testWaitForTimeout(500);
      _Check_DTC_Res(1,0,Ang_NotCal);
      testWaitForTimeout(1000);
      for(j=0;j<3;j++)
      {
        if(j==0)
        {
          _K15_OFF();
          _K30_OFF();
          testWaitForTimeout(3000);
          _K15_ON();
          _K30_ON();
          testWaitForTimeout(7000);
        }
        else if(j==1)
        {
          _Set_Ready(0);
          _Set_CarSpd(0);
          testWaitForTimeout(1000);
          _K15_OFF();
          testWaitForTimeout(3000);
          _K15_ON();
          testWaitForTimeout(500);
          _Set_Ready(Struct_Ready.Ready_Active);
          testWaitForTimeout(6000);
        }
        else
          _TestWaitForTesterConfirmation("转动方向盘");
        _unlockECU();
        _Send_Diag(Send_Len_Clear,Send_ID,SendData_Clear);
        _Check_31Routine_Rx(SendData_Clear,1);
        testWaitForTimeout(500);
        _Check_DTC_Res(1,Ang_NotCal,0);
        _Send_Diag(Send_Len_Cail,Send_ID,SendData_Cail);
        _Check_31Routine_Rx(SendData_Cail,1);
        testWaitForTimeout(200);
        _Send_Diag(Send_Len_Cail,Send_ID,SendData_Check);
        _Check_31Routine_Rx(SendData_Check,1);
        testWaitForTimeout(500);
        _Check_DTC_Res(1,0,Ang_NotCal);
        testWaitForTimeout(1000);
      }
    }
  }
}

void Geely_31_3082()
{
  byte SendData_Close[5] = {0x31,0x01,0x30,0x82,0x00};
  byte SendData_Open[5] = {0x31,0x01,0x30,0x82,0x01};
  int Send_Len,i;
  dword Send_ID;
  
  Send_Len = 5;
  {
    diagStartTesterPresent(Cdd_Name);
    for(i=0;i<2;i++)
    {
      _unlockECU();
      if(i == 0)
        Send_ID = phyreq_ID;
      else
        Send_ID = funreq_ID;
      _TestWaitForTesterConfirmation("进行角度自学习，查看自学习情况，应当学习成功");
      _Send_Diag(Send_Len,Send_ID,SendData_Close);
      _Check_31Routine_Rx(SendData_Close,1);
      _TestWaitForTesterConfirmation("进行角度自学习，查看自学习情况，应当学习失败");
      {
        _Set_Ready(0);_Set_CarSpd(0);
        testWaitForTimeout(1000);
        _K15_OFF();
        testWaitForTimeout(3000);
        _K15_ON();
        testWaitForTimeout(500);
        _Set_Ready(Struct_Ready.Ready_Active);
        testWaitForTimeout(2000);
      }
      _TestWaitForTesterConfirmation("进行角度自学习，查看自学习情况，应当学习失败");
      _unlockECU();
      _Send_Diag(Send_Len,Send_ID,SendData_Open);
      _Check_31Routine_Rx(SendData_Open,1);
      _TestWaitForTesterConfirmation("进行角度自学习，查看自学习情况，应当学习成功");
      {
        _Set_Ready(0);_Set_CarSpd(0);
        testWaitForTimeout(1000);
        _K15_OFF();
        testWaitForTimeout(3000);
        _K15_ON();
        testWaitForTimeout(500);
        _Set_Ready(Struct_Ready.Ready_Active);
        testWaitForTimeout(2000);
      }
      _TestWaitForTesterConfirmation("进行角度自学习，查看自学习情况，应当学习成功");
      _unlockECU();
      _Send_Diag(Send_Len,Send_ID,SendData_Close);
      _Check_31Routine_Rx(SendData_Close,1);
      _TestWaitForTesterConfirmation("进行角度自学习，查看自学习情况，应当学习失败");
      {
        _K15_OFF();
        _K30_OFF();
        testWaitForTimeout(3000);
        _K15_ON();
        _K30_ON();
        testWaitForTimeout(3000);
      }
      _TestWaitForTesterConfirmation("进行角度自学习，查看自学习情况，应当学习失败");
      _unlockECU();
      _Send_Diag(Send_Len,Send_ID,SendData_Open);
      _Check_31Routine_Rx(SendData_Open,1);
      _TestWaitForTesterConfirmation("进行角度自学习，查看自学习情况，应当学习成功");
      {
        _K15_OFF();
        _K30_OFF();
        testWaitForTimeout(3000);
        _K15_ON();
        _K30_ON();
        testWaitForTimeout(3000);
      }
      _TestWaitForTesterConfirmation("进行角度自学习，查看自学习情况，应当学习成功");
      _SetSession(defsession);
      testWaitForTimeout(1000);
    }
  }
}

void Geely_31_3083()
{
  byte SendData_Clear[5] = {0x31,0x01,0x30,0x83,0x00};
  int Send_Len,i;
  dword Send_ID;
  
  Send_Len = 4;
  {
    diagStartTesterPresent(Cdd_Name);
    for(i=0;i<2;i++)
    {
      if(i == 0)
        Send_ID = phyreq_ID;
      else
        Send_ID = funreq_ID;
      {
        _TestWaitForTesterConfirmation("进行PDC学习，查看学习情况，应当学习成功");
        _unlockECU();
        _Send_Diag(Send_Len,Send_ID,SendData_Clear);
        _Check_31Routine_Rx(SendData_Clear,1);
        _TestWaitForTesterConfirmation("查看PDC学习值，学习值应当为0");
        {
          _Set_Ready(0);_Set_CarSpd(0);
          testWaitForTimeout(1000);
          _K15_OFF();
          testWaitForTimeout(3000);
          _K15_ON();
          testWaitForTimeout(500);
          _Set_Ready(Struct_Ready.Ready_Active);
          testWaitForTimeout(2000);
        }
        _TestWaitForTesterConfirmation("查看PDC学习值，学习值应当为0");
        _TestWaitForTesterConfirmation("进行PDC学习，查看学习情况，应当学习成功");
        _unlockECU();
        _Send_Diag(Send_Len,Send_ID,SendData_Clear);
        _Check_31Routine_Rx(SendData_Clear,1);
        _TestWaitForTesterConfirmation("查看PDC学习值，学习值应当为0");
      }
      _SetSession(defsession);
      testWaitForTimeout(1000);
    }
  }
}

void Geely_31_308B()
{
  byte SendData_Clear[5] = {0x31,0x01,0x30,0x8B,0x00};
  int Send_Len,i;
  dword Send_ID;
  
  Send_Len = 4;
  {
    diagStartTesterPresent(Cdd_Name);
    for(i=0;i<2;i++)
    {
      if(i == 0)
        Send_ID = phyreq_ID;
      else
        Send_ID = funreq_ID;
      {
        _TestWaitForTesterConfirmation("进行角度自学习，查看学习情况，应当学习成功");
        _unlockECU();
        _Send_Diag(Send_Len,Send_ID,SendData_Clear);
        _Check_31Routine_Rx(SendData_Clear,1);
        _TestWaitForTesterConfirmation("查看角度自学习值，学习值应当为0");
        {
          _Set_Ready(0);_Set_CarSpd(0);
          testWaitForTimeout(1000);
          _K15_OFF();
          testWaitForTimeout(3000);
          _K15_ON();
          testWaitForTimeout(500);
          _Set_Ready(Struct_Ready.Ready_Active);
          testWaitForTimeout(2000);
        }
        _TestWaitForTesterConfirmation("查看角度自学习值，学习值应当为0");
        _TestWaitForTesterConfirmation("进行角度自学习，查看学习情况，应当学习成功");
        _unlockECU();
        _Send_Diag(Send_Len,Send_ID,SendData_Clear);
        _Check_31Routine_Rx(SendData_Clear,1);
        _TestWaitForTesterConfirmation("查看角度自学习值，学习值应当为0");
      }
      _SetSession(defsession);
      testWaitForTimeout(1000);
    }
  }
}
void Geely_31_3088()
{
  byte SendData_Clear[5] = {0x31,0x01,0x30,0x88,0x00};
  int Send_Len,i;
  dword Send_ID;
  
  Send_Len = 4;
  {
    diagStartTesterPresent(Cdd_Name);
    for(i=0;i<2;i++)
    {
      if(i == 0)
        Send_ID = phyreq_ID;
      else
        Send_ID = funreq_ID;
      {
        _TestWaitForTesterConfirmation("进行左侧末端学习，查看学习情况，应当学习成功");
        _unlockECU();
        _Send_Diag(Send_Len,Send_ID,SendData_Clear);
        _Check_31Routine_Rx(SendData_Clear,1);
        _TestWaitForTesterConfirmation("查看末端学习值，学习值应当为初始值");
        _TestWaitForTesterConfirmation("进行右侧末端学习，查看学习情况，应当学习成功");
        _Send_Diag(Send_Len,Send_ID,SendData_Clear);
        _Check_31Routine_Rx(SendData_Clear,1);
        _TestWaitForTesterConfirmation("查看末端学习值，学习值应当为初始值");
        {
          _Set_Ready(0);_Set_CarSpd(0);
          testWaitForTimeout(1000);
          _K15_OFF();
          testWaitForTimeout(3000);
          _K15_ON();
          testWaitForTimeout(500);
          _Set_Ready(Struct_Ready.Ready_Active);
          testWaitForTimeout(2000);
        }
        _TestWaitForTesterConfirmation("查看末端学习值，学习值应当为初始值");
      }
      _SetSession(defsession);
      testWaitForTimeout(1000);
    }
  }
}

Geely_31_SentError()
{
  int i;
  byte Send_Data[10];
  _SetSession(exsession);
  _Set_11_Restoration();
  _TestWaitForTesterConfirmation("断开传感器");
  _unlockECU();
  for(i=0;i<Serve_31_Hex_Count;i++)
  {
    Send_Data[0] = 0x31;
    Send_Data[1] = Serve_31_Hex[i].Control_Type[0];
    Send_Data[2] = Serve_31_Hex[i].Routine[0];
    Send_Data[3] = Serve_31_Hex[i].Routine[1];
    if(Serve_31_Hex[i].Routine_Len == 5)
      Send_Data[4] = Serve_31_Hex[i].Control_Option[0][0];
    if(Send_Data[2] == 0x30 && Send_Data[3] == 0x7B)
    {
      _Send_Diag(Serve_31_Hex[i].Routine_Len,phyreq_ID,Send_Data);
      _TestResult(SendData,phyreq_ID,"",NRC31);
      Send_Data[1] = 0x03;
      _Send_Diag(Serve_31_Hex[i].Routine_Len,phyreq_ID,Send_Data);
      _Check_31Routine_Rx(Send_Data,2);
    }
    else
    {
      _Send_Diag(Serve_31_Hex[i].Routine_Len,phyreq_ID,Send_Data);
      _Check_31Routine_Rx(Send_Data,1);
    }
  }
  _TestWaitForTesterConfirmation("恢复传感器");
  _Set_11_Restoration();
}

void BYD_31_0203()
{
  byte Send_Data_31H[4] = {0x31,0x01,0x02,0x03};
  _Send_Diag(elcount(Send_Data_31H),phyreq_ID,Send_Data_31H);
  _Check_31Routine_Rx(Send_Data_31H,1);
  _Set_11_Restoration();
  _SetSession(exsession);
  _Send_Diag(elcount(Send_Data_31H),phyreq_ID,Send_Data_31H);
  _Check_31Routine_Rx(Send_Data_31H,1);
  _Power_Down();
  testWaitForTimeout(2000);
  _Power_Up();
  testWaitForTimeout(2000);
  _SetSession(exsession);
  _Send_Diag(elcount(Send_Data_31H),phyreq_ID,Send_Data_31H);
  _Check_31Routine_Rx(Send_Data_31H,1);
  _K30_OFF();
  testWaitForTimeout(2000);
  _K30_ON();
  testWaitForTimeout(2000);
  _SetSession(exsession);
  _Send_Diag(elcount(Send_Data_31H),phyreq_ID,Send_Data_31H);
  _Check_31Routine_Rx(Send_Data_31H,1);
  _Set_CarSpd(3);
  _Set_CarSpd_Invalid(Struct_CarSpd.Invalid_Value[0]);
  _TestDisableMsg(Struct_CarSpd.Sig_Id);
  testWaitForTimeout(Struct_CarSpd.Lost_Time*1.2);
  _SetSession(exsession);
  _Send_Diag(elcount(Send_Data_31H),phyreq_ID,Send_Data_31H);
  _Check_31Routine_Rx(Send_Data_31H,1);
  _Reset_CarSpd_Invalid();
  _TestEnableMsg(Struct_CarSpd.Sig_Id);
}

void BYD_31_AC00()
{
  byte Send_Data_31H[4] = {0x31,0x01,0xAC,0x00};
  byte Send_Data_31H_Check[4] = {0x31,0x03,0xAC,0x00};
  _Set_Ready(Struct_Ready.Ready_Active);
  _Set_CarSpd(10);
  _TestWaitForTesterConfirmation("转动方向盘，到一定角度后  维持  并点击YES");
  _unlockECU();
  _Send_Diag(elcount(Send_Data_31H),phyreq_ID,Send_Data_31H);
  _Check_31Routine_Rx(Send_Data_31H,1);
  _Send_Diag(elcount(Send_Data_31H_Check),phyreq_ID,Send_Data_31H_Check);
  _Check_31Routine_Rx(Send_Data_31H_Check,1);
  _TestWaitForTesterConfirmation("查看当前角度是否接近0°，然后松开方向盘");
  _Set_CarSpd(0);
  _Set_Ready(0);
  _K15_OFF();
  testWaitForTimeout(2000);
  _K15_ON();
  _Set_Ready(Struct_Ready.Ready_Active);
  testWaitForTimeout(2000);
  _TestWaitForTesterConfirmation("查看当前角度是否保持在0°附近，查看回正功能是否存在");
  _unlockECU();
  _Send_Diag(elcount(Send_Data_31H),phyreq_ID,Send_Data_31H);
  _Check_31Routine_Rx(Send_Data_31H,1);
  _Send_Diag(elcount(Send_Data_31H_Check),phyreq_ID,Send_Data_31H_Check);
  _Check_31Routine_Rx(Send_Data_31H_Check,1);
  _Set_11_Restoration(0);
  _TestWaitForTesterConfirmation("查看当前角度是否保持在0°附近，查看回正功能是否存在");
  _unlockECU();
  _Send_Diag(elcount(Send_Data_31H),phyreq_ID,Send_Data_31H);
  _Check_31Routine_Rx(Send_Data_31H,1);
  _Send_Diag(elcount(Send_Data_31H_Check),phyreq_ID,Send_Data_31H_Check);
  _Check_31Routine_Rx(Send_Data_31H_Check,1);
  _Set_CarSpd(10);
  _K30_OFF();
  testWaitForTimeout(2000);
  _K30_ON();
  testWaitForTimeout(2000);
  _TestWaitForTesterConfirmation("查看当前角度是否保持在0°附近，查看回正功能是否存在");
  _unlockECU();
  _Send_Diag(elcount(Send_Data_31H),phyreq_ID,Send_Data_31H);
  _Check_31Routine_Rx(Send_Data_31H,1);
  _Send_Diag(elcount(Send_Data_31H_Check),phyreq_ID,Send_Data_31H_Check);
  _Check_31Routine_Rx(Send_Data_31H_Check,1);
  _TestWaitForTesterConfirmation("查看当前角度是否保持在0°附近，查看回正功能是否存在");
}

void BYD_31_F004()
{
  byte Send_Data_31H[4] = {0x31,0x01,0xF0,0x04};
  byte Send_Data_31H_Check[4] = {0x31,0x03,0xF0,0x04};
  _Set_Ready(Struct_Ready.Ready_Active);
  _Set_CarSpd(0);
  _TestWaitForTesterConfirmation("进行PDC学习，使其值不为0");
  _Power_Down();
  testWaitForTimeout(2000);
  _Power_Up();

  _unlockECU();
  _Send_Diag(elcount(Send_Data_31H),phyreq_ID,Send_Data_31H);
  _Check_31Routine_Rx(Send_Data_31H,1);
  _Send_Diag(elcount(Send_Data_31H_Check),phyreq_ID,Send_Data_31H_Check);
  _Check_31Routine_Rx(Send_Data_31H_Check,1);
  _TestWaitForTesterConfirmation("查看当前PDC学习值是否为0");
  _Power_Down();
  testWaitForTimeout(2000);
  _Power_Up();
  _TestWaitForTesterConfirmation("已正常上下电，再次查看当前PDC学习值是否为0");

  _TestWaitForTesterConfirmation("再次进行PDC学习，使其值不为0");
  _Power_Down();
  testWaitForTimeout(2000);
  _Power_Up();
  _TestWaitForTesterConfirmation("查看PDC学习值，是否不为0");
  _unlockECU();
  _Send_Diag(elcount(Send_Data_31H),phyreq_ID,Send_Data_31H);
  _Check_31Routine_Rx(Send_Data_31H,1);
  _Send_Diag(elcount(Send_Data_31H_Check),phyreq_ID,Send_Data_31H_Check);
  _Check_31Routine_Rx(Send_Data_31H_Check,1);
  _TestWaitForTesterConfirmation("已11复位，再次查看当前PDC学习值是否为0");
  _Set_11_Restoration(0);

  _TestWaitForTesterConfirmation("再次进行PDC学习，使其值不为0");
  _Power_Down();
  testWaitForTimeout(2000);
  _Power_Up();
  _TestWaitForTesterConfirmation("查看PDC学习值，是否不为0");
  _unlockECU();
  _Send_Diag(elcount(Send_Data_31H),phyreq_ID,Send_Data_31H);
  _Check_31Routine_Rx(Send_Data_31H,1);
  _Send_Diag(elcount(Send_Data_31H_Check),phyreq_ID,Send_Data_31H_Check);
  _Check_31Routine_Rx(Send_Data_31H_Check,1);
  _K30_OFF();
  testWaitForTimeout(2000);
  _K30_ON();
  testWaitForTimeout(2000);
  _TestWaitForTesterConfirmation("已异常复位，再次查看当前PDC学习值是否为0");

  _TestWaitForTesterConfirmation("再次进行PDC学习，使其值不为0");
  _Power_Down();
  testWaitForTimeout(2000);
  _Power_Up();
  _TestWaitForTesterConfirmation("查看PDC学习值，是否不为0");
  _unlockECU();
  _Send_Diag(elcount(Send_Data_31H),phyreq_ID,Send_Data_31H);
  _Check_31Routine_Rx(Send_Data_31H,1);
  _Send_Diag(elcount(Send_Data_31H_Check),phyreq_ID,Send_Data_31H_Check);
  _Check_31Routine_Rx(Send_Data_31H_Check,1);
}

void BYD_31_3001()
{
  byte Send_Data_31HAng[4] = {0x31,0x01,0xAC,0x00};
  byte Send_Data_31H[4] = {0x31,0x01,0x30,0x01};
  byte Send_Data_31H_Check[4] = {0x31,0x03,0x30,0x01};
  _Set_Ready(Struct_Ready.Ready_Active);
  _Set_CarSpd(0);
  _unlockECU();
  _Send_Diag(elcount(Send_Data_31HAng),phyreq_ID,Send_Data_31HAng);
  _Check_31Routine_Rx(Send_Data_31HAng,1);
  _TestWaitForTesterConfirmation("查看当前末端是否恢复到初始值");

  _TestWaitForTesterConfirmation("往左打学习左末端");
  _unlockECU();
  _Send_Diag(elcount(Send_Data_31H),phyreq_ID,Send_Data_31H);
  _Check_31Routine_Rx(Send_Data_31H,1);
  _Send_Diag(elcount(Send_Data_31H_Check),phyreq_ID,Send_Data_31H_Check);
  _Check_31Routine_Rx(Send_Data_31H_Check,1);
  _TestWaitForTesterConfirmation("监控左末端是否恢复到初始值");
  _Power_Down();
  testWaitForTimeout(2000);
  _Power_Up();
  _TestWaitForTesterConfirmation("监控左末端是否保持为初始值");

  _TestWaitForTesterConfirmation("往右打学习右末端");
  _unlockECU();
  _Send_Diag(elcount(Send_Data_31H),phyreq_ID,Send_Data_31H);
  _Check_31Routine_Rx(Send_Data_31H,1);
  _Send_Diag(elcount(Send_Data_31H_Check),phyreq_ID,Send_Data_31H_Check);
  _Check_31Routine_Rx(Send_Data_31H_Check,1);
  _TestWaitForTesterConfirmation("监控右末端是否恢复到初始值");
  _K30_OFF();
  testWaitForTimeout(2000);
  _K30_ON();
  testWaitForTimeout(2000);
  _TestWaitForTesterConfirmation("监控右末端是否保持为初始值");

  _TestWaitForTesterConfirmation("往左打学习左末端");
  _unlockECU();
  _Send_Diag(elcount(Send_Data_31H),phyreq_ID,Send_Data_31H);
  _Check_31Routine_Rx(Send_Data_31H,1);
  _Send_Diag(elcount(Send_Data_31H_Check),phyreq_ID,Send_Data_31H_Check);
  _Check_31Routine_Rx(Send_Data_31H_Check,1);
  _TestWaitForTesterConfirmation("监控左末端是否恢复到初始值");
  _Set_11_Restoration(0);
  _TestWaitForTesterConfirmation("监控左末端是否保持为初始值");

  _TestWaitForTesterConfirmation("往右打学习右末端");
  _unlockECU();
  _Send_Diag(elcount(Send_Data_31H),phyreq_ID,Send_Data_31H);
  _Check_31Routine_Rx(Send_Data_31H,1);
  _Send_Diag(elcount(Send_Data_31H_Check),phyreq_ID,Send_Data_31H_Check);
  _Check_31Routine_Rx(Send_Data_31H_Check,1);
}

void BYD_31_3002()
{
  byte Send_Data_AngCal[4] = {0x31,0x01,0xAC,0x00};
  byte Send_Data_AngClear[4] = {0x31,0x01,0x30,0x02};
  byte Send_Data_AngClear_Check[4] = {0x31,0x03,0x30,0x02};
  _Set_Ready(Struct_Ready.Ready_Active);
  _Set_CarSpd(10);
  _unlockECU();
  _Send_Diag(elcount(Send_Data_AngClear),phyreq_ID,Send_Data_AngClear);
  _Check_31Routine_Rx(Send_Data_AngClear,1);
  _Send_Diag(elcount(Send_Data_AngClear_Check),phyreq_ID,Send_Data_AngClear_Check);
  _Check_31Routine_Rx(Send_Data_AngClear_Check,1);
  testWaitForTimeout(1000);
  _Check_DTC_Res(1,Ang_NotCal,0);
  _TestWaitForTesterConfirmation("查看当前助力状态以及角度自学习是否不为初始值,末端是否保持初始值");
  _Set_11_Restoration(0);
  testWaitForTimeout(CAN_Init_Time+1000);
  _TestWaitForTesterConfirmation("已11复位，查看当前助力状态以及角度自学习是否不为初始值,末端是否保持初始值");
  _Check_DTC_Res(1,Ang_NotCal,0);
  
  _Set_Ready(0);
  _Set_CarSpd(0);
  _unlockECU();
  _Send_Diag(elcount(Send_Data_AngCal),phyreq_ID,Send_Data_AngCal);
  _Check_31Routine_Rx(Send_Data_AngCal,1);
  testWaitForTimeout(1000);
  _Check_DTC_Res(1,0,Ang_NotCal);
  _Send_Diag(elcount(Send_Data_AngClear),phyreq_ID,Send_Data_AngClear);
  _Check_31Routine_Rx(Send_Data_AngClear,1);
  _Send_Diag(elcount(Send_Data_AngClear_Check),phyreq_ID,Send_Data_AngClear_Check);
  _Check_31Routine_Rx(Send_Data_AngClear_Check,1);
  testWaitForTimeout(1000);
  _Check_DTC_Res(1,Ang_NotCal,0);
  _TestWaitForTesterConfirmation("查看当前助力状态以及角度自学习是否不为初始值,末端是否保持初始值");
  _Power_Down();
  testWaitForTimeout(2000);
  _Power_Up();
  testWaitForTimeout(CAN_Init_Time+1000);
  _Set_Ready(Struct_Ready.Ready_Active);
  _TestWaitForTesterConfirmation("已正常上下电，查看当前助力状态以及角度自学习是否不为初始值,末端是否保持初始值");
  _Check_DTC_Res(1,Ang_NotCal,0);
  
  _unlockECU();
  _Send_Diag(elcount(Send_Data_AngCal),phyreq_ID,Send_Data_AngCal);
  _Check_31Routine_Rx(Send_Data_AngCal,1);
  testWaitForTimeout(1000);
  _Check_DTC_Res(1,0,Ang_NotCal);
  _Send_Diag(elcount(Send_Data_AngClear),phyreq_ID,Send_Data_AngClear);
  _Check_31Routine_Rx(Send_Data_AngClear,1);
  _Send_Diag(elcount(Send_Data_AngClear_Check),phyreq_ID,Send_Data_AngClear_Check);
  _Check_31Routine_Rx(Send_Data_AngClear_Check,1);
  testWaitForTimeout(1000);
  _Check_DTC_Res(1,Ang_NotCal,0);
  _TestWaitForTesterConfirmation("查看当前助力状态以及角度自学习是否不为初始值,末端是否保持初始值");
  _K30_OFF();
  testWaitForTimeout(2000);
  _K30_ON();
  testWaitForTimeout(CAN_Init_Time+2000);
  _TestWaitForTesterConfirmation("已异常复位，查看当前助力状态以及角度自学习是否不为初始值,末端是否保持初始值");
  _Check_DTC_Res(1,Ang_NotCal,0);
  
  _unlockECU();
  _Send_Diag(elcount(Send_Data_AngCal),phyreq_ID,Send_Data_AngCal);
  _Check_31Routine_Rx(Send_Data_AngCal,1);
  testWaitForTimeout(1000);
  _Check_DTC_Res(1,0,Ang_NotCal);
  _Send_Diag(elcount(Send_Data_AngClear),phyreq_ID,Send_Data_AngClear);
  _Check_31Routine_Rx(Send_Data_AngClear,1);

  writeEx(-3,0,"测试完成，完成角度对中");
  _Send_Diag(elcount(Send_Data_AngCal),phyreq_ID,Send_Data_AngCal);
  _Check_31Routine_Rx(Send_Data_AngCal,1);
}

void BYD_31_A001()
{
  byte Send_Data_31H[4] = {0x31,0x01,0xA0,0x01};
  
  _TestWaitForTesterConfirmation("进行角度自学习，使其值不为初始值");
  _Power_Down();
  testWaitForTimeout(2000);
  _Power_Up();
  _unlockECU();
  _Send_Diag(elcount(Send_Data_31H),phyreq_ID,Send_Data_31H);
  _Check_31Routine_Rx(Send_Data_31H,1);
  _TestWaitForTesterConfirmation("查看当前值是否为初始值");
  _Power_Down();
  testWaitForTimeout(2000);
  _Power_Up();
  testWaitForTimeout(2000);
  _TestWaitForTesterConfirmation("已正常上下电，查看当前值是否为初始值");

  _TestWaitForTesterConfirmation("进行角度自学习，使其值不为初始值");
  _Power_Down();
  testWaitForTimeout(2000);
  _Power_Up();
  testWaitForTimeout(2000);
  _unlockECU();
  _Send_Diag(elcount(Send_Data_31H),phyreq_ID,Send_Data_31H);
  _Check_31Routine_Rx(Send_Data_31H,1);
  _K30_OFF();
  testWaitForTimeout(2000);
  _K30_ON();
  testWaitForTimeout(2000);
  _TestWaitForTesterConfirmation("已异常复位，查看当前值是否为初始值");

  
  _TestWaitForTesterConfirmation("进行角度自学习，使其值不为初始值");
  _Power_Down();
  testWaitForTimeout(2000);
  _Power_Up();
  testWaitForTimeout(2000);
  _unlockECU();
  _Send_Diag(elcount(Send_Data_31H),phyreq_ID,Send_Data_31H);
  _Check_31Routine_Rx(Send_Data_31H,1);
  _Set_11_Restoration(0);
  _TestWaitForTesterConfirmation("已11复位，查看当前值是否为初始值");

  _TestWaitForTesterConfirmation("进行角度自学习，使其值不为初始值");
  _Power_Down();
  testWaitForTimeout(2000);
  _Power_Up();
  testWaitForTimeout(2000);
  _unlockECU();
  _Send_Diag(elcount(Send_Data_31H),phyreq_ID,Send_Data_31H);
  _Check_31Routine_Rx(Send_Data_31H,1);
}

void BYD_31_3003_02()
{
  byte Send_Data_31H[5] = {0x31,0x03,0x30,0x03,0x00};
  byte Read_22H[3] = {0x22,0x00,0x0E};
  byte Rx22H[4] = {0x62,0x00,0x0E,0x00};

  Rx22H[3] = 0x0C;
  _Send_Diag(3,phyreq_ID,Read_22H);
  _Check_Response(SendData,4,Rx22H);
  
  _unlockECU();
  Send_Data_31H[4] = 0x00;
  Rx22H[3] = 0;
  _Send_Diag(elcount(Send_Data_31H),phyreq_ID,Send_Data_31H);
  _Check_31Routine_Rx(Send_Data_31H,1);
  testWaitForTimeout(1000);
  _Send_Diag(3,phyreq_ID,Read_22H);
  _Check_Response(SendData,4,Rx22H);
  _TestWaitForTesterConfirmation("请求激活WIR，验证WIR不可用");

  _Power_Down();
  testWaitForTimeout(2000);
  _Power_Up();
  _TestWaitForTesterConfirmation("已正常上下电，请求激活WIR，验证WIR不可用");
  Send_Data_31H[4] = 0x02;
  Rx22H[3] = 0x02;
  _unlockECU();
  _Send_Diag(elcount(Send_Data_31H),phyreq_ID,Send_Data_31H);
  _Check_31Routine_Rx(Send_Data_31H,1);
  testWaitForTimeout(1000);
  _Send_Diag(3,phyreq_ID,Read_22H);
  _Check_Response(SendData,4,Rx22H);
  _TestWaitForTesterConfirmation("请求激活WIR，验证WIR可用");
  _K30_OFF();
  testWaitForTimeout(2000);
  _K30_ON();
  testWaitForTimeout(2000);
  _TestWaitForTesterConfirmation("已异常复位，请求激活WIR，验证WIR可用");
  
  Send_Data_31H[4] = 0x00;
  Rx22H[3] = 0x00;
  _unlockECU();
  _Send_Diag(elcount(Send_Data_31H),phyreq_ID,Send_Data_31H);
  _Check_31Routine_Rx(Send_Data_31H,1);
  testWaitForTimeout(1000);
  _Send_Diag(3,phyreq_ID,Read_22H);
  _Check_Response(SendData,4,Rx22H);
  _TestWaitForTesterConfirmation("请求激活WIR，验证WIR不可用");
  _Set_11_Restoration();
  testWaitForTimeout(2000);
  _TestWaitForTesterConfirmation("已11复位，请求激活WIR，验证WIR不可用");

  Send_Data_31H[4] = 0x02;
  Rx22H[3] = 0x02;
  _unlockECU();
  _Send_Diag(elcount(Send_Data_31H),phyreq_ID,Send_Data_31H);
  _Check_31Routine_Rx(Send_Data_31H,1);
  testWaitForTimeout(1000);
  _Send_Diag(3,phyreq_ID,Read_22H);
  _Check_Response(SendData,4,Rx22H);
}

void BYD_31_3003_04()
{
  byte Send_Data_31H[5] = {0x31,0x03,0x30,0x03,0x00};
  byte Read_22H[3] = {0x22,0x00,0x0E};
  byte Rx22H[4] = {0x62,0x00,0x0E,0x00};

  _unlockECU();
  Send_Data_31H[4] = 0x00;
  Rx22H[3] = 0x00;
  _Send_Diag(elcount(Send_Data_31H),phyreq_ID,Send_Data_31H);
  _Check_31Routine_Rx(Send_Data_31H,1);
  testWaitForTimeout(1000);
  _Send_Diag(3,phyreq_ID,Read_22H);
  _Check_Response(SendData,4,Rx22H);
  _TestWaitForTesterConfirmation("进行PDC学习，查看是否学习失败");
  _Power_Down();
  testWaitForTimeout(2000);
  _Power_Up();
  _TestWaitForTesterConfirmation("已正常上下电，进行PDC学习，查看是否学习失败");

  Send_Data_31H[4] = 0x04;
  Rx22H[3] = 0x04;
  _unlockECU();
  _Send_Diag(elcount(Send_Data_31H),phyreq_ID,Send_Data_31H);
  _Check_31Routine_Rx(Send_Data_31H,1);
  testWaitForTimeout(1000);
  _Send_Diag(3,phyreq_ID,Read_22H);
  _Check_Response(SendData,4,Rx22H);
  _TestWaitForTesterConfirmation("进行PDC学习，查看是否学习成功");
  _K30_OFF();
  testWaitForTimeout(2000);
  _K30_ON();
  testWaitForTimeout(2000);
  _TestWaitForTesterConfirmation("已异常复位，进行PDC学习，查看是否学习成功");
  
  Send_Data_31H[4] = 0x00;
  Rx22H[3] = 0x00;
  _unlockECU();
  _Send_Diag(elcount(Send_Data_31H),phyreq_ID,Send_Data_31H);
  _Check_31Routine_Rx(Send_Data_31H,1);
  testWaitForTimeout(1000);
  _Send_Diag(3,phyreq_ID,Read_22H);
  _Check_Response(SendData,4,Rx22H);
  _TestWaitForTesterConfirmation("进行PDC学习，查看是否学习失败");
  _Set_11_Restoration();
  testWaitForTimeout(2000);
  _TestWaitForTesterConfirmation("已11复位，进行PDC学习，查看是否学习失败");

  Send_Data_31H[4] = 0x04;
  Rx22H[3] = 0x04;
  _unlockECU();
  _Send_Diag(elcount(Send_Data_31H),phyreq_ID,Send_Data_31H);
  _Check_31Routine_Rx(Send_Data_31H,1);
  testWaitForTimeout(1000);
  _Send_Diag(3,phyreq_ID,Read_22H);
  _Check_Response(SendData,4,Rx22H);
}

void BYD_31_3003_08()
{
  byte Send_Data_31H[5] = {0x31,0x03,0x30,0x03,0x00};
  byte Read_22H[3] = {0x22,0x00,0x0E};
  byte Rx22H[4] = {0x62,0x00,0x0E,0x00};

  _unlockECU();
  Send_Data_31H[4] = 0x00;
  Rx22H[3] = 0x00;
  _Send_Diag(elcount(Send_Data_31H),phyreq_ID,Send_Data_31H);
  _Check_31Routine_Rx(Send_Data_31H,1);
  testWaitForTimeout(1000);
  _Send_Diag(3,phyreq_ID,Read_22H);
  _Check_Response(SendData,4,Rx22H);
  _TestWaitForTesterConfirmation("进行角度学习，查看是否学习失败");
  _Power_Down();
  testWaitForTimeout(2000);
  _Power_Up();
  _TestWaitForTesterConfirmation("已正常上下电，进行角度学习，查看是否学习失败");

  Send_Data_31H[4] = 0x08;
  Rx22H[3] = 0x08;
  _unlockECU();
  _Send_Diag(elcount(Send_Data_31H),phyreq_ID,Send_Data_31H);
  _Check_31Routine_Rx(Send_Data_31H,1);
  testWaitForTimeout(1000);
  _Send_Diag(3,phyreq_ID,Read_22H);
  _Check_Response(SendData,4,Rx22H);
  _TestWaitForTesterConfirmation("进行角度自学习，查看是否学习成功");
  _K30_OFF();
  testWaitForTimeout(2000);
  _K30_ON();
  testWaitForTimeout(2000);
  _TestWaitForTesterConfirmation("已异常复位，进行角度自学习，查看是否学习成功");
  
  Send_Data_31H[4] = 0x00;
  Rx22H[3] = 0x00;
  _unlockECU();
  _Send_Diag(elcount(Send_Data_31H),phyreq_ID,Send_Data_31H);
  _Check_31Routine_Rx(Send_Data_31H,1);
  testWaitForTimeout(1000);
  _Send_Diag(3,phyreq_ID,Read_22H);
  _Check_Response(SendData,4,Rx22H);
  _TestWaitForTesterConfirmation("进行角度自学习，查看是否学习失败");
  _Set_11_Restoration();
  testWaitForTimeout(2000);
  _TestWaitForTesterConfirmation("已11复位，进行角度自学习，查看是否学习失败");

  Send_Data_31H[4] = 0x08;
  Rx22H[3] = 0x08;
  _unlockECU();
  _Send_Diag(elcount(Send_Data_31H),phyreq_ID,Send_Data_31H);
  _Check_31Routine_Rx(Send_Data_31H,1);
  testWaitForTimeout(1000);
  _Send_Diag(3,phyreq_ID,Read_22H);
  _Check_Response(SendData,4,Rx22H);
}

void BYD_31_3003_0E()
{
  byte Send_Data_31H[5] = {0x31,0x03,0x30,0x03,0x00};
  byte Read_22H[3] = {0x22,0x00,0x0E};
  byte Rx22H[4] = {0x62,0x00,0x0E,0x00};

  _unlockECU();
  Send_Data_31H[4] = 0x00;
  Rx22H[3] = 0x00;
  _Send_Diag(elcount(Send_Data_31H),phyreq_ID,Send_Data_31H);
  _Check_31Routine_Rx(Send_Data_31H,1);
  testWaitForTimeout(1000);
  _Send_Diag(3,phyreq_ID,Read_22H);
  _Check_Response(SendData,4,Rx22H);
  _TestWaitForTesterConfirmation("所有功能均无法执行(PDC/WIR/角度自学习)");
  _Power_Down();
  testWaitForTimeout(2000);
  _Power_Up();
  _TestWaitForTesterConfirmation("已正常上下电，所有功能均无法执行(PDC/WIR/角度自学习)");

  Send_Data_31H[4] = 0x0E;
  Rx22H[3] = 0x0E;  
  _unlockECU();
  _Send_Diag(elcount(Send_Data_31H),phyreq_ID,Send_Data_31H);
  _Check_31Routine_Rx(Send_Data_31H,1);
  testWaitForTimeout(1000);
  _Send_Diag(3,phyreq_ID,Read_22H);
  _Check_Response(SendData,4,Rx22H);
  _TestWaitForTesterConfirmation("所有功能均正常执行(PDC/WIR/角度自学习)");
  _K30_OFF();
  testWaitForTimeout(2000);
  _K30_ON();
  testWaitForTimeout(2000);
  _TestWaitForTesterConfirmation("已异常复位，所有功能均正常执行(PDC/WIR/角度自学习)");
  
  Send_Data_31H[4] = 0x00;
  Rx22H[3] = 0x00;
  _unlockECU();
  _Send_Diag(elcount(Send_Data_31H),phyreq_ID,Send_Data_31H);
  _Check_31Routine_Rx(Send_Data_31H,1);
  testWaitForTimeout(1000);
  _Send_Diag(3,phyreq_ID,Read_22H);
  _Check_Response(SendData,4,Rx22H);
  _TestWaitForTesterConfirmation("所有功能均无法执行(PDC/WIR/角度自学习)");
  _Set_11_Restoration();
  testWaitForTimeout(2000);
  _TestWaitForTesterConfirmation("已11复位，所有功能均无法执行(PDC/WIR/角度自学习)");

  Send_Data_31H[4] = 0x0E;
  Rx22H[3] = 0x0E;  
  _unlockECU();
  _Send_Diag(elcount(Send_Data_31H),phyreq_ID,Send_Data_31H);
  _Check_31Routine_Rx(Send_Data_31H,1);
  testWaitForTimeout(1000);
  _Send_Diag(3,phyreq_ID,Read_22H);
  _Check_Response(SendData,4,Rx22H);
}

