/*@!Encoding:936*/
includes
{
  #if X64
    #pragma library("..\Library\capldll.dll")
    #pragma library("..\Library\AES_CBC.dll")
  #else
    #pragma library("..\Library\capldll.dll")
    #pragma library("..\Library\AES_CBC.dll")
  #endif
  
  #include "..\Struct.cin"
  #include "..\Library\ArrayFuncTest.cin"
  #include "..\Library\ValueGet_Config.cin"
  #include "..\Library\Hash256.cin"
}

variables
{
  
}

/// <Power>
/*****************新老化板******************/
//RelayON(端口X) ：端口X 黑色接口-黄色接口
//RelayOFF(端口X)：端口X 黑色接口-绿色接口
void RelayON(byte Ctr_state)
{
  Relaymsg.can = Board_Channel;
  Relaymsg.id=0x101;
  if(Burn_in_Board==2)
    LHB_State = LHB_State_New;
  switch(Ctr_state)
  { //置为0
    case 1:LHB_State &=0xFE;break;
    case 2:LHB_State &=0xFD;break;
    case 3:LHB_State &=0xFB;break;
    case 4:LHB_State &=0xF7;break;
  }
  LHB_State_New = LHB_State;
  Relaymsg.byte(0)= LHB_State ;
  output(Relaymsg);
}
/// <Power>
void RelayOFF(byte Ctr_state)
{ 
  Relaymsg.can = Board_Channel;
  Relaymsg.id=0x101;
  if(Burn_in_Board==2)
    LHB_State = LHB_State_New;
  switch(Ctr_state)
  {//置为1
    case 1:LHB_State |=1;break;
    case 2:LHB_State |=2;break;
    case 3:LHB_State |=4;break;
    case 4:LHB_State |=8;break;
  }
  LHB_State_New = LHB_State;
  Relaymsg.byte(0)= LHB_State ;
  output(Relaymsg);
}
/// <Power>
_K15_ON()
{
  if(Burn_in_Board==1)
    RelayON(2);
  else if(Burn_in_Board==2)
    RelayOFF(2);
  else 
  {
    IGON.can = Board_Channel;
    IGON.byte(0)=0x02;
    IGON.byte(1)=0x01;
    IGON.byte(2)=0x01;
    output (IGON);
  } 
  testWaitForTimeout(100);
  _WriteEx_and_Report("上点火","K15->ON,等待100ms");
}
/// <Power>
_K15_ON_NoTime()
{
  if(Burn_in_Board==1)
    RelayON(2);
  else if(Burn_in_Board==2)
    RelayOFF(2);
  else 
  {
    IGON.can = Board_Channel;
    IGON.byte(0)=0x02;
    IGON.byte(1)=0x01;
    IGON.byte(2)=0x01;
    output (IGON);
  } 
  _WriteEx_and_Report("上点火","K15->ON");
}
/// <Power>
_K15_OFF()
{
  if(Burn_in_Board==1)
    RelayOFF(2);
  else if(Burn_in_Board==2)
    RelayON(2);
  else 
  {
    IGON.can = Board_Channel;
    IGON.byte(0)=0x02;
    IGON.byte(1)=0x01;
    IGON.byte(2)=0x00;
    output (IGON);
  } 
  testWaitForTimeout(100);
  _WriteEx_and_Report("下点火","K15->OFF,等待100ms");
}
/// <Power>
_K30_ON()
{
  if(Burn_in_Board==1)
    RelayON(1);
  else if(Burn_in_Board==2)
    RelayOFF(1);
  else 
  {
    IGON.can = Board_Channel;
    IGON.byte(0)=0x02;
    IGON.byte(1)=0x27;
    IGON.byte(2)=0x01;
    output (IGON);
  } 
  testWaitForTimeout(100);
  _WriteEx_and_Report("上总电","K30->ON,等待100ms");
}
/// <Power>
_K30_OFF()
{
  if(Burn_in_Board==1)
    RelayOFF(1);
  else if(Burn_in_Board==2)
    RelayON(1);
  else 
  {
    IGON.can = Board_Channel;
    IGON.byte(0)=0x02;
    IGON.byte(1)=0x27;
    IGON.byte(2)=0x00;
    output (IGON);
  } 
  testWaitForTimeout(100);
  _WriteEx_and_Report("下总电","K30->OFF,等待100ms");
}
/// <Power>
_Power_Down()
{
  /*修改老化板无法上下电问题*/
  _Get_CarSpd();
  _Get_Ready();
  /*-------------------*/
  _Set_CarSpd(0);
  _Set_Ready(0);
  testWaitForTimeout(1000);
  _K15_OFF();
  Session_BIN = 1;
  testWaitForTimeout(K15_OFF_Time);
}
/// <Power>
_Power_Up()
{
  _K15_ON();
  /*修改老化板无法上下电问题*/
  _Set_CarSpd(CarSpd_Now);
  _Set_Ready(Engine_State);
  testWaitForTimeout(1000);
}
/// <Power>
_Power_Down_()
{
  if(Burn_in_Board==1)
    RelayOFF(2);
  else 
  {
    IGON.can = Board_Channel;
    IGON.byte(0)=0x02;
    IGON.byte(1)=0x01;
    IGON.byte(2)=0x00;
    output (IGON);
    testWaitForTimeout(5);
  } 
  if(Burn_in_Board==1)
    RelayOFF(1);
  else 
  {
    IGON.can = Board_Channel;
    IGON.byte(0)=0x02;
    IGON.byte(1)=0x27;
    IGON.byte(2)=0x00;
    output (IGON);
  }   
  _WriteEx_and_Report("","下电");
  Session_BIN = 1;
}
/// <Power>
_Power_Up_()
{
  if(Burn_in_Board==1)
    RelayON(1);
  else 
  {
    IGON.can = Board_Channel;
    IGON.byte(0)=0x02;
    IGON.byte(1)=0x27;
    IGON.byte(2)=0x01;
    output (IGON);
    testWaitForTimeout(5);
  }  
  if(Burn_in_Board==1)
    RelayON(2);
  else 
  {
    IGON.can = Board_Channel;
    IGON.byte(0)=0x02;
    IGON.byte(1)=0x01;
    IGON.byte(2)=0x01;
    output (IGON);
  } 
  _WriteEx_and_Report("","上电");
}
/// <Power>
_Power_Down_19()
{
  _Get_CarSpd();
  _Get_Ready();
  _Set_CarSpd(0);
  _Set_Ready(0);
  testWaitForTimeout(200);
  _K15_OFF();
}
/// <Power>
_Power_Up_19()
{
  _Set_Ready(Engine_State);
  _Set_CarSpd(CarSpd_Now);
  testWaitForTimeout(300);
  _K15_On();
}

/// <DID_22>
/*-------------------------------------22DID遍历----------------------------------------------*/
/*
  遍历输入的DID
  Type = 0：仅读取
  Type = 1：读取后进行异常写入
*/
int _Check_22DID(dword ID,byte DID_Send[],byte Session,byte Type)
{
  int Re,Write_NRC,Check_Return;
  dword Fun;
  Fun = (DID_Send[1]<<8) ^ (DID_Send[2]);
  Check_Return = _Check_Fun_IDAndSess(0x22,Fun,ID,Session);
  testStep("","DID 0x%04X",Fun);
  if(Fun == 0xD01C && Geely3_Flage == 1)
  {
    _WriteEx_and_Report("","该DID单独执行，此处不进行测试");
    return 1;
  }
  if(Support_ReadSession == 1 && DID_Send[1] ==Read_Now_Session[1] && DID_Send[2] ==Read_Now_Session[2])
  {
    Analysis = 1;
    DID_Data[0] = Session;
    Len_Input = 1;
  }
  if(Check_Return == -1)
  {
    Re = Analysis_Select(Analysis,ID,DID_Send,0);
  }
  else if(Check_Return == 1)
  {
    Re = Analysis_Select(Analysis,ID,DID_Send,-1);
    if(Type == 1 && Write_Flage == 0)
    {
      byte Send_Data[1000],Send_Data_2[2],Serve_pos;
      int k;
      _WriteEx_and_Report("","开始测试异常写入");
      Write_NRC = 0;
      Serve_pos = _Check_Serve(0x11,0,0);
      Send_Data[0] = 0x2E;
      Send_Data[1] = DID_Send[1];
      Send_Data[2] = DID_Send[2];
      Send_Data_2[0] = 0x11;
      Send_Data_2[1] = Serve_Data[Serve_pos].Serve_Fun[0];
      for(k=0;k<DID_len_Ex-3;k++)
        Send_Data[3+k] = 0xFF;
      _unlockECU();
      _Send_Diag(DID_len_Ex,phyreq_ID,Send_Data);
      _TestResult(SendData,phyreq_ID,"",0x31);
      if(diagGetLastResponseCode(SendData) != 0x31)
        Write_NRC = -1;
      {
        /*复位前读取*/
        Re = Analysis_Select(Analysis,ID,DID_Send,-1);
      }
      _Send_Diag(2,phyreq_ID,Send_Data_2);
      _TestResult(SendData,phyreq_ID,"",-1);
      testWaitForTimeout(1000);

      if(_Check_Serve(0x22,Fun,5) == 1)
        _unlockECU();

      {
        /*复位后再次读取*/
        Re = Analysis_Select(Analysis,ID,DID_Send,-1);
      }
      if(Write_NRC == -1)
        Re = -1;
    }
  }
  return Re;
}
/// <DID_22>
int Analysis_Select(int Type,dword ID,byte DID_Send[],int Res)
{
  int Return_Value;
  switch(Analysis)
  {
    case 2:
      Return_Value = _Check_22DID_ASCII(ID,DID_len_Ex,DID_Send,DID_Data_str,Res);break;
    case 3:
      Return_Value = _Check_22DID_DecAll(ID,DID_len_Ex,DID_Send,DID_Data_str,Res);break;
    case 4:
      Return_Value = _Check_22DID_DecByte(ID,DID_len_Ex,DID_Send,DID_Data_str,Res);break;
    case 5:
      Return_Value = _Check_22DID_HexSplicing(ID,DID_len_Ex,DID_Send,DID_Data_str,Res);break;
    case 6:
      Return_Value = _Check_22DID_Mixed_DecALL_DecByte(ID,DID_len_Ex,DID_Send,DID_Data_str,Res);break;
    case 7:
      Return_Value = _Check_22DID_Mixed_BCD_ASCII3(ID,DID_len_Ex,DID_Send,DID_Data_str,Res);break;
    case 8:
      Return_Value = _Check_22DID_Mixed_BCD_ASCII3_3(ID,DID_len_Ex,DID_Send,DID_Data_str,Res);break;
    case 9:
      Return_Value = _Check_22DID_Mixed_DIDs(ID,DID_len_Ex,DID_Send,DID_Data_str,Res);break;
    default:
      Return_Value = _Check_22DID_Hex(ID,DID_len_Ex,DID_Send,DID_Data,Res);break;
  }
  return Return_Value;
}
/// <DID_22>
int _Check_22DID_Hex(dword msgID,dword LenEx,byte Tx_Data[],byte Rx_Data[],int passcondition)
{
  diagRequest * req1; 
  char str[500];
  int i = 0, Len_Rx = 0;
  int flage_0 = 0;
  int flage = 0;
  int Return_Value,Temp_Return_Flage;
  Return_Value = 0;
  
  snprintf(str,elCount(str),"%s","");
  snprintf(str,elCount(str),"%s%02X",str,Tx_Data[1]);
  snprintf(str,elCount(str),"%s%s",str,"  ");
  snprintf(str,elCount(str),"%s%02X",str,Tx_Data[2]);
  diagResize(req1,3);
  for(i=0;i<3;i++)
    DiagSetPrimitiveByte(req1,i,Tx_Data[i]);
  _SendAndWriteReport(req1,msgID);
  if((diagGetLastResponseCode(req1) == 0) && (passcondition != 0))
    testWaitForDiagResponse(req1,2000);
  Len_Rx = diagGetRespPrimitiveSize(req1);
  if((diagGetLastResponseCode(req1) == passcondition) && (passcondition != 0))
  {
    if(Len_Rx != LenEx)
    {
      testStepFail(str,"长度异常,预期长度为%d，实际长度为%d",LenEx,Len_Rx);
      Return_Value = -1;
    }
    else if((Len_Rx == LenEx))
      testStepPass(str,"长度与预期一致"); 
    if(Len_Input<=Len_Rx)
    {
      if((DiagGetRespPrimitiveByte(req1,0) != (DiagGetPrimitiveByte(req1,0)^0x40)) ||DiagGetRespPrimitiveByte(req1,1)!=Tx_Data[1] ||DiagGetRespPrimitiveByte(req1,2)!=Tx_Data[2] )
      {
        testStepFail(str,"前三字符存在异常,实际反馈为 0x%2X  0x%2X  0x%2X ",DiagGetRespPrimitiveByte(req1,0),DiagGetRespPrimitiveByte(req1,1),DiagGetRespPrimitiveByte(req1,2));
        Return_Value = -1;
      }
      else
        testStepPass(str,"前三字符与预期一致");
      if(Len_Input==0)
        _WriteEx_and_Report(str,"未输入预期值，跳过内容检测");
      else if(Len_Input>0)
      {
        for(i=0;i<Len_Input;i++)
        {
          if(Rx_Data[i]!= DiagGetRespPrimitiveByte(req1,i+3))
          {
            flage_0 = 1;
            Return_Value = -1;
            testStepFail(str,"反馈值异常，预期为；0x%2X,第%d 位实际反馈值为:0x%2X",Rx_Data[i],i+4,DiagGetRespPrimitiveByte(req1,i+3));
          }
        }
        if(flage_0 == 0)
          testStepPass(str,"反馈与预期一致");
       if(Len_Input<Len_Rx-3)
        {
          _WriteEx_and_Report("","存在未使用的填充位");
          for(i=Len_Input+3;i<Len_Rx;i++)
          {
            if(DiagGetRespPrimitiveByte(req1,i) != UnUse_Byte)
            {
              flage = 1;
              Return_Value = -1;
              testStepFail(str,"未使用位填充值存在非预期情况，默认填充值为；0x%2X,第%d 位实际反馈值为:0x%2X",UnUse_Byte,i+1,DiagGetRespPrimitiveByte(req1,i));
            }
          }
          if(flage == 0)
            testStepPass(str,"未使用填充位为默认值0x%2X",UnUse_Byte);
        } 
      }
    }
    else if(Len_Input>Len_Rx)
    {
      Return_Value = -1;
      testStepFail(str,"长度异常,收到的长度小于期望长度");
    }
  }
  else if((diagGetLastResponseCode(req1) == passcondition) && (passcondition == 0))
    testStepPass(str,"与预期一致无响应");
  else if(diagGetLastResponseCode(req1) != passcondition)
  {
    Return_Value = -1;
    testStepFail(str,"收到响应异常");
  }
  return Return_Value;
}

/// <DID_22>
int _Check_22DID_ASCII(dword msgID,dword LenEx,byte Tx_Data[],char Rx_Data[],int passcondition)
{
  diagRequest * req1; 
  char str[500];
  int i = 0, Len_Rx = 0;
  int flage = 0;
  char Buffer[500];
  int Return_Value,Temp_Return_Flage;
  int InPut_Len;
  Return_Value = 0;
  
  snprintf(Buffer,elCount(Buffer),"%s","");
  snprintf(str,elCount(str),"%s","");
  snprintf(str,elCount(str),"%s%02X",str,Tx_Data[1]);
  snprintf(str,elCount(str),"%s%s",str,"  ");
  snprintf(str,elCount(str),"%s%02X",str,Tx_Data[2]);
//  InPut_Len = strlen(Rx_Data);
  diagResize(req1,3);
  for(i=0;i<3;i++)
    DiagSetPrimitiveByte(req1,i,Tx_Data[i]);
  _SendAndWriteReport(req1,msgID);
  if((diagGetLastResponseCode(req1) == 0) && (passcondition != 0))
    testWaitForDiagResponse(req1,1000);
  Len_Rx = diagGetRespPrimitiveSize(req1);
  if((diagGetLastResponseCode(req1) == passcondition) && (passcondition != 0))
  {
    if(Len_Rx != LenEx)
    {
      Return_Value = -1;
      testStepFail(str,"长度异常,预期长度为%d，实际长度为%d",LenEx,Len_Rx);
    }
    else if((Len_Rx == LenEx))
      testStepPass(str,"长度与预期一致"); 
    if(strlen(Rx_Data)<=Len_Rx)
    {      
      if((DiagGetRespPrimitiveByte(req1,0) != (DiagGetPrimitiveByte(req1,0)^0x40)) ||DiagGetRespPrimitiveByte(req1,1)!=Tx_Data[1] ||DiagGetRespPrimitiveByte(req1,2)!=Tx_Data[2] )
      {
        Return_Value = -1;
        testStepFail(str,"前三字符存在异常,实际反馈为 0x%02X  0x%02X  0x%02X ",DiagGetRespPrimitiveByte(req1,0),DiagGetRespPrimitiveByte(req1,1),DiagGetRespPrimitiveByte(req1,2));
      }
      else
        testStepPass(str,"前三字符与预期一致");
      if(strlen(Rx_Data)!=0)
      {
        for(i=3;i<strlen(Rx_Data)+3;i++)
        {
          snprintf(Buffer,elCount(Buffer),"%s%c",Buffer,HexToAsc(DiagGetRespPrimitiveByte(req1,i))); //ASCII码查表切换
        }
        Temp_Return_Flage = Check_information_(Buffer,Rx_Data,str);
        if(Temp_Return_Flage == -1)
          Return_Value = -1;
        if(strlen(Rx_Data)<Len_Rx-3)
        {
          _WriteEx_and_Report("","存在未使用的填充位");
          for(i=strlen(Rx_Data)+3;i<Len_Rx;i++)
          {
            if(DiagGetRespPrimitiveByte(req1,i) != UnUse_Byte)
            {
              flage = 1;
              Return_Value = -1;
              testStepFail(str,"未使用位填充值存在非预期情况，默认填充值为；0x%02X,第%d 位实际反馈值为:0x%2X",UnUse_Byte,i+1,DiagGetRespPrimitiveByte(req1,i));
            }
          }
          if(flage == 0)
            testStepPass(str,"未使用填充位为默认值0x%02X",UnUse_Byte);
        }
      }
      if(strlen(Rx_Data)==0)
        _WriteEx_and_Report(str,"未输入预期值，跳过内容检测");
    }
    else if(strlen(Rx_Data)>Len_Rx)
    {
      Return_Value = -1;
      testStepFail(str,"长度异常,收到的长度小于期望长度");
      if(strlen(Rx_Data)!=0)
      {
        for(i=3;i<Len_Rx;i++)
        {
          snprintf(Buffer,elCount(Buffer),"%s%c",Buffer,HexToAsc(DiagGetRespPrimitiveByte(req1,i))); //ASCII码查表切换
        }
        Temp_Return_Flage = Check_information_(Buffer,Rx_Data,str);
      }
    }
  }
  else if((diagGetLastResponseCode(req1) == passcondition) && (passcondition == 0))
    testStepPass(str,"与预期一致无响应");
  else if(diagGetLastResponseCode(req1) != passcondition)
  {
    Return_Value = -1;
    testStepFail(str,"收到响应异常");
  }
  return Return_Value;
}

/// <DID_22>
int _Check_22DID_DecAll(dword msgID,dword LenEx,byte Tx_Data[],char Rx_Data[],int passcondition)/*整体转换*/
{
  diagRequest * req1; 
  char str[500];
  int i = 0, Len_Rx = 0;
  qword Data_Temp ;
  char Buffer[500];
  char Buffer_Check[500];
  int Return_Value,Temp_Return_Flage;
  Return_Value = 0;
  snprintf(Buffer,elCount(Buffer),"%s","");
  snprintf(Buffer_Check,elCount(Buffer_Check),"%s","");
  Data_Temp = 0;
  snprintf(str,elCount(str),"%s","");
  snprintf(str,elCount(str),"%s%02X",str,Tx_Data[1]);
  snprintf(str,elCount(str),"%s%s",str,"  ");
  snprintf(str,elCount(str),"%s%02X",str,Tx_Data[2]);
  diagResize(req1,3);
  for(i=0;i<3;i++)
    DiagSetPrimitiveByte(req1,i,Tx_Data[i]);
  _SendAndWriteReport(req1,msgID);
  if((diagGetLastResponseCode(req1) == 0) && (passcondition != 0))
    testWaitForDiagResponse(req1,1000);
  Len_Rx = diagGetRespPrimitiveSize(req1);
  if((diagGetLastResponseCode(req1) == passcondition) && (passcondition != 0))
  {
    if(Len_Rx != LenEx)
    {
      Return_Value = -1;
      testStepFail(str,"长度异常,预期长度为%d，实际长度为%d",LenEx,Len_Rx);
    }
    else if((Len_Rx == LenEx))
      testStepPass(str,"长度与预期一致"); 
    if((DiagGetRespPrimitiveByte(req1,0) != (DiagGetPrimitiveByte(req1,0)^0x40)) ||DiagGetRespPrimitiveByte(req1,1)!=Tx_Data[1] ||DiagGetRespPrimitiveByte(req1,2)!=Tx_Data[2] )
    {
      Return_Value = -1;
      testStepFail(str,"前三字符存在异常,实际反馈为 0x%02X  0x%02X  0x%02X ",DiagGetRespPrimitiveByte(req1,0),DiagGetRespPrimitiveByte(req1,1),DiagGetRespPrimitiveByte(req1,2));
    }
    else
      testStepPass(str,"前三字符与预期一致");
    snprintf(Buffer,elCount(Buffer),"%s%s",Buffer,"0x");
    if(strlen(Rx_Data)!=0)
    {
      for(i=3;i<Len_Rx;i++)
      {
        if(DiagGetRespPrimitiveByte(req1,i)>0x0F)
            snprintf(Buffer,elCount(Buffer),"%s%2X",Buffer,DiagGetRespPrimitiveByte(req1,i));
        else
          {
            snprintf(Buffer,elCount(Buffer),"%s%s",Buffer,"0");
            snprintf(Buffer,elCount(Buffer),"%s%X",Buffer,DiagGetRespPrimitiveByte(req1,i));
          }
      }
      strtoull(Buffer,Data_Temp);
      snprintf(Buffer_Check,elCount(Buffer_Check),"%s%I64u",Buffer_Check,Data_Temp);
      Temp_Return_Flage = Check_information_(Buffer_Check,Rx_Data,str);
      if(Temp_Return_Flage == -1)
        Return_Value = -1;
    }
    if(strlen(Rx_Data)==0)
      _WriteEx_and_Report(str,"未输入预期值，跳过内容检测");
  }
  else if((diagGetLastResponseCode(req1) == passcondition) && (passcondition == 0))
    testStepPass(str,"与预期一致无响应");
  else if(diagGetLastResponseCode(req1) != passcondition)
  {
    Return_Value = -1;
    testStepFail(str,"收到响应异常");
  }
  return Return_Value;
}

/// <DID_22>
int _Check_22DID_DecByte(dword msgID,dword LenEx,byte Tx_Data[],char Rx_Data[],int passcondition)/*每个Byte分别转换*/
{
  diagRequest * req1; 
  char str[500];
  int i = 0, Len_Rx = 0;
  char Buffer[500];
  char Buffer_Check[500];
  int Return_Value,Temp_Return_Flage;
  Return_Value = 0;
  snprintf(Buffer,elCount(Buffer),"%s","");
  snprintf(Buffer_Check,elCount(Buffer_Check),"%s","");
  
  snprintf(str,elCount(str),"%s","");
  snprintf(str,elCount(str),"%s%02X",str,Tx_Data[1]);
  snprintf(str,elCount(str),"%s%s",str,"  ");
  snprintf(str,elCount(str),"%s%02X",str,Tx_Data[2]);
  diagResize(req1,3);
  for(i=0;i<3;i++)
    DiagSetPrimitiveByte(req1,i,Tx_Data[i]);
  _SendAndWriteReport(req1,msgID);
  if((diagGetLastResponseCode(req1) == 0) && (passcondition != 0))
    testWaitForDiagResponse(req1,1000);
  Len_Rx = diagGetRespPrimitiveSize(req1);
  if((diagGetLastResponseCode(req1) == passcondition) && (passcondition != 0))
  {
    if(Len_Rx != LenEx)
    {
      Return_Value = -1;
      testStepFail(str,"长度异常,预期长度为%d，实际长度为%d",LenEx,Len_Rx);
    }
    else if((Len_Rx == LenEx))
      testStepPass(str,"长度与预期一致"); 
    if((DiagGetRespPrimitiveByte(req1,0) != (DiagGetPrimitiveByte(req1,0)^0x40)) ||DiagGetRespPrimitiveByte(req1,1)!=Tx_Data[1] ||DiagGetRespPrimitiveByte(req1,2)!=Tx_Data[2] )
    {
      Return_Value = -1;
      testStepFail(str,"前三字符存在异常,实际反馈为 0x%02X  0x%02X  0x%02X ",DiagGetRespPrimitiveByte(req1,0),DiagGetRespPrimitiveByte(req1,1),DiagGetRespPrimitiveByte(req1,2));
    }
    else
      testStepPass(str,"前三字符与预期一致");
    snprintf(Buffer,elCount(Buffer),"%s%s",Buffer,"0x");
    if(strlen(Rx_Data)!=0)
    {
      for(i=3;i<Len_Rx;i++)
      {
        ltoa(DiagGetRespPrimitiveByte(req1,i),Buffer,10);
        if(strlen(Buffer) == 1)
        {
          snprintf(Buffer_Check,200,"%s%s",Buffer_Check,"0");
        }
        snprintf(Buffer_Check,200,"%s%s",Buffer_Check,Buffer);
      }
      Temp_Return_Flage = Check_information_(Buffer_Check,Rx_Data,str);
      if(Temp_Return_Flage == -1)
        Return_Value = -1;
    }
    if(strlen(Rx_Data)==0)
      _WriteEx_and_Report(str,"未输入预期值，跳过内容检测");
  }
  else if((diagGetLastResponseCode(req1) == passcondition) && (passcondition == 0))
    testStepPass(str,"与预期一致无响应");
  else if(diagGetLastResponseCode(req1) != passcondition)
  {
    Return_Value = -1;
    testStepFail(str,"收到响应异常");
  }
  return Return_Value;
}

/// <DID_22>
int _Check_22DID_HexSplicing(dword msgID,dword LenEx,byte Tx_Data[],char Rx_Data[],int passcondition)/*16进制拼接*/
{
  diagRequest * req1; 
  char str[500];
  int i = 0, Len_Rx = 0;
  int flage = 0;
  qword Data_Temp = 0;
  char Buffer[500];
  char Buffer_Check[500];
  int Return_Value,Temp_Return_Flage;
  Return_Value = 0;
  snprintf(Buffer,elCount(Buffer),"%s","");
  snprintf(Buffer_Check,elCount(Buffer_Check),"%s","");
  
  snprintf(str,elCount(str),"%s","");
  snprintf(str,elCount(str),"%s%02X",str,Tx_Data[1]);
  snprintf(str,elCount(str),"%s%s",str,"  ");
  snprintf(str,elCount(str),"%s%02X",str,Tx_Data[2]);
  diagResize(req1,3);
  for(i=0;i<3;i++)
    DiagSetPrimitiveByte(req1,i,Tx_Data[i]);
  _SendAndWriteReport(req1,msgID);
  if((diagGetLastResponseCode(req1) == 0) && (passcondition != 0))
    testWaitForDiagResponse(req1,1000);
  Len_Rx = diagGetRespPrimitiveSize(req1);
  if((diagGetLastResponseCode(req1) == passcondition) && (passcondition != 0))
  {
    if(Len_Rx != LenEx)
    {
      Return_Value = -1;
      testStepFail(str,"长度异常,预期长度为%d，实际长度为%d",LenEx,Len_Rx);
    }
    else if((Len_Rx == LenEx))
      testStepPass(str,"长度与预期一致"); 
    if(strlen(Rx_Data)/2<=Len_Rx)
    {      
      if((DiagGetRespPrimitiveByte(req1,0) != (DiagGetPrimitiveByte(req1,0)^0x40)) ||DiagGetRespPrimitiveByte(req1,1)!=Tx_Data[1] ||DiagGetRespPrimitiveByte(req1,2)!=Tx_Data[2] )
      {
        Return_Value = -1;
        testStepFail(str,"前三字符存在异常,实际反馈为 0x%02X  0x%02X  0x%02X ",DiagGetRespPrimitiveByte(req1,0),DiagGetRespPrimitiveByte(req1,1),DiagGetRespPrimitiveByte(req1,2));
      }
      else
        testStepPass(str,"前三字符与预期一致");
      snprintf(Buffer,elCount(Buffer),"%s%s",Buffer,"0x");
      if(strlen(Rx_Data)!=0)
      {
        for(i=3;i<strlen(Rx_Data)/2+3;i++)
        {
          ltoa(DiagGetRespPrimitiveByte(req1,i),Buffer,16);
          if(strlen(Buffer) == 1)
          {
            snprintf(Buffer_Check,200,"%s%s",Buffer_Check,"0");
          }
          snprintf(Buffer_Check,200,"%s%s",Buffer_Check,Buffer);
        }
        toUpper(Buffer_Check, Buffer_Check, elcount(Buffer_Check));
        Temp_Return_Flage = Check_information_(Buffer_Check,Rx_Data,str);
        if(Temp_Return_Flage == -1)
          Return_Value = -1;
        if(strlen(Rx_Data)/2<Len_Rx-3)
        {
          _WriteEx_and_Report("","存在未使用的填充位");
          for(i=strlen(Rx_Data)/2+3;i<Len_Rx;i++)
          {
            if(DiagGetRespPrimitiveByte(req1,i) != UnUse_Byte)
            {
              flage = 1;
              Return_Value = -1;
              testStepFail(str,"未使用位填充值存在非预期情况，默认填充值为；0x%02X,第%d 位实际反馈值为:0x%02X",UnUse_Byte,i+1,DiagGetRespPrimitiveByte(req1,i));
            }
          }
          if(flage == 0)
            testStepPass(str,"未使用填充位为默认值0x%02X",UnUse_Byte);
        }
      }
      if(strlen(Rx_Data)==0)
        _WriteEx_and_Report(str,"未输入预期值，跳过内容检测");
    }
    else if(strlen(Rx_Data)/2>Len_Rx)
    {
      Return_Value = -1;
      testStepFail(str,"长度异常");
    }
  }
  else if((diagGetLastResponseCode(req1) == passcondition) && (passcondition == 0))
    testStepPass(str,"与预期一致无响应");
  else if(diagGetLastResponseCode(req1) != passcondition)
  {
    Return_Value = -1;
    testStepFail(str,"收到响应异常");
  }
  return Return_Value;
}

/// <DID_22>
int _Check_22DID_Mixed_DecALL_DecByte(dword msgID,dword LenEx,byte Tx_Data[],char Rx_Data[],int passcondition)/*混合解析BYD: F1 95*/
{
  diagRequest * req1; 
  char str[500];
  int i = 0, Len_Rx = 0;
  qword Data_Temp = 0;
  char Buffer[500];
  char Buffer_1[500];
  char Buffer_Check[500];
  char Buffer_Check_1[500];
  int Return_Value,Temp_Return_Flage;
  Return_Value = 0;
  snprintf(Buffer,elCount(Buffer),"%s","");
  snprintf(Buffer_1,elCount(Buffer_1),"%s","");
  snprintf(Buffer_Check,elCount(Buffer_Check),"%s","");
  snprintf(Buffer_Check_1,elCount(Buffer_Check_1),"%s","");
  snprintf(str,elCount(str),"%s","");
  snprintf(str,elCount(str),"%s%02X",str,Tx_Data[1]);
  snprintf(str,elCount(str),"%s%s",str,"  ");
  snprintf(str,elCount(str),"%s%02X",str,Tx_Data[2]);
  diagResize(req1,3);
  for(i=0;i<3;i++)
    DiagSetPrimitiveByte(req1,i,Tx_Data[i]);
  _SendAndWriteReport(req1,msgID);
  if((diagGetLastResponseCode(req1) == 0) && (passcondition != 0))
    testWaitForDiagResponse(req1,1000);
  Len_Rx = diagGetRespPrimitiveSize(req1);
  if((diagGetLastResponseCode(req1) == passcondition) && (passcondition != 0))
  {
    if(Len_Rx != LenEx)
    {
      Return_Value = -1;
      testStepFail(str,"长度异常,预期长度为%d，实际长度为%d",LenEx,Len_Rx);
    }
    else if((Len_Rx == LenEx))
      testStepPass(str,"长度与预期一致"); 
    if((DiagGetRespPrimitiveByte(req1,0) != (DiagGetPrimitiveByte(req1,0)^0x40)) ||DiagGetRespPrimitiveByte(req1,1)!=Tx_Data[1] ||DiagGetRespPrimitiveByte(req1,2)!=Tx_Data[2] )
    {
      Return_Value = -1;
      testStepFail(str,"前三字符存在异常,实际反馈为 0x%02X  0x%02X  0x%02X ",DiagGetRespPrimitiveByte(req1,0),DiagGetRespPrimitiveByte(req1,1),DiagGetRespPrimitiveByte(req1,2));
    }
    else
      testStepPass(str,"前三字符与预期一致");
    snprintf(Buffer,elCount(Buffer),"%s%s",Buffer,"0x");
    if(strlen(Rx_Data)!=0)
    {
      for(i=3;i<5;i++)
      {
        if(DiagGetRespPrimitiveByte(req1,i)>0x0F)
            snprintf(Buffer,elCount(Buffer),"%s%2X",Buffer,DiagGetRespPrimitiveByte(req1,i));
        else
          {
            snprintf(Buffer,elCount(Buffer),"%s%s",Buffer,"0");
            snprintf(Buffer,elCount(Buffer),"%s%X",Buffer,DiagGetRespPrimitiveByte(req1,i));
          }
      }
      strtoull(Buffer,Data_Temp);
      snprintf(Buffer_Check,elCount(Buffer_Check),"%s%I64u",Buffer_Check,Data_Temp);
      if(strstr(Rx_Data,",") != -1)
      { 
        snprintf(Buffer_Check_1,200,"%s%s",Buffer_Check_1,",");
        for(i=5;i<Len_Rx;i++)
        {
          ltoa(DiagGetRespPrimitiveByte(req1,i),Buffer_1,10);
          if(strlen(Buffer_1) == 1)
          {
           snprintf(Buffer_Check_1,200,"%s%s",Buffer_Check_1,"0");
          }
         snprintf(Buffer_Check_1,200,"%s%s",Buffer_Check_1,Buffer_1);
        }
      }
      else if(strstr(Rx_Data,",") == -1)
      {
        _WriteEx_and_Report("","未填充第二部分，跳过第二部分检测");
      }
      snprintf(Buffer_Check,300,"%s%s",Buffer_Check,Buffer_Check_1);
      Temp_Return_Flage = Check_information_(Buffer_Check,Rx_Data,str);
      if(Temp_Return_Flage == -1)
        Return_Value = -1;
    }
    if(strlen(Rx_Data)==0)
      _WriteEx_and_Report(str,"未输入预期值，跳过所有内容检测");
  }
  else if((diagGetLastResponseCode(req1) == passcondition) && (passcondition == 0))
    testStepPass(str,"与预期一致无响应");
  else if(diagGetLastResponseCode(req1) != passcondition)
  {
    Return_Value = -1;
    testStepFail(str,"收到响应异常");
  }
  return Return_Value;
}

/// <DID_22>
/*前面为BCD格式-后3字节为ASCII码*/
int _Check_22DID_Mixed_BCD_ASCII3(dword msgID,dword LenEx,byte Tx_Data[],char Rx_Data[],int passcondition)
{
  diagRequest * req1; 
  char str[500];
  int i = 0, Len_Rx = 0;
  int flage = 0;
  char Buffer[500];
  char Buffer_Check[500];
  int Return_Value,Temp_Return_Flage;
  int InPut_Len;
  Return_Value = 0;
  
  snprintf(str,elCount(str),"%s","");
  snprintf(str,elCount(str),"%s%02X",str,Tx_Data[1]);
  snprintf(str,elCount(str),"%s%s",str,"  ");
  snprintf(str,elCount(str),"%s%02X",str,Tx_Data[2]);
  snprintf(Buffer,elCount(Buffer),"%s","");
  snprintf(Buffer_Check,elCount(Buffer_Check),"%s","");
  diagResize(req1,3);
  for(i=0;i<3;i++)
    DiagSetPrimitiveByte(req1,i,Tx_Data[i]);
  _SendAndWriteReport(req1,msgID);
  if((diagGetLastResponseCode(req1) == 0) && (passcondition != 0))
    testWaitForDiagResponse(req1,1000);
  Len_Rx = diagGetRespPrimitiveSize(req1);
  if((diagGetLastResponseCode(req1) == passcondition) && (passcondition != 0))
  {
    if(Len_Rx != LenEx)
    {
      Return_Value = -1;
      testStepFail(str,"长度异常,预期长度为%d，实际长度为%d",LenEx,Len_Rx);
    }
    else if((Len_Rx == LenEx))
      testStepPass(str,"长度与预期一致"); 
    if(strlen(Rx_Data)<=(Len_Rx-6)*2+3)
    {      
      if((DiagGetRespPrimitiveByte(req1,0) != (DiagGetPrimitiveByte(req1,0)^0x40)) ||DiagGetRespPrimitiveByte(req1,1)!=Tx_Data[1] ||DiagGetRespPrimitiveByte(req1,2)!=Tx_Data[2] )
      {
        Return_Value = -1;
        testStepFail(str,"前三字符存在异常,实际反馈为 0x%02X  0x%02X  0x%02X ",DiagGetRespPrimitiveByte(req1,0),DiagGetRespPrimitiveByte(req1,1),DiagGetRespPrimitiveByte(req1,2));
      }
      else
        testStepPass(str,"前三字符与预期一致");
      if(strlen(Rx_Data)!=0)
      {
        for(i=3;i<Len_Rx-3;i++) //前面为BCD拼接
        {
          ltoa(DiagGetRespPrimitiveByte(req1,i),Buffer,16);
          if(strlen(Buffer) == 1)
            snprintf(Buffer_Check,200,"%s%s",Buffer_Check,"0");
          snprintf(Buffer_Check,200,"%s%s",Buffer_Check,Buffer);
          snprintf(Buffer,200,"");
        }
        for(i=Len_Rx-3;i<Len_Rx;i++)  //后三字节为ASCII码
        {
          snprintf(Buffer_Check,elCount(Buffer_Check),"%s%c",Buffer_Check,HexToAsc(DiagGetRespPrimitiveByte(req1,i))); //ASCII码查表切换
        }
        str_replace(Rx_Data, "/", "  "); //将'/'替换为'  '
        Temp_Return_Flage = Check_information_(Buffer_Check,Rx_Data,str);
        if(Temp_Return_Flage == -1)
          Return_Value = -1;
      }
      if(strlen(Rx_Data)==0)
        _WriteEx_and_Report(str,"未输入预期值，跳过内容检测");
    }
    else if(strlen(Rx_Data)>Len_Rx)
    {
      Return_Value = -1;
      testStepFail(str,"长度异常,收到的长度小于期望长度");
      if(strlen(Rx_Data)!=0)
      {
        for(i=3;i<Len_Rx-3;i++)
        {
          ltoa(DiagGetRespPrimitiveByte(req1,i),Buffer,16);
          if(strlen(Buffer) == 1)
            snprintf(Buffer_Check,200,"%s%s",Buffer_Check,"0");
          snprintf(Buffer_Check,200,"%s%s",Buffer_Check,Buffer);
          snprintf(Buffer,200,"");
        }
        for(i=Len_Rx-3;i<Len_Rx;i++)  //后三字节为ASCII码
        {
          snprintf(Buffer_Check,elCount(Buffer_Check),"%s%c",Buffer_Check,HexToAsc(DiagGetRespPrimitiveByte(req1,i))); //ASCII码查表切换
        }
        str_replace(Rx_Data, "/", "  "); //将'/'替换为'  '
        Temp_Return_Flage = Check_information_(Buffer,Rx_Data,str);
      }
    }
  }
  else if((diagGetLastResponseCode(req1) == passcondition) && (passcondition == 0))
    testStepPass(str,"与预期一致无响应");
  else if(diagGetLastResponseCode(req1) != passcondition)
  {
    Return_Value = -1;
    testStepFail(str,"收到响应异常");
  }
  return Return_Value;
}
/// <DID_22>
/*前面为BCD格式-后3字节为ASCII码 多组*/
int _Check_22DID_Mixed_BCD_ASCII3_3(dword msgID,dword LenEx,byte Tx_Data[],char Rx_Data[],int passcondition)
{
  diagRequest * req1; 
  char str[500];
  int i, Len_Rx,j;
  int flage;
  char Buffer[500];
  char Buffer_Check[500];
  char Temp_Rx_Data[500];
  int Return_Value,Temp_Return_Flage;
  int InPut_Len;
  int RxLen_Temp,Group_Temp;
  Return_Value = 0;
  flage = 0;
  snprintf(str,elCount(str),"%s","");
  snprintf(str,elCount(str),"%s%02X",str,Tx_Data[1]);
  snprintf(str,elCount(str),"%s%s",str,"  ");
  snprintf(str,elCount(str),"%s%02X",str,Tx_Data[2]);
  diagResize(req1,3);
  for(i=0;i<3;i++)
    DiagSetPrimitiveByte(req1,i,Tx_Data[i]);
  _SendAndWriteReport(req1,msgID);
  if((diagGetLastResponseCode(req1) == 0) && (passcondition != 0))
    testWaitForDiagResponse(req1,1000);
  Len_Rx = diagGetRespPrimitiveSize(req1);
  if((diagGetLastResponseCode(req1) == passcondition) && (passcondition != 0))
  {
    if(Len_Rx != LenEx)
    {
      Return_Value = -1;
      testStepFail(str,"长度异常,预期长度为%d，实际长度为%d",LenEx,Len_Rx);
    }
    else if((Len_Rx == LenEx))
      testStepPass(str,"长度与预期一致"); 
      
    if((DiagGetRespPrimitiveByte(req1,0) != (DiagGetPrimitiveByte(req1,0)^0x40)) ||DiagGetRespPrimitiveByte(req1,1)!=Tx_Data[1] ||DiagGetRespPrimitiveByte(req1,2)!=Tx_Data[2] )
    {
      Return_Value = -1;
      testStepFail(str,"前三字符存在异常,实际反馈为 0x%02X  0x%02X  0x%02X ",DiagGetRespPrimitiveByte(req1,0),DiagGetRespPrimitiveByte(req1,1),DiagGetRespPrimitiveByte(req1,2));
    }
    else
      testStepPass(str,"前三字符与预期一致");
    if(DiagGetPrimitiveByte(req1,3) != 3)
      testStepPass(str,"第四字节错误，期望为0x03,实际为0x%02X",DiagGetPrimitiveByte(req1,3));
    
    Group_Temp = (Len_Rx-4)/DiagGetRespPrimitiveByte(req1,3); //分组  
    if(strlen(Rx_Data)!=0)
    {
      for(j=0;j<DiagGetRespPrimitiveByte(req1,3);j++)
      {
        snprintf(Buffer,elCount(Buffer),"%s","");
        snprintf(Buffer_Check,elCount(Buffer_Check),"%s","");
        snprintf(Temp_Rx_Data,elCount(Temp_Rx_Data),"%s","");
        RxLen_Temp = Group_Temp*(j+1);
        substr_cpy(Temp_Rx_Data, Rx_Data, (strlen(Rx_Data)/3)*j, strlen(Rx_Data)/3, elcount(Temp_Rx_Data));
        for(i=4+Group_Temp*j;i<RxLen_Temp+4-3;i++) //前面为BCD拼接
        {
          ltoa(DiagGetRespPrimitiveByte(req1,i),Buffer,16);
          if(strlen(Buffer) == 1)
            snprintf(Buffer_Check,200,"%s%s",Buffer_Check,"0");
          snprintf(Buffer_Check,200,"%s%s",Buffer_Check,Buffer);
          snprintf(Buffer,200,"");
        }
        for(i=RxLen_Temp+4-3;i<RxLen_Temp+4;i++)  //后三字节为ASCII码
        {
          snprintf(Buffer_Check,elCount(Buffer_Check),"%s%c",Buffer_Check,HexToAsc(DiagGetRespPrimitiveByte(req1,i))); //ASCII码查表切换
        }
        str_replace(Temp_Rx_Data, "/", "  "); //将'/'替换为'  '
        writeEx(-3,0,"第 %d 组数据",j+1);
        Temp_Return_Flage = Check_information_(Buffer_Check,Temp_Rx_Data,str);
        if(Temp_Return_Flage == -1)
          Return_Value = -1;
      }
    }
    if(strlen(Rx_Data)==0)
      _WriteEx_and_Report(str,"未输入预期值，跳过内容检测");
  }
  else if((diagGetLastResponseCode(req1) == passcondition) && (passcondition == 0))
    testStepPass(str,"与预期一致无响应");
  else if(diagGetLastResponseCode(req1) != passcondition)
  {
    Return_Value = -1;
    testStepFail(str,"收到响应异常");
  }
  return Return_Value;
}

/// <DID_22>
/*多组DID混合，输入口为混合DID组*/
int _Check_22DID_Mixed_DIDs(dword msgID,dword LenEx,byte Tx_Data[],char Rx_Data[],int passcondition)
{
  diagRequest * req1; 
  char str[500];
  int i,Len_Rx,j,m;
  char Buffer[500]; // 临时装载数据
  char Buffer_Check[500];//装载转换后的数据
  char DID_Str[20][10]; //装载裁剪区分后的字符串
  char DID_TempStr[20];//装载DID
  byte Did_byte[2];//装载DID
  int Return_Value;
  int Group_Temp;
  int Analysis_Temp,ExLen,Flage;
  char Rx_DataTemp[200];
  char Out[500];
  Return_Value = 0;
  
  snprintf(str,elCount(str),"%s","");
  snprintf(str,elCount(str),"%s%02X  %02X",str,Tx_Data[1],Tx_Data[2]);
  diagResize(req1,3);
  for(i=0;i<3;i++)
    DiagSetPrimitiveByte(req1,i,Tx_Data[i]);
  _SendAndWriteReport(req1,msgID);
  if((diagGetLastResponseCode(req1) == 0) && (passcondition != 0))
    testWaitForDiagResponse(req1,1000);
  Len_Rx = diagGetRespPrimitiveSize(req1);
  if((diagGetLastResponseCode(req1) == passcondition) && (passcondition != 0))
  {
    if(Len_Rx != LenEx)
    {
      Return_Value = -1;
      testStepFail(str,"长度异常,预期长度为%d，实际长度为%d",LenEx,Len_Rx);
    }
    else if((Len_Rx == LenEx))
      testStepPass(str,"长度与预期一致"); 
      
    if((DiagGetRespPrimitiveByte(req1,0) != (DiagGetPrimitiveByte(req1,0)^0x40)) ||DiagGetRespPrimitiveByte(req1,1)!=Tx_Data[1] ||DiagGetRespPrimitiveByte(req1,2)!=Tx_Data[2] )
    {
      Return_Value = -1;
      testStepFail(str,"前三字符存在异常,实际反馈为 0x%02X  0x%02X  0x%02X ",DiagGetRespPrimitiveByte(req1,0),DiagGetRespPrimitiveByte(req1,1),DiagGetRespPrimitiveByte(req1,2));
    }
    else
      testStepPass(str,"前三字符与预期一致");
    
    if(strlen(Rx_Data)!=0)
    {
      Group_Temp = CountChar(Rx_Data,",")+1;
      Truncate_Str(Rx_Data,DID_Str,",");
      for(j=0;j<Group_Temp;j++)
      {
        dword DID_;
        char DID_s[10];
        byte DataGet[50];
        Flage = 0;//该DID是否存在与返回中
        snprintf(DID_TempStr,elCount(DID_TempStr),"DID_%s",DID_Str[j]);
        toUpper(DID_TempStr,DID_TempStr,strlen(DID_TempStr));//大写数据类型防止后续判断时不匹配
        snprintf(DID_s,elCount(DID_s),"0x%s",DID_Str[j]);
        DID_ = atol(DID_s);
        Did_byte[0] = (DID_>>8)&0xFF;
        Did_byte[1] = DID_&0xFF;
        _Get_DID(DID_TempStr);
        Analysis_Temp = Analysis;
        ExLen = DID_len_Ex -3;//减去DID + Serve长度
        snprintf(Rx_DataTemp,elCount(Rx_DataTemp),"%s",DID_Data_str);
        if(Analysis_Temp == 7 || Analysis_Temp == 8)
          str_replace(Rx_DataTemp, "/", "  "); //将'/'替换为'  '
        for(i=3;i<Len_Rx-1;i++)
        {
          if((DiagGetRespPrimitiveByte(req1,i) == Did_byte[0]) && (DiagGetRespPrimitiveByte(req1,i+1) == Did_byte[1]))
          {
            Flage = 1;
            for(m=i+2;m<ExLen+i+2;m++)
              DataGet[m-i-2] = DiagGetRespPrimitiveByte(req1,m);
          }
        }
        if(Flage == 0)
        {
          testStepFail(DID_s,"该DID未在返回数据中");
          continue;
        }
        if((Analysis_Temp == 1 && Len_Input == 0) || (strlen(Rx_DataTemp) == 0))
        {
          _WriteEx_and_Report(str,"未输入预期值，跳过内容检测");
          continue;
        }
        /*针对不同解析方式进行数据处理*/
        {
          DataChange_Analysis(Analysis_Temp,DataGet,ExLen,Out,Rx_DataTemp,UnUse_Byte,DID_s);
        }
      }
    }
    if(strlen(Rx_Data)==0)
      _WriteEx_and_Report(str,"未输入预期值，跳过内容检测");
  }
  else if((diagGetLastResponseCode(req1) == passcondition) && (passcondition == 0))
    testStepPass(str,"与预期一致无响应");
  else if(diagGetLastResponseCode(req1) != passcondition)
  {
    Return_Value = -1;
    testStepFail(str,"收到响应异常");
  }
  return Return_Value;
}

/*----------------------------------------------------------------------------------------*/

/*
  判断是否为CANFD报文,修改对应的发送长度
  用于NRC13遍历，CANFD报文返回0x3E，CAN报文返回7
*/
dword _Check_CANFD_Flage()
{
  dword data = 0;
  if (CANFD_Flage == 0)
  {
    _WriteEx_and_Report("","当前为CAN报文数据");
    data = 0x07;   
  }
  if (CANFD_Flage == 1)
  {
    _WriteEx_and_Report("","当前为CANFD报文数据");
    data = 0x3E;   
  }
  return data;
}
_Check_DID_2E(dword ID,byte Session)
{
  char str1[2000];
  byte Read_Data[2000];
  int Read_Data_Len;
  int i,m,Flage_Read,Fun_Temp,UnlockFlage;
  snprintf(str1,elCount(str1),"%s","");
  snprintf(str1,elCount(str1),"%s","获取第一次写入数据: ");
  if(Support_Read_2E_DID == 1)
  {
    for(i=0;i<DID_2E_SendData_1_Len;i++)
    {
      snprintf(str1,elCount(str1),"%s%02X",str1,DID_2E_SendData_1[i]);
      snprintf(str1,elCount(str1),"%s%s",str1,"  ");
    }
    _WriteEx_and_Report("",str1);
    Fun_Temp = ((Read_2E_DID[1]<<8)|Read_2E_DID[2]);
    UnlockFlage = _Check_Serve(0x22,Fun_Temp,5);
    if(UnlockFlage == 1)
      _unlockECU();
    _Send_Diag(Read_2E_DID_Len,phyreq_ID,Read_2E_DID);
    _TestResult(SendData,phyreq_ID,"",-1);
    {
      Flage_Read = 0;
      if(diagGetLastResponseCode(SendData) == -1)
      {
        Read_Data_Len =  DiagGetRespPrimitiveSize(SendData);
        Flage_Read = 1;
        for(m=0;m<Read_Data_Len;m++)
          Read_Data[m] = DiagGetRespPrimitiveByte(SendData,m);
      }
    }
    if(UnlockFlage != 1)
      _unlockECU();
    if(DID_2E_SendData_1_Response == -1)
    {
      _Send_Diag_(DID_2E_SendData_1_Len,ID,DID_2E_SendData_1);
      _TestResult(SendData,ID,"",-1);
      testWaitForTimeout(500);
      _Send_Diag(Read_2E_DID_Len,phyreq_ID,Read_2E_DID);
      _Check_Response_2E(SendData,DID_2E_SendData_1_Len,DID_2E_SendData_1);
      _WriteEx_and_Report("","第一次写入判断完成");
      _Power_Down();
      testWaitForTimeout(2000);
      _Power_Up();
      testWaitForTimeout(3000);
      _SetSession(exsession);
      testWaitForTimeout(200);
      if(UnlockFlage == 1)
        _unlockECU();
      _Send_Diag(Read_2E_DID_Len,phyreq_ID,Read_2E_DID);
      _Check_Response_2E(SendData,DID_2E_SendData_1_Len,DID_2E_SendData_1);
      _WriteEx_and_Report("","正常上下电读取判断完成");
      if(UnlockFlage == 1)
        _Set_11_Restoration(0);
      else
        _Set_11_Restoration();
      if(UnlockFlage == 1)
        _unlockECU();
      _Send_Diag(Read_2E_DID_Len,phyreq_ID,Read_2E_DID);
      _Check_Response_2E(SendData,DID_2E_SendData_1_Len,DID_2E_SendData_1);
      _WriteEx_and_Report("","11复位读取判断完成");
      _K30_OFF();
      testWaitForTimeout(2000);
      _K30_ON();
      testWaitForTimeout(3000);
      if(UnlockFlage == 1)
        _unlockECU();
      _Send_Diag(Read_2E_DID_Len,phyreq_ID,Read_2E_DID);
      _Check_Response_2E(SendData,DID_2E_SendData_1_Len,DID_2E_SendData_1);
      _WriteEx_and_Report("","异常复位读取判断完成");
    }
    else
    {
      _WriteEx_and_Report("","期望结果不为正响应,验证异常写入后值不被改变");
      _Send_Diag_(DID_2E_SendData_1_Len,ID,DID_2E_SendData_1);
      _TestResult(SendData,phyreq_ID,"",DID_2E_SendData_1_Response);
      if(Flage_Read == 0)
        _WriteEx_and_Report("","第一次读取时未获取到正确值,不再测试后续部分");
      else
      {
        _Send_Diag(Read_2E_DID_Len,phyreq_ID,Read_2E_DID);
        _Check_Response_2E(SendData,Read_Data_Len,Read_Data);
        _Power_Down();
        testWaitForTimeout(2000);
        _Power_Up();
        testWaitForTimeout(3000);
        _SetSession(exsession);
        testWaitForTimeout(200);
        if(UnlockFlage == 1)
          _unlockECU();
        _Send_Diag(Read_2E_DID_Len,phyreq_ID,Read_2E_DID);
        _Check_Response_2E(SendData,Read_Data_Len,Read_Data);
        _WriteEx_and_Report("","正常上下电读取判断完成");
        if(UnlockFlage == 1)
          _Set_11_Restoration(0);
        else
          _Set_11_Restoration();

        if(UnlockFlage == 1)
          _unlockECU();
        _Send_Diag(Read_2E_DID_Len,phyreq_ID,Read_2E_DID);
        _Check_Response_2E(SendData,Read_Data_Len,Read_Data);
        _WriteEx_and_Report("","11复位读取判断完成");
        _K30_OFF();
        testWaitForTimeout(2000);
        _K30_ON();
        testWaitForTimeout(3000);
        if(UnlockFlage == 1)
          _unlockECU();
        _Send_Diag(Read_2E_DID_Len,phyreq_ID,Read_2E_DID);
        _Check_Response_2E(SendData,Read_Data_Len,Read_Data);
        _WriteEx_and_Report("","异常复位读取判断完成");
      }
    }
    if(UnlockFlage != 1)
      _unlockECU();
    if(DID_2E_SendData_1_Response == -1 && DID_2E_SendData_2_Response == -1)
    {
      _Clear_Config(DID_2E_SendData_1,Session);
      _Send_Diag_(DID_2E_SendData_2_Len,ID,DID_2E_SendData_2);
      _TestResult(SendData,ID,"",-1);
      testWaitForTimeout(500);
      _Send_Diag(Read_2E_DID_Len,phyreq_ID,Read_2E_DID);
      _Check_Response_2E(SendData,DID_2E_SendData_2_Len,DID_2E_SendData_2);
      _WriteEx_and_Report("","第二次写入判断完成");
    }
    else if(DID_2E_SendData_1_Response != -1 && DID_2E_SendData_2_Response == -1)
    {
      _WriteEx_and_Report("","第一次写入值未成功,验证第二次写入");
      _Clear_Config(DID_2E_SendData_1,Session);
      _Send_Diag_(DID_2E_SendData_2_Len,ID,DID_2E_SendData_2);
      _TestResult(SendData,ID,"",-1);
      testWaitForTimeout(500);
      _Send_Diag(Read_2E_DID_Len,phyreq_ID,Read_2E_DID);
      _Check_Response_2E(SendData,DID_2E_SendData_2_Len,DID_2E_SendData_2);
      _WriteEx_and_Report("","第二次写入判断完成");
      _Power_Down();
      testWaitForTimeout(2000);
      _Power_Up();
      testWaitForTimeout(3000);
      if(UnlockFlage == 1)
        _unlockECU();
      _Send_Diag(Read_2E_DID_Len,phyreq_ID,Read_2E_DID);
      _Check_Response_2E(SendData,DID_2E_SendData_2_Len,DID_2E_SendData_2);
      _WriteEx_and_Report("","正常上下电读取判断完成");
      if(UnlockFlage == 1)
        _Set_11_Restoration(0);
      else
        _Set_11_Restoration();

      if(UnlockFlage == 1)
        _unlockECU();
      _Send_Diag(Read_2E_DID_Len,phyreq_ID,Read_2E_DID);
      _Check_Response_2E(SendData,DID_2E_SendData_2_Len,DID_2E_SendData_2);
      _WriteEx_and_Report("","11复位读取判断完成");
      _K30_OFF();
      testWaitForTimeout(2000);
      _K30_ON();
      testWaitForTimeout(3000);
      if(UnlockFlage == 1)
        _unlockECU();
      _Send_Diag(Read_2E_DID_Len,phyreq_ID,Read_2E_DID);
      _Check_Response_2E(SendData,DID_2E_SendData_2_Len,DID_2E_SendData_2);
      _WriteEx_and_Report("","异常复位读取判断完成");
    }
    else if(DID_2E_SendData_2_Response != -1)
    {
      _Clear_Config(DID_2E_SendData_1,Session);
      _Send_Diag_(DID_2E_SendData_2_Len,ID,DID_2E_SendData_2);
      _TestResult(SendData,ID,"",DID_2E_SendData_2_Response);
    }
  }
  else
  {
    _WriteEx_and_Report("","不支持读取,仅验证写入后正响应");
    _unlockECU();
    _Send_Diag_(DID_2E_SendData_1_Len,ID,DID_2E_SendData_1);
    _TestResult(SendData,ID,"",-1);
  }
}

/// <DTC_Diag>
/*
  诊断当前故障
*/
_Send_01_Fault(dword ID)
{
  int size,flage,DTC_Count,i;
  dword Byte_H,Byte_M,Byte_L;
  dword DTC[100];
  diagResize(Diag01,3);
  DiagSetPrimitiveByte(Diag01,0,0x19);
  DiagSetPrimitiveByte(Diag01,1,0x2);
  DiagSetPrimitiveByte(Diag01,2,0x1);
  _SendAndWriteReport(Diag01,ID);
  if(diagGetLastResponseCode(Diag01) == 0)
    testWaitForDiagResponse(Diag01,2000);
  flage = diagGetLastResponseCode(Diag01);
  if(flage==0)
    _WriteEx_and_Report("","响应异常");
  else
  {
    size = DiagGetRespPrimitiveSize(Diag01);
    if(size == 3)
    {}
    else
    {
      DTC_Count = (size-3)/4;
      testStep("DTC","共%d个DTC",DTC_Count);
      for(i = 0;i< DTC_Count ; i ++) 
      {      
         Byte_H = (dword)diagGetRespPrimitiveByte(Diag01,i*4 + 3 + 0);
         Byte_M = (dword)diagGetRespPrimitiveByte(Diag01,i*4 + 3 + 1);
         Byte_L = (dword)diagGetRespPrimitiveByte(Diag01,i*4 + 3 + 2);
         DTC[i] = Byte_H<<16 | Byte_M<<8 | Byte_L ;    
         testStep("DTC","第%d个DTC为 0x%06X",i,DTC[i]);
      }
    }
  }
  _WriteEx_and_Report("","诊断当前故障");
}
/// <DTC_Diag>
/*
  诊断历史故障
*/
_Send_09_Fault(dword ID)
{
  diagResize(Diag09,3);
  DiagSetPrimitiveByte(Diag09,0,0x19);
  DiagSetPrimitiveByte(Diag09,1,0x2);
  DiagSetPrimitiveByte(Diag09,2,0x09);
  _SendAndWriteReport(Diag09,ID);
  
  if(diagGetLastResponseCode(Diag09) == 0)
    testWaitForDiagResponse(Diag09,2000);
  _WriteEx_and_Report("","诊断所有故障");
}

/// <DTC_Diag>
_Clear_DTC(dword ID)
{
  int CarSpd_Flage,Ready_Flage;
  float Car_Now,Ready_Now;
  
  CarSpd_Flage = 0;
  Ready_Flage = 0;
  
  if((_Set_NRC22(0x14,0,2)&0x01) != 0)
  {
    Car_Now = _Get_CarSpd();
    if(Car_Now>NRC22_CarSpd)
    {
      CarSpd_Flage = 1;
      _Set_CarSpd(0);
    }
  }
  if((_Set_NRC22(0x14,0,2)&0x20) != 0)
  {
    Ready_Now = _Get_Ready();
    if(Ready_Now == Ready_NRC22)
    {
      Ready_Flage = 1;
      if(Ready_NRC22 == 0)
        _Set_Ready(Struct_Ready.Ready_Active);
      else
        _Set_Ready(0);
    }
  }
  
  diagResize(ClearDTC,4);
  DiagSetPrimitiveByte(ClearDTC,0,0x14);
  DiagSetPrimitiveByte(ClearDTC,1,0xFF);
  DiagSetPrimitiveByte(ClearDTC,2,0xFF);
  DiagSetPrimitiveByte(ClearDTC,3,0xFF);
  _SendAndWriteReport(ClearDTC,ID);
  _TestResult(ClearDTC,ID,"清除故障",-1);
  
  if(CarSpd_Flage == 1)
    _Set_CarSpd(Car_Now);
  if(Ready_Flage == 1)
    _Set_Ready(Ready_Now);
}

/// <DTC_Diag>
_Clear_DTC(dword ID,int Res,char Step[])
{
  int CarSpd_Flage,Ready_Flage;
  float Car_Now,Ready_Now;
  
  CarSpd_Flage = 0;
  Ready_Flage = 0;
  
  if((_Set_NRC22(0x14,0,2)&0x01) != 0)
  {
    Car_Now = _Get_CarSpd();
    if(Car_Now>NRC22_CarSpd)
    {
      CarSpd_Flage = 1;
      _Set_CarSpd(0);
    }
  }
  if((_Set_NRC22(0x14,0,2)&0x20) != 0)
  {
    Ready_Now = _Get_Ready();
    if(Ready_Now == Ready_NRC22)
    {
      Ready_Flage = 1;
      if(Ready_NRC22 == 0)
        _Set_Ready(Struct_Ready.Ready_Active);
      else
        _Set_Ready(0);
    }
  }
  
  diagResize(ClearDTC,4);
  DiagSetPrimitiveByte(ClearDTC,0,0x14);
  DiagSetPrimitiveByte(ClearDTC,1,0xFF);
  DiagSetPrimitiveByte(ClearDTC,2,0xFF);
  DiagSetPrimitiveByte(ClearDTC,3,0xFF);
  _SendAndWriteReport(ClearDTC,ID);
  _TestResult(ClearDTC,ID,Step,Res);
  
  if(CarSpd_Flage == 1)
    _Set_CarSpd(Car_Now);
  if(Ready_Flage == 1)
    _Set_Ready(Ready_Now);
}

/// <DTC_Diag>
/*
  检测85服务中DTC是否存在DTC问题
  Type = 1：发送19 02 01
  Type = 9：发送19 02 09
  DTC = 0：无期望故障，白名单除外
  DTC = xx：期望该DTC存在
*/
_85_Check_DTC(byte Type,dword DTC)
{
  dword DTC_Ex[10];
  
  StepByGeely3_0(0x19,Active);
  if(Type == 1)
    _Send_01_Fault(phyreq_ID);
  else if(Type == 9)
    _Send_09_Fault(phyreq_ID);
  DTC_Ex[0] = DTC;
  if(Type == 1)
    _Check_Response_DTC(Diag01,DTC_Ex);
  else if(Type == 9)
    _Check_Response_DTC(Diag09,DTC_Ex);
}
/// <DTC_Diag>
_Check_DTC(byte Type,dword DTC[])
{
  if(Type == 1)
    _Send_01_Fault(phyreq_ID);
  else if(Type == 9)
    _Send_09_Fault(phyreq_ID);
  if(Type == 1)
    _Check_Response_DTC(Diag01,DTC);
  else if(Type == 9)
    _Check_Response_DTC(Diag09,DTC);
}

/// <DTC_Diag>
/*
  Mask:当前故障或历史故障
*/
_Check_DTC_Mask(diagRequest *Diag,dword DTC_1,dword Mask)
{
  dword size;
  dword i;
  dword DTCread[200];
  dword Buffer_Receive[300];
  if(diagGetLastResponseCode(Diag) == 0)
    testWaitForDiagResponse(Diag,2000);
  if(DiagGetRespPrimitiveSize(Diag)>3)
  {
    size=DiagGetRespPrimitiveSize(Diag);
    if(DiagGetRespPrimitiveByte(Diag,2) != Mask_19)
      testStepFail("","掩码异常，预期为：0x%2X，实际为：0x%2X",Mask_19,DiagGetRespPrimitiveByte(Diag,2));
    for(i=0;i<(size-3);i++)
      Buffer_Receive[i]=DiagGetRespPrimitiveByte(Diag,i+3);
    size=(size-3)/4;
    for(i=0;i<size;i++)
      DTCread[i]=(Buffer_Receive[i*4]<<16)|(Buffer_Receive[i*4+1]<<8)|Buffer_Receive[i*4+2];
    for(i = 0;i<size;i++)
    {
      if(DTC_1 == DTCread[i])
      {
        testStepPass("","预期故障在反馈故障码中");
        if((Buffer_Receive[4*i+3]& Mask) != Mask)
          testStepFail("","当前故障的掩码异常,预期为：0x%2X，实际为：0x%2X",Mask,(Buffer_Receive[4*i+3]& Mask));
        else
          testStepPass("","故障码掩码与预期一致");
        break;
      }
    }
    if(i==size)
      testStepFail("","未诊断到预期故障码");
  }
  else 
    testStepFail("异常","未诊断到故障");
}

/// <DTC_Diag>
DTC_Check_For_bit(diagRequest* Diag,int Count_Num)
{
  int RxSize,Rx_Count,i,Error_Flage;
  dword DTC_Res[100][2];
  byte Send_Mask;
  byte Count_ForEx;
  dword DTC_Ex[50][2];
  if(diagGetLastResponseCode(Diag) == 0)
    testWaitForDiagResponse(Diag,1000);
  if(diagGetLastResponseCode(Diag) == 0)
    testStepFail("未收到响应");
  else if(diagGetLastResponseCode(Diag) > 0)
    testStepFail("收到消极应答");
  else
  {
    RxSize = DiagGetRespPrimitiveSize(Diag);
    Rx_Count = (RxSize-3)/4;
    Send_Mask = DiagGetPrimitiveByte(Diag,2);
    Error_Flage = 0; Count_ForEx = 0;
    for(i=0;i<DTC_ResList_Count;i++)  //统计并装载所有已有故障的掩码中匹配对应bit位的故障个数
    {
      if((DTC_ResList[i][1]&Send_Mask) != 0)
      {
        DTC_Ex[Count_ForEx][0] = DTC_ResList[i][0];
        DTC_Ex[Count_ForEx][1] = DTC_ResList[i][1];
        Count_ForEx++;
      }
    }
    for(i=0;i<3;i++)
    {
      if(i == 0)
      {
        if(diagGetRespPrimitiveByte(Diag,i) != 0x59)
          testStepFail("前三字节","第%d字节错误，预期为0x%02X,实测为0x%02X",0,0x59,diagGetRespPrimitiveByte(Diag,i));
      }
      else if(i == 2)
      {
        if(diagGetRespPrimitiveByte(Diag,i) != Mask_19)
          testStepFail("前三字节","第%d字节错误，预期为0x%02X,实测为0x%02X",i,Mask_19,diagGetRespPrimitiveByte(Diag,i));
      }
      else
      {
        if(DiagGetPrimitiveByte(Diag,i) != diagGetRespPrimitiveByte(Diag,i))
          testStepFail("前三字节","第%d字节错误，预期为0x%02X,实测为0x%02X",i,DiagGetPrimitiveByte(Diag,i),diagGetRespPrimitiveByte(Diag,i));
      }
    }
    if(Count_Num != -1)
    {
      if(Rx_Count != Count_Num)
        testStepFail("","当前DTC个数与期望不符,期望为 %d 实际为 %d 个",Count_Num,Rx_Count);
      else
        testStepPass("","当前DTC个数与期望一致均为 %d 个",Count_Num);
    }
    for(i=0;i<Rx_Count;i++)
    {
      DTC_Res[i][0] = (diagGetRespPrimitiveByte(Diag,i*4+3+0)<<16) + (diagGetRespPrimitiveByte(Diag,i*4+3+1)<<8)+ (diagGetRespPrimitiveByte(Diag,i*4+3+2));
      DTC_Res[i][1] = diagGetRespPrimitiveByte(Diag,i*4+3+3);
    }
    for(i=0;i<Rx_Count;i++)
    {
      if((DTC_Res[i][1] & Send_Mask) == 0)
      {
        Error_Flage = 1;
        testStepfail("","当前DTC为0x%06X，掩码为0x%02X，发送数据状态位为 0x%02X",DTC_Res[i][0],DTC_Res[i][1],Send_Mask);
      }
    }
    if(Error_Flage == 0)
      testStepPass("","当前返回DTC掩码均符合请求状态位");
    if(Rx_Count != Count_ForEx)
    {
      testStepfail("","当前请求bit位0x%02X返回故障个数与期望不一致，期望为 %d,实际为 %d",Send_Mask,Count_ForEx,Rx_Count);
      for(i=0;i<Count_ForEx;i++)
      {
        if(_Check_Dword_in_Num(DTC_Ex[i][0],DTC_Res,Rx_Count) == -1)
          testStepfail("","故障码0x%06X,对应掩码0x%02X 在请求bit位为0x%02X时，未正常反馈",DTC_Ex[i][0],DTC_Ex[i][1],Send_Mask);
      }
    }
  }
}

/// <DTC_Diag>
Get_DTC_FromRequest(byte MaskSend)
{
  byte DiagSend[3];
  int ResLen,i;
  DiagSend[0] = 0x19;DiagSend[1] = 0x02;DiagSend[2] = MaskSend;
  DTC_ResList_Count = 0;
  _Send_Diag(3,phyreq_ID,DiagSend);
  if(diagGetLastResponseCode(SendData) == 0)
    testWaitForDiagResponse(SendData,1000);
  if(diagGetLastResponseCode(SendData) == -1)
  {
    ResLen = DiagGetRespPrimitiveSize(SendData);
    DTC_ResList_Count = (ResLen-3)/4;
    for(i=0;i<DTC_ResList_Count;i++)
    {
      DTC_ResList[i][0] = (diagGetRespPrimitiveByte(SendData,i*4+3+0)<<16) + (diagGetRespPrimitiveByte(SendData,i*4+3+1)<<8)+ (diagGetRespPrimitiveByte(SendData,i*4+3+2));
      DTC_ResList[i][1] = diagGetRespPrimitiveByte(SendData,i*4+3+3);
    }
  }
}
/// <Node>
/*----------------------节点操作----------------------*/
_Close_One_Node(dword DTC_Node[])
{
  testDisableMsg(DTC_Node[0]);
  DTC_Node[2] = (DTC_Node[2] | 0x09);
  _WriteEx_and_Report("","停止0x%03X节点外发",DTC_Node[0]);
  testWaitForTimeout(DTC_Node[3]*1.5);
}
/// <Node>
_Open_One_Node(dword DTC_Node[])
{
  testEnableMsg(DTC_Node[0]);
  DTC_Node[2] = (DTC_Node[2] ^ 0x01);
  _WriteEx_and_Report("","打开0x%03X节点外发",DTC_Node[0]);
  testWaitForTimeout(DTC_Node[3]*1.5);
}
/// <Node>
_Close_All()
{
  int m;
  for(m=0;m<DTC_19_Count;m++)
  {
    if(Geely3_Flage == 1 && DTC_19[m][0]== Struct_Ready.Sig_Id )
      continue;
    _TestDisableMsg(DTC_19[m][0]);
    DTC_19[m][2] = (DTC_19[m][2] | 0x09);
  }
}
/// <Node>
_Close_All_Expect(dword DTC_[])
{
  int m;
  for(m=0;m<DTC_19_Count;m++)
  {
    if(DTC_19[m][0]==DTC_[0])
      continue;
    _testDisableMsg(DTC_19[m][0]);
    DTC_19[m][2] = (DTC_19[m][2] | 0x09);
  }
}
/// <Node>
/*
      关闭所有高级功能相关节点
*/
_Close_All_Advanced_function()
{
  int m,k;
  k=0;
  for(m=0;m<Advanced_function_Count;m++)
  {
    if(Advanced_function[m].Node!=0)
      _TestDisableMsg(Advanced_function[m].Node);
  }
}
/// <Node>
_Open_All_Advanced_function()
{
  int m;
  for(m=0;m<Advanced_function_Count;m++)
  {
    if(Advanced_function[m].Node!=0)
      _TestEnableMsg(Advanced_function[m].Node);
  }
}

/// <Node>
_Open_All()
{
  int m;
  for(m=0;m<DTC_19_Count;m++)
  {
    _TestEnableMsg(DTC_19[m][0]);
    DTC_19[m][2] = (DTC_19[m][2] ^ 0x01);
  }
}
/// <Node>
_Open_All(dword DTC_[])
{
  int m;
  for(m=0;m<DTC_19_Count;m++)
  {
    if(DTC_19[m][0]==DTC_[0])
      continue;
    _TestEnableMsg(DTC_19[m][0]);
    DTC_19[m][2] = (DTC_19[m][2] ^ 0x01);
  }
}
/// <Node>
int _Invalid_Node(dword Node) //节点无效操作
{
  int ii,pos_;
  char T_Str[200];
  pos_ = -1;
  for(ii=0;ii<Node_Invalid_Count;ii++)
  {
    if(Node == Node_Invalid[ii].Node  && Node_Invalid[ii].Invalid_Index == 0)
    {
      pos_ = ii;
      break;
    }
  }
  if(pos_ != -1)
  {
    setSignal(Node_Invalid[pos_].Signal_Name,Node_Invalid[pos_].Invalid_Value);
    snprintf(T_Str,elCount(T_Str),"EV_%s",Node_Invalid[pos_].Signal_Name);
    putValue(T_Str,Node_Invalid[pos_].Invalid_Value);
    putValue(Node_Invalid[pos_].Signal_Name,Node_Invalid[pos_].Invalid_Value);
    testWaitForTimeout(Node_Invalid[pos_].Time*1.3);
    testStep(Node_Invalid[pos_].Signal_Name,"设置信号值为%d",Node_Invalid[pos_].Invalid_Value);
    writeEx(-3,0,"设置信号 %s 为 %d",Node_Invalid[pos_].Signal_Name,Node_Invalid[pos_].Invalid_Value);
    Node_Invalid[pos_].Invalid_Index = 1;
    return 1;
  }
  else
  {
    return -1;
    // testStep("","0x%X 未查询到对应的节点",Node);
  }
}
/// <Node>
int _Recover_Invalid_Node(dword Node) //节点无效恢复操作
{
  int ii,pos_;
  char T_Str[200];
  pos_ = -1;
  for(ii=0;ii<Node_Invalid_Count;ii++)
  {
    if(Node == Node_Invalid[ii].Node && Node_Invalid[ii].Invalid_Index == 1)
    {
      setSignal(Node_Invalid[ii].Signal_Name,Node_Invalid[ii].Normal_Value);
      snprintf(T_Str,elCount(T_Str),"EV_%s",Node_Invalid[ii].Signal_Name);
      putValue(T_Str,Node_Invalid[ii].Normal_Value);
      putValue(Node_Invalid[ii].Signal_Name,Node_Invalid[ii].Normal_Value);
      testWaitForTimeout(Node_Invalid[ii].Time*1.3);
      testStep(Node_Invalid[ii].Signal_Name,"设置信号值为%d",Node_Invalid[ii].Normal_Value);
      writeEx(-3,0,"设置信号 %s 为 %d",Node_Invalid[ii].Signal_Name,Node_Invalid[ii].Normal_Value);
      Node_Invalid[ii].Invalid_Index = 0;
      pos_ = 1;
    }
  }
  return pos_;
}
/// <Node>
int _Invalid_Node(char Snapshot[],dword Node) //节点无效操作
{
  int ii,pos_;
  char T_Str[200];
  pos_ = -1;
  for(ii=0;ii<Snapshot_Special_Count;ii++)
  {
    if(Node == Snapshot_Special[ii].Sig_ID)
    {
      if(strlen(Snapshot_Special[ii].Sig_Name)>0)
      {
        _WriteEx_and_Report(Snapshot_Special[ii].Sig_Name,"   %d",Snapshot_Special[ii].Invalid_Value);
        setSignal(Snapshot_Special[ii].Sig_Name,Snapshot_Special[ii].Invalid_Value);
        snprintf(T_Str,elCount(T_Str),"EV_%s",Snapshot_Special[ii].Sig_Name);
        putValue(Snapshot_Special[ii].Sig_Name,Snapshot_Special[ii].Invalid_Value);
        putValue(T_Str,Snapshot_Special[ii].Invalid_Value);
        testWaitForTimeout(Snapshot_Special[ii].Invalid_Time*1.3);
        testStep(Snapshot_Special[ii].Sig_Name,"设置信号值为%d",Snapshot_Special[ii].Invalid_Value);
        pos_ = 1;
      }
    }
  }
  return pos_;
}
/// <Node>
int _Recover_Invalid_Node(char Snapshot[],dword Node) //节点无效恢复操作
{
  int ii,pos_;
  char T_Str[200];
  pos_ = -1;
  for(ii=0;ii<Snapshot_Special_Count;ii++)
  {
    if(Node == Snapshot_Special[ii].Sig_ID)
    {
      if(strlen(Snapshot_Special[ii].Sig_Name)>0)
      {
        _WriteEx_and_Report(Snapshot_Special[ii].Sig_Name,"   %d",Snapshot_Special[ii].Normal_Value);
        setSignal(Snapshot_Special[ii].Sig_Name,Snapshot_Special[ii].Normal_Value);
        snprintf(T_Str,elCount(T_Str),"EV_%s",Snapshot_Special[ii].Sig_Name);
        putValue(T_Str,Snapshot_Special[ii].Normal_Value);
        putValue(Snapshot_Special[ii].Sig_Name,Snapshot_Special[ii].Normal_Value);
        testWaitForTimeout(Snapshot_Special[ii].Invalid_Time*1.3);
        testStep(Snapshot_Special[ii].Sig_Name,"设置信号值为%d",Snapshot_Special[ii].Normal_Value);
        pos_ = 1;
      }
    }
  }
  return pos_;
}

/// <Node>
_TestDisableMsg(dword Node_ID)
{
  char Tem[20];
  snprintf(Tem,elCount(Tem),"0x%03X",Node_ID);
  _WriteEx_and_Report("丢失节点",Tem);
  testDisableMsg(Node_ID);
}
/// <Node>
_TestEnableMsg(dword Node_ID)
{
  char Tem[20];
  snprintf(Tem,elCount(Tem),"0x%03X",Node_ID);
  _WriteEx_and_Report("恢复节点",Tem);
  testEnableMsg(Node_ID);
}
/// <Node>
_TestDisableMsg(char str[])
{
  dword ID_Tmep;
  ID_Tmep = atol(str);
  _Check_ID(str);

  if(Canoe_Node_Flage == 1)
  {
    _WriteEx_and_Report("","丢失节点 0x%X",ID_Tmep);
    testDisableMsg(ID_Tmep);
  }
}
/// <Node>
_TestEnableMsg(char str[])
{
  dword ID_Tmep;
  ID_Tmep = atol(str);
  _Check_ID(str);
  if(Canoe_Node_Flage == 1)
  {
    _WriteEx_and_Report("","恢复节点 0x%X",ID_Tmep);
    testEnableMsg(ID_Tmep);
  }
}
/*-----------------------------------------------*/

_Send_Diag(int size,dword ID,byte Send_Data[])
{
  int i;
  dword LenSend;
  i=0;
  LenSend = elCount(Send_Data);
  diagResize(SendData,size);
  if(size<=LenSend)
  {
    for(i=0;i<size;i++)
      DiagSetPrimitiveByte(SendData,i,Send_Data[i]);
  }
  else if(size>LenSend)
  {
    for(i=0;i<LenSend;i++)
      DiagSetPrimitiveByte(SendData,i,Send_Data[i]);
    for(i=LenSend;i<size;i++)
      DiagSetPrimitiveByte(SendData,i,Send_filler);
  } 
  _SendAndWriteReport(SendData,ID); 
}

_Send_Diag_(dword size,dword ID,byte Send_Data[])
{
  int i;
  dword LenSend;
  i=0;
  LenSend = elCount(Send_Data);
  diagResize(SendData,size);
  if(size<=LenSend)
  {
    for(i=0;i<size;i++)
      DiagSetPrimitiveByte(SendData,i,Send_Data[i]);
  }
  else if(size>LenSend)
  {
    for(i=0;i<LenSend;i++)
      DiagSetPrimitiveByte(SendData,i,Send_Data[i]);
    for(i=LenSend;i<size;i++)
      DiagSetPrimitiveByte(SendData,i,Send_filler);
  } 
  _SendAndWriteReport(SendData,ID); 
}


_Send_Diag(byte size,dword ID,byte Send_Data[],dword Time)
{
  int i;
  dword LenSend;
  i=0;
  LenSend = elCount(Send_Data);
  diagResize(SendData,size);
  if(size<=LenSend)
  {
    for(i=0;i<size;i++)
      DiagSetPrimitiveByte(SendData,i,Send_Data[i]);
  }
  else if(size>LenSend)
  {
    for(i=0;i<LenSend;i++)
      DiagSetPrimitiveByte(SendData,i,Send_Data[i]);
    for(i=LenSend;i<size;i++)
      DiagSetPrimitiveByte(SendData,i,Send_filler);
  } 
  _SendAndWriteReport(SendData,ID,Time); 
}

_Send_Diag_NoTime(byte size,dword ID,byte Send_Data[])
{
  int i;
  dword LenSend;
  i=0;
  LenSend = elCount(Send_Data);
  diagResize(SendData,size);
  if(size<=LenSend)
  {
    for(i=0;i<size;i++)
      DiagSetPrimitiveByte(SendData,i,Send_Data[i]);
  }
  else if(size>LenSend)
  {
    for(i=0;i<LenSend;i++)
      DiagSetPrimitiveByte(SendData,i,Send_Data[i]);
    for(i=LenSend;i<size;i++)
      DiagSetPrimitiveByte(SendData,i,Send_filler);
  }
  _SendAndWriteReport_NoTime(SendData,ID);
}

_Send_Diag_3E80_After_NRC78(byte size,dword ID,byte Send_Data[])
{
  double Start_time,End_time,DiffTime;
  int i,NRC78_Count;
  _Send_Diag_NoTime(size,ID,Send_Data);
  Start_time = (double)timeNow()/100;
  testWaitForDiagResponse(SendData,p2cmax);
  if(diagGetLastResponseCode(SendData)==0x78)
  {
    message *Msg;
    writeEx(-3,0,"/*----------收到NRC78应答，发送3E 80----------*/");
    Msg.id = funreq_ID;  Msg.dlc = 8; Msg.can = 1;
    Msg.byte(0) = 0x02; Msg.byte(1) = 0x3E; Msg.byte(2) = 0x80;
    for(i=3;i<8;i++)
      Msg.byte(i) = 0x55;
    if(Support_CAN == 2)
    {
      Msg.FDF = 1;Msg.BRS = 1;
    }
    output(Msg);
    End_time = (double)timeNow()/100;
    DiffTime = End_time - Start_time;
    NRC78_Count = 0;  Res_NRC78 = 1;
    _WriteEx_and_Report("","第一次收到NRC78响应时间: %.2f ms",DiffTime);
    do{
      NRC78_Count++;
      if(NRC78_Count>1)
      {
        Start_time = (double)timeNow()/100;  
        DiffTime = Start_time - End_time;
        if(DiffTime<0.3*P2_can_server)
          testStepFail("","第 %d 次NRC78响应时间过短,期望大于 %d ms，当前响应时间为 %.2f ms",NRC78_Count,0.3*P2_can_server,DiffTime);
        if(DiffTime>0.8*P2_can_server)
          testStepFail("","第 %d 次NRC78响应时间过长,期望小于 %d ms，当前响应时间为 %.2f ms",NRC78_Count,0.8*P2_can_server,DiffTime);
      }
      testWaitForDiagResponse(SendData,p2cmax*100);
    }while(diagGetLastResponseCode(SendData)==0x78);
  }
  if(diagGetLastResponseCode(SendData)!=0)
    testReportWriteDiagResponse(SendData);
}

_Send_Diag_And_Get_CF(byte size,dword ID,byte Send_Data[])
{
  _Send_Diag(size,ID,Send_Data);
  if(AES_128 != 0)/*多帧存在接收不全问题*/
  {
    if(diagGetLastResponseCode(SendData)==0)
      testWaitForDiagResponse(SendData,200);
  }
}
/*
    发送并判断当前会话
    Session == 0xFF,特殊情况不判断返回值，并返回当前会话
*/
byte _Send_And_Check_NowSession(dword ID,byte Session)
{
  _get_Arry("Read_Now_Session");
  if(Support_ReadSession == 1)
  {
    if(Read_Now_Session_BT == -1 && Session == 2)
      return 0;
    testWaitForTimeout(10);
    _Send_Diag(3,ID,Read_Now_Session);
    if(Session == 2 && Read_Now_Session_BT == 0)
      _TestResult(SendData,ID,"读取当前会话模式",NRC31);
    else
    {
      _TestResult(SendData,ID,"读取当前会话模式",-1);
      if(diagGetLastResponseCode(SendData)==-1)
      {
        byte Session_Now;
        Session_Now = DiagGetRespPrimitiveByte(SendData,3);
        if(Session == 0xFF)
          return Session_Now;
        if(Session_Now == Session)
          testStepPass("","当前会话与预期一致为0x%02X",Session_Now);
        else
          testStepFail("","当前会话为0x%02X，预期会话为0x%02X",Session_Now,Session);
        return Session_Now;
      }
    }
  }
  else
  {
//    _WriteEx_and_Report("","不支持读取当前会话");
  }
  return 0;
}
/*
  检测输入数据是否被28服务所支持
  Send_Data[];输入数组
*/
int _Check_SendData_In_28H(byte Send_Data[])
{
  int Return_Value;
  int m,Serve_Pos,Fun_Pos,Com_Pos;
  Serve_Pos = -1;
  Fun_Pos = -1;
  Com_Pos = -1;
  
  Serve_Pos = _Check_Serve(Send_Data[0],0,0);
  if(Serve_Pos == -1)
  {
//    _WriteEx_and_Report("","当前服务不支持");
    return -3;
  }
  for(m=0;m<Serve_Data[Serve_Pos].Serve_Fun_Count;m++)
  {
    if((Send_Data[1] == Serve_Data[Serve_Pos].Serve_Fun[m]) || ((Serve_Data[Serve_Pos].RSP[m]==1) && (Send_Data[1] == (Serve_Data[Serve_Pos].Serve_Fun[m])|0x80)))
    {
      Fun_Pos = m;
      break;
    }
  }
  if(Fun_Pos == -1)
  {
//    _WriteEx_and_Report("","当前服务子功能不支持");
    return -2;
  }
  for(m=0;m<Serve_Data[Serve_Pos].Serve_Para_Count[Fun_Pos];m++)
  {
    if(Send_Data[2] == Serve_Data[Serve_Pos].Serve_Para[Fun_Pos][m])
    {
      Com_Pos = m;
      break;
    }
  }
  Return_Value = Com_Pos;
  return Return_Value;
}

/*
  获取0x19服务的发送数据
  Fun 子功能
*/
int _Get_19_ServeData(byte Send_Data[],byte Fun)
{
  byte DTC_H,DTC_M,DTC_L;
  int Re;
  _Clear_SendData(Send_Data);
  Send_Data[0] = 0x19;
  Send_Data[1] = Fun;
  if(Fun == 0x01 || Fun == 0x02)
  {
    Re = 3;
    Send_Data[2] = 0x01;
  }
  else if(Fun == 0x03)
  {
    Re = 2;
  }
  else if(Fun == 0x0A)
  {
    Re = 2;
  }
  else if(Fun == 0x04)
  {
    Re = 6;
    DTC_H = (DTC_19[1][1]>>16);
    DTC_M = (DTC_19[1][1]>>8);
    DTC_L = (DTC_19[1][1]&0xFF);
    Send_Data[2] = DTC_H;
    Send_Data[3] = DTC_M;
    Send_Data[4] = DTC_L;
    Send_Data[5] = 0Xff;
  }
  else if(Fun == 0x06)
  {
    Re = 6;
    DTC_H = (DTC_19[1][1]>>16);
    DTC_M = (DTC_19[1][1]>>8);
    DTC_L = (DTC_19[1][1]&0xFF);
    Send_Data[2] = DTC_H;
    Send_Data[3] = DTC_M;
    Send_Data[4] = DTC_L;
    Send_Data[5] = 0X01;
  }
  return Re;
}
/*
  获取0x31服务的发送数据
  Type = 0:正常发送
*/
_Get_31_ServeData(dword Serve_Poss,byte Send_Data[],byte Type)
{
  _Clear_SendData(Send_Data);
  if(Serve_Poss < Serve_31_Hex_Count)
  {
    Send_Data[0] = 0x31;
    Send_Data[1] = Serve_31_Hex[Serve_Poss].Control_Type[0];
    Send_Data[2] = Serve_31_Hex[Serve_Poss].Routine[0];
    Send_Data[3] = Serve_31_Hex[Serve_Poss].Routine[1];
    Len_31H = Serve_31_Hex[Serve_Poss].Routine_Len;
    if(Serve_31_Hex[Serve_Poss].Control_Option_Count[0] != 0)
      Send_Data[4] = Serve_31_Hex[Serve_Poss].Control_Option[0][0];
  }
  else
  {
    Send_Data[0] = 0x31;
    Send_Data[1] = Serve_31_Hex[0].Control_Type[0];
    Send_Data[2] = Serve_31_Hex[0].Routine[0];
    Send_Data[3] = Serve_31_Hex[0].Routine[1];
    Len_31H = Serve_31_Hex[0].Routine_Len;
    if(Serve_31_Hex[0].Control_Option_Count[0] != 0)
      Send_Data[4] = Serve_31_Hex[0].Control_Option[0][0];
  }
  if(Type == 0)
    return;
}
/*
  检测输入数据是否在31结构体中
  Send_Data[];输入数组
*/
int _Check_SendData_In_31H(byte Send_Data[])
{
  int Return_Value;
  int m,Routine_Pos,Type_Pos;
  Routine_Pos = -1;
  Type_Pos = -1;
  for(m=0;m<Serve_31_Hex_Count;m++)
  {
    if((Serve_31_Hex[m].Routine[0] == Send_Data[2]) && (Serve_31_Hex[m].Routine[1] == Send_Data[3]))
    {
      Routine_Pos = m;
      break;
    }
  }
  if(m == Serve_31_Hex_Count)
  {
    return -1;
  }
  for(m=0;m<Serve_31_Hex[Routine_Pos].Control_Type_Count;m++)
  {
    if(Serve_31_Hex[Routine_Pos].Control_Type[m] == Send_Data[1])
    {
      Type_Pos = m;
      break;
    }
  }
  Return_Value = Type_Pos;
  return Return_Value;
}
/*
  检测31服务对应例程的响应结果
  Type = 1 成功响应
  Type = 0 失败响应
  Type = other
*/
int _Check_31Routine_Rx(byte Send_Data[],byte Type)
{
  int Return_Value,Flag;
  int m,n,Routine_Pos,Type_Pos;
  int Rx_Len;
  Routine_Pos = -1;
  Type_Pos = -1;
  Flag = 0;
  for(m=0;m<Serve_31_Hex_Count;m++)
  {
    if((Serve_31_Hex[m].Routine[0] == Send_Data[2]) && (Serve_31_Hex[m].Routine[1] == Send_Data[3]))
    {
      Routine_Pos = m;
      break;
    }
  }
  if(m == Serve_31_Hex_Count)
  {
    _WriteEx_and_Report("","未查询到对应进程");
    return -1;
  }
  for(m=0;m<Serve_31_Hex[Routine_Pos].Control_Type_Count;m++)
  {
    if(Serve_31_Hex[Routine_Pos].Control_Type[m] == Send_Data[1])
    {
      Type_Pos = m;
      break;
    }
  }
  if(m == Serve_31_Hex[Routine_Pos].Control_Type_Count)
  {
    _WriteEx_and_Report("","未查询到对应控制类型");
    return -1;
  }
  if(diagGetLastResponseCode(SendData) == 0)
    testWaitForDiagResponse(SendData,200);
  if(diagGetLastResponseCode(SendData) != -1)
    testStepFail("","未收到正响应");
  else
  {
    Rx_Len = DiagGetRespPrimitiveSize(SendData);
    if(Rx_Len != Serve_31_Hex[Routine_Pos].Control_Type_RxLen[Type_Pos])
      testStepFail("","收到的响应长度与预期不符，期望长度为 %d ,收到长度为 %d",Serve_31_Hex[Routine_Pos].Control_Type_RxLen[Type_Pos],Rx_Len);
    else
    {
      if(DiagGetRespPrimitiveByte(SendData,0) != (Send_Data[0]^0x40))
        testStepFail("","实际反馈服务异常");
      for(n=1;n<4;n++)
      {
        if(DiagGetRespPrimitiveByte(SendData,n) != Send_Data[n])
          Flag = 1;
      }
      if(Flag == 0)
        testStepPass("","反馈结果与期望一致");
      else
        testStepFail("","反馈与预期不一致");
      if(Type == 1)
      {
        if(Rx_Len == 5)
        {
          if(DiagGetRespPrimitiveByte(SendData,4) != Serve_31_Hex[Routine_Pos].Control_Type_Success[Type_Pos])
            testStepFail("","期望成功响应结果为 0x%02X ,实际响应结果为 0x%02X",Serve_31_Hex[Routine_Pos].Control_Type_Success[Type_Pos],DiagGetRespPrimitiveByte(SendData,4));
          else
            testStepPass("","期望成功响应结果与实际一致为 0x%02X",DiagGetRespPrimitiveByte(SendData,4));
        }
        else if(Rx_Len == 6) //返回长度为6，默认为Geely相关项目，第5byte响应固定为0x10;
        {
          if(DiagGetRespPrimitiveByte(SendData,4) != 0x10)
            testStepFail("","期望成功响应结果为 0x10 ,实际响应结果为 0x%02X",DiagGetRespPrimitiveByte(SendData,4));
          if(DiagGetRespPrimitiveByte(SendData,5) != Serve_31_Hex[Routine_Pos].Control_Type_Success[Type_Pos])
            testStepFail("","期望成功响应结果为 0x%02X ,实际响应结果为 0x%02X",Serve_31_Hex[Routine_Pos].Control_Type_Success[Type_Pos],DiagGetRespPrimitiveByte(SendData,5));
          else
            testStepPass("","期望成功响应结果与实际一致为 0x%02X",DiagGetRespPrimitiveByte(SendData,5));
        }
      }
      else if(Type == 0)
      {
        if(Rx_Len == 5)
        {
          if(DiagGetRespPrimitiveByte(SendData,4) != Serve_31_Hex[Routine_Pos].Control_Type_Failed[Type_Pos])
            testStepFail("","期望失败响应结果为 0x%02X ,实际响应结果为 0x%02X",Serve_31_Hex[Routine_Pos].Control_Type_Failed[Type_Pos],DiagGetRespPrimitiveByte(SendData,4));
          else
            testStepPass("","期望失败响应结果与实际一致为 0x%02X",DiagGetRespPrimitiveByte(SendData,4));
        }
        else if(Rx_Len == 6) //返回长度为6，默认为Geely相关项目，第5byte响应固定为0x10;
        {
          if(DiagGetRespPrimitiveByte(SendData,4) != 0x10)
            testStepFail("","期望失败响应结果为 0x10 ,实际响应结果为 0x%02X",DiagGetRespPrimitiveByte(SendData,4));
          if(DiagGetRespPrimitiveByte(SendData,5) != Serve_31_Hex[Routine_Pos].Control_Type_Failed[Type_Pos])
            testStepFail("","期望失败响应结果为 0x%02X ,实际响应结果为 0x%02X",Serve_31_Hex[Routine_Pos].Control_Type_Failed[Type_Pos],DiagGetRespPrimitiveByte(SendData,5));
          else
            testStepPass("","期望失败响应结果与实际一致为 0x%02X",DiagGetRespPrimitiveByte(SendData,5));
        }
      }
      else 
      {
        if(Rx_Len == 5)
        {
          if(DiagGetRespPrimitiveByte(SendData,4) != Type)
            testStepFail("","期望失败响应结果为 0x%02X ,实际响应结果为 0x%02X",Type,DiagGetRespPrimitiveByte(SendData,4));
          else
            testStepPass("","期望失败响应结果与实际一致为 0x%02X",DiagGetRespPrimitiveByte(SendData,4));
        }
        else if(Rx_Len == 6) //返回长度为6，默认为Geely相关项目，第5byte响应固定为0x10;
        {
          if(DiagGetRespPrimitiveByte(SendData,4) != 0x10)
            testStepFail("","期望失败响应结果为 0x10 ,实际响应结果为 0x%02X",DiagGetRespPrimitiveByte(SendData,4));
          if(DiagGetRespPrimitiveByte(SendData,5) != Type)
            testStepFail("","期望失败响应结果为 0x%02X ,实际响应结果为 0x%02X",Type,DiagGetRespPrimitiveByte(SendData,5));
          else
            testStepPass("","期望失败响应结果与实际一致为 0x%02X",DiagGetRespPrimitiveByte(SendData,5));
        }
      }
    }
  }
  return Return_Value;
}
_Clear_SendData(byte Send_Data[])
{
  int k;
  for(k=0;k<elcount(Send_Data);k++)
    Send_Data[k] = Send_filler;
}

/// <Security Access>
/*
  长安工厂模式
  Type = 0 ：进入工厂模式
  Type = 1 ：退出工厂模式
*/
_Factory_Mode(byte Type)
{
  byte Send_Data[6] = {0x2E,0X01,0X00,0X00,0X00,0X00};
  _unlockECU();
  Send_Data[3] = Type;
  _Send_Diag(6,phyreq_ID,Send_Data);
  _TestResult(SendData,phyreq_ID,"",-1);
}

/// <Security Access>
//请求解锁ECU
_unlockECU()
{
  if(AES_128 != 2)
    _SetSession(exsession);
  diagResize(reqseed,2);
  diagResize(sendkey,SendKey_Len);
  DiagSetPrimitiveByte(reqseed,0,0x27);
  DiagSetPrimitiveByte(sendkey,0,0x27);
  DiagSetPrimitiveByte(reqseed,1,RequestSeed_27);
  DiagSetPrimitiveByte(sendkey,1,SendKey_27);
  if(AES_128==0)
  {
    dword seed;
    dword skey;
    testCaseComment("请求解锁ECU");
    diagSendRequest(reqseed);
    diagSetP2Extended(-1);
    testWaitForDiagRequestSent(reqseed,500);
    testWaitForDiagResponse(reqseed,p2cmax);
    if(diagGetLastResponseCode(reqseed)==0x78)
      testWaitForDiagResponse(reqseed,p2cmax*100);
    if(diagGetLastResponseCode(reqseed)==-1)
    {
      int Seed_Pos,Seed_Len,Key_Loop;
      Seed_Len = DiagGetRespPrimitiveSize(reqseed);
      seed = 0;skey = 0;
      for(Seed_Pos = 2 ;Seed_Pos < Seed_Len;Seed_Pos++)
        seed = seed | (DiagGetRespPrimitiveByte(reqseed,Seed_Pos) << ((Seed_Len -3 -(Seed_Pos-2))*8));
      /*安全算法函数*/
      testStep("种子","种子为0x%08X",seed);
      _SecurityAccess(seed,skey);
      testStep("密钥","计算出密钥为0x%08X",skey);
      DiagSetPrimitiveByte(sendkey,0,0x27);
      for(Key_Loop = 2;Key_Loop < SendKey_Len;Key_Loop++)
        DiagSetPrimitiveByte(sendkey,Key_Loop,(skey>>((SendKey_Len-1-Key_Loop)*8))&0xFF);
      diagSendRequest(sendkey);
      testWaitForDiagRequestSent(sendkey,50);
      diagSetP2Extended(-1);
      testWaitForDiagResponse(sendkey,p2cmax);
      if(diagGetLastResponseCode(sendkey)==0x78)
        testWaitForDiagResponse(sendkey,p2cmax*100);
      /*判断是否解锁成功*/
      if(diagGetLastResponseCode(sendkey)==-1)
        testStepPass("ECU解锁成功");
      else
        testStepFail("ECU解锁失败");
    }
    else
      testStepFail("ECU解锁,获取种子失败");
    testWaitForTimeout(500);
  }
  else if(AES_128==1)
  {
    testWaitForTimeout(500);    //排除10 03的反馈干扰,会影响到获取种子
    testCaseComment("请求解锁ECU");
    _SendAndWriteReport_NoTime(reqseed,phyreq_ID);
    _saveMsg(p2cmax);
    _CheckCode(-1,4);
    testWaitForTimeout(200);
    diagResize(sendkey,SendKey_Len);
    DiagSetPrimitiveByte(sendkey,1,SendKey_27);
    _padding2702(0);
    _SendAndWriteReport_NoTime(sendkey,phyreq_ID);
    _saveMsg(p2cmax);
    testWaitForTimeout(150);
  }
  else if(AES_128==2) /*AES_CBC*/
  {
    byte data[3]={0x22,0xF1,0x8C};
    int m;
    testCaseComment("获取序列号");
    _Send_Diag_And_Get_CF(3,phyreq_ID,data);
    if(diagGetLastResponseCode(SendData) == -1)
    {
      if(DiagGetRespPrimitiveSize(SendData) == 22)
      {
        for(m=0;m<16;m++)
          Serial_number[m] = DiagGetRespPrimitiveByte(SendData,m+6);
        /*序列号移位*/
        LeftMove(Serial_number,3);
//        for(m=0;m<16;m++)
//          writeEx(-3,0,"----------移位后序列号-------0x%02X",Serial_number[m]);
        /*用ECU KEY加密移位后的序列号 获取密钥KEY*/
        AES128_CBC_encrypt_buffer(Secret_KEY,Serial_number,KEY_Len,ECU_Key,Iv); 
//        for(m=0;m<16;m++)
//          writeEx(-3,0,"----------移位后密钥KEY-------0x%02X",Secret_KEY[m]);
        
        _SetSession(exsession);
        testWaitForTimeout(150);
        testCaseComment("请求解锁ECU");
        _SendAndWriteReport(reqseed,phyreq_ID,500);
        if(diagGetLastResponseCode(reqseed) == -1)
        {
//          byte Temp_Seed_Check[16] = {0x83,0x88,0x5F,0x19,0x0D,0x55,0xCD,0xB8,0xE9,0x23,0x67,0x4E,0x89,0x45,0x1C,0xA2};
//          RA[m]=Temp_Seed_Check[m];
          for(m=0;m<16;m++)
            RA[m]=DiagGetRespPrimitiveByte(reqseed,m+2);
          /*用密钥KEY解密RA 得到ra`*/
          AES128_CBC_decrypt_buffer(ra,RA,KEY_Len,Secret_KEY,Iv);
          
          /*ra逆向*/
          reverseNum(ra,16);
          testWaitForTimeout(100);
          /*用密钥KEY加密r得到R*/
          AES128_CBC_encrypt_buffer(R,ra,KEY_Len,Secret_KEY,Iv);
          diagResize(sendkey,18);
          DiagSetPrimitiveByte(sendkey,1,SendKey_27);
          for(m=0;m<16;m++)
            DiagSetPrimitiveByte(sendkey,m+2,R[m]);
          _SendAndWriteReport(sendkey,phyreq_ID,p2cmax);
          if(diagGetLastResponseCode(sendkey)==-1)
            testStepPass("ECU解锁成功");
          else
            testStepFail("ECU解锁失败");
        }
        else
          testStepFail("","请求种子失败");
      }
      else
        testStepFail("","返回序列号长度错误,导致秘钥Key不可信");
    }
    else
      testStepFail("","未收到正确序列号,无法进行安全访问");
  }
}
/// <Security Access>
_unlockFactory()
{
  dword seed;
  dword skey;
  byte Tem[2] = {0x10,0x60};
  testCaseComment("请求进入工厂模式");
  _SetSession(3);
  _Send_Diag(2,phyreq_ID,Tem);
  _TestResult(SendData,phyreq_ID,"",-1);
  diagResize(reqseed,2);
  DiagSetPrimitiveByte(reqseed,0,0x27);
  DiagSetPrimitiveByte(reqseed,1,0x61);
  diagSendRequest(reqseed);
  testWaitForDiagResponse(reqseed,p2cmax);
  if(diagGetLastResponseCode(reqseed)==-1)
  {
    dword KeyK;
    dword KeyResult;
    int Seed_Pos,Seed_Len,Key_Loop;
    KeyK=0X00000137;
    Seed_Len = DiagGetRespPrimitiveSize(reqseed);
    for(Seed_Pos = 2 ;Seed_Pos < Seed_Len;Seed_Pos++)
      seed = seed | (DiagGetRespPrimitiveByte(reqseed,Seed_Pos) << ((Seed_Len -3 -(Seed_Pos-2))*8));
      /*安全算法函数*/
    
    KeyResult = ((((seed >> 1) ^ seed) <<3) ^ (seed >>2));
    skey = KeyResult ^ KeyK;
    skey += 0x112233cc;
    diagResize(sendkey,6);
    DiagSetPrimitiveByte(sendkey,0,0x27);
    DiagSetPrimitiveByte(sendkey,1,0x62);
    for(Key_Loop = 2;Key_Loop < 6;Key_Loop++)
      DiagSetPrimitiveByte(sendkey,Key_Loop,(skey>>((5-Key_Loop)*8))&0xFF);
    diagSendRequest(sendkey);
    testWaitForDiagResponse(sendkey,p2cmax+50);
      /*判断是否解锁成功*/
    if(diagGetLastResponseCode(sendkey)==-1)
      testStepPass("进入工厂模式成功");
    else
      testStepFail("进入工厂模式失败");
  }
  else
    testStepFail("进入工厂模式失败");
  testWaitForTimeout(500);
}
/// <Security Access>
/*
  加入时间，用于高负载测试
*/
qword _get_seed(dword ID,dword Time)        //获取种子
{
  byte Temp[2] = {0x27,0x01};
  byte Serial_Num_Req[3] = {0x22,0xF1,0x8C};
  qword seed_Temp;
  byte Len,i,Falge_AES_CBC;
  byte m;
  Len = 0;
  m = 0;
  seed_Temp = 0;
  Falge_AES_CBC = 0;
  Temp[1] = RequestSeed_27;
  if(AES_128==2 && Get_Seed_Flage==0)/*重复请求种子时跳过发送此部分*/
  {
    _WriteEx_and_Report(ECU_project,"当前采用AES-CBC算法");
    _WriteEx_and_Report("","获取序列号");
    _Send_Diag(3,phyreq_ID,Serial_Num_Req);
    if(diagGetLastResponseCode(SendData) == 0)
      testWaitForDiagResponse(SendData,Time);
    if(diagGetLastResponseCode(SendData) == -1)
    {
      if(DiagGetRespPrimitiveSize(SendData) == 22)
      {
        for(m=0;m<16;m++)
          Serial_number[m] = DiagGetRespPrimitiveByte(SendData,m+6);
        /*序列号移位*/
        LeftMove(Serial_number,3);
        /*用ECU KEY加密移位后的序列号 获取密钥KEY*/
        AES128_CBC_encrypt_buffer(Secret_KEY,Serial_number,KEY_Len,ECU_Key,Iv);
      }
      else
      {
        testStepFail("序列号长度错误");
        Falge_AES_CBC =1;
      }
    }
    else
    {
      testStepFail("获取序列号失败");
      Falge_AES_CBC =1;
    }
  }
  Temp[1] = RequestSeed_27;
  _Send_Diag(2,ID,Temp);
  if(diagGetLastResponseCode(SendData) == 0)
    testWaitForDiagResponse(SendData,Time);
  if(diagGetLastResponseCode(SendData)==-1)
  {
    Len = DiagGetRespPrimitiveSize(SendData);
    if(AES_128==0)
    {
      for(i=2;i<Len;i++)
        seed_Temp = seed_Temp | (DiagGetRespPrimitiveByte(SendData,i)<<((Len-i-1)*8));
      testStep("种子","获取到种子为0x%2X",seed_Temp);
      Seed_Count_List[Seed_Count] = seed_Temp;
      Seed_Count++;
      return seed_Temp;
    }
    else if(AES_128==1)
    {
      _WriteEx_and_Report(ECU_project,"当前采用AES-128算法");
      for(i=2;i<Len;i++)
      {
        Seed_AES[i-2] = DiagGetRespPrimitiveByte(SendData,i);
        Seed_Count_List_AES128[Seed_Count][i-2] = DiagGetRespPrimitiveByte(SendData,i);
      }
      Seed_Count++;
      return 0;
    }
    else if(AES_128==2 && Falge_AES_CBC == 0)
    {
      for(i=2;i<Len;i++)
      {
        Seed_CBC[i-2] = DiagGetRespPrimitiveByte(SendData,i);
        Seed_Count_List_AES128[Seed_Count][i-2] = DiagGetRespPrimitiveByte(SendData,i);
      }
      Seed_Count++;
      return 0;
    }
    else if(AES_128==2 && Falge_AES_CBC == 1)
    {
      _WriteEx_and_Report(ECU_project,"序列号错误导致计算的秘钥不可信");
      return -1;
    }
    else
    {
      _WriteEx_and_Report(ECU_project,"安全访问算法选择异常");
      return -1;
    }
  }
  else
  {
    testStep("","获取种子失败");
    return -1;
  }
}
/// <Security Access>
/*
  默认时间获取种子
*/
qword _get_seed(dword ID)        //获取种子
{
  byte Temp[2] = {0x27,0x01};
  byte Serial_Num_Req[3] = {0x22,0xF1,0x8C};
  qword seed_Temp;
  byte Len,i,Falge_AES_CBC;
  byte m;
  Len = 0;
  m = 0;
  seed_Temp = 0;
  Falge_AES_CBC = 0;
  Temp[1] = RequestSeed_27;
  if(AES_128==2 && Get_Seed_Flage==0)/*重复请求种子时跳过发送此部分*/
  {
    _WriteEx_and_Report(ECU_project,"当前采用AES-CBC算法");
    _WriteEx_and_Report("","获取序列号");
    _Send_Diag_And_Get_CF(3,phyreq_ID,Serial_Num_Req);
    if(diagGetLastResponseCode(SendData) == -1)
    {
      if(DiagGetRespPrimitiveSize(SendData) == 22)
      {
        for(m=0;m<16;m++)
          Serial_number[m] = DiagGetRespPrimitiveByte(SendData,m+6);
        /*序列号移位*/
        LeftMove(Serial_number,3);
        /*用ECU KEY加密移位后的序列号 获取密钥KEY*/
        AES128_CBC_encrypt_buffer(Secret_KEY,Serial_number,KEY_Len,ECU_Key,Iv);
      }
      else
      {
        testStepFail("序列号长度错误");
        Falge_AES_CBC =1;
      }
    }
    else
    {
      testStepFail("获取序列号失败");
      Falge_AES_CBC =1;
    }
  }
  Temp[1] = RequestSeed_27;
  _Send_Diag_And_Get_CF(2,ID,Temp);
  if(diagGetLastResponseCode(SendData)==-1)
  {
    if(DiagGetRespPrimitiveByte(SendData,1) != RequestSeed_27)
      testStepfail("","收到响应异常,非请求种子的应答");
    Len = DiagGetRespPrimitiveSize(SendData);
    if(AES_128==0)
    {
      for(i=2;i<Len;i++)
        seed_Temp = seed_Temp | (DiagGetRespPrimitiveByte(SendData,i)<<((Len-i-1)*8));
      testStep("种子","获取到种子为0x%2X",seed_Temp);
      Seed_Count_List[Seed_Count] = seed_Temp;
      Seed_Count++;
      return seed_Temp;
    }
    else if(AES_128==1)
    {
      // _WriteEx_and_Report(ECU_project,"当前采用AES-128算法");
      for(i=2;i<Len;i++)
      {
        Seed_AES[i-2] = DiagGetRespPrimitiveByte(SendData,i);
        Seed_Count_List_AES128[Seed_Count][i-2] = DiagGetRespPrimitiveByte(SendData,i);
      }
      Seed_Count++;
      return 0;
    }
    else if(AES_128==2 && Falge_AES_CBC == 0)
    {
      for(i=2;i<Len;i++)
      {
        Seed_CBC[i-2] = DiagGetRespPrimitiveByte(SendData,i);
        Seed_Count_List_AES128[Seed_Count][i-2] = DiagGetRespPrimitiveByte(SendData,i);
      }
      Seed_Count++;
      return 0;
    }
    else if(AES_128==2 && Falge_AES_CBC == 1)
    {
      _WriteEx_and_Report(ECU_project,"序列号错误导致计算的秘钥不可信");
      return -1;
    }
    else
    {
      _WriteEx_and_Report(ECU_project,"安全访问算法选择异常");
      return -1;
    }
  }
  else
  {
    testStep("","获取种子失败");
    return -1;
  }
}

/// <Security Access>
_get_seed_Send(dword ID)        //仅发送,不进行其余判断
{
  byte Temp[2] = {0x27,0x01};
  Temp[1] = RequestSeed_27;
  _Send_Diag_NoTime(2,ID,Temp);
}

/// <Security Access>
qword _get_seed_NRC78(dword ID)        //获取种子
{
  byte Temp[2] = {0x27,0x01};
  byte Serial_Num_Req[3] = {0x22,0xF1,0x8C};
  qword seed_Temp;
  byte Len,i,Falge_AES_CBC;
  byte m;
  Len = 0;
  m = 0;
  seed_Temp = 0;
  Falge_AES_CBC = 0;
  Temp[1] = RequestSeed_27;
  if(AES_128==2 && Get_Seed_Flage==0)/*重复请求种子时跳过发送此部分*/
  {
    _WriteEx_and_Report(ECU_project,"当前采用AES-CBC算法");
    _WriteEx_and_Report("","获取序列号");
    _Send_Diag_And_Get_CF(3,phyreq_ID,Serial_Num_Req);
    if(diagGetLastResponseCode(SendData) == -1)
    {
      if(DiagGetRespPrimitiveSize(SendData) == 22)
      {
        for(m=0;m<16;m++)
          Serial_number[m] = DiagGetRespPrimitiveByte(SendData,m+6);
        /*序列号移位*/
        LeftMove(Serial_number,3);
        /*用ECU KEY加密移位后的序列号 获取密钥KEY*/
        AES128_CBC_encrypt_buffer(Secret_KEY,Serial_number,KEY_Len,ECU_Key,Iv);
      }
      else
      {
        testStepFail("序列号长度错误");
        Falge_AES_CBC =1;
      }
    }
    else
    {
      testStepFail("获取序列号失败");
      Falge_AES_CBC =1;
    }
  }
  Temp[1] = RequestSeed_27;
  _Send_Diag_3E80_After_NRC78(2,ID,Temp);
  if(diagGetLastResponseCode(SendData)==-1)
  {
    if(DiagGetRespPrimitiveByte(SendData,1) != RequestSeed_27)
      testStepfail("","收到响应异常,非请求种子的应答");
    Len = DiagGetRespPrimitiveSize(SendData);
    if(AES_128==0)
    {
      for(i=2;i<Len;i++)
        seed_Temp = seed_Temp | (DiagGetRespPrimitiveByte(SendData,i)<<((Len-i-1)*8));
      testStep("种子","获取到种子为0x%2X",seed_Temp);
      Seed_Count_List[Seed_Count] = seed_Temp;
      Seed_Count++;
      return seed_Temp;
    }
    else if(AES_128==1)
    {
      // _WriteEx_and_Report(ECU_project,"当前采用AES-128算法");
      for(i=2;i<Len;i++)
      {
        Seed_AES[i-2] = DiagGetRespPrimitiveByte(SendData,i);
        Seed_Count_List_AES128[Seed_Count][i-2] = DiagGetRespPrimitiveByte(SendData,i);
      }
      Seed_Count++;
      return 0;
    }
    else if(AES_128==2 && Falge_AES_CBC == 0)
    {
      for(i=2;i<Len;i++)
      {
        Seed_CBC[i-2] = DiagGetRespPrimitiveByte(SendData,i);
        Seed_Count_List_AES128[Seed_Count][i-2] = DiagGetRespPrimitiveByte(SendData,i);
      }
      Seed_Count++;
      return 0;
    }
    else if(AES_128==2 && Falge_AES_CBC == 1)
    {
      _WriteEx_and_Report(ECU_project,"序列号错误导致计算的秘钥不可信");
      return -1;
    }
    else
    {
      _WriteEx_and_Report(ECU_project,"安全访问算法选择异常");
      return -1;
    }
  }
  else
  {
    testStep("","获取种子失败");
    return -1;
  }
}

/// <Security Access>
/*
  通过种子计算出密钥并发送
  len 发送长度
  ID 发送ID
  Temp_seed 种子
  type = 0：正确密钥
  type = 1：错误密钥
*/
_Send_Key(byte len, dword ID,qword Temp_seed,dword type)   
{
  byte Key_Data[18];
  dword m=0;
  dword Skey;
  word key_i;
  Key_Data[0] = 0x27;
  Key_Data[1] = SendKey_27;
  if(AES_128 == 0)
  {
    _SecurityAccess(Temp_seed,Skey);
    testStep("密钥","计算出密钥为0x%2X",Skey);
    if(type == 1)
    {
      for(m=2;m<len;m++)
        Key_Data[m] = 0x00;
    }
    else
    {
      for(m=2;m<len;m++)
        Key_Data[m] = (Skey>>(abs(m+1-len)*8))&0xFF;
    }
    _Send_Diag(len,ID,Key_Data);   
  }
  else if(AES_128 == 1)
  {
    _WriteEx_and_Report(ECU_project,"当前采用AES-CMAC算法");
    if(type == 0)
    {
      _Key_Count();
      for(key_i = 0; key_i < 16; key_i++)
        Key_Data[key_i+2] = corresKey[key_i];
    }
    else
    {
      for(key_i = 0; key_i < 16; key_i++)
        Key_Data[key_i+2] = 0x00;
    }
    _Send_Diag(len,ID,Key_Data);
  }
  else if(AES_128 == 2)
  {
    _WriteEx_and_Report(ECU_project,"当前采用AES-CBC算法");
    if(type == 0)
    {
      for(m=0;m<16;m++)
        RA[m]=Seed_CBC[m];
      /*用密钥KEY解密RA 得到ra`*/
      AES128_CBC_decrypt_buffer(ra,RA,KEY_Len,Secret_KEY,Iv);
      /*ra`逆向*/
      reverseNum(ra,16);
      testWaitForTimeout(50);
      /*用密钥KEY加密r得到R*/
      AES128_CBC_encrypt_buffer(R,ra,KEY_Len,Secret_KEY,Iv);
      for(key_i = 0; key_i < 16; key_i++)
        Key_Data[key_i+2] = R[key_i];
    }
    else
    {
      for(key_i = 0; key_i < 16; key_i++)
        Key_Data[key_i+2] = 0x00;
    }
    _Send_Diag(len,ID,Key_Data);
  }
  else
    _WriteEx_and_Report(ECU_project,"安全访问算法选择异常");
}

/// <Security Access>
_Send_Key_NRC78(byte len, dword ID,qword Temp_seed,dword type)   
{
  byte Key_Data[18];
  dword m=0;
  dword Skey;
  word key_i;
  Key_Data[0] = 0x27;
  Key_Data[1] = SendKey_27;
  if(AES_128 == 0)
  {
    _SecurityAccess(Temp_seed,Skey);
    testStep("密钥","计算出密钥为0x%2X",Skey);
    if(type == 1)
    {
      for(m=2;m<len;m++)
        Key_Data[m] = 0x00;
    }
    else
    {
      for(m=2;m<len;m++)
        Key_Data[m] = (Skey>>(abs(m+1-len)*8))&0xFF;
    }
    _Send_Diag_3E80_After_NRC78(len,ID,Key_Data);   
  }
  else if(AES_128 == 1)
  {
    _WriteEx_and_Report(ECU_project,"当前采用AES-CMAC算法");
    if(type == 0)
    {
      _Key_Count();
      for(key_i = 0; key_i < 16; key_i++)
        Key_Data[key_i+2] = corresKey[key_i];
    }
    else
    {
      for(key_i = 0; key_i < 16; key_i++)
        Key_Data[key_i+2] = 0x00;
    }
    _Send_Diag_3E80_After_NRC78(len,ID,Key_Data);
  }
  else if(AES_128 == 2)
  {
    _WriteEx_and_Report(ECU_project,"当前采用AES-CBC算法");
    if(type == 0)
    {
      for(m=0;m<16;m++)
        RA[m]=Seed_CBC[m];
      /*用密钥KEY解密RA 得到ra`*/
      AES128_CBC_decrypt_buffer(ra,RA,KEY_Len,Secret_KEY,Iv);
      /*ra`逆向*/
      reverseNum(ra,16);
      testWaitForTimeout(50);
      /*用密钥KEY加密r得到R*/
      AES128_CBC_encrypt_buffer(R,ra,KEY_Len,Secret_KEY,Iv);
      for(key_i = 0; key_i < 16; key_i++)
        Key_Data[key_i+2] = R[key_i];
    }
    else
    {
      for(key_i = 0; key_i < 16; key_i++)
        Key_Data[key_i+2] = 0x00;
    }
    _Send_Diag_3E80_After_NRC78(len,ID,Key_Data);
  }
  else
    _WriteEx_and_Report(ECU_project,"安全访问算法选择异常");
}
/// <Security Access>
/*
  通过种子计算出密钥并发送
  len 发送长度
  ID 发送ID
  Temp_seed 种子
  type = 0：正确密钥
  type = 1：错误密钥
  type = 2：不进行密钥发送
*/
_Send_Key_NoResponse(byte len, dword ID,qword Temp_seed,dword type)   
{
  byte Key_Data[18];
  dword m=0;
  dword Skey;
  word key_i;
  Key_Data[0] = 0x27;
  Key_Data[1] = SendKey_27;
  if(AES_128 == 0)
  {
    _SecurityAccess(Temp_seed,Skey);
    testStep("密钥","计算出密钥为0x%2X",Skey);
    if(type == 1)
    {
      for(m=2;m<len;m++)
        Key_Data[m] = 0x00;
    }
    else 
    {
      for(m=2;m<len;m++)
        Key_Data[m] = (Skey>>(abs(m+1-len)*8))&0xFF;
    }
    if(type != 2)
      _Send_Diag_NoTime(len,ID,Key_Data);  
    else
    {
      for(m=0;m<len-2;m++)
        Key_Save[m] = Key_Data[m+2];
    }
  }
  else if(AES_128 == 1)
  {
    _WriteEx_and_Report(ECU_project,"当前采用AES-CMAC算法");
    if(type == 0 || type == 2)
    {
      _Key_Count();
      for(key_i = 0; key_i < 16; key_i++)
        Key_Data[key_i+2] = corresKey[key_i];
    }
    else
    {
      for(key_i = 0; key_i < 16; key_i++)
        Key_Data[key_i+2] = 0x00;
    }
    if(type != 2)
      _Send_Diag_NoTime(len,ID,Key_Data);
    else
    {
      for(key_i = 0; key_i < 16; key_i++)
        Key_Save[key_i] = Key_Data[key_i+2];
    }
  }
  else if(AES_128 == 2)
  {
    _WriteEx_and_Report(ECU_project,"当前采用AES-CBC算法");
    if(type == 0 || type == 2)
    {
      for(m=0;m<16;m++)
        RA[m]=Seed_CBC[m];
      /*用密钥KEY解密RA 得到ra`*/
      AES128_CBC_decrypt_buffer(ra,RA,KEY_Len,Secret_KEY,Iv);
      /*ra`逆向*/
      reverseNum(ra,16);
      testWaitForTimeout(50);
      /*用密钥KEY加密r得到R*/
      AES128_CBC_encrypt_buffer(R,ra,KEY_Len,Secret_KEY,Iv);
      for(key_i = 0; key_i < 16; key_i++)
        Key_Data[key_i+2] = R[key_i];
    }
    else
    {
      for(key_i = 0; key_i < 16; key_i++)
        Key_Data[key_i+2] = 0x00;
    }
    if(type != 2)
      _Send_Diag_NoTime(len,ID,Key_Data);
    else
    {
      for(key_i = 0; key_i < 16; key_i++)
        Key_Save[key_i] = Key_Data[key_i+2];
    }
  }
  else
    _WriteEx_and_Report(ECU_project,"安全访问算法选择异常");
}
/// <Security Access>
/*
  通过种子计算出密钥并发送,发送多个正确秘钥
  len 发送长度
  ID 发送ID
  Temp_seed 种子
*/
_Send_Key_(byte len, dword ID,qword Temp_seed,int Type)   
{
  byte Key_Data[500];
  dword m=0;
  dword Skey;
  int i;
  word key_i,End_Byte;
  
  Key_Data[0] = 0x27;
  Key_Data[1] = SendKey_27;
  if(AES_128 == 0)
  {
    byte Skey_Temp_Byte[4];
    _SecurityAccess(Temp_seed,Skey);
    testStep("密钥","计算出密钥为0x%2X",Skey);
    Skey_Temp_Byte[3] = Skey&0xFF;
    Skey_Temp_Byte[2] = (Skey>>8)&0xFF;
    Skey_Temp_Byte[1] = (Skey>>16)&0xFF;
    Skey_Temp_Byte[0] = (Skey>>24)&0xFF;
    for(m=2;m<len;m++)
      Key_Data[m] = Skey_Temp_Byte[(m-2)%4];
  }
  else if(AES_128 == 1)
  {
    _WriteEx_and_Report(ECU_project,"当前采用AES-CMAC算法");
    _Key_Count();
    for(key_i = 0; key_i < len; key_i++)
      Key_Data[key_i+2] = corresKey[key_i%16];
  }
  else if(AES_128 == 2)
  {
    _WriteEx_and_Report(ECU_project,"当前采用AES-CBC算法");
    for(m=0;m<16;m++)
      RA[m]=Seed_CBC[m];
    /*用密钥KEY解密RA 得到ra`*/
    AES128_CBC_decrypt_buffer(ra,RA,KEY_Len,Secret_KEY,Iv);
    /*ra`逆向*/
    reverseNum(ra,16);
    testWaitForTimeout(50);
    /*用密钥KEY加密r得到R*/
    AES128_CBC_encrypt_buffer(R,ra,KEY_Len,Secret_KEY,Iv);
    for(key_i = 0; key_i < len; key_i++)
      Key_Data[key_i+2] = R[key_i%16];
  }
  if(Type>=0)
    Key_Data[1] = Type;
  _Send_Diag(len,ID,Key_Data);   
}

/// <Security Access>
_Key_Count() // 用于匹配简化输入调用，计算安全秘钥使用
{
  switch(AES_CMAC_27)
  {
    case 0:
      _SecurityAccess_AES(Seed_AES,Mask_GeelyAPP,corresKey);break;
    case 1:
      _SecurityAccess_AES(Seed_AES,Mask_RCAPP,corresKey);break;
    case 2:
      _SecurityAccess_AES(Seed_AES,Mask_Chery_APP,corresKey);break;
    case 3:
      _SecurityAccess_AES(Seed_AES,Mask_DongFeng_APP,corresKey);break;
    case 4:
      _SecurityAccess_AES(Seed_AES,Mask_CCAG_APP,corresKey);break;
    default:
      _WriteEx_and_Report("","未收到正确的配置信息");break;
  }
}

dword _Check_Repeat(dword Len)   
{
  dword Repeat_Count;
  dword Repeat_Count_0,Repeat_Count_;
  dword count;
  dword i,j,k;
  int Same_Flage;
  char comment[500];
  char comment_2[500];
  char comment_3[500];
  Repeat_Count = 0;
  Repeat_Count_0 = 0;
  count = 0;
  {
    if(AES_128==0)
    {      
      for(i=0;i<Len;i++)
      {
        Seed_Count_Rept[i][0] = Seed_Count_List[i];
        Same_Flage = _Seed_Repeat( Seed_Count_List[i],i,0);
        if(Same_Flage == 1)
          Repeat_Count++;
      }
      for(i=0;i<Len;i++)
      {
        Seed_Count_Rept[i][1]++; //初始值为1,出现次数在原基础上加上本身
        if(Seed_Count_List[i]==0)
          Repeat_Count_0++;
      }
      if(Repeat_Count_0==Len)   //若获取到的全部为0,则未收到种子，无重复
        Repeat_Count =0;
    }
    else
    {
      for(i=0;i<Len;i++)
      {
        Repeat_Count_ = 0;
        for(k=0;k<16;k++)
        {
          Seed_Count_AES_Rept[i][k] = Seed_Count_List_AES128[i][k];
          if(Seed_Count_List_AES128[i][k] == 0)
            Repeat_Count_++;
          if(Repeat_Count_ == 16)
            Repeat_Count_0++;
        }
        Same_Flage = _Seed_Repeat(Seed_Count_List_AES128[i],i);
        if(Same_Flage == 1)
          Repeat_Count++;
        Seed_Count_AES_Rept[i][16]++; //初始值为1,出现次数在原基础上加上本身
        testWaitForTimeout(10);
      }
    }
    
    {
      snprintf(comment,elCount(comment),"验证 %d 次,当前重复次数为 %d 次",Len,Repeat_Count);
      snprintf(comment_2,elCount(comment_2),"验证 %d 次,全0种子出现 %d 次",Len,Repeat_Count_0);
      _WriteEx_and_Report("",comment);
      _WriteEx_and_Report("",comment_2);
      if(AES_128 == 0)
      {
        for(i=0;i<Seed_Count;i++)
        {
          if(Seed_Count_Rept[i][1]>1)
          {
            snprintf(comment_3,elCount(comment_3),"种子 0x%08X ,出现次数 %d ",Seed_Count_Rept[i][0],Seed_Count_Rept[i][1]);
            _WriteEx_and_Report("",comment_3);
          }
        }
      }
      else
      {
        for(i=0;i<Seed_Count;i++)
        {
          if(Seed_Count_AES_Rept[i][16]>1)
          {
            char Temp_Str[200];
            snprintf(comment_3,elCount(comment_3),"");
            snprintf(Temp_Str,elCount(Temp_Str),"种子0x");
            for(k=0;k<16;k++)
              snprintf(Temp_Str,elCount(Temp_Str),"%s%02X",Temp_Str,Seed_Count_AES_Rept[i][k]);
            snprintf(comment_3,elCount(comment_3),"%s,出现次数 %d ",Temp_Str,Seed_Count_AES_Rept[i][16]);
            _WriteEx_and_Report("",comment_3);
          }
        }
      }
      if(Request_Seed_Consistency==1)
      {
        if(Repeat_Count!=Len )
          testStepFail("","重复次数与请求次数不等，重复次数为%d",Repeat_Count);
        else
          testStepPass("","重复次数与请求次数相等");
      }
    }
  }
  _Clear_Seed();
  return Repeat_Count;
}

dword _Check_Repeat(int Len,byte Type)   
{
  dword Repeat_Count;
  dword Repeat_Count_0,Repeat_Count_;
  dword count;
  dword i,j,k;
  char comment[500];
  char comment_2[500];
  char comment_3[500];
  int Same_Flage;
  Repeat_Count = 0;
  Repeat_Count_0 = 0;
  count = 0;
  if(Type==0)
    _Check_Repeat(Len);
  else
  {
    if(AES_128==0)
    {
      for(i=0;i<Len;i++)
      {
        Seed_Count_Rept[i][0] = Seed_Count_List[i];
        Same_Flage = _Seed_Repeat( Seed_Count_List[i],i,0);
        if(Same_Flage == 1)
          Repeat_Count++;
      }
      for(i=0;i<Len;i++)
      {
        Seed_Count_Rept[i][1]++; //初始值为1,出现次数在原基础上加上本身
        if(Seed_Count_List[i]==0)
          Repeat_Count_0++;
      }
      if(Repeat_Count_0==Len)   //若获取到的全部为0,则未收到种子，无重复
        Repeat_Count =0;
    }
    else
    {
      for(i=0;i<Len;i++)
      {
        Repeat_Count_ = 0;
        for(k=0;k<16;k++)
        {
          Seed_Count_AES_Rept[i][k] = Seed_Count_List_AES128[i][k];
          if(Seed_Count_List_AES128[i][k] == 0)
            Repeat_Count_++;
          if(Repeat_Count_ == 16)
            Repeat_Count_0++;
        }
        Same_Flage = _Seed_Repeat(Seed_Count_List_AES128[i],i);
        if(Same_Flage == 1)
          Repeat_Count++;
        Seed_Count_AES_Rept[i][16]++; //初始值为1,出现次数在原基础上加上本身
        testWaitForTimeout(3);
      }
    }
    snprintf(comment,elCount(comment),"验证 %d 次,当前重复次数为 %d 次",Len,Repeat_Count);
    snprintf(comment_2,elCount(comment_2),"验证 %d 次,全0种子出现 %d 次",Len,Repeat_Count_0);
    _WriteEx_and_Report("",comment);
    _WriteEx_and_Report("",comment_2);
    if(AES_128 == 0)
    {
      for(i=0;i<Seed_Count;i++)
      {
        if(Seed_Count_Rept[i][1]>1)
        {
          snprintf(comment_3,elCount(comment_3),"种子 0x%08X ,出现次数 %d ",Seed_Count_Rept[i][0],Seed_Count_Rept[i][1]);
          _WriteEx_and_Report("",comment_3);
        }
      }
    }
    else
    {
      for(i=0;i<Seed_Count;i++)
      {
        if(Seed_Count_AES_Rept[i][16]>1)
        {
          char Temp_Str[200];
          snprintf(comment_3,elCount(comment_3),"");
          snprintf(Temp_Str,elCount(Temp_Str),"种子0x");
          for(k=0;k<16;k++)
            snprintf(Temp_Str,elCount(Temp_Str),"%s%02X",Temp_Str,Seed_Count_AES_Rept[i][k]);
          snprintf(comment_3,elCount(comment_3),"%s,出现次数 %d ",Temp_Str,Seed_Count_AES_Rept[i][16]);
          _WriteEx_and_Report("",comment_3);
        }
      }
    }
    if(Len>=10000 && Repeat_Count >=5)
      testStepFail("","");
    else
      testStepPass("","");
  }
  testWaitForTimeout(2000);
  _Clear_Seed();
  return Repeat_Count;
}
/*
  检测种子是否已经出现过重复
  Seed_ 待检测种子
  _Repeat_Count:已重复种子列表个数
  Type = 0：非AES128类算法,种子长度在4byte以内
*/
int _Seed_Repeat(qword Seed_,dword _Repeat_Count,byte Type)
{
  int Return_Value;
  int k;
  Return_Value = 0;
  for(k=0;k<_Repeat_Count;k++)
  {
    if(Type == 0)
    {
      if(Seed_ == Seed_Count_Rept[k][0])
      {
        Seed_Count_Rept[k][1]++;
        Return_Value = 1;
        break;
      }
    }
  }
  return  Return_Value;
}
/*
  检测种子是否已经出现过重复
  AES 128型
  Seed_ 待检测种子
  _Repeat_Count:列表个数
*/
int _Seed_Repeat(byte Seed_[],dword _Repeat_Count)
{
  int Return_Value;
  int k,m;
  Return_Value = 0;
  for(k=0;k<_Repeat_Count;k++)
  {
    for(m=0;m<16;m++)
    {
      if(Seed_[m] != Seed_Count_AES_Rept[k][m])
        break;
    }
    if(m == 16)
    {
      Seed_Count_AES_Rept[k][16]++;
      Return_Value = 1;
      break;
    }
  }
  return  Return_Value;
}

/// <Security Access>
//安全算法
_SecurityAccess(dword SaccSeed,dword& SaccKey)
{
  if(strncmp(ECU_project,"BYD",strlen(ECU_project)) == 0 && strlen(ECU_project) == strlen("BYD"))
  {
    dword KeyK;
    dword KeyResult;
    KeyK = 0X00000137;
    _WriteEx_and_Report(ECU_project,"当前项目为BYD,采用BYD安全算法");
    KeyResult = ((((SaccSeed >> 1) ^ SaccSeed) <<3) ^ (SaccSeed >>2));
    SaccKey = KeyResult ^ KeyK;
  }
  else if(strncmp(ECU_project,"ChangAn",strlen(ECU_project)) == 0 && strlen(ECU_project) == strlen("ChangAn"))
  {
    dword key1;
    dword key2;
    dword getSeed1;
    dword getSeed2;
    dword AppKeyConst;
    int i;
    AppKeyConst  =0x70F77302;
    key1 = 0;key2 = 0;
    getSeed2  = 0;
    getSeed1 = SaccSeed;
    _WriteEx_and_Report(ECU_project,"当前项目为长安,采用长安安全算法");
    key1 = AppKeyConst ^ getSeed1;
    for(i = 32;i > 0;i--)
  	{
  		getSeed2 |=  ((getSeed1 & 0x80000000) >> (i-1));
      getSeed1 = getSeed1<<1;
  	}
  	key2 = AppKeyConst ^ getSeed2;
  	SaccKey = (dword)(key1 + key2);
  }
  else if(strncmp(ECU_project,"SGMW",strlen(ECU_project)) == 0 && strlen(ECU_project) == strlen("SGMW"))
  {
    word uds_key_mul[32] = 
    {
      0x7678, 0x9130, 0xd753, 0x750f, 0x72cb, 0x55f7, 0x13da, 0x786b, 
      0x372a, 0x4932, 0x0e7c, 0x3687, 0x3261, 0xa82c, 0x8935, 0xd00c, 
      0x1995, 0x4311, 0xb854, 0x0d8d, 0x9863, 0x1a21, 0xf753, 0xd6d3,
      0xb15d, 0x7f3d, 0x6821, 0x791c, 0x26c5, 0x2e37, 0x0e69, 0x64a0 
    };
    dword temp;
  	word index;
  	word mult1;
  	word mult2;
    dword NC_DEFAULT_SEED;
    dword NC_UDS_KEYMASK;
    NC_DEFAULT_SEED=0xA548FD85;
    NC_UDS_KEYMASK=0x5C7D4EF3;
    index = 0x5D39;
  	if(SaccSeed == 0) 
  		SaccSeed = NC_DEFAULT_SEED;
  	for(temp=0x80000000;temp!=0;temp>>=1)
  	{
  		if(temp & SaccSeed) 
      {
  			index = croshortright(index,1);
  			if (temp & NC_UDS_KEYMASK) 
  				index ^= 0x74c9;
  		}
  	}
  	mult1 = (uds_key_mul[(index >> 2) & ((1 << 5) - 1)] ^ index);
  	mult2 = (uds_key_mul[(index >> 8) &((1 << 5) - 1)] ^ index);
  	temp = (((dword) mult1) << 16) | ((dword) mult2);
  	temp = mulu32(SaccSeed,temp);
  	SaccKey = temp;
  }
  else if(strncmp(ECU_project,"Geely1.0",strlen(ECU_project)) == 0 && strlen(ECU_project) == strlen("Geely1.0"))
  {
    byte i;
    byte XorArray[4] = {0xC1,0x1C,0x12,0x81};
    byte calData[4];
    byte skeybyte[4];
    for (i = 0;i < 4;i++)
      calData[i] = 0;
    for (i = 0;i < 4;i++)
      calData[i] = ((SaccSeed>>(24-8*i))&0xFF)^ XorArray[i];/*修改秘钥传入方式为MSB*/
    skeybyte[0] = ((calData[3] & 0x0F) << 4 )|(calData[3]&0xF0);
    skeybyte[1] = ((calData[1] & 0x0F) << 4 )|((calData[0]&0xF0) >> 4 );
    skeybyte[2] = (calData[1] & 0xF0)|((calData[2] & 0xF0) >> 4);
    skeybyte[3] = ((calData[0] & 0x0F) << 4 )|(calData[2] & 0x0F);
    SaccKey=skeybyte[0];
    SaccKey=(SaccKey<<8)|skeybyte[1];
    SaccKey=(SaccKey<<8)|skeybyte[2];
    SaccKey=(SaccKey<<8)|skeybyte[3];
  }
  else if(strncmp(ECU_project,"BaoTeng",strlen(ECU_project)) == 0 && strlen(ECU_project) == strlen("BaoTeng"))
  {
    byte i;
    byte XorArray[4] = {0x53,0x4E,0x22,0xCD};
    byte calData[4];
    byte skeybyte[4];
    for (i = 0;i < 4;i++)
      calData[i] = 0;
    for (i = 0;i < 4;i++)
      calData[i] = ((SaccSeed>>(24-8*i))&0xFF)^ XorArray[i];/*修改秘钥传入方式为MSB*/
    skeybyte[0] = ((calData[3] & 0x0F) << 4 )|(calData[3]&0xF0);
    skeybyte[1] = ((calData[1] & 0x0F) << 4 )|((calData[0]&0xF0) >> 4 );
    skeybyte[2] = (calData[1] & 0xF0)|((calData[2] & 0xF0) >> 4);
    skeybyte[3] = ((calData[0] & 0x0F) << 4 )|(calData[2] & 0x0F);
    SaccKey=skeybyte[0];
    SaccKey=(SaccKey<<8)|skeybyte[1];
    SaccKey=(SaccKey<<8)|skeybyte[2];
    SaccKey=(SaccKey<<8)|skeybyte[3];
  }
  else if((strncmp(ECU_project,"DongFeng",strlen(ECU_project)) == 0 && strlen(ECU_project) == strlen("DongFeng")) || (strncmp(ECU_project,"Seres",strlen(ECU_project)) == 0 && strlen(ECU_project) == strlen("Seres")))
  {
    byte i;
    byte XorArray[4] = {0xD1,0x31,0x54,0x07};
    byte calData[4];
    byte skeybyte[4];
    for (i = 0;i < 4;i++)
    {
      calData[i] = 0;
      skeybyte[i] = 0;
    }
    for (i = 0;i < 4;i++)
      calData[i] = ((SaccSeed>>(24-8*i))&0xFF)^ XorArray[i];/*修改秘钥传入方式为MSB*/
    skeybyte[0] = ((calData[0] & 0x0F) << 4 )|(calData[1]&0xF0);
    skeybyte[1] = ((calData[1] & 0x0F) << 4 )|((calData[2]&0xF0) >> 4 );
    skeybyte[2] = (calData[2] & 0xF0)|((calData[3] & 0xF0) >> 4);
    skeybyte[3] = ((calData[3] & 0x0F) << 4 )|(calData[0] & 0x0F);
    SaccKey=skeybyte[0];
    SaccKey=(SaccKey<<8)|skeybyte[1];
    SaccKey=(SaccKey<<8)|skeybyte[2];
    SaccKey=(SaccKey<<8)|skeybyte[3];
  }  
  else if((strncmp(ECU_project,"SRM",strlen(ECU_project)) == 0 && strlen(ECU_project) == strlen("SRM")))
  {
    byte i;
    byte XorArray[4] = {0xA1,0x59,0xD4,0x30};
    byte getKey[4];
    byte getSeed[4];
    byte Cal[4];
    dword _Key;
    _Key = 0;
    for (i = 0;i < 4;i++)
    {
      Cal[i] = 0;
      getKey[i] = 0;
      getSeed[i] = 0;
    }
    getSeed[0] = (SaccSeed>>24)&0xFF;
    getSeed[1] = (SaccSeed>>16)&0xFF;
    getSeed[2] = (SaccSeed>>8)&0xFF;
    getSeed[3] = (SaccSeed)&0xFF;
    for(i=0;i<4;i++)
      Cal[i] = getSeed[i]^XorArray[i];
    
    getKey[0] = ((Cal[3] & 0x0f)<<4) | (Cal[0] & 0xff);
		getKey[1] =	(Cal[1] & 0xd8) | ((Cal[2] & 0xf0)>>4);
		getKey[2] =	(Cal[2] & 0xcf) | (Cal[0] & 0xf0);
		getKey[3] = (Cal[3] & 0xf0) | ((Cal[1] & 0xd0)>>4);
    
    _Key |= getKey[0]<<24;
    _Key |= getKey[1]<<16;
    _Key |= getKey[2]<<8;
    _Key |= getKey[3];
    SaccKey = _Key;
  }
  else if(strncmp(ECU_project,"Chery",strlen(ECU_project)) == 0 && strlen(ECU_project) == strlen("Chery"))
  {
    Byte bSeed[2];
    Word remainder;
    Byte n;
    Byte i;
    bSeed[0] = (Byte)(SaccSeed >> 8); 
    bSeed[1] = (Byte)SaccSeed; 
    remainder =0xFFFE;
    for (n = 0; n < 2; n++)
    {
      remainder ^= ((bSeed[n]) << 8);
      for (i = 0; i < 8; i++)
      {
        if (remainder & 0x8000)
        {
          if(remainder & 0x0080)
            remainder = (remainder << 1) ^ 0x8408;
          else
            remainder = (remainder << 1) ^ 0x8025;
        }
        else
          remainder = (remainder << 1);
      }
    }
    SaccKey = remainder;
  }
  else if(strncmp(ECU_project,"GAC",strlen(ECU_project)) == 0 && strlen(ECU_project) == strlen("GAC"))
  {
    dword _Key;
    dword APPKeyConst;
    byte Seed[4],Key_[4],AppConst[4];
    int i;
    APPKeyConst = 0x20F77302;
    _Key = 0;
    for(i=0;i<4;i++)
    {
      Seed[i] = (SaccSeed>>(8*(4-i-1)))&0xFF;
      AppConst[i] = (APPKeyConst>>(8*(4-i-1)))&0xFF;
      Key_[i] = Seed[i] ^ AppConst[i];
    }
    for(i=0;i<4;i++)
      _Key = _Key + (Key_[i]<<(8*(4-1-i)));
    SaccKey = _Key;
  }
}
/// <Security Access>
/*数组逆向*/
void reverseNum(byte num[],dword size)
{
  dword startnum;
  dword temp;
  dword endnum;
  
  startnum = 0;
  endnum = size - 1;
  while(startnum < endnum)
  {
    temp = num[startnum];
    num[startnum] = num[endnum];
    num[endnum] = temp;
    startnum++;
    endnum--;
  }
}
/// <Security Access>
/*数组移位*/
void LeftMove(byte Serial_Num[],byte bit)
{
  dword i;
  byte current;
  byte carry;
  byte shif;  
  carry = 0;
  for(i=15;i>=0;i--)
  {
    current = Serial_Num[i];
    shif = current << bit;
    shif |= carry;
    Serial_Num[i] = shif & 0xFF;
    carry = (current>>(8-bit)) & ((1<<bit)-1);
  }
}
/// <Security Access>
//用于五菱安全算法
word croshortright(word c, word b)
{
	word right;
	word left;
	word crorightvalue;
  right = c >> b;
  left = c << (16 - b);
  crorightvalue = left | right;
	return crorightvalue;
}
/// <Security Access>
//用于五菱安全算法
dword croleft(dword c, word b)
{
	dword left;
	dword right;
	dword croleftvalue;
  left = c << b;
  right = c >> (32 - b);
  croleftvalue = left | right;
	return croleftvalue;
}
/// <Security Access>
//用于五菱安全算法
dword mulu32(dword val1, dword val2)
{
	dword x, y, z, p;
  dword NC_UDS_KEYMASK=0x5c7d4ef3;
	x = (val1 & NC_UDS_KEYMASK) | ((~val1) & val2);
	y = ((croleft(val1, 1)) & (croleft(val2, 14)))
	        | ((croleft(NC_UDS_KEYMASK, 21)) & (~(croleft(val1, 30))));
	z = (croleft(val1, 17)) ^ (croleft(val2, 4))
	        ^ (croleft(NC_UDS_KEYMASK, 11));
	p = x ^ y ^ z;
	return p;
}
/// <Security Access>
void _SecurityAccess_AES(dword seed[], word Byte_[],word corresKey[])
{
  char M[16],mic[16];
  int i;
  char fixByte[16];
  word gHandle;
  for(i=0;i<16;i++)
  {
    fixByte[i] = Byte_[i];
  }
  gHandle = registerCAPLDLL();
  for(i = 0; i < 16; i++)
  {
    M[i] = seed[i];
  }
  aes_128_cmac(M,fixByte,mic);
  for(i = 0; i < 16; i++)
  {
    corresKey[i] = mic[i] & 0xFF;
  }
  fileClose(gHandle);
}

/// <Security Access>
/*2702密钥填充：type:0:正确密钥  1:错误密钥*/
void _padding2702(int type)
{
  word key_i;
//  dword Seed_AES_[16] = {0x6b,0xc1,0xbe,0xe2,0x2e,0x40,0x9f,0x96,0xe9,0x3d,0x7e,0x11,0x73,0x93,0x17,0x2a};
  if(type == 0)
  {
    _Key_Count();
    for(key_i = 0; key_i < 16; key_i++)
      DiagSetPrimitiveByte(sendkey,key_i+2,corresKey[key_i]);
  }
  else
  {
    for(key_i = 0; key_i < 16; key_i++)
      DiagSetPrimitiveByte(sendkey,key_i+2,0x00);
  }
}
/**
  将接受到的所有报文装载到responseMsgs中
  且第一帧在50ms，后续帧通过参数time来控制
**/
void _saveMsg(int time)
{
  byte i,j;
  int flag_getMsg;
  flag_getMsg = _getMsg(responseMsgs[0],p2cmax);
  if(flag_getMsg == 1)
  {
    for(i = 1; i < 10; i++)
    {
      _getMsg(responseMsgs[i],N_Cr_Time);
      if(responseMsgs[i].dlc == 0)
        break;
    }
  }
}
/**
  获取报文，判断报文响应时间是否在目标时间time内
**/
int _getMsg(message 0x00 msg,int time)
{
  char comment[50];
  byte i;
  int re;
  int resave;
  int flag_getMsg;//判断有没有获取到报文
  re = testWaitForMessage(Response_ID,time);
  if(re>0)
  {
    testGetWaitEventMsgData(msg);
    snprintf(comment,elCount(comment),"已收到报文");
    for(i=0;i<8;i++)
    {
      snprintf(comment,elCount(comment),"%s %02X",comment,msg.byte(i));
    }
    resave++;
    flag_getMsg = 1;
  }
  else
    flag_getMsg = 0;
  
  if(re == 0 && resave == 0)
  {
    if(noFail == 0)
      TestStepFail("报文响应超时");
  }
  return flag_getMsg;
}
//发送请求等待响应，并将请求和响应写进报告。如果响应是多帧不要使用此函数，因为p2cmax时间可能不够
_SendAndWriteReport_NoTime(diagRequest* obj,dword ID)
{
  char comment[70];
  byte primitiveRaw[300];
  long size;
  byte i;
  
  size=DiagGetPrimitiveData(obj,primitiveRaw,elCount(primitiveRaw));
  if(DiagGetPrimitiveByte(obj,0) == 0x10 || DiagGetPrimitiveByte(obj,0) == 0x11 || DiagGetPrimitiveByte(obj,0) == 0x27 || DiagGetPrimitiveByte(obj,0) == 0x3E)
  {
    NRC78_flag = 1;
  }
  if(ID==@sysvar::DID::phyreq_ID)
    snprintf(comment,elCount(comment),"已发送物理寻址请求:[%02X]",size);
  else
    snprintf(comment,elCount(comment),"已发送功能寻址请求:[%02X]",size);
  for(i=0;i<size;i++)
  {
    snprintf(comment,elCount(comment),"%s %02X",comment,primitiveRaw[i]);
  }
  if(ID==@sysvar::DID::phyreq_ID)
    diagSendRequest(obj);
  else if(ID==@sysvar::DID::funreq_ID)
    diagSendFunctional(obj);
  
  diagSetP2Extended(-1);
  testWaitForDiagRequestSent(obj,500);
  testCaseComment(comment);
  writeEx(-3,0,comment);
  testReportWriteDiagObject(obj);
}
int _CheckCode(int passcondition,int checkLength)
{
  int resNum,i,j,allRes_i;
  int checkResult;
  word allRes[100];
  word dlc,allRes_length;
  checkResult = 0;
  dlc = 8;
  for(i = 0; i< 10; i++)//获取当前响应码序列长度
  {
    if(responseMsgs[i].dlc == 0)
      break;
    else if(responseMsgs[i].byte(0) == 0x03 && responseMsgs[i].byte(1) == 0x7f && responseMsgs[i].byte(3) == 0x78 && NRC78_flag == 0)//响应78不存入验证数组
    {
      allRes_i++;
      resNum--;
    }
    else if(responseMsgs[i].byte(0) == 0x30 )  //流控帧不计入数组
    {
      allRes_i++;
      resNum--;
    }
    else
    {
      for(j = 0; j < dlc ; j++)
        allRes[((i-allRes_i)*dlc)+j] = responseMsgs[i].byte(j);
    }  
    resNum++;
  }
  allRes_length = resNum * dlc;
  if(AES_128 == 1 && allRes_length > 0)//将响应的种子存入seed    需注意区分CAN与CANFD
  {
    word inx;
    inx = 4;
    if(Response_CanFD==0)
    {
      for(j = 0; j < 16; j++)
      {
        Seed_AES[j] = allRes[j+inx];
        if(j == 3)
          inx = 5;
        if(j == 10)
          inx = 6;
      }
    }
    else
    {
      for(j = 0; j < 16; j++)
        Seed_AES[j] = allRes[j+inx];
    }
    inx = 4;
  }
  if(passcondition == -1)
    testStepPass("收到肯定响应");
  else if(passcondition == 0)
    testStepfail("无响应");
  else
    testStepfail("收到否定响应");
  resNum = 0;
  allRes_i = 0;
  NRC78_flag = 0;
  for(i = 0; i < 100 ; i++)
    allRes[i] = 0;
  _initMsg(responseMsgs);
  return checkResult;
}
/* 操作完后将responseMsgs重置*/
void _initMsg(message 0x00 msg[])
{
  message 0x00 init_msg;
  word i;
  for(i = 0; i < elCount(msg); i++)
    msg[i] = init_msg;
}

//重置为默认会话或扩展会话
_SetSession(byte Session)
{
  if(Session==defsession)
  {
    _Switch_To_Def();
    Session_BIN = 0x01;
  }
  else if(Session==exsession)
  {
    _Switch_To_Ex();
    Session_BIN = 0x04;
  }
}
//请求重置为默认会话
_Switch_To_Def()
{
  testCaseComment("请求重置为默认会话");
  diagResize(Session_Start,2);
  DiagSetPrimitiveByte(Session_Start,0,0x10);
  DiagSetPrimitiveByte(Session_Start,1,defsession);
  diagSendRequest(Session_Start);
  testWaitForDiagRequestSent(Session_Start,50);
  diagSetP2Extended(-1);
  testWaitForDiagResponse(Session_Start,p2cmax);
  if(diagGetLastResponseCode(Session_Start)==0x78)
  {
    do{
    testWaitForDiagResponse(Session_Start,p2cmax*100);
    }while(diagGetLastResponseCode(Session_Start)==0x78);
  }
  /*判断重置默认会话是否成功并体现在报告里*/
  if(diagGetLastResponseCode(Session_Start)==-1)
    testStepPass("重置默认会话成功");
  else
    testStepFail("重置默认会话失败");
}

//请求重置为扩展会话
_Switch_To_Ex()
{
  testCaseComment("请求重置为扩展会话");
//  diagSetTarget(Cdd_Name); //重新连接Cdd文件会导致前面定义的信息无效化
  diagResize(Session_Start,2);
  DiagSetPrimitiveByte(Session_Start,0,0x10);
  DiagSetPrimitiveByte(Session_Start,1,exsession);
  diagSendRequest(Session_Start);
  testWaitForDiagRequestSent(Session_Start,50);
  diagSetP2Extended(-1);
  testWaitForDiagResponse(Session_Start,p2cmax);
  if(diagGetLastResponseCode(Session_Start)==0x78)
  {
    do{
    testWaitForDiagResponse(Session_Start,p2cmax*100);
    }while(diagGetLastResponseCode(Session_Start)==0x78);
  }
  /*判断重置扩展会话是否成功并体现在报告里*/
  if(diagGetLastResponseCode(Session_Start)==-1)
    testStepPass("重置扩展会话成功");
  else
    testStepFail("重置扩展会话失败");
}
//重置为默认会话或扩展会话
_SetSession(byte Session,dword Time)
{
  if(Session==defsession)
  {
    _Switch_To_Def(Time);
    Session_BIN = 0x01;
  }
  else if(Session==exsession)
  {
    _Switch_To_Ex(Time);
    Session_BIN = 0x04;
  }
}
//请求重置为默认会话
_Switch_To_Def(dword Time)
{
  testCaseComment("请求重置为默认会话");
  diagResize(Session_Start,2);
  DiagSetPrimitiveByte(Session_Start,0,0x10);
  DiagSetPrimitiveByte(Session_Start,1,defsession);
  diagSendRequest(Session_Start);
  testWaitForDiagRequestSent(Session_Start,500);
  diagSetP2Extended(-1);
  testWaitForDiagResponse(Session_Start,Time);
  if(diagGetLastResponseCode(Session_Start)==0x78)
    testWaitForDiagResponse(Session_Start,Time*100);
  /*判断重置默认会话是否成功并体现在报告里*/
  if(diagGetLastResponseCode(Session_Start)==-1)
    testStepPass("重置默认会话成功");
  else
    testStepFail("重置默认会话失败");
}

//请求重置为扩展会话
_Switch_To_Ex(dword Time)
{
  testCaseComment("请求重置为扩展会话");
  diagResize(Session_Start,2);
  DiagSetPrimitiveByte(Session_Start,0,0x10);
  DiagSetPrimitiveByte(Session_Start,1,exsession);
  diagSendRequest(Session_Start);
  testWaitForDiagRequestSent(Session_Start,500);
  diagSetP2Extended(-1);
  testWaitForDiagResponse(Session_Start,Time);
  if(diagGetLastResponseCode(Session_Start)==0x78)
    testWaitForDiagResponse(Session_Start,Time*100);
  /*判断重置扩展会话是否成功并体现在报告里*/
  if(diagGetLastResponseCode(Session_Start)==-1)
    testStepPass("重置扩展会话成功");
  else
    testStepFail("重置扩展会话失败");
}

/*
    打印数据到Trace界面以及Report报告中
*/
_WriteEx_and_Report(char str1[],char str2[])
{
  char str[500];
  
  snprintf(str,elCount(str),"%s","");
  
  TestStep(str1,str2);
  strncpy(str,str1,elCount(str));
  strncat(str,"   ",elCount(str));
  strncat(str,str2,elCount(str));
  writeEx(-3,0,str);
}
/*
    打印数据到Trace界面以及Report报告中
*/
_WriteEx_and_Report(char str1[],char str2[],char str3[])
{
  char str[500];
  char str_[500];
  
  snprintf(str,elCount(str),"%s","");
  snprintf(str_,elCount(str_),"%s","");
  strncpy(str,str1,elCount(str));
  strncat(str,"   ",elCount(str));
  strncat(str,str2,elCount(str));
  snprintf(str,elCount(str),"%s%s",str,str3);
  writeEx(-3,0,str);
  snprintf(str_,elCount(str_),"%s%s",str2,str3);
  TestStep(str1,str_);
}
/*
    打印数据到Trace界面以及Report报告中
*/
_WriteEx_and_Report(char str1[],char str2[],dword Da)
{
  char str[500];
  
  snprintf(str,elCount(str),"%s","");
  
  TestStep(str1,str2,Da);
  strncpy(str,str1,elCount(str));
  strncat(str,"   ",elCount(str));
  strncat(str,str2,elCount(str));
  writeEx(-3,0,str,Da);
}
/*
    打印数据到Trace界面以及Report报告中
*/
_WriteEx_and_Report(char str1[],char str2[],float Da)
{
  char str[500];
  
  snprintf(str,elCount(str),"%s","");
  
  TestStep(str1,str2,Da);
  strncpy(str,str1,elCount(str));
  strncat(str,"   ",elCount(str));
  strncat(str,str2,elCount(str));
  writeEx(-3,0,str,Da);
}
/*
    打印数据到Trace界面以及Report报告中
*/
_WriteEx_and_Report(char str1[],char str2[],char Sig[],dword Da)
{
  char str[500];
  
  snprintf(str,elCount(str),"%s","");
  
  TestStep(str1,str2,Da);
  strncpy(str,str1,elCount(str));
  strncat(str,"   ",elCount(str));
  strncat(str,str2,elCount(str));
  writeEx(-3,0,str,Sig,Da);
}

_Check_Response_2E(diagRequest *Diag,dword LenInput,byte Tx_Data[])
{
  dword ReSize,i;
  byte Temp_Flage_1;
  i = 0;
  Temp_Flage_1=0;
  if(diagGetLastResponseCode(Diag) == 0)
    testWaitForDiagResponse(Diag,1000);
  ReSize = DiagGetRespPrimitiveSize(Diag);
  if(diagGetLastResponseCode(Diag) == 0)
  {
    testStepFail("未收到响应");
    writeEx(-3,0,"未收到响应");
  }
  else if(diagGetLastResponseCode(Diag) > 0)
  {
    testStepFail("收到消极应答");
    writeEx(-3,0,"收到消极应答");
  }
  else if(diagGetLastResponseCode(Diag) == -1)
  {
    if(ReSize == LenInput)
      testStepPass("","反馈长度与预期一致");
    else
      testStepFail("","反馈长度与预期不一致,预期为：%d，实际为：%d",LenInput,ReSize);
    if(DiagGetRespPrimitiveByte(SendData,0)!=0x62)
      testStepFail("","反馈值与预期不一致,预期为0x%2X,实际为0x%2X",0x62,DiagGetRespPrimitiveByte(SendData,0));
    if(strncmp(ECU_project,"BYD",strlen(ECU_project)) == 0 && strlen(ECU_project) == strlen("BYD"))
    {
      if(Tx_Data[0]==0x2E && Tx_Data[1] == 0xf1 && Tx_Data[2] == 0xa1)
      {
        for(i=3;i<LenInput-1;i++)
        {
          if(Tx_Data[i]!=0x00 && Tx_Data[i]!=0xFF)
            Temp_Flage_1 = 1;
        }
        if(Temp_Flage_1==1)
        {
          for(i=1;i<ReSize-1;i++)
          {
            if(DiagGetRespPrimitiveByte(SendData,i)!=Tx_Data[i])
              testStepFail("","第 %d 位,反馈值与预期不一致,预期为0x%2X,实际为0x%2X",i+1,Tx_Data[i],DiagGetRespPrimitiveByte(SendData,i));
            else
              testStepPass("","反馈值与预期一致");
          } 
        }
        else
        {
          if(DiagGetRespPrimitiveByte(SendData,ReSize-1)!=0x00)
            testStepFail("","第 %d 位,反馈值与预期不一致,预期为0x%X,实际为0x%X",ReSize,0x00,DiagGetRespPrimitiveByte(SendData,ReSize-1));
          else
            testStepPass("","反馈值与预期一致");
        }
      }
      else
      {
        for(i=1;i<ReSize;i++)
        {
          if(DiagGetRespPrimitiveByte(SendData,i)!=Tx_Data[i])
            testStepFail("","第 %d 位,反馈值与预期不一致,预期为0x%2X,实际为0x%2X",i+1,Tx_Data[i],DiagGetRespPrimitiveByte(SendData,i));
          else
            testStepPass("","反馈值与预期一致");
        }
      }
    }
    else
    {
      for(i=1;i<ReSize;i++)
      {
        if(DiagGetRespPrimitiveByte(SendData,i)!=Tx_Data[i])
          testStepFail("","第 %d 位,反馈值与预期不一致,预期为0x%2X,实际为0x%2X",i+1,Tx_Data[i],DiagGetRespPrimitiveByte(SendData,i));
        else
          testStepPass("","反馈值与预期一致");
      }
    }
  }
}
_Check_Response_Part_number(diagRequest *Diag,dword LenInput,byte Tx_Data[])
{
  dword ReSize,i;
  byte Temp_Flage_1;
  i = 0;
  Temp_Flage_1=0;
  if(diagGetLastResponseCode(Diag) == 0)
    testWaitForDiagResponse(Diag,1000);
  ReSize = DiagGetRespPrimitiveSize(Diag);
  if(diagGetLastResponseCode(Diag) == 0)
  {
    testStepFail("未收到响应");
    writeEx(-3,0,"未收到响应");
  }
  else if(diagGetLastResponseCode(Diag) > 0)
  {
    testStepFail("收到消极应答");
    writeEx(-3,0,"收到消极应答");
  }
  else if(diagGetLastResponseCode(Diag) == -1)
  {
    if(DiagGetRespPrimitiveByte(SendData,0)!=0x62)
      testStepFail("","反馈值与预期不一致,预期为0x%2X,实际为0x%2X",0x62,DiagGetRespPrimitiveByte(SendData,0));
    if(Write_Part_number_Special == 0)
    {
      if(ReSize == LenInput)
        testStepPass("","反馈长度与预期一致");
      else
        testStepFail("","反馈长度与预期不一致,预期为：%d，实际为：%d",LenInput,ReSize);
      for(i=1;i<ReSize;i++)
      {
        if(DiagGetRespPrimitiveByte(SendData,i)!=Tx_Data[i])
          testStepFail("","第 %d 位,反馈值与预期不一致,预期为0x%2X,实际为0x%2X",i+1,Tx_Data[i],DiagGetRespPrimitiveByte(SendData,i));
        else
          testStepPass("","反馈值与预期一致");
      }
    }
    else if(Write_Part_number_Special == 1)
    {
      // 2E 00 01 11 22 33 44 55 66 77 88 99 AA 11 22 22 33 44
      if(ReSize == LenInput-10)/*减去 11 22 …… AA长度*/
        testStepPass("","反馈长度与预期一致");
      else
        testStepFail("","反馈长度与预期不一致,预期为：%d，实际为：%d", LenInput-10,ReSize);
      for(i=1;i<3;i++)
      {
        if(DiagGetRespPrimitiveByte(SendData,i) != DiagGetPrimitiveByte(SendData,i))
          testStepFail("","反馈值与预期不一致,预期为0x%2X,实际为0x%2X",DiagGetPrimitiveByte(SendData,i),DiagGetRespPrimitiveByte(SendData,0));
      }
      for(i=3;i<ReSize;i++)
      {
        if(DiagGetRespPrimitiveByte(SendData,i)!=Tx_Data[i+10])
          testStepFail("","第 %d 位,反馈值与预期不一致,预期为0x%2X,实际为0x%2X",i+1,Tx_Data[i+10],DiagGetRespPrimitiveByte(SendData,i));
        else
          testStepPass("","反馈值与预期一致");
      }
    }
  }
}
_Check_Response_(diagRequest *Diag,dword size,byte Ex[],byte Mask)
{
  dword ReSize,i;
  dword LenEx ;
  byte Flage;
  byte Flage_1;
  char Re[200];
  byte ResMask;
  i = 0;
  Flage = 0; Flage_1 = 0;
  LenEx = elCount(Ex);
  if(diagGetLastResponseCode(Diag) == 0)
    testWaitForDiagResponse(Diag,2000);
  ReSize = DiagGetRespPrimitiveSize(Diag);
  if(diagGetLastResponseCode(Diag) == 0)
  {
    testStepFail("未收到响应");
    writeEx(-3,0,"未收到响应");
  }
  else if(diagGetLastResponseCode(Diag) > 0)
  {
    testStepFail("收到消极应答");
    writeEx(-3,0,"收到消极应答");
  }
  else if(diagGetLastResponseCode(Diag) == -1)
  {
    if(ReSize == size)
      testStepPass("","反馈长度与预期一致");
    else
      testStepFail("","反馈长度与预期不一致,预期为：%d，实际为：%d",size,ReSize);
    ResMask = DiagGetRespPrimitiveByte(Diag,5);
    for(i=0;i<size;i++)
    {
      if(i==5)
      {
        if(Mask == 0)//故障掩码跳过检测
          continue;
        else if(Mask == 1) //当前故障
        {
          if((ResMask & 0x01) == 1)
            testStepPass("","掩码与预期一致为当前故障");
          else
            testStepFail("","期望为当前故障，实际掩码为0X%02X",ResMask);
        }
        else if(Mask == 8) //历史故障
        {
          if(((ResMask & 0x08) == 8) && ((ResMask & 0x01) == 0))
            testStepPass("","掩码与预期一致为历史故障");
          else
            testStepFail("","期望为历史故障，实际掩码为0X%02X",ResMask);
        }
      }
      if(i == 5)
        continue;
      if(Ex[i] != DiagGetRespPrimitiveByte(Diag,i))
      {
        Flage = 1;
        testStep("","预期反馈结果：0x%2X",Ex[i]);
        testStep("","实际反馈结果：0x%2X",DiagGetRespPrimitiveByte(Diag,i));
        testStepFail("","反馈值存在于预期不符情况");
      }
    }
    if(Flage == 0)
      testStepPass("","反馈与预期一致");
  }
  testWaitForTimeout(100);
}
/// <DTC_Diag>
/*检测返回故障码是否均为预期故障或在白名单中*/
_Check_Response_DTC(diagRequest *Diag,dword Ex[])
{
  dword LenEx,ReSize,Wait_Flage;
  dword DTC_Rx[100],DTC_Rx_Count,DTC_Ex[20],DTC_Ex_Count;
  dword DTC_UnEx[100],DTC_UnEx_Count;
  int i,j,n;
  int Data_Zero_Count,DTC_UnEx_Flage,DTC_Same_Count;
  
  Data_Zero_Count = 0;
  DTC_UnEx_Flage = 0;
  DTC_Same_Count = 0;
  DTC_Ex_Count = 0;
  for(i=0;i<elCount(Ex);i++)
  {
    if(_Check_Dword_in_Num(Ex[i],DTC_Ex,DTC_Ex_Count) == -1)
    {
      DTC_Ex[DTC_Ex_Count] = Ex[i];
      DTC_Ex_Count++;
    }
    if(Ex[i]==0)
      Data_Zero_Count = 1;
  }
  LenEx = (DTC_Ex_Count-Data_Zero_Count)*4+3;/*无预期DTC输入,长度为3*/
  DTC_Ex_Count = DTC_Ex_Count-Data_Zero_Count;/*------*/
  DTC_Rx_Count = 0;
  DTC_UnEx_Count = 0;
  
  if(diagGetLastResponseCode(Diag) == 0)
  {
    Wait_Flage = 1;
    testWaitForDiagResponse(Diag,200);
  }
  ReSize = DiagGetRespPrimitiveSize(Diag);
  
  if(diagGetLastResponseCode(Diag) != -1)
    testStepFail("诊断反馈未收到正响应");
  else
  {
    if(Wait_Flage == 1 && ReSize<=7)
      testStepFail("","收到单帧时出现响应超时现象");
    DTC_Rx_Count = (ReSize-3)/4;
    for(i=0;i<DTC_Rx_Count;i++)
      DTC_Rx[i] = (diagGetRespPrimitiveByte(Diag,i*4 + 3 + 0)<<16) | (diagGetRespPrimitiveByte(Diag,i*4 + 3 + 1)<<8) | (diagGetRespPrimitiveByte(Diag,i*4 + 3 + 2));
    if(LenEx == ReSize)
    {
      testStepPass("","长度与期望一致");
      for(i=0;i<DTC_Ex_Count;i++)
      {
        j = _Check_Dword_in_Num(DTC_Ex[i],DTC_Rx,DTC_Rx_Count);
        if(j==-1)
          testStepFail("","期望 0x%06X DTC ,未报出",DTC_Ex[i]);
        else
          testStep("","DTC：0x%06X 存在",DTC_Ex[n]);
      }
    }
    else if(LenEx > ReSize)
    {
      testStepFail("","有期望DTC未报出");
      for(i=0;i<DTC_Ex_Count;i++)
      {
        j = _Check_Dword_in_Num(DTC_Ex[i],DTC_Rx,DTC_Rx_Count);
        if(j==-1)
          testStepFail("","期望 0x%06X DTC ,未报出",DTC_Ex[i]);
        else
          testStep("","DTC：0x%06X 存在",DTC_Ex[n]);
      }
    }
    else /*LenEx < ReSize 有非预期故障或白名单中故障*/
    {
      /*此处不判断长度，白名单故障不稳定全部出现*/
      for(i=0;i<DTC_Rx_Count;i++)
      {
        j = _Check_Dword_in_Num(DTC_Rx[i],DTC_Ex,DTC_Ex_Count);
        if(j==-1)
        {
          DTC_UnEx[DTC_UnEx_Count] = DTC_Rx[i];
          DTC_UnEx_Count++;
        }
      }
      for(i=0;i<DTC_UnEx_Count;i++)
      {
        j = _Check_Dword_in_Num(DTC_UnEx[i],DTC_Whitelist,DTC_Whitelist_Count);
        if(j==-1)
        {
          DTC_UnEx_Flage = 1;
          testStepFail("","出现非白名单中故障 0x%06X  ",DTC_UnEx[i]);
        }
      }
      if(DTC_UnEx_Flage == 0)
        testStepPass("","所有故障均在预期中");
      for(n=0;n<DTC_Ex_Count;n++)
      {
        if(DTC_Ex[n]==0)
          continue;
        j = _Check_Dword_in_Num(DTC_Ex[n],DTC_Rx,DTC_Rx_Count);
        if(j==-1)
          testStepFail("","期望DTC：0x%06X 存在，实际未报出",DTC_Ex[n]);
        else
          testStep("","DTC：0x%06X 存在",DTC_Ex[n]);
      }
    }
  }
}
_Check_Response(diagRequest *Diag,dword size,byte Ex[])
{
  dword ReSize,i;
  dword LenEx ;
  byte Flage;
  byte Flage_1;
  char Re[200];
  i = 0;
  Flage = 0; Flage_1 = 0;
  LenEx = elCount(Ex);
  if(diagGetLastResponseCode(Diag) == 0)
    testWaitForDiagResponse(Diag,300);
  if(diagGetLastResponseCode(Diag) == 0)
  {
    testStepFail("未收到响应");
    writeEx(-3,0,"未收到响应");
  }
  else if(diagGetLastResponseCode(Diag) > 0)
  {
    testStepFail("收到消极应答");
    writeEx(-3,0,"收到消极应答");
  }
  else if(diagGetLastResponseCode(Diag) == -1)
  {
    ReSize = DiagGetRespPrimitiveSize(Diag);
    if(ReSize == size)
      testStepPass("","反馈长度与预期一致");
    else
      testStepFail("","反馈长度与预期不一致,预期为：%d，实际为：%d",size,ReSize);
    for(i=0;i<ReSize;i++)
    {
      if(Ex[i] != DiagGetRespPrimitiveByte(Diag,i))
      {
        Flage = 1; 
        // testStep("","预期反馈结果：0x%02X 实际反馈结果：0x%02X",Ex[i],DiagGetRespPrimitiveByte(Diag,i));
        testStepFail("","反馈值存在于预期不符情况,预期反馈结果：0x%02X 实际反馈结果：0x%02X",Ex[i],DiagGetRespPrimitiveByte(Diag,i));
      }
    }
    if(Flage == 0)
      testStepPass("","反馈与预期一致");
    if( LenEx < size)   //检测未使用填充位
      testStepFail("","返回长度与期望长度不匹配");
  }
}
_Check_Response(diagRequest *Diag,int PassByte,dword size,byte Ex[])
{
  dword ReSize,i;
  dword LenEx ;
  byte Flage;
  byte Flage_1;
  char Re[200];
  i = 0;
  Flage = 0; Flage_1 = 0;
  LenEx = elCount(Ex);
  if(diagGetLastResponseCode(Diag) == 0)
    testWaitForDiagResponse(Diag,300);
  if(diagGetLastResponseCode(Diag) == 0)
  {
    testStepFail("未收到响应");
    writeEx(-3,0,"未收到响应");
  }
  else if(diagGetLastResponseCode(Diag) > 0)
  {
    testStepFail("收到消极应答");
    writeEx(-3,0,"收到消极应答");
  }
  else if(diagGetLastResponseCode(Diag) == -1)
  {
    ReSize = DiagGetRespPrimitiveSize(Diag);
    if(ReSize == size)
      testStepPass("","反馈长度与预期一致");
    else
      testStepFail("","反馈长度与预期不一致,预期为：%d，实际为：%d",size,ReSize);
    for(i=0;i<ReSize;i++)
    {
      if(i == PassByte)
        continue;
      if(Ex[i] != DiagGetRespPrimitiveByte(Diag,i))
      {
        Flage = 1;
        // testStep("","预期反馈结果：0x%02X 实际反馈结果：0x%02X",Ex[i],DiagGetRespPrimitiveByte(Diag,i));
        testStepFail("","反馈值存在于预期不符情况,预期反馈结果：0x%02X 实际反馈结果：0x%02X",Ex[i],DiagGetRespPrimitiveByte(Diag,i));
      }
    }
    if(Flage == 0)
      testStepPass("","反馈与预期一致");
    if( LenEx < size)   //检测未使用填充位
      testStepFail("","返回长度与期望长度不匹配");
  }
}

_Check_NoResponse(diagRequest *Diag)        /*期望不响应*/
{
  if(diagGetLastResponseCode(Diag) == 0)
  {
    testStepPass("未收到响应");
    writeEx(-3,0,"未收到响应");
  }
  else if(diagGetLastResponseCode(Diag) == -1)
  {
    testStepFail("收到积极应答");
    writeEx(-3,0,"收到积极应答");
  }
  else 
  {
    testStepFail("收到消极应答");
    writeEx(-3,0,"收到消极应答");
  }
  testWaitForTimeout(300);
}
/*
    除第0位外，其余每一位均和输入数组进行对比判断
    第0位与发送数组第0位^0x40进行判断
*/

void _Check_Response_Config(diagRequest* obj,byte Ex_Res[])
{
  int i,Flag;
  Flag = 0;
  if(diagGetLastResponseCode(obj) == -1)
  {
    if(DiagGetRespPrimitiveByte(obj,0) != (DiagGetPrimitiveByte(obj,0)^0x40))
      testStepFail("","实际反馈值与预期不等,期望为 0x%02X,实际为 0x%02X",(DiagGetPrimitiveByte(obj,0)^0x40),DiagGetRespPrimitiveByte(obj,0));
    if(DiagGetRespPrimitiveSize(obj)> elCount(Ex_Res))
      testStepFail("","收到返回长度与期望不符");
    else
    {
      for(i=1;i<DiagGetRespPrimitiveSize(obj);i++)
      {
        if(DiagGetRespPrimitiveByte(obj,i) != Ex_Res[i])
        {
          Flag = 1;
          testStepFail("","实际反馈值与预期不等,期望为 0x%02X,实际为 0x%02X",Ex_Res[i],DiagGetRespPrimitiveByte(obj,i));
        }
      }
      if(Flag == 0)
        testStepPass("","反馈值与预期一致");
    }
  }
  else
    _WriteEx_and_Report("","未收到正响应");
}

/// <DTC_Diag>
/*
    高级功能DTC变化
    Config_Send：当前写入的配置字
    DTC_Output：输出DTC
*/
void _Advanced_function_DTC(byte Config_Send[],dword DTC_Output[])
{
  int i,DTC_Count;
  byte Check_Byte,Check_Bit;
  DTC_Count = 0;
  for(i=0;i<Advanced_function_Count;i++)
  {
    if(Advanced_function[i].DTC != 0) //当无DTC时,不进行DTC输出
    {
      Check_Byte = Advanced_function[i].Fun_Byte+3;   //加上未计入的2E服务以及DID号
      Check_Bit = Advanced_function[i].Fun_Bit;
      if(((Config_Send[Check_Byte]>>Check_Bit) &0x01) == 1)
      {
        DTC_Output[DTC_Count] = Advanced_function[i].DTC;
        DTC_Count++;
      }
    }
  }
}
/*
  检测28服务返回值是否与期望相符
  Type = 0：取无效值
  Type = 1：第一次返回值
  Type = 2：第二次返回值
  Type = 3：第二次返回值 + 5
*/
_Check_Return(byte Type)
{
  int i,Flage,Size;
  qword Temp_Data;
  float Temp_Vaule;
  Flage = 0;   
  Temp_Data = 0;
  Temp_Vaule = 0;
  if(diagGetLastResponseCode(SendData) == 0)
    testStepFail("未收到响应");
  else if(diagGetLastResponseCode(SendData) > 0)
    testStepFail("收到消极应答");
  else 
  {
    Size = DiagGetRespPrimitiveSize(SendData);
    if(DiagGetRespPrimitiveByte(SendData,0)!=(DiagGetPrimitiveByte(SendData,0)^0x40))
    {
      Flage = 1;
      testStepFail("","反馈值与预期不一致,预期为0x%2X,实际为0x%2X",DiagGetPrimitiveByte(SendData,0)^0x40,DiagGetRespPrimitiveByte(SendData,0));
    }
    for(i=1;i<3;i++)
    {
      if(DiagGetRespPrimitiveByte(SendData,i)!= DiagGetPrimitiveByte(SendData,i))
      {
        Flage = 1;
        testStepFail("","反馈值与预期不一致,预期为0x%2X,实际为0x%2X",DiagGetPrimitiveByte(SendData,i),DiagGetRespPrimitiveByte(SendData,i));
      }
    }
    for(i=3;i<DiagGetRespPrimitiveSize(SendData);i++)
      Temp_Data = Temp_Data + (DiagGetRespPrimitiveByte(SendData,i)<<(8*(Size-(i+1))));
    if(Type != 0)
    {
      Temp_Vaule = Temp_Data*Factor_28 - Offset_28;
      if(Type == 1)
      {
        if((Temp_Vaule>= (DID28_Case_CarSpd_1 - Tolerance_28)) && (Temp_Vaule<= (DID28_Case_CarSpd_1 + Tolerance_28)))
          testStepPass("","期望值与反馈值在误差范围内,实际反馈值为 %.2f",Temp_Vaule);
        else
          testStepFail("","期望结果与实际结果相差较大,期望为 %d ± %.2f,实际为 %.2f ",DID28_Case_CarSpd_1,Tolerance_28,Temp_Vaule);
      }
      else if(Type == 2)
      {
        if((Temp_Vaule>= (DID28_Case_CarSpd_2 - Tolerance_28)) && (Temp_Vaule<= (DID28_Case_CarSpd_2 + Tolerance_28)))
          testStepPass("","期望值与反馈值在误差范围内,实际反馈值为 %.2f",Temp_Vaule);
        else
          testStepFail("","期望结果与实际结果相差较大,期望为 %d ± %.2f,实际为 %.2f ",DID28_Case_CarSpd_2,Tolerance_28,Temp_Vaule);
      }
      else if(Type == 3)
      {
        if((Temp_Vaule>= (DID28_Case_CarSpd_2+5 - Tolerance_28)) && (Temp_Vaule<= (DID28_Case_CarSpd_2+5 + Tolerance_28)))
          testStepPass("","期望值与反馈值在误差范围内,实际反馈值为 %.2f",Temp_Vaule);
        else
          testStepFail("","期望结果与实际结果相差较大,期望为 %d ± %.2f,实际为 %.2f ",DID28_Case_CarSpd_2+5,Tolerance_28,Temp_Vaule);
      }
    }
    else if(Type == 0)
    {
      if(DID28_Sig_Invaild_Value == -1) //上一次有效值
      {
        Temp_Vaule = Temp_Data*Factor_28 - Offset_28;
        _WriteEx_and_Report("","取上一次有效值");
        if((Temp_Vaule>= (DID28_Case_CarSpd_1 - Tolerance_28)) && (Temp_Vaule<= (DID28_Case_CarSpd_1 + Tolerance_28)))
          testStepPass("","期望值与反馈值在误差范围内,实际反馈值为 %.2f",Temp_Vaule);
        else
          testStepFail("","期望结果与实际结果相差较大,期望为 %d ± %.2f,实际为 %.2f ",DID28_Case_CarSpd_1,Tolerance_28,Temp_Vaule);
      }
      else
      {
        if(Temp_Data != DID28_Sig_Invaild_Value)
        {
          testStepFail("","期望无效值与实际无效值不等");
          testStep("","期望无效值为 0x%X",DID28_Sig_Invaild_Value);
          testStep("","实际无效值为 0x%X",Temp_Data);
        }
        else
          testStepPass("","期望无效值与实际无效值一致,实际无效值为 0x%X",Temp_Data);
      }
    }
  }
}
/*
  判断10服务的返回内容
  size：预期返回长度
  Sub_Function：发送子功能
  Time_1：10服务返回的P2can_server
  Time_2：10服务返回的P2_can_server
*/
_Check_10_01(dword size,byte Sub_Function,dword Time_1,dword Time_2)
{
  dword Temp_Time_1;
  dword Temp_Time_2;
  int i=0;
  char Buffer_Temp[100];
  byte result;
  message 0x00 msg;
  Temp_Time_1 = 0;Temp_Time_2 = 0;
  snprintf(Buffer_Temp,elCount(Buffer_Temp),"%s","");
  Buffer_Temp[0] = 0x50;
  Buffer_Temp[1] = Sub_Function;
//  if(Sub_Function ==0x02 && Sub_1002_NRC78==1)
  if(Sub_Function ==0x02 && _Check_Dword_in_Num(0x10,NotNRC78_Serve,NotNRC78_Serve_Count)!=-1)
  {
    result=testWaitForMessage(Response_ID,p2cmax);
    testGetWaitEventMsgData(msg);
    if((msg.byte(0)==0x03)&&(msg.byte(1)==0x7F)&&(msg.byte(3)==0x78))
      testStepFail("","收到否定响应NRC78");
    else
      testStepPass("","未收到否定响应NRC78");
  }
  if(diagGetLastResponseCode(SendData) == 0)
    testWaitForDiagResponse(SendData,p2cmax);
  testReportWriteDiagResponse(SendData);
  if(size==DiagGetRespPrimitiveSize(SendData))
  {
    testStepPass("","反馈长度与预期长度一致");
    writeEx(-3,0,"反馈长度与预期长度一致");
  }
  else
  {
    testStepFail("","预期长度%d，实际长度：%d",size,DiagGetRespPrimitiveSize(SendData));
    writeEx(-3,0,"预期长度%d，实际长度：%d",size,DiagGetRespPrimitiveSize(SendData));
  }
  for(i=0;i<2;i++)
  {
    if(DiagGetRespPrimitiveByte(SendData,i) != Buffer_Temp[i])
      testStepFail("","正响应部分异常，与期望不一致");
    else
      testStepPass("","响应与期望一致");
  }
  if(Sub_Function==0x02 && Sub_1002_Time_Flage==0)
  {
    Temp_Time_1 = DiagGetRespPrimitiveByte(SendData,2)*256+DiagGetRespPrimitiveByte(SendData,3);
    if(Temp_Time_1 == Sub_1002_Time)
      testStepPass("","P2can_server时间与期望一致为%d",Time_1);
    else
      testStepFail("","P2can_server期望为%d,实际为%d",Sub_1002_Time,Temp_Time_1);
  }
  else
  {
    Temp_Time_1 = DiagGetRespPrimitiveByte(SendData,2)*256+DiagGetRespPrimitiveByte(SendData,3);
    Temp_Time_2 = DiagGetRespPrimitiveByte(SendData,4)*256+DiagGetRespPrimitiveByte(SendData,5);
    if(Temp_Time_1 == Time_1)
      testStepPass("","P2can_server时间与期望一致为%d",Time_1);
    else
      testStepFail("","P2can_server期望为%d,实际为%d",Time_1,Temp_Time_1);
    if(Temp_Time_2*10 == Time_2)
      testStepPass("","P2*can_server时间与期望一致为%d",Time_2);
    else
      testStepFail("","P2*can_server期望为%d,实际为%d",Time_2,Temp_Time_2*10);
  }
}
int _Check_1901(diagRequest* Diag)
{
  int Re_count;
  Re_count = 0;
  if(diagGetLastResponseCode(Diag) == 0)
    testStepFail("未收到响应");
  else if(diagGetLastResponseCode(Diag) > 0)
    testStepFail("收到消极应答");
  else
  {
    if(DiagGetRespPrimitiveSize(Diag)!= 6)
    {
      testStepFail("","长度错误,预期长度为6,实测长度为%d",DiagGetRespPrimitiveSize(Diag));
    }
    else{
    if(DiagGetRespPrimitiveByte(Diag,0)!=0x59)
      testStepFail("","反馈值与预期不一致,预期为0x%02X,实际为0x%02X",DiagGetPrimitiveByte(Diag,0)^0x40,DiagGetRespPrimitiveByte(Diag,0));
    if(DiagGetRespPrimitiveByte(Diag,1)!=DiagGetPrimitiveByte(Diag,1))
      testStepFail("","反馈值与预期不一致,预期为0x%02X,实际为0x%02X",DiagGetPrimitiveByte(Diag,1),DiagGetRespPrimitiveByte(Diag,1));
    if(DiagGetRespPrimitiveByte(Diag,2)!=Mask_19)
      testStepFail("","反馈值与预期不一致,预期为0x%02X,实际为0x%02X",Mask_19,DiagGetRespPrimitiveByte(Diag,2));
    if(DiagGetRespPrimitiveByte(Diag,3)!=DTC_Code)
      testStepFail("","反馈值与预期不一致,预期为0x%02X,实际为0x%02X",DTC_Code,DiagGetRespPrimitiveByte(Diag,3));
    Re_count = (DiagGetRespPrimitiveByte(Diag,4)<<16)+DiagGetRespPrimitiveByte(Diag,5);  /*由于白名单问题,导致此处数据会与预期数据有冲突,导致不可信,此处不检测实际个数*/
//    if(Re_count!= count)
//      testStepFail("","预期DTC个数为%d个,实测响应DTC个数为%d个",count,Re_count);
//    else
//      testStepPass("","预期DTC个数与实际一致");
    testStep("","预期DTC个数%d",Re_count);
    }
  }
  return Re_count;
}

_Check_190201(diagRequest* Diag,dword DTC,dword Mask,int Count_Num)
{
  int ii,j,Rx_Count,DTC_ReFlage;
  dword DTC_Res[100][2];
  dword RxSize;
  byte Temp_59[3] = {0x59,0x02,0x09};
  byte DTC_HisOrNow_Flage;
  Temp_59[2] = Mask_19;
  DTC_ReFlage = 0;
  if(diagGetLastResponseCode(Diag) == 0)
    testWaitForDiagResponse(Diag,500);
  if(diagGetLastResponseCode(Diag) == 0)
    testStepFail("未收到响应");
  else if(diagGetLastResponseCode(Diag) > 0)
    testStepFail("收到消极应答");
  else
  {
    RxSize = DiagGetRespPrimitiveSize(Diag);
    Rx_Count = (RxSize-3)/4;
    //判断为当前故障还是历史故障
    if((Mask & 0x09) == 9)
      DTC_HisOrNow_Flage = 1;//当前故障
    else
      DTC_HisOrNow_Flage = 0;
    for(ii=0;ii<3;ii++)
    {
      if(Temp_59[ii] != diagGetRespPrimitiveByte(Diag,ii))
        testStepFail("前三字节","第%d字节错误，预期为0x%02X,实测为0x%02X",ii,Temp_59[ii],diagGetRespPrimitiveByte(Diag,ii));
    }
    if(RxSize>=7)
    {
      for(ii=0;ii<Rx_Count;ii++)
      {
        DTC_Res[ii][0] = (diagGetRespPrimitiveByte(Diag,ii*4+3+0)<<16) + (diagGetRespPrimitiveByte(Diag,ii*4+3+1)<<8)+ (diagGetRespPrimitiveByte(Diag,ii*4+3+2));
        DTC_Res[ii][1] = diagGetRespPrimitiveByte(Diag,ii*4+3+3);
      }
    }
    if(DTC != 0)
    {
      if(Count_Num != -1) //检测个数及反馈
      {
        if(Rx_Count != Count_Num)
          testStepFail("","实际反馈的故障与预期的故障个数不匹配,期望为%d ,实际为%d",Count_Num,(RxSize-3)/4);
        else
          testStepPass("","19 %02X %02X故障个数与预期一致",DiagGetPrimitiveByte(Diag,1),DiagGetPrimitiveByte(Diag,2));
        if(Rx_Count == Count_Num && Count_Num == 0)
          return;
        if(RxSize<7 && Count_Num>0)
          testStepFail("","长度异常,当前长度无故障");
        else
        {
          for(ii=0;ii<Rx_Count;ii++)
          {
            if(DTC_Res[ii][0] == DTC)
            {
              byte Rx_DTC_HisOrNow_Flage;
              DTC_ReFlage = 1;
              testStepPass("","故障码0x%06X在反馈中",DTC);
              if((DTC_Res[ii][1] & 0x09) == 9)
                Rx_DTC_HisOrNow_Flage = 1;
              else
                Rx_DTC_HisOrNow_Flage = 0;
              if(Rx_DTC_HisOrNow_Flage == DTC_HisOrNow_Flage)
              {
                if(DTC_HisOrNow_Flage == 1)
                  testStepPass("","掩码与预期一致为当前故障,实测掩码为0x%02X",DTC_Res[ii][1]);
                else
                  testStepPass("","掩码与预期一致为历史故障,实测掩码为0x%02X",DTC_Res[ii][1]);
              }
              else
              {
                if(DTC_HisOrNow_Flage == 1)
                  testStepFail("","故障码0x%X对应的掩码与预期不符,预期为当前故障,实测掩码为0x%02X",DTC,DTC_Res[ii][1]);
                else
                  testStepFail("","故障码0x%X对应的掩码与预期不符,预期为历史故障,实测掩码为0x%02X",DTC,DTC_Res[ii][1]);
              }
              break;
            }
          }
          if(RxSize > 7)
          {
            testStep("","存在其他故障");
            for(ii=0;ii<Rx_Count;ii++)
            {
              j= _Check_Dword_in_Num(DTC_Res[ii][0],DTC_Whitelist,DTC_Whitelist_Count);
              if(j==-1 && DTC_Res[ii][0] != DTC)
                testStepFail("","存在非预期故障0x%06X",DTC_Res[ii][0]);
            }
          }
          if(DTC_ReFlage == 0)
            testStepFail("","预期故障码0x%06X未报出",DTC);
        }
      }
      else //仅检测DTC反馈状态
      {
        for(ii=0;ii<Rx_Count;ii++)
        {
          if(DTC_Res[ii][0] == DTC)
          {
            byte Rx_DTC_HisOrNow_Flage;
            DTC_ReFlage = 1;
            testStepPass("","故障码0x%06X在反馈中",DTC);
            if((DTC_Res[ii][1] & 0x09) == 9)
              Rx_DTC_HisOrNow_Flage = 1;
            else
              Rx_DTC_HisOrNow_Flage = 0;
            if(Rx_DTC_HisOrNow_Flage == DTC_HisOrNow_Flage)
            {
              if(DTC_HisOrNow_Flage == 1)
                testStepPass("","掩码与预期一致为当前故障,实测掩码为0x%02X",DTC_Res[ii][1]);
              else
                testStepPass("","掩码与预期一致为历史故障,实测掩码为0x%02X",DTC_Res[ii][1]);
            }
            else
            {
              if(DTC_HisOrNow_Flage == 1)
                testStepFail("","故障码0x%X对应的掩码与预期不符,预期为当前故障,实测掩码为0x%02X",DTC,DTC_Res[ii][1]);
              else
                testStepFail("","故障码0x%X对应的掩码与预期不符,预期为历史故障,实测掩码为0x%02X",DTC,DTC_Res[ii][1]);
            }
            break;
          }
          else 
          {
            if((DTC_Res[ii][1] & DiagGetPrimitiveByte(Diag,2)) == 0)
              testStepFail("","故障码0x%X对应的掩码与预期发送不匹配,实测掩码为0x%02X",DTC,DTC_Res[ii][1]);
          }
        }
        if(DTC_ReFlage == 0 && DTC !=0)
          testStepFail("","故障码0x%06X不在反馈中",DTC);
      }
    }
    else
    {
      if(RxSize>3)
      {
        testStep("","长度异常,当前长度存在其他故障");
        for(ii=0;ii<Rx_Count;ii++)
        {
          j= _Check_Dword_in_Num(DTC_Res[ii][0],DTC_Whitelist,DTC_Whitelist_Count);
          if(j == -1 )
            testStepFail("","存在非预期故障0x%06X",DTC_Res[ii][0]);
        }
      }
    }
  }
}

_Check_190201(diagRequest* Diag,dword DTC,dword Mask)
{
  int ii,j,Rx_Count,DTC_ReFlage;
  dword DTC_Res[100][2];
  dword RxSize;
  byte Temp_59[3] = {0x59,0x02,0x09};
  byte DTC_HisOrNow_Flage;
  Temp_59[2] = Mask_19;
  DTC_ReFlage = 0;
  if(diagGetLastResponseCode(Diag) == 0)
    testWaitForDiagResponse(Diag,500);
  if(diagGetLastResponseCode(Diag) == 0)
    testStepFail("未收到响应");
  else if(diagGetLastResponseCode(Diag) > 0)
    testStepFail("收到消极应答");
  else
  {
    RxSize = DiagGetRespPrimitiveSize(Diag);
    Rx_Count = (RxSize-3)/4;
    //判断为当前故障还是历史故障
    if((Mask & 0x09) == 9)
      DTC_HisOrNow_Flage = 1;//当前故障
    else
      DTC_HisOrNow_Flage = 0;
    for(ii=0;ii<3;ii++)
    {
      if(Temp_59[ii] != diagGetRespPrimitiveByte(Diag,ii))
        testStepFail("前三字节","第%d字节错误，预期为0x%02X,实测为0x%02X",ii,Temp_59[ii],diagGetRespPrimitiveByte(Diag,ii));
    }
    if(RxSize>=7)
    {
      for(ii=0;ii<Rx_Count;ii++)
      {
        DTC_Res[ii][0] = (diagGetRespPrimitiveByte(Diag,ii*4+3+0)<<16) + (diagGetRespPrimitiveByte(Diag,ii*4+3+1)<<8)+ (diagGetRespPrimitiveByte(Diag,ii*4+3+2));
        DTC_Res[ii][1] = diagGetRespPrimitiveByte(Diag,ii*4+3+3);
      }
    }
    if(DTC != 0)
    {
      if(RxSize<7)
        testStepFail("","长度异常,当前长度无故障");
      else
      {
        for(ii=0;ii<Rx_Count;ii++)
        {
          if(DTC_Res[ii][0] == DTC)
          {
            byte Rx_DTC_HisOrNow_Flage;
            DTC_ReFlage = 1;
            testStepPass("","故障码0x%06X在反馈中",DTC);
            if((DTC_Res[ii][1] & 0x09) == 9)
              Rx_DTC_HisOrNow_Flage = 1;
            else
              Rx_DTC_HisOrNow_Flage = 0;
            if(Rx_DTC_HisOrNow_Flage == DTC_HisOrNow_Flage)
            {
              if(DTC_HisOrNow_Flage == 1)
                testStepPass("","掩码与预期一致为当前故障,实测掩码为0x%02X",DTC_Res[ii][1]);
              else
                testStepPass("","掩码与预期一致为历史故障,实测掩码为0x%02X",DTC_Res[ii][1]);
            }
            else
            {
              if(DTC_HisOrNow_Flage == 1)
                testStepFail("","故障码0x%X对应的掩码与预期不符,预期为当前故障,实测掩码为0x%02X",DTC,DTC_Res[ii][1]);
              else
                testStepFail("","故障码0x%X对应的掩码与预期不符,预期为历史故障,实测掩码为0x%02X",DTC,DTC_Res[ii][1]);
            }
            break;
          }
        }
        if(RxSize > 7)
        {
          testStep("","存在其他故障");
          for(ii=0;ii<Rx_Count;ii++)
          {
            j= _Check_Dword_in_Num(DTC_Res[ii][0],DTC_Whitelist,DTC_Whitelist_Count);
            if(j==-1 && DTC_Res[ii][0] != DTC)
              testStepFail("","存在非预期故障0x%06X",DTC_Res[ii][0]);
          }
        }
        if(DTC_ReFlage == 0)
          testStepFail("","预期故障码0x%06X未报出",DTC);
      }
    }
    else
    {
      if(RxSize>3)
      {
        testStep("","长度异常,当前长度存在其他故障");
        for(ii=0;ii<Rx_Count;ii++)
        {
          j= _Check_Dword_in_Num(DTC_Res[ii][0],DTC_Whitelist,DTC_Whitelist_Count);
          if(j == -1 )
            testStepFail("","存在非预期故障0x%06X",DTC_Res[ii][0]);
        }
      }
    }
  }
}


_Check_1902(diagRequest* Diag)
{
  int ii,k,j;
  dword DTC_Temp[100][3];
  byte DTC_Temp_Count;
  dword DTC_Res[100][3];
  byte state,Flage_For;
  dword RxSize;
  dword Byte_H,Byte_M,Byte_L;
  Flage_For = 0;
  state = DiagGetPrimitiveByte(Diag,2);
  DTC_Temp_Count = 0;
  if(diagGetLastResponseCode(Diag) == 0)
    testWaitForDiagResponse(Diag,500);
  if(diagGetLastResponseCode(Diag) == 0)
    testStepFail("未收到响应");
  else if(diagGetLastResponseCode(Diag) > 0)
    testStepFail("收到消极应答");
  else
  {
    if((state & Mask_19) != 0)
    {
      for(ii=0;ii<DTC_19_Count;ii++) //来源于外部DTC输入
      {
        if((DTC_19[ii][2]&state)>0 ) //此时已被制造故障或恢复故障更改
        {
          DTC_Temp[DTC_Temp_Count][0] = DTC_19[ii][1];
          DTC_Temp[DTC_Temp_Count][1] = DTC_19[ii][2];
          if((DTC_Temp[DTC_Temp_Count][1]&0x09) == 9) 
            DTC_Temp[DTC_Temp_Count][2] = 1;  //当前故障
          else
            DTC_Temp[DTC_Temp_Count][2] = 0; //历史故障
          DTC_Temp_Count++;
        }
      }
      RxSize = DiagGetRespPrimitiveSize(Diag);
      DTC_Num_Rx = (RxSize - 3)/4;
      for(ii=0;ii<DTC_Num_Rx;ii++)
      {
        DTC_Res[ii][0] = (diagGetRespPrimitiveByte(Diag,ii*4+3+0)<<16) + (diagGetRespPrimitiveByte(Diag,ii*4+3+1)<<8)+ (diagGetRespPrimitiveByte(Diag,ii*4+3+2));
        DTC_Res[ii][1] = diagGetRespPrimitiveByte(Diag,ii*4+3+3);
        if((DTC_Res[ii][1]&0x09) == 9) 
          DTC_Res[ii][2] = 1;  //当前故障
        else
          DTC_Res[ii][2] = 0; //历史故障
      }
      testStep("","读取0x19 0x02 0x%02X对应的掩码的故障码数量为%d个",state,DTC_Temp_Count);
      for(ii=0;ii<DTC_19_Count;ii++) 
      {
        for(k=0;k<DTC_Num_Rx;k++)
        {
          if(DTC_Temp[ii][0] == DTC_Res[k][0])
          {
            if(DTC_Temp[ii][2] == DTC_Res[k][2])
            {
              testStepPass("","故障码0x%X在反馈DTC中且与预期掩码一致",DTC_Temp[ii][0]);
              testStep("掩码","预期掩码：0x%02X,实际掩码：0x%02X",DTC_Temp[ii][1],DTC_Res[k][1]);
              break;
            }
            else
            {
              for(j=0;j<DTC_Whitelist_Count;j++)
              {
                if(DTC_Res[k][0] == DTC_Whitelist[j])  //白名单中故障码
                {
                  if((DTC_Res[k][1] & 0x09)==0x09)
                  {
                    testStepPass("","故障码0x%X为白名单中故障，其掩码状态为当前：0x%02X",DTC_Res[k][0],DTC_Res[k][1]);
                    break;
                  }
                }
              }
              if (j==DTC_Whitelist_Count)
                  testStepFail("","故障码0x%06X对应的掩码与预期不符,预期为0x%02X,实测为0x%02X",DTC_Temp[ii][0],DTC_Temp[ii][1],DTC_Res[k][1]);
            }
          }
        }
      }
    }
    else
    {
      byte data_0[3] = {0x59,0x02,0x09};
      data_0[2] = Mask_19;
      _Check_Response(Diag,3,data_0);
    }
  }
}
/*
  仅检测DTC个数，不检测其他
*/
_Check_1902(diagRequest* Diag,dword Rx_Num)
{
  byte DTC_Temp_Count;
  dword DTC_Res[100][2];
  dword RxSize;
  dword Byte_H,Byte_M,Byte_L;
  int ii;
  byte state,Flage_For;
  byte State_Count;
  state = DiagGetPrimitiveByte(Diag,2);
  State_Count = 0;
  if(diagGetLastResponseCode(Diag) == 0)
    testWaitForDiagResponse(Diag,500);
  if(diagGetLastResponseCode(Diag) == 0)
    testStepFail("未收到响应");
  else if(diagGetLastResponseCode(Diag) > 0)
    testStepFail("收到消极应答");
  else
  {
    RxSize = DiagGetRespPrimitiveSize(Diag);
    DTC_Temp_Count = (RxSize - 3)/4;
    for(ii=0;ii<DTC_Temp_Count;ii++)
    {
      DTC_Res[ii][0] = (diagGetRespPrimitiveByte(Diag,ii*4+3+0)<<16) + (diagGetRespPrimitiveByte(Diag,ii*4+3+1)<<8)+ (diagGetRespPrimitiveByte(Diag,ii*4+3+2));
      DTC_Res[ii][1] = diagGetRespPrimitiveByte(Diag,ii*4+3+3);
    }
    for(ii=0;ii<DTC_Temp_Count;ii++)
    {
      if((DTC_Res[ii][1] & state) >0)
      {
        State_Count++;
      }
      else
        teststep("","DTC: 0x%06X 掩码为 0x%02X",DTC_Res[ii][0],DTC_Res[ii][1]);
    }
    if(Rx_Num != State_Count)
      testStepFail("","获取到的DTC个数与实际反馈个数不一致，预期个数为%d,实际个数为%d",Rx_Num,State_Count);
    else
      testStepPass("","实际反馈个数与预期个数一致，为%d个",Rx_Num);
  }
}
/*
  仅检测DTC对应掩码
*/
_Check_1902(diagRequest* Diag,dword DTC,byte Mask)
{
  byte DTC_Temp_Count;
  dword DTC_Res[100][2];
  dword RxSize;
  int ii;
  byte state;
  state = DiagGetPrimitiveByte(Diag,2);
  if(diagGetLastResponseCode(Diag) == 0)
    testWaitForDiagResponse(Diag,500);
  if(diagGetLastResponseCode(Diag) == 0)
    testStepFail("未收到响应");
  else if(diagGetLastResponseCode(Diag) > 0)
    testStepFail("收到消极应答");
  else
  {
    RxSize = DiagGetRespPrimitiveSize(Diag);
    DTC_Temp_Count = (RxSize - 3)/4;
    for(ii=0;ii<DTC_Temp_Count;ii++)
    {
      DTC_Res[ii][0] = (diagGetRespPrimitiveByte(Diag,ii*4+3+0)<<16) + (diagGetRespPrimitiveByte(Diag,ii*4+3+1)<<8)+ (diagGetRespPrimitiveByte(Diag,ii*4+3+2));
      DTC_Res[ii][1] = diagGetRespPrimitiveByte(Diag,ii*4+3+3);
    }
    for(ii=0;ii<DTC_Temp_Count;ii++)
    {
      if(DTC_Res[ii][0] == DTC)
      {
        if(DTC_Res[ii][1] == Mask)
          testStepPass("","DTC:0x%06X,掩码与期望一致，均为0x%02X",DTC,Mask);
        else
          testStepFail("","DTC:0x%06X,掩码与期望不一致，期望为0x%02X，实际为0x%02X",DTC,Mask,DTC_Res[ii][1]);
        break;
      }
    }
    if(ii == DTC_Temp_Count)
      testStepFail("","DTC:0x%06X,未检测到",DTC);
  }
}
//
//_Check_1904_ChangAn_New(diagRequest* Diag,dword mask)
//{
//  dword Rx_Len;
//  int ii,n;
//  byte DID_Data[6];
//  byte DID_Data_Len;
//  byte DID[2];
//  dword Start_0;
//  if(diagGetLastResponseCode(Diag) == 0)
//    testWaitForDiagResponse(Diag,1000);
//  if(diagGetLastResponseCode(Diag) == 0)
//    testStepFail("未收到响应");
//  else if(diagGetLastResponseCode(Diag) > 0)
//    testStepFail("收到消极应答");
//  else
//  {
//    Rx_Len = DiagGetRespPrimitiveSize(Diag);
//    for(ii=0;ii<6;ii++)
//    {
//      if(ii==0)
//      {
//        if((DiagGetPrimitiveByte(Diag,0)^0x40)!=diagGetRespPrimitiveByte(Diag,0))
//          testStepFail("","预期结果为0x%2x,实测结果为0x%2x",DiagGetPrimitiveByte(Diag,0)^0x40,diagGetRespPrimitiveByte(Diag,ii));
//      }
//      else if(ii==5)
//      {
//        if(mask!=diagGetRespPrimitiveByte(Diag,5))
//          testStepFail("","预期结果为0x%2x,实测结果为0x%2x",mask,diagGetRespPrimitiveByte(Diag,ii));
//      }
//      else
//      {
//        if(DiagGetPrimitiveByte(Diag,ii)!=diagGetRespPrimitiveByte(Diag,ii))
//          testStepFail("","预期结果为0x%2x,实测结果为0x%2x",DiagGetPrimitiveByte(Diag,ii),diagGetRespPrimitiveByte(Diag,ii));     
//      }
//    }
//    if(DiagGetPrimitiveByte(Diag,5)!= 0xFF)
//    {
//      if(diagGetRespPrimitiveByte(Diag,6)!= DiagGetPrimitiveByte(Diag,5))
//        testStepFail("快照号","预期结果为0x%2x,实测结果为0x%2x",DiagGetPrimitiveByte(Diag,5),diagGetRespPrimitiveByte(Diag,6)); 
//    }
//    else
//    {
//      if(diagGetRespPrimitiveByte(Diag,6)!= Freeze_Frame_Number[0])
//        testStepFail("快照号","预期结果为0x%2x,实测结果为0x%2x",Freeze_Frame_Number[0],diagGetRespPrimitiveByte(Diag,6)); 
//    }
//    if(diagGetRespPrimitiveByte(Diag,7)!= mixArray_Len)
//      testStepFail("快照个数","预期结果为0x%2x,实测结果为0x%2x",mixArray_Len,diagGetRespPrimitiveByte(Diag,7)); 
//    for(ii=0;ii<mixArray_Len;ii++)
//    {
//      DID[0] = 0x30;
//      DID[1] = ii+1;
//      if(DID[1]==1)
//      {
//        DID_Data[0] = 0;  DID_Data_Len = 1;  Start_0 = 10;
//      }
//      else if(DID[1]==2)
//      {
//        DID_Data[0] = 0xFF;  DID_Data[1] = 0xFF;  DID_Data_Len = 2;
//      }
//      else if(DID[1]==3)
//      {
//        DID_Data[0] = 0xFF;  DID_Data_Len = 1;
//      }
//      else if(DID[1]==4)
//      {
//        DID_Data[0] = 0xFF;  DID_Data_Len = 1;
//      }
//      else if(DID[1]==5)
//      {
//        DID_Data[0] = 0xFF;  DID_Data[1] = 0xFF;  DID_Data_Len = 2;
//      }
//      else if(DID[1]==6)
//      {
//        DID_Data[0] = 0;  DID_Data_Len = 1;
//      }
//      else if(DID[1]==7)
//      {
//        DID_Data[0] = 0xFF;  DID_Data[1] = 0xFF;  DID_Data_Len = 2;
//      }
//      else if(DID[1]==8)
//      {
//        DID_Data[0] = 0x00;  DID_Data[1] = 0x00;  DID_Data_Len = 2;
//      }
//      else if(DID[1]==9)
//      {
//        DID_Data[0] = 0;  DID_Data_Len = 1;
//      }
//      else if(DID[1]==0x0a)
//      {
//        DID_Data_Len = 6;
//        for(n=0;n<DID_Data_Len;n++)
//          DID_Data[n] = 0;
//      }
//      Start_0 =Start_0 + DID_Data_Len + 1;
//      _Check_New(Diag,DID,DID_Data,DID_Data_Len,Start_0);
//    }
//  }
//}
//
//
//_Check_New(diagRequest* Diag,byte DID[],byte Ex_Data[],dword len_Ex_Data,dword Start_)
//{
//  int m;
//  char Comment[70];
//  byte Check_Flage;
//  byte DID_1[2] = {0X30,0X01};
//  byte DID_2[2] = {0X30,0X04};
//  Check_Flage = 0;
//  for(m=0;m<elcount(DID);m++)
//    snprintf(Comment,elCount(Comment),"%s %02X",Comment,DID[m]);
//  if( (Array_Compare(DID,DID_1)!=-1 ) || (Array_Compare(DID,DID_2)!=-1 ) )
//  {
//    testStep(Comment,"不检测该部分");
//  }
//  else
//  {
//    for(m=Start_;m<len_Ex_Data;m++)
//    {
//      if(Ex_Data[m-Start_] != diagGetRespPrimitiveByte(Diag,m))
//      {
//        Check_Flage = 1;
//        testStepFail(Comment,"反馈与预期不符,预期为0x%2x,实际为0x%2x",Ex_Data[m-Start_],diagGetRespPrimitiveByte(Diag,m));
//      }
//    }
//    if(Check_Flage == 0)
//      testStepPass(Comment,"反馈数据与期望一致");
//  }
//}

_Check_19_NoFreeze(diagRequest* Diag,char STR[])
{
  int n;
  byte Flage_Check;
  byte Dta_[6]={0x59,0x04,0x00,0x00,0x00,0x00};
  Flage_Check = 0;
  Dta_[1] = DiagGetPrimitiveByte(Diag,1);
  if(diagGetLastResponseCode(Diag) == 0)
    testWaitForDiagResponse(Diag,100);
  if(diagGetLastResponseCode(Diag) == 0)
    testStepFail("未收到响应");
  else if(diagGetLastResponseCode(Diag) > 0)
    testStepFail("收到消极应答");
  else
  {
    for(n=0;n<6;n++)
      Dta_[n] = DiagGetPrimitiveByte(Diag,n);
    Dta_[0] = (DiagGetPrimitiveByte(Diag,0)^0x40);
    Dta_[5] = 0x00;
    for(n=0;n<6;n++)
    {
      if(diagGetRespPrimitiveByte(Diag,n)!= Dta_[n])
      {
        Flage_Check = 1;
        testStepFail(STR,"与预期不一致,期望结果为0x%2x,实测结果为0x%2x",Dta_[n],diagGetRespPrimitiveByte(Diag,n));
      }
    }
    if(Flage_Check == 0)
      testStepPass(STR,"与预期一致");
  }
}

_Check_1904(diagRequest* Diag,dword mask,char Check_Str[],float Ex_Value,dword type) //type = 0:有效值   type = 1:无效值  type = 2:仅获取值 
{
  int ii,n;
  char Comment[70];
  dword Rx_Len;
  int swhere;
  int swhere_1;
  int Possition_LocalTime[6];
  byte DID_Tmep[2];
  byte DID_Tmep_1[2];
  byte DID_Tmep_2[2];
  byte Res_Data[100];
  byte Check_Flage_Value;
  char Vaule_Str_Temp[20];
  float Vaule_Temp;
  int Possition;
  Res1904_Data_Count = 0;
  Check_Flage_Value = 0;
  if(diagGetLastResponseCode(Diag) == 0)
    testWaitForDiagResponse(Diag,1500);
  if(diagGetLastResponseCode(Diag) == 0)
    testStepFail("未收到响应");
  else if(diagGetLastResponseCode(Diag) > 0)
    testStepFail("收到消极应答");
  else
  {
    Rx_Len = DiagGetRespPrimitiveSize(Diag);
    for(ii=0;ii<5;ii++)
    {
      if(ii==0)
      {
        if((DiagGetPrimitiveByte(Diag,0)^0x40)!=diagGetRespPrimitiveByte(Diag,0))
          testStepFail("","预期结果为0x%02X,实测结果为0x%02X",DiagGetPrimitiveByte(Diag,0)^0x40,diagGetRespPrimitiveByte(Diag,ii));
      }
      else
      {
        if(DiagGetPrimitiveByte(Diag,ii)!=diagGetRespPrimitiveByte(Diag,ii))
          testStepFail("","预期结果为0x%02X,实测结果为0x%02X",DiagGetPrimitiveByte(Diag,ii),diagGetRespPrimitiveByte(Diag,ii));     
      }
    }
    {
      if(mask != 0)
      {
        if(((mask &0x01) == (diagGetRespPrimitiveByte(Diag,5)&0x01)) && ((mask &0x08) == (diagGetRespPrimitiveByte(Diag,5)&0x08)))
          testStepPass("","当前掩码状态与预期一致");
        else
          testStepFail("","当前掩码状态与预期不一致，预期为 0x%02X ,实际为0x%02X",mask,diagGetRespPrimitiveByte(Diag,5));
      }
    }
    if(DiagGetPrimitiveByte(Diag,5) != 0xFF)
    {
      if(diagGetRespPrimitiveByte(Diag,6)!= DiagGetPrimitiveByte(Diag,5))
        testStepFail("快照号","预期结果为0x%02X,实测结果为0x%02X",DiagGetPrimitiveByte(Diag,5),diagGetRespPrimitiveByte(Diag,6)); 
      else
        testStepPass("快照号","预期与实测结果一致为: 0x%02X",diagGetRespPrimitiveByte(Diag,6)); 
    }
    else
    {
      if(diagGetRespPrimitiveByte(Diag,6)!= Freeze_Frame_Number[0])
        testStepFail("快照号","预期结果为0x%02X,实测结果为0x%02X",Freeze_Frame_Number[0],diagGetRespPrimitiveByte(Diag,6)); 
      else
        testStepPass("快照号","预期与实测结果一致为: 0x%02X",diagGetRespPrimitiveByte(Diag,6)); 
    }
    if(diagGetRespPrimitiveByte(Diag,7)!= mixArray_Len)
      testStepFail("快照个数","预期结果为0x%02X,实测结果为0x%02X",mixArray_Len,diagGetRespPrimitiveByte(Diag,7)); 
    else
      testStepPass("快照个数","预期与实测结果一致为: 0x%02X",diagGetRespPrimitiveByte(Diag,7)); 
    for(ii=8;ii<Rx_Len-2;ii++)
    {
      int Flage_DID_Tmep_2;
      
      DID_Tmep[0] = diagGetRespPrimitiveByte(Diag,ii);
      DID_Tmep[1] = diagGetRespPrimitiveByte(Diag,ii+1);
      Possition = Array_Compare_1904(DID_Tmep);     //DID在结构体的位置
      Vaule_Temp = 0;
      if(Possition != -1)
      {
        DID_Tmep_1[0] = diagGetRespPrimitiveByte(Diag,ii-2);
        DID_Tmep_1[1] = diagGetRespPrimitiveByte(Diag,ii-1);
        if(Rx_Len<Rx_Len-4)
        {
          DID_Tmep_2[0] = diagGetRespPrimitiveByte(Diag,ii+2);
          DID_Tmep_2[1] = diagGetRespPrimitiveByte(Diag,ii+3);
          Flage_DID_Tmep_2 =  Array_Compare_1904(DID_Tmep_2);
        }
        else
          Flage_DID_Tmep_2 = 1;
        if(Array_Compare_1904(DID_Tmep_1)!=-1 && Flage_DID_Tmep_2 !=-1) //判断是数据还是DID
        { }
        else
        {
          snprintf(Comment,elCount(Comment),"%s","");
          Res1904_Data[Res1904_Data_Count].Res_DID[0] = DID_Tmep[0];
          Res1904_Data[Res1904_Data_Count].Res_DID[1] = DID_Tmep[1];
          snprintf(Comment,elCount(Comment),"%s %02X",Comment,DID_Tmep[0]);
          snprintf(Comment,elCount(Comment),"%s %02X",Comment,DID_Tmep[1]);
          Res1904_Data[Res1904_Data_Count].Res_DID_Data_Len = mixArray[Possition].DID_1904_Len;
          Res1904_Data[Res1904_Data_Count].Factor = mixArray[Possition].Factor;
          Res1904_Data[Res1904_Data_Count].Offset = mixArray[Possition].Offset;
          Res1904_Data[Res1904_Data_Count].Tolerance = mixArray[Possition].Tolerance;
          Res1904_Data[Res1904_Data_Count].Possition = Possition;
          snprintf( Res1904_Data[Res1904_Data_Count].Str,elcount(mixArray[Possition].Str_DID_1904),"%s",mixArray[Possition].Str_DID_1904);
          snprintf( Res1904_Data[Res1904_Data_Count].Symbol,elcount(mixArray[Possition].Symbol),"%s",mixArray[Possition].Symbol);
          for(n=0;n<mixArray[Possition].DID_1904_Len;n++)
             Res1904_Data[Res1904_Data_Count].Res_DID_Data[n] = diagGetRespPrimitiveByte(Diag,ii+2+n);
          {
            if(strncmp(Res1904_Data[Res1904_Data_Count].Symbol,"signed",strlen(Res1904_Data[Res1904_Data_Count].Symbol)) == 0)
            {
              if((Res1904_Data[Res1904_Data_Count].Res_DID_Data[0]&0x80)==0x80 )   //负数
              {
                qword Da;
                qword Tem;
                Tem = 0;
                for(n=0;n<Res1904_Data[Res1904_Data_Count].Res_DID_Data_Len;n++)
                  Tem = Tem + (Res1904_Data[Res1904_Data_Count].Res_DID_Data[n]<<(8*(Res1904_Data[Res1904_Data_Count].Res_DID_Data_Len-n-1)));
                if(Res1904_Data[Res1904_Data_Count].Res_DID_Data_Len == 4)
                  Da = 0xFFFFFFFF;
                else if(Res1904_Data[Res1904_Data_Count].Res_DID_Data_Len == 3)
                  Da = 0xFFFFFF;
                else if(Res1904_Data[Res1904_Data_Count].Res_DID_Data_Len == 2)
                  Da = 0xFFFF;
                else if(Res1904_Data[Res1904_Data_Count].Res_DID_Data_Len == 1)
                  Da = 0xFF;
                Vaule_Temp = (0xFFFFFFFF - Tem) & Da;
                Vaule_Temp = Vaule_Temp*(-1);
              }
              else
              {
                for(n=0;n<Res1904_Data[Res1904_Data_Count].Res_DID_Data_Len;n++)
                  Vaule_Temp = Vaule_Temp + (Res1904_Data[Res1904_Data_Count].Res_DID_Data[n]<<(8*(Res1904_Data[Res1904_Data_Count].Res_DID_Data_Len-n-1)));
              }
            }
            else
            {
              for(n=0;n<Res1904_Data[Res1904_Data_Count].Res_DID_Data_Len;n++)
                Vaule_Temp = Vaule_Temp + (Res1904_Data[Res1904_Data_Count].Res_DID_Data[n]<<(8*(Res1904_Data[Res1904_Data_Count].Res_DID_Data_Len-n-1)));    
            }
            Res1904_Data[Res1904_Data_Count].Vaule_Now = (Vaule_Temp*Res1904_Data[Res1904_Data_Count].Factor) + Res1904_Data[Res1904_Data_Count].Offset;
          }
          
          if(strncmp(Check_Str,"ALL",strlen(Check_Str))==0 && strlen(Check_Str)!=0)   //19 04整体检测
          {
            if(strncmp(mixArray[Possition].Str_DID_1904,"LocalTime",strlen(mixArray[Possition].Str_DID_1904))==0) //时间单独判断
            {
              char Cmment_T[200];
              snprintf(Cmment_T,elCount(Cmment_T),"%s","");
              for(n=0;n<Res1904_Data[Res1904_Data_Count].Res_DID_Data_Len;n++)
                snprintf(Cmment_T,elCount(Cmment_T),"%s %02x",Cmment_T,Res1904_Data[Res1904_Data_Count].Res_DID_Data[n]);
              if(strncmp(mixArray[Possition].Symbol,"BCD",strlen(mixArray[Possition].Symbol))==0)   //BCD格式,全原码拼接
              {
                /*判断是:年/月/日/时/分/秒       还是:秒/分/时/日/月/年*/
                /************************待完善*************************/
                Possition_LocalTime[0] = _Check_StrPossion("year",Possition,0);
                if(mixArray[Possition].LocalTime[Possition_LocalTime[0]][1]==0)
                {
                  for(n=0;n<Res1904_Data[Res1904_Data_Count].Res_DID_Data_Len;n++)
                  {
                    snprintf(Vaule_Str_Temp,elCount(Vaule_Str_Temp),"%s","");
                    snprintf(Vaule_Str_Temp,elcount(Vaule_Str_Temp),"%s%X",Vaule_Str_Temp,Res1904_Data[Res1904_Data_Count].Res_DID_Data[n]);
                    if(strlen(Vaule_Str_Temp)<2)
                      snprintf(Vaule_Str_Temp,elCount(Vaule_Str_Temp),"%c%s",'0',Vaule_Str_Temp);
                    snprintf(Res1904_Data[Res1904_Data_Count].LocalTime_Value,elCount(Res1904_Data[Res1904_Data_Count].LocalTime_Value),"%s%s",Res1904_Data[Res1904_Data_Count].LocalTime_Value,Vaule_Str_Temp);
                  }
                }
                else
                {
                  for(n=Res1904_Data[Res1904_Data_Count].Res_DID_Data_Len-1;n>=0;n--)
                  {
                    snprintf(Vaule_Str_Temp,elCount(Vaule_Str_Temp),"%s","");
                    snprintf(Vaule_Str_Temp,elcount(Vaule_Str_Temp),"%s%X",Vaule_Str_Temp,Res1904_Data[Res1904_Data_Count].Res_DID_Data[n]);
                    if(strlen(Vaule_Str_Temp)<2)
                      snprintf(Vaule_Str_Temp,elCount(Vaule_Str_Temp),"%c%s",'0',Vaule_Str_Temp);
                    snprintf(Res1904_Data[Res1904_Data_Count].LocalTime_Value,elCount(Res1904_Data[Res1904_Data_Count].LocalTime_Value),"%s%s",Res1904_Data[Res1904_Data_Count].LocalTime_Value,Vaule_Str_Temp);
                  }
                }
              }
              else
              {
                qword Temp_Time;
                dword swhere_temp;
                Possition_LocalTime[0] = _Check_StrPossion("year",Possition,0);
                Possition_LocalTime[1] = _Check_StrPossion("month",Possition,0);
                Possition_LocalTime[2] = _Check_StrPossion("day",Possition,0);
                Possition_LocalTime[3] = _Check_StrPossion("hour",Possition,0);
                Possition_LocalTime[4] = _Check_StrPossion("minute",Possition,0);
                Possition_LocalTime[5] = _Check_StrPossion("second",Possition,0);
                Temp_Time =0;
                if(mixArray[Possition].LocalTime[Possition_LocalTime[0]][1]>0)
                {
                  for(n=0;n<Res1904_Data[Res1904_Data_Count].Res_DID_Data_Len;n++)
                  {
                    snprintf(Vaule_Str_Temp,elCount(Vaule_Str_Temp),"%s","");
                    if(Possition_LocalTime[n] == -1)    //仅包含部分时间,不是完整的 年月日时分秒,舍弃未查询到的字符
                    {
                      //snprintf(Vaule_Str_Temp,elCount(Vaule_Str_Temp),"%c%s",'00',Vaule_Str_Temp);
                    }
                    else
                    {
                      swhere_temp = mixArray[Possition].LocalTime[Possition_LocalTime[n]][1];    //预期所在位置
                      swhere_temp = Res1904_Data[Res1904_Data_Count].Res_DID_Data_Len - swhere_temp - 1;  //装载后位置反向排序后取正确位置
                      Temp_Time = Res1904_Data[Res1904_Data_Count].Res_DID_Data[swhere_temp] + mixArray[Possition].LocalTime[Possition_LocalTime[n]][2]; //计算后的值
                      snprintf(Vaule_Str_Temp,elcount(Vaule_Str_Temp),"%s%X",Vaule_Str_Temp,Temp_Time);
                      if(strlen(Vaule_Str_Temp)<2)
                        snprintf(Vaule_Str_Temp,elCount(Vaule_Str_Temp),"%c%s",'0',Vaule_Str_Temp);
                    }
                    snprintf(Res1904_Data[Res1904_Data_Count].LocalTime_Value,elCount(Res1904_Data[Res1904_Data_Count].LocalTime_Value),"%s%s",Res1904_Data[Res1904_Data_Count].LocalTime_Value,Vaule_Str_Temp);
                  }
                }
                else
                {
                  for(n=0;n<Res1904_Data[Res1904_Data_Count].Res_DID_Data_Len;n++)
                  {
                    snprintf(Vaule_Str_Temp,elCount(Vaule_Str_Temp),"%s","");
                    if(Possition_LocalTime[n] == -1)    //仅包含部分时间,不是完整的 年月日时分秒,舍弃未查询到的字符
                    {
                      //snprintf(Vaule_Str_Temp,elCount(Vaule_Str_Temp),"%c%s",'00',Vaule_Str_Temp);
                    }
                    else
                    {
                      swhere_temp = mixArray[Possition].LocalTime[Possition_LocalTime[n]][1];    //预期所在位置
                      swhere_temp = Res1904_Data[Res1904_Data_Count].Res_DID_Data_Len - 1;  //装载后位置反向排序后取正确位置
                      Temp_Time = Res1904_Data[Res1904_Data_Count].Res_DID_Data[swhere_temp] + mixArray[Possition].LocalTime[Possition_LocalTime[n]][2]; //计算后的值
                      snprintf(Vaule_Str_Temp,elcount(Vaule_Str_Temp),"%s%X",Vaule_Str_Temp,Temp_Time);
                      if(strlen(Vaule_Str_Temp)<2)
                        snprintf(Vaule_Str_Temp,elCount(Vaule_Str_Temp),"%c%s",'0',Vaule_Str_Temp);
                    }
                    snprintf(Res1904_Data[Res1904_Data_Count].LocalTime_Value,elCount(Res1904_Data[Res1904_Data_Count].LocalTime_Value),"%s%s",Res1904_Data[Res1904_Data_Count].LocalTime_Value,Vaule_Str_Temp);
                  }
                }
              }
              if(type == 2 ) //&& mixArray[Possition].Step_Flage == 1
              {
                _WriteEx_and_Report("","/---------------   LocalTime   ---------------/");
                testStep(Comment,"接收到的数据为 %s",Cmment_T);
                testStep(Comment,"转换后为 %s",Res1904_Data[Res1904_Data_Count].LocalTime_Value);
                writeEx(-3,0,"%s  转换后为 %s",Comment,Res1904_Data[Res1904_Data_Count].LocalTime_Value);
              }
              else if(type == 0 && mixArray[Possition].Step_Flage == 1)
              {
                _WriteEx_and_Report("","/---------------   LocalTime   ---------------/");
                if(strncmp(Res1904_Data[Res1904_Data_Count].LocalTime_Value,mixArray[Possition].LocalTime_Value,strlen(Res1904_Data[Res1904_Data_Count].LocalTime_Value))==0)
                {
                  testStepFail(Comment,"预期结果与实际设置结果不一致,预期结果为 %s ,实际结果为 %s",mixArray[Possition].LocalTime_Value,Res1904_Data[Res1904_Data_Count].LocalTime_Value);
                  testStep(Comment,"接收到的数据为 %s",Cmment_T);
                  writeEx(-3,0,"%s  预期结果与实际设置结果不一致,预期结果为 %s ,实际结果为 %s",Comment,mixArray[Possition].LocalTime_Value,Res1904_Data[Res1904_Data_Count].LocalTime_Value);
                }
                else
                {
                  testStepPass(Comment,"预期结果与实际结果一致");
                  testStep(Comment,"接收到的数据为 %s",Res1904_Data[Res1904_Data_Count].LocalTime_Value);
                  writeEx(-3,0,"%s  预期结果与实际结果一致,预期结果为 %s ",Comment,mixArray[Possition].LocalTime_Value);
                }
              }
              else
              {
                /*未做其他操作，无效检测*/
              }
            }
            else
            {
              char Cmment_T[200];
              char Cmment_S[200];
              char Cmment_D[200];
              snprintf(Cmment_S,elCount(Cmment_S),"%s","");
              snprintf(Cmment_S,elCount(Cmment_S),"/---------------   %s   ---------------/",Res1904_Data[Res1904_Data_Count].Str);
              snprintf(Cmment_D,elCount(Cmment_D),"%s","");
              snprintf(Cmment_D,elCount(Cmment_D),"%02X  %02X",Res1904_Data[Res1904_Data_Count].Res_DID[0],Res1904_Data[Res1904_Data_Count].Res_DID[1]);
              snprintf(Cmment_T,elCount(Cmment_T),"%s","");
              for(n=0;n<Res1904_Data[Res1904_Data_Count].Res_DID_Data_Len;n++)
                snprintf(Cmment_T,elCount(Cmment_T),"%s %02X",Cmment_T,Res1904_Data[Res1904_Data_Count].Res_DID_Data[n]);
              if(type == 1 && mixArray[Possition].Step_Flage == 1)
              {
                if(mixArray[Possition].Invalid_LastValue == 0)
                {
                  qword Invalid_Value;
                  Invalid_Value = 0;
                  _WriteEx_and_Report("",Cmment_S);
                  testStep(Comment,"使用无效值,无效值为0x%02X",mixArray[Possition].Invalid);
                  for(n=0;n<Res1904_Data[Res1904_Data_Count].Res_DID_Data_Len;n++)
                    Invalid_Value = Invalid_Value +  diagGetRespPrimitiveByte(Diag,ii+2+n)<<(8*(Res1904_Data[Res1904_Data_Count].Res_DID_Data_Len - n - 1));
                  if(Invalid_Value != mixArray[Possition].Invalid)
                    Check_Flage_Value = 1;
                  if(Check_Flage_Value == 0)
                    testStepPass(Comment,"当值为无效时,返回数据与无效值状态相匹配");
                  else
                    testStepFail(Comment,"当值无效时,返回数据与无效值不匹配");
                }
                else                    //最后一次有效值
                {
                   testStepWarning(Comment,"使用最后一次有效值");
                  /************************待完善****（仅在1904检测全部快照时使用该部分）*********************/
                }
              }
              else if(type == 2)
              {
                _WriteEx_and_Report("",Cmment_S);
                testStep(Comment,"接收到的数据为 %s",Cmment_T);
                testStep(Comment,"转换后为 %.2f",Res1904_Data[Res1904_Data_Count].Vaule_Now);
                writeEx(-3,0,"%s  转换后为 %.2f",Comment,Res1904_Data[Res1904_Data_Count].Vaule_Now);
              }
              else if(type == 0 && mixArray[Possition].Step_Flage == 1)
              {
                _WriteEx_and_Report("",Cmment_S);
                _WriteEx_and_Report("","DID: ",Cmment_D);
                _WriteEx_and_Report("","接收到的数据为 ",Cmment_T);
                _WriteEx_and_Report("","预期结果为 %.2f",mixArray[Possition].Vaule_Ex);
                _WriteEx_and_Report("","实际结果为 %.2f",Res1904_Data[Res1904_Data_Count].Vaule_Now);
                if(Res1904_Data[Res1904_Data_Count].Vaule_Now > mixArray[Possition].Vaule_Ex + mixArray[Possition].Tolerance || Res1904_Data[Res1904_Data_Count].Vaule_Now < mixArray[Possition].Vaule_Ex - mixArray[Possition].Tolerance)
                {
//                  testStepFail(Comment,"预期结果与实际设置结果不一致,预期结果为 %.2f ,实际结果为 %.2f",mixArray[Possition].Vaule_Ex,Res1904_Data[Res1904_Data_Count].Vaule_Now);
                  testStepFail(Comment,"");
                  testStep(Comment,"接收到的数据为 %s",Cmment_T);
                }
                else
                {
                  testStepPass(Comment,"预期结果与实际结果一致");
                  testStep(Comment,"接收到的数据为 %s",Cmment_T);
                }
              }
              else if(mixArray[Possition].Step_Flage == -1)
              {
                testStep("",Cmment_S);
                _WriteEx_and_Report(mixArray[Possition].Str_DID_1904,"未进行相应操作使其变化,故不检测");
              }
              else
                _WriteEx_and_Report(Check_Str,"格式选择错误");
            }
          }
          Res1904_Data_Count++;
        } //数据DID循环
      }
    }  // for循环结束,获取到全部数据装入结构体Res1904_Data中
    
    if(strncmp(Check_Str,"ALL",strlen(Check_Str))!=0)
      swhere_1 =  _Check_StrPossion_Res(Check_Str,2);  //字符串在返回数据中的位置
    if(strncmp(Check_Str,"LocalTime",strlen(Check_Str))==0 && strlen(Check_Str)!=0)
    {
      swhere = _Check_StrPossion_Res("LocalTime",1); //字符串在预输入数据中的位置
      if(swhere == -1)
        _WriteEx_and_Report("LocalTime","当前预输入中无时间快照信息");
      else         //时间拼接计算 真实时间
      {
        if(strncmp(Res1904_Data[swhere_1].Symbol,"BCD",strlen(Res1904_Data[swhere_1].Symbol))==0)   //BCD格式,全原码拼接
        {
          /*判断是:年/月/日/时/分/秒       还是:秒/分/时/日/月/年*/
          /************************待完善*************************/
          Possition_LocalTime[0] = _Check_StrPossion("year",swhere,0);
          if(mixArray[swhere].LocalTime[Possition_LocalTime[0]][1]>0)
          {
            for(n=0;n<Res1904_Data[swhere_1].Res_DID_Data_Len;n++)
            {
              snprintf(Vaule_Str_Temp,elCount(Vaule_Str_Temp),"%s","");
              snprintf(Vaule_Str_Temp,elcount(Vaule_Str_Temp),"%s%X",Vaule_Str_Temp,Res1904_Data[swhere_1].Res_DID_Data[n]);
              if(strlen(Vaule_Str_Temp)<2)
                snprintf(Vaule_Str_Temp,elCount(Vaule_Str_Temp),"%c%s",'0',Vaule_Str_Temp);
              snprintf(Res1904_Data[swhere_1].LocalTime_Value,elCount(Res1904_Data[swhere_1].LocalTime_Value),"%s%s",Res1904_Data[swhere_1].LocalTime_Value,Vaule_Str_Temp);
            }
          }
          else
          {
            for(n=Res1904_Data[swhere_1].Res_DID_Data_Len;n>=0;n--)
            {
              snprintf(Vaule_Str_Temp,elCount(Vaule_Str_Temp),"%s","");
              snprintf(Vaule_Str_Temp,elcount(Vaule_Str_Temp),"%s%x",Vaule_Str_Temp,Res1904_Data[swhere_1].Res_DID_Data[n]);
              if(strlen(Vaule_Str_Temp)<2)
                snprintf(Vaule_Str_Temp,elCount(Vaule_Str_Temp),"%c%s",'0',Vaule_Str_Temp);
              snprintf(Res1904_Data[swhere_1].LocalTime_Value,elCount(Res1904_Data[swhere_1].LocalTime_Value),"%s%s",Res1904_Data[swhere_1].LocalTime_Value,Vaule_Str_Temp);
            }
          }
        }
        else
        {
          qword Temp_Time;
          dword swhere_temp;
          Possition_LocalTime[0] = _Check_StrPossion("year",swhere,0);
          Possition_LocalTime[1] = _Check_StrPossion("month",swhere,0);
          Possition_LocalTime[2] = _Check_StrPossion("day",swhere,0);
          Possition_LocalTime[3] = _Check_StrPossion("hour",swhere,0);
          Possition_LocalTime[4] = _Check_StrPossion("minute",swhere,0);
          Possition_LocalTime[5] = _Check_StrPossion("second",swhere,0);
          Temp_Time =0;
          if(mixArray[swhere].LocalTime[Possition_LocalTime[0]][1]>0)
          {
            for(n=0;n<Res1904_Data[swhere_1].Res_DID_Data_Len;n++)
            {
              snprintf(Vaule_Str_Temp,elCount(Vaule_Str_Temp),"%s","");
              if(Possition_LocalTime[n] == -1)    //仅包含部分时间,不是完整的 年月日时分秒,舍弃未查询到的字符
              {
                //snprintf(Vaule_Str_Temp,elCount(Vaule_Str_Temp),"%c%s",'00',Vaule_Str_Temp);
              }
              else
              {
                swhere_temp = mixArray[swhere_1].LocalTime[Possition_LocalTime[n]][1];    //预期所在位置
                swhere_temp = Res1904_Data[swhere_1].Res_DID_Data_Len - swhere_temp - 1;  //装载后位置反向排序后取正确位置
                Temp_Time = Res1904_Data[swhere_1].Res_DID_Data[swhere_temp] + mixArray[swhere_1].LocalTime[Possition_LocalTime[n]][2]; //计算后的值
                snprintf(Vaule_Str_Temp,elcount(Vaule_Str_Temp),"%s%X",Vaule_Str_Temp,Temp_Time);
                if(strlen(Vaule_Str_Temp)<2)
                  snprintf(Vaule_Str_Temp,elCount(Vaule_Str_Temp),"%c%s",'0',Vaule_Str_Temp);
              }
              snprintf(Res1904_Data[swhere_1].LocalTime_Value,elCount(Res1904_Data[swhere_1].LocalTime_Value),"%s%s",Res1904_Data[swhere_1].LocalTime_Value,Vaule_Str_Temp);
            }
          }
          else
          {
            for(n=0;n<Res1904_Data[swhere_1].Res_DID_Data_Len;n++)
            {
              snprintf(Vaule_Str_Temp,elCount(Vaule_Str_Temp),"%s","");
              if(Possition_LocalTime[n] == -1)    //仅包含部分时间,不是完整的 年月日时分秒,舍弃未查询到的字符
              {
                //snprintf(Vaule_Str_Temp,elCount(Vaule_Str_Temp),"%c%s",'00',Vaule_Str_Temp);
              }
              else
              {
                swhere_temp = mixArray[swhere_1].LocalTime[Possition_LocalTime[n]][1];    //预期所在位置
                swhere_temp = Res1904_Data[swhere_1].Res_DID_Data_Len - 1;  //装载后位置反向排序后取正确位置
                Temp_Time = Res1904_Data[swhere_1].Res_DID_Data[swhere_temp] + mixArray[swhere_1].LocalTime[Possition_LocalTime[n]][2]; //计算后的值
                snprintf(Vaule_Str_Temp,elcount(Vaule_Str_Temp),"%s%X",Vaule_Str_Temp,Temp_Time);
                if(strlen(Vaule_Str_Temp)<2)
                  snprintf(Vaule_Str_Temp,elCount(Vaule_Str_Temp),"%c%s",'0',Vaule_Str_Temp);
              }
              snprintf(Res1904_Data[swhere_1].LocalTime_Value,elCount(Res1904_Data[swhere_1].LocalTime_Value),"%s%s",Res1904_Data[swhere_1].LocalTime_Value,Vaule_Str_Temp);
            }
          }
        }
      }
      _WriteEx_and_Report("","/---------------   LocalTime   ---------------/");
      _WriteEx_and_Report("","预期时间为 %s",mixArray[swhere].LocalTime_Value);
      _WriteEx_and_Report("","实际返回为 %s",Res1904_Data[swhere_1].LocalTime_Value);
      if(strncmp(Res1904_Data[swhere_1].LocalTime_Value,mixArray[swhere].LocalTime_Value,strlen(Res1904_Data[swhere_1].LocalTime_Value))==0 &&strncmp(mixArray[swhere].LocalTime_Value,Res1904_Data[swhere_1].LocalTime_Value,strlen(mixArray[swhere].LocalTime_Value))==0)
        testStepPass(Check_Str,"预期时间与实际返回时间一致,均为 %s",Res1904_Data[swhere_1].LocalTime_Value);
      else
        testStepFail(Check_Str,"预期时间为 %s  ,实际返回为 %s",mixArray[swhere].LocalTime_Value,Res1904_Data[swhere_1].LocalTime_Value);
    }
    else
    {
      dword Temp_Possion;
      qword Invalid_Value_;
      char Cmment_S[200];
      char Cmment_T[200];
      char Cmment_D[200];
      snprintf(Cmment_S,elCount(Cmment_S),"%s","");
      snprintf(Cmment_D,elCount(Cmment_D),"%s","");
      snprintf(Cmment_T,elCount(Cmment_T),"%s","");
      if(strncmp(Check_Str,"ALL",strlen(Check_Str))==0 && strlen(Check_Str)!=0)
        return;
      Temp_Possion = _Check_StrPossion_Res(Check_Str,1);  //字符串预期输入数据中的位置
      if(Temp_Possion == -1 || swhere_1 == -1 ) 
        _WriteEx_and_Report(Check_Str,"所输入判断数据不在预期列表中");
      else
      {
        snprintf(Cmment_D,elCount(Cmment_D),"%02X  %02X",Res1904_Data[swhere_1].Res_DID[0],Res1904_Data[swhere_1].Res_DID[1]);
        for(n=0;n<Res1904_Data[swhere_1].Res_DID_Data_Len;n++)
          snprintf(Cmment_T,elCount(Cmment_T),"%s %02X",Cmment_T,Res1904_Data[swhere_1].Res_DID_Data[n]);
        snprintf(Cmment_S,elCount(Cmment_S),"/---------------   %s   ---------------/",mixArray[Temp_Possion].Str_DID_1904);
        _WriteEx_and_Report("",Cmment_S);
        _WriteEx_and_Report("","DID: ",Cmment_D);
        _WriteEx_and_Report("","接收到的数据为 ",Cmment_T);
        if(type == 0)   //正常有效值
        {
          _WriteEx_and_Report("","预期结果为 %.2f",Ex_Value);
          _WriteEx_and_Report("","实际结果为 %.2f",Res1904_Data[swhere_1].Vaule_Now);
          if(Ex_Value < mixArray[Temp_Possion].DID_Value_min || Ex_Value > mixArray[Temp_Possion].DID_Value_max)
            _Check_ValueInRange_IsWrite(Res1904_Data[swhere_1].Vaule_Now,Ex_Value,0,Check_Str,0,0);
          else
            _Check_ValueInRange_IsWrite(Res1904_Data[swhere_1].Vaule_Now,Ex_Value,Res1904_Data[swhere_1].Tolerance,Check_Str,0,0);
        }
        else if(type == 1)    // 无效值
        {
          if(mixArray[Temp_Possion].Invalid_LastValue == 0)
          {
            char Ex_Invalid[30];
            char Now_Invalid[30];
            _WriteEx_and_Report("","使用无效值");
            snprintf(Ex_Invalid,elCount(Ex_Invalid),"%s","");
            snprintf(Now_Invalid,elCount(Now_Invalid),"%s","");
            for(n=0;n<Res1904_Data[swhere_1].Res_DID_Data_Len;n++)
              snprintf(Now_Invalid,elCount(Now_Invalid),"%s%02X",Now_Invalid,Res1904_Data[swhere_1].Res_DID_Data[n]);
            ltoa(mixArray[Temp_Possion].Invalid,Ex_Invalid,16);
            _Str_Upper(Ex_Invalid);
            _WriteEx_and_Report("","预期结果为 ",Ex_Invalid);
            _WriteEx_and_Report("","实际结果为 ",Now_Invalid);
            if((strncmp(Ex_Invalid,Now_Invalid,strlen(Ex_Invalid)) != 0))
              testStepFail(Check_Str,"无效值状态异常,期望无效值为 %s ,实际无效值为 %s",Ex_Invalid,Now_Invalid);
            else
              testStepPass(Check_Str,"无效值与期望一致,为 %s",Now_Invalid);
          }
          else   //最后一次有效值
          {
            /************************待完善*************************/
            _WriteEx_and_Report("","无效值为最后一次有效值");
            _WriteEx_and_Report("","预期结果为 %.2f",Ex_Value);
            _WriteEx_and_Report("","实际结果为 %.2f",Res1904_Data[swhere_1].Vaule_Now);
            _Check_ValueInRange_IsWrite(Res1904_Data[swhere_1].Vaule_Now,Ex_Value,Res1904_Data[swhere_1].Tolerance,Check_Str,0,0);
          }
        }
        else if(type == 2)    // 仅获取值并打印到报告中,不判断
        {
          char comment[200];
          snprintf(comment,elCount(comment),"%s","");
          snprintf(comment,elCount(comment),"%s  获取到的数据为",Check_Str);
          _WriteEx_and_Report("","实际结果为 %.2f",Res1904_Data[swhere_1].Vaule_Now);
          _WriteEx_and_Report("","解析后的值为 %.2f",Check_Str,Res1904_Data[swhere_1].Vaule_Now);
          for(n=0;n<Res1904_Data[swhere_1].Res_DID_Data_Len;n++)
            snprintf(comment,elCount(comment),"%s %02X",comment,Res1904_Data[swhere_1].Res_DID_Data[n]);
          testCaseComment(comment);
          writeEx(-3,0,comment);
        }
      }
    }
  }
}

_Check_1904(diagRequest* Diag ,char Check_Str[],float Ex_Value[],char Time_Str[][],dword type) //type = 0:有效值   type = 1:无效值  type = 2:仅获取值 (多组快照号(检测全部时不区分type状态))
{
  int ii,n,k;
  char Comment[70];
  dword Rx_Len;   //接收到的长度
  int swhere;     //字符串在预输入mixArray数据中的位置
  int Possition_LocalTime[6];  //年月日等时间在mixArray数据中的位置
  byte DID_Tmep[2];       //获取到的DID
  byte DID_Tmep_1[2];     //获取到的DID前两个Byte   ---用于判断是数据还是DID
  byte DID_Tmep_2[2];     //获取到的DID后两个Byte   ---用于判断是数据还是DID
  byte Res_Data[100];     //数据装载
  char Vaule_Str_Temp[20];//临时字符串装载
  float Vaule_Temp;       //临时值
  int Possition;          //DID在结构体mixArray的位置
  int Count_Len;          //每组快照长度
  int Group,Group_Start;  //当前循环到第几组快照,及当前快照组起始的位置
  char Comment_2[8][70];  //用于打印原始数据
  int Count_Loop;
  
  if(diagGetLastResponseCode(Diag) == 0)
    testWaitForDiagResponse(Diag,1500);
  if(diagGetLastResponseCode(Diag) == 0)
    testStepFail("未收到响应");
  else if(diagGetLastResponseCode(Diag) > 0)
    testStepFail("收到消极应答");
  else
  {
    Rx_Len = DiagGetRespPrimitiveSize(Diag);
    for(ii=0;ii<5;ii++)
    {
      if(ii==0)
      {
        if((DiagGetPrimitiveByte(Diag,0)^0x40)!=diagGetRespPrimitiveByte(Diag,0))
          testStepFail("","预期结果为0x%02X,实测结果为0x%02X",DiagGetPrimitiveByte(Diag,0)^0x40,diagGetRespPrimitiveByte(Diag,ii));
      }
      else
      {
        if(DiagGetPrimitiveByte(Diag,ii)!=diagGetRespPrimitiveByte(Diag,ii))
          testStepFail("","预期结果为0x%02X,实测结果为0x%02X",DiagGetPrimitiveByte(Diag,ii),diagGetRespPrimitiveByte(Diag,ii));     
      }
    }
    if(DiagGetPrimitiveByte(Diag,5)==0xFF)
      Count_Len = (Rx_Len - 6)/(Freeze_Frame_Number_Count-1); //每组快照长度
    else
      Count_Len = Rx_Len;
    if(Freeze_Frame_Number_Count-1 == 0)
    {
      Group_Start = 6 ;
      Count_Loop = 1;
    }
    for(n=0;n<Freeze_Frame_Number_Count-1;n++) //此处排除0xFF
    {
      if(Freeze_Frame_Number[n] == DiagGetPrimitiveByte(Diag,5))
      {
        Group_Start = 6 ;
        Count_Loop = 1;
        break;
      }
      else
      {
        Group_Start = 6 + (n*Count_Len);
        Count_Loop = Freeze_Frame_Number_Count-1;
      }
    }//前面获取到发送的快照是读取单独快照还是全体快照部分
    for(Group = 0;Group<Count_Loop;Group++)
    {
      Res1904_Data_Count = 0;
      if(DiagGetPrimitiveByte(Diag,5) == 0xFF)
      {
        Group_Start = 6 + (Group*Count_Len);
        if(diagGetRespPrimitiveByte(Diag,Group_Start)!= Freeze_Frame_Number[Group])
          testStepFail("快照号","预期结果为0x%02X,实测结果为0x%02X",Freeze_Frame_Number[Group],diagGetRespPrimitiveByte(Diag,Group_Start)); 
        if(diagGetRespPrimitiveByte(Diag,Group_Start+1)!= mixArray_Len)
          testStepFail("快照个数","预期结果为0x%02X,实测结果为0x%02X",mixArray_Len,diagGetRespPrimitiveByte(Diag,Group_Start+1)); 
      }
      else
      {
        if(diagGetRespPrimitiveByte(Diag,Group_Start)!= Freeze_Frame_Number[n])
          testStepFail("快照号","预期结果为0x%02X,实测结果为0x%02X",Freeze_Frame_Number[n],diagGetRespPrimitiveByte(Diag,Group_Start)); 
        if(diagGetRespPrimitiveByte(Diag,Group_Start+1)!= mixArray_Len)
          testStepFail("快照个数","预期结果为0x%02X,实测结果为0x%02X",mixArray_Len,diagGetRespPrimitiveByte(Diag,Group_Start+1)); 
      }
      for(ii=Group_Start+2;ii<Group_Start + Count_Len -2;ii++)
      {
        DID_Tmep[0] = diagGetRespPrimitiveByte(Diag,ii);
        DID_Tmep[1] = diagGetRespPrimitiveByte(Diag,ii+1);
        Possition = Array_Compare_1904(DID_Tmep);     //DID在结构体的位置
        Vaule_Temp = 0;
        if(Possition != -1)    //获取到的DID在结构体中
        {
          DID_Tmep_1[0] = diagGetRespPrimitiveByte(Diag,ii-2);
          DID_Tmep_1[1] = diagGetRespPrimitiveByte(Diag,ii-1);
          DID_Tmep_2[0] = diagGetRespPrimitiveByte(Diag,ii+2);
          DID_Tmep_2[1] = diagGetRespPrimitiveByte(Diag,ii+3);
          if(Array_Compare_1904(DID_Tmep_1)!=-1 && Array_Compare_1904(DID_Tmep_2)!=-1) //将数据与DID区分，此处实际获取为数据
            continue;
          else //此处为DID
          {
            snprintf(Comment,elCount(Comment),"%s","");
            Res1904_Data[Res1904_Data_Count].Res_DID[0] = DID_Tmep[0];
            Res1904_Data[Res1904_Data_Count].Res_DID[1] = DID_Tmep[1];
            snprintf(Comment,elCount(Comment),"%02X %02X",DID_Tmep[0],DID_Tmep[1]); //获取DID并准备打印
            Res1904_Data[Res1904_Data_Count].Res_DID_Data_Len = mixArray[Possition].DID_1904_Len;
            Res1904_Data[Res1904_Data_Count].Factor = mixArray[Possition].Factor;
            Res1904_Data[Res1904_Data_Count].Offset = mixArray[Possition].Offset;
            Res1904_Data[Res1904_Data_Count].Tolerance = mixArray[Possition].Tolerance;
            Res1904_Data[Res1904_Data_Count].Possition = Possition;
            snprintf(Res1904_Data[Res1904_Data_Count].Str,elcount(Res1904_Data[Res1904_Data_Count].Str),"%s",mixArray[Possition].Str_DID_1904);
            snprintf(Res1904_Data[Res1904_Data_Count].Symbol,elcount(Res1904_Data[Res1904_Data_Count].Symbol),"%s",mixArray[Possition].Symbol);
            for(n=0;n<mixArray[Possition].DID_1904_Len;n++)
              Res1904_Data[Res1904_Data_Count].Res_DID_Data_2[Group][n] = diagGetRespPrimitiveByte(Diag,ii+2+n);
            
            {
              if(strncmp(Res1904_Data[Res1904_Data_Count].Symbol,"signed",strlen(Res1904_Data[Res1904_Data_Count].Symbol)) == 0) //有符号
              {
                if((Res1904_Data[Res1904_Data_Count].Res_DID_Data_2[Group][0]&0x80)==0x80 )   //负数(最高位Bit为1)
                {
                  qword Da;
                  qword Tem;
                  Tem = 0;
                  Res1904_Data[Res1904_Data_Count].Res_DID_Data_2[Group][0] = (Res1904_Data[Res1904_Data_Count].Res_DID_Data_2[Group][0]&0x7f);
                  for(n=0;n<Res1904_Data[Res1904_Data_Count].Res_DID_Data_Len;n++)
                    Tem = Tem + (Res1904_Data[Res1904_Data_Count].Res_DID_Data_2[Group][n]<<(8*(Res1904_Data[Res1904_Data_Count].Res_DID_Data_Len-n-1)));
                  if(Res1904_Data[Res1904_Data_Count].Res_DID_Data_Len == 4)
                    Da = 0xFFFFFFFF;
                  else if(Res1904_Data[Res1904_Data_Count].Res_DID_Data_Len == 3)
                    Da = 0xFFFFFF;
                  else if(Res1904_Data[Res1904_Data_Count].Res_DID_Data_Len == 2)
                    Da = 0xFFFF;
                  else if(Res1904_Data[Res1904_Data_Count].Res_DID_Data_Len == 1)
                    Da = 0xFF;
                  Vaule_Temp = (0xFFFFFFFF - Tem) & Da;
                  Vaule_Temp = Vaule_Temp*(-1);
                }
                else
                {
                  for(n=0;n<Res1904_Data[Res1904_Data_Count].Res_DID_Data_Len;n++)
                    Vaule_Temp = Vaule_Temp + (Res1904_Data[Res1904_Data_Count].Res_DID_Data_2[Group][n]<<(8*(Res1904_Data[Res1904_Data_Count].Res_DID_Data_Len-n-1)));
                }
              }
              else   //无符号
              {
                for(n=0;n<Res1904_Data[Res1904_Data_Count].Res_DID_Data_Len;n++)
                  Vaule_Temp = Vaule_Temp + (Res1904_Data[Res1904_Data_Count].Res_DID_Data_2[Group][n]<<(8*(Res1904_Data[Res1904_Data_Count].Res_DID_Data_Len-n-1)));
              }
              Res1904_Data[Res1904_Data_Count].Vaule_Now_2[Group] = (Vaule_Temp*Res1904_Data[Res1904_Data_Count].Factor) + Res1904_Data[Res1904_Data_Count].Offset; //获取非时间数据,分组装载当前返回值
              if(strncmp(Res1904_Data[Res1904_Data_Count].Str,"LocalTime",strlen(Res1904_Data[Res1904_Data_Count].Str))==0)   //获取到的数据为时间
              {
                swhere = _Check_StrPossion("LocalTime",1,0);  //获取时间在预输入mixArray数据中的位置
                snprintf(Res1904_Data[Res1904_Data_Count].LocalTime_Value_2[Group],elCount(Res1904_Data[Res1904_Data_Count].LocalTime_Value_2[Group]),"%s","");
                if(strncmp(Res1904_Data[Res1904_Data_Count].Symbol,"BCD",strlen(Res1904_Data[Res1904_Data_Count].Symbol))==0)   //BCD格式,全原码拼接
                {
                  for(n=0;n<Res1904_Data[Res1904_Data_Count].Res_DID_Data_Len;n++)
                  {
                    snprintf(Vaule_Str_Temp,elCount(Vaule_Str_Temp),"%s","");
                    snprintf(Vaule_Str_Temp,elcount(Vaule_Str_Temp),"%s%x",Vaule_Str_Temp,Res1904_Data[Res1904_Data_Count].Res_DID_Data_2[Group][n]);
                    if(strlen(Vaule_Str_Temp)<2)
                      snprintf(Vaule_Str_Temp,elCount(Vaule_Str_Temp),"%c%s",'0',Vaule_Str_Temp);
                    snprintf(Res1904_Data[Res1904_Data_Count].LocalTime_Value_2[Group],elCount(Res1904_Data[Res1904_Data_Count].LocalTime_Value_2[Group]),"%s%s",Res1904_Data[Res1904_Data_Count].LocalTime_Value_2[Group],Vaule_Str_Temp);
                  }
                }
                else    //非BCD格式      注意排列顺序
                {
                  qword Temp_Time;
                  dword swhere_temp;
                  Possition_LocalTime[0] = _Check_StrPossion("year",Possition,0);
                  Possition_LocalTime[1] = _Check_StrPossion("month",Possition,0);
                  Possition_LocalTime[2] = _Check_StrPossion("day",Possition,0);
                  Possition_LocalTime[3] = _Check_StrPossion("hour",Possition,0);
                  Possition_LocalTime[4] = _Check_StrPossion("minute",Possition,0);
                  Possition_LocalTime[5] = _Check_StrPossion("second",Possition,0);
                  if(mixArray[Possition].LocalTime[Possition_LocalTime[0]][1]>1) // 秒/分/时/日/月/年   数组逆向
                    reverseNum(Res1904_Data[Res1904_Data_Count].Res_DID_Data_2[Group],Res1904_Data[Res1904_Data_Count].Res_DID_Data_Len);  //年-月-日-时-分-秒
                  swhere_temp = 0;
                  for(n=0;n<6;n++)
                  {
                    Temp_Time =0;
                    snprintf(Vaule_Str_Temp,elCount(Vaule_Str_Temp),"%s","");
                    if(Possition_LocalTime[n] == -1)    //仅包含部分时间,不是完整的 年月日时分秒,舍弃未查询到的字符
                    {
                      //snprintf(Vaule_Str_Temp,elCount(Vaule_Str_Temp),"%c%s",'00',Vaule_Str_Temp);
                    }
                    else
                    {
                      for(k=swhere_temp;k<swhere_temp + mixArray[Possition].LocalTime[Possition_LocalTime[n]][0];k++)
                        Temp_Time = Temp_Time + (Res1904_Data[Res1904_Data_Count].Res_DID_Data_2[Group][k]<<(8*((mixArray[Possition].LocalTime[Possition_LocalTime[n]][0])-k-1+swhere_temp)));
                      swhere_temp += mixArray[Possition].LocalTime[Possition_LocalTime[n]][0];
                      Temp_Time = Temp_Time + mixArray[Possition].LocalTime[Possition_LocalTime[n]][2]; //计算后的值
                      snprintf(Vaule_Str_Temp,elcount(Vaule_Str_Temp),"%s%d",Vaule_Str_Temp,Temp_Time);
                      if(strlen(Vaule_Str_Temp)<2)
                        snprintf(Vaule_Str_Temp,elCount(Vaule_Str_Temp),"%c%s",'0',Vaule_Str_Temp);
                    }
                    snprintf(Res1904_Data[Res1904_Data_Count].LocalTime_Value_2[Group],elCount(Res1904_Data[Res1904_Data_Count].LocalTime_Value_2[Group]),"%s%s",Res1904_Data[Res1904_Data_Count].LocalTime_Value_2[Group],Vaule_Str_Temp);                
                  }
                }
              }
            }//获取到转换后的反馈值   时间 + 其余值
            Res1904_Data_Count++;
          }//判断是DID的处理循环
        }//判断获取到的值在预输入结构体中判断循环
      }//获取到完整的一组快照循环
    }//多组快照完全获取
    if((strncmp(Check_Str,"All",strlen(Check_Str))==0) || (strncmp(Check_Str,"ALL",strlen(Check_Str))==0))    //检测"All"时暂不写无效值状态,预期结果由外部传输（涉及到上一次有效值获取）
    {
      for(ii=0;ii<mixArray_Len;ii++)
      {
        snprintf(Comment,elCount(Comment),"%s","");
        snprintf(Comment,elCount(Comment),"%s",mixArray[ii].Str_DID_1904);   //获取对应的释义
        Possition = _Check_StrPossion_Res(Comment,2);  //字符串在Res1904_Data中位置
        swhere =  _Check_StrPossion_Res(Comment,1);    //字符串在mixArray中位置
        if(Possition == -1)
          _WriteEx_and_Report(Check_Str,"未在返回数据中");
        else
        {
          char Temp_DID_S[100];
          snprintf(Temp_DID_S,elCount(Temp_DID_S),"%s","");
          snprintf(Temp_DID_S,elCount(Temp_DID_S),"0x%02X  0x%02X",Res1904_Data[Possition].Res_DID[0],Res1904_Data[Possition].Res_DID[1]);
          if(strncmp(Comment,"LocalTime",strlen(Comment))==0)
          {
            for(n=0;n<Group_Count;n++)
              snprintf(Time_Str[n],elCount(Time_Str[n]),"%s",mixArray[swhere].LocalTime_Value_2[n]);   //获取反馈数据的原始值
          }
          else
          {
            for(n=0;n<Group_Count;n++)
              Ex_Value[n] = mixArray[swhere].Vaule_Ex_2[n];
          }
          for(n=0;n<Group_Count;n++)
          {
            snprintf(Comment_2[n],elCount(Comment_2[n]),"%s","");
            for(k=0;k<Res1904_Data[Possition].Res_DID_Data_Len;k++)
              snprintf(Comment_2[n],elCount(Comment_2[n]),"%s 0x%02X",Comment_2[n],Res1904_Data[Possition].Res_DID_Data_2[n][k]);   //获取反馈数据的原始值
          }
          if(mixArray[swhere].Step_Flage !=1)   //未执行操作,仅获取数据值
          {
            char Temp_Str[100];
            snprintf(Temp_Str,elCount(Temp_Str),"%s","");
            snprintf(Temp_Str,elCount(Temp_Str),"/---------------   %s   ---------------/",Res1904_Data[Possition].Str);
            _WriteEx_and_Report("",Temp_Str);
            _WriteEx_and_Report(Comment,"未执行操作,仅获取数据值");
            if(strncmp(Comment,"LocalTime",strlen(Comment))==0)
            {
              _WriteEx_and_Report("",Temp_DID_S);
              for(n=0;n<Group;n++)
              {
                testStep("","第 %d 组快照,获取到的时间为 %s",n,Res1904_Data[Possition].LocalTime_Value_2[n]);
                writeEx(-3,0,"第 %d 组快照,获取到的时间为 %s",n,Res1904_Data[Possition].LocalTime_Value_2[n]);
              }
            }
            else
            {
              _WriteEx_and_Report("",Temp_DID_S);
              for(n=0;n<Group;n++)
              {
                testStep("","第 %d 组快照,获取到的数据为 %.2f",n,Res1904_Data[Possition].Vaule_Now_2[n]);
                writeEx(-3,0,"第 %d 组快照,获取到的数据为 %.2f",n,Res1904_Data[Possition].Vaule_Now_2[n]);
              }
            }
            for(n=0;n<Group;n++)
            {
              testStep("","第 %d 组快照,获取到的原始数据为 %s",n,Comment_2[n]);
              writeEx(-3,0,"第 %d 组快照,获取到的原始数据为 %s",n,Comment_2[n]);
            }
          }
          else
          {
            char Temp_Str[100];
            char Temp_Fault_str[100];
            snprintf(Temp_Str,elCount(Temp_Str),"%s","");
            snprintf(Temp_Str,elCount(Temp_Str),"/---------------   %s   ---------------/",Res1904_Data[Possition].Str);
            _WriteEx_and_Report("",Temp_Str);
            if(strncmp(Comment,"LocalTime",strlen(Comment))==0)
            {
              _WriteEx_and_Report("",Temp_DID_S);
              for(n=0;n<Group;n++)
              {
                _WriteEx_and_Report("","第 %d 组快照",n);
                snprintf(Temp_Fault_str,elCount(Temp_Fault_str),"%s","原始数据为: ");
                snprintf(Temp_Fault_str,elCount(Temp_Fault_str),"%s%s",Temp_Fault_str,Res1904_Data[Possition].LocalTime_Value_2[n]);
                _WriteEx_and_Report("",Temp_Fault_str);
                if(strncmp(Time_Str[n],Res1904_Data[Possition].LocalTime_Value_2[n],strlen(Res1904_Data[Possition].LocalTime_Value_2[n]))==0)
                  testStepPass(Res1904_Data[Possition].Str,"获取到的数据与预期一致为 %s",Time_Str[n]);
                else
                {
                  testStepFail(Res1904_Data[Possition].Str,"获取到的数据与预期不一致,预期为 %s  ,实际为 %s",Time_Str[n],Res1904_Data[Possition].LocalTime_Value_2[n]);
                  _WriteEx_and_Report("","/*****数据异常*****/");
                }
              }
            }
            else
            {
              int Temp_Ret;
              _WriteEx_and_Report("",Temp_DID_S);
              for(n=0;n<Group;n++)
              {
                testStep("","第 %d 组快照",n);
                snprintf(Temp_Fault_str,elCount(Temp_Fault_str),"%s","原始数据为: ");
                testStep("","第 %d 组快照,当前数据为 %.2f ,期望结果为 %.2f",n,Res1904_Data[Possition].Vaule_Now_2[n],Ex_Value[n]);
                writeEx(-3,0,"第 %d 组快照,当前数据为 %.2f ,期望结果为 %.2f",n,Res1904_Data[Possition].Vaule_Now_2[n],Ex_Value[n]);
                Temp_Ret = _Check_ValueInRange_IsWrite(Res1904_Data[Possition].Vaule_Now_2[n],Ex_Value[n],abs(Res1904_Data[Possition].Tolerance),Comment,0,0);
                if(Temp_Ret == -1)//打印错误数据
                {
                  int m;
                   _WriteEx_and_Report("","/*****数据异常*****/");
                  for(m=0;m<Res1904_Data[Possition].Res_DID_Data_Len;m++)
                    snprintf(Temp_Fault_str,elCount(Temp_Fault_str),"%s 0x%02X",Temp_Fault_str,Res1904_Data[Possition].Res_DID_Data_2[n][m]);
                  _WriteEx_and_Report("",Temp_Fault_str);
                }
              }
            }
          }
        }
      }
    }
    else
    {
      Possition = _Check_StrPossion_Res(Check_Str,2);
      swhere =  _Check_StrPossion_Res(Check_Str,1);
      if(Possition == -1)
      {
        if((strncmp(Check_Str,"All",strlen(Check_Str))!=0) && (strncmp(Check_Str,"ALL",strlen(Check_Str))!=0))
          _WriteEx_and_Report(Check_Str,"未在返回数据中");
      }
      else if(Possition != -1 && mixArray[swhere].Step_Flage==1)
      {
        for(n=0;n<Group;n++)
        {
          snprintf(Comment_2[n],elCount(Comment_2[n]),"%s","");
          for(k=0;k<Res1904_Data[Possition].Res_DID_Data_Len;k++)
            snprintf(Comment_2[n],elCount(Comment_2[n]),"%s 0x%02X",Comment_2[n],Res1904_Data[Possition].Res_DID_Data_2[n][k]);
        }
        if(type == 0) //有效值
        {
          if(strncmp(Check_Str,"LocalTime",strlen(Check_Str))==0)
          {
            for(n=0;n<Group;n++)
            {
              testStep("","第 %d 组快照",n);
              if(strncmp(Time_Str[n],Res1904_Data[Possition].LocalTime_Value_2[n],strlen(Res1904_Data[Possition].LocalTime_Value_2[n]))==0)
                testStepPass(Check_Str,"获取到的数据与预期一致为 %s",Time_Str[n]);
              else
                testStepFail(Check_Str,"获取到的数据与预期不一致,预期为 %s  ,实际为 %s",Time_Str[n],Res1904_Data[Possition].LocalTime_Value_2[n]);
            }
          }
          else
          {
            for(n=0;n<Group;n++)
            {
              testStep("","第 %d 组快照",n);
              _Check_ValueInRange_IsWrite(Res1904_Data[Possition].Vaule_Now_2[n],Ex_Value[n],Res1904_Data[Possition].Tolerance,Check_Str,0,0);
            }
          }
        }
        else if(type == 1)  //无效值
        {
          dword Temp_Invalid;
          if(mixArray[swhere].Invalid_LastValue == 0)
          {
            for(n=0;n<Group;n++)
            {
              testStep("","第 %d 组快照",n);
              Temp_Invalid =0;
              for(k=0;k<Res1904_Data[Possition].Res_DID_Data_Len;k++)
                Temp_Invalid = Temp_Invalid + Res1904_Data[Possition].Res_DID_Data_2[n][k]<<(8*(Res1904_Data[Possition].Res_DID_Data_Len-k-1));
              if(Temp_Invalid != mixArray[swhere].Invalid)
                testStepFail(Check_Str,"获取到的无效值为0x%X ,预期无效值为 0x%X",Temp_Invalid,mixArray[swhere].Invalid);
              else
                testStepPass(Check_Str,"获取到的无效值与预期无效值一致为 0x%X",mixArray[swhere].Invalid);
            }
          }
          else
          {
            /***********************上一次有效值,暂未使用,待完善****************************/
          }
        }
        else if(type == 2)  //仅获取值
        {
          if(strncmp(Check_Str,"LocalTime",strlen(Check_Str))==0)
          {
            for(n=0;n<Group;n++)
            {
              testStep("","第 %d 组快照,获取到的时间为 %s",n,Res1904_Data[Possition].LocalTime_Value_2[n]);
              writeEx(-3,0,"第 %d 组快照,获取到的时间为 %s",n,Res1904_Data[Possition].LocalTime_Value_2[n]);
            }
          }
          else
          {
            for(n=0;n<Group;n++)
            {
              testStep("","第 %d 组快照,获取到的数据为 %.2f",n,Res1904_Data[Possition].Vaule_Now_2[n]);
              writeEx(-3,0,"第 %d 组快照,获取到的数据为 %.2f",n,Res1904_Data[Possition].Vaule_Now_2[n]);
            }
          }
          for(n=0;n<Group;n++)
          {
            testStep("","第 %d 组快照,获取到的原始数据为 %s",n,Comment_2[n]);
            writeEx(-3,0,"第 %d 组快照,获取到的原始数据为 %s",n,Comment_2[n]);
          }
        }
      }
      else
      {
        _WriteEx_and_Report(Check_Str,"未进行对应操作,待完善步骤");
      }
    }
  }
}

_Get_1904_All_Data(diagRequest* Diag)  //获取1904快照写入到结构体中
{
  int ii,n,k;
  char Comment[70];
  dword Rx_Len;  //接收到的长度
  int swhere;     //字符串在预输入mixArray数据中的位置
  int Possition_LocalTime[6];  //年月日等时间在mixArray数据中的位置
  byte DID_Tmep[2];      //获取到的DID
  byte DID_Tmep_1[2];    //获取到的DID前两个Byte   ---用于判断是数据还是DID
  byte DID_Tmep_2[2];    //获取到的DID后两个Byte   ---用于判断是数据还是DID
  byte Res_Data[100];    //数据装载
  char Vaule_Str_Temp[20]; //临时字符串装载
  float Vaule_Temp;       //临时值
  int Possition;          //DID在结构体mixArray的位置
  int Count_Len;          //每组快照长度
  int Group,Group_Start;              //当前循环到第几组快照,及当前快照组起始的位置
  char Comment_2[8][70]; //用于打印原始数据
  int Count_Loop;
  
  if(diagGetLastResponseCode(Diag) == 0)
    testWaitForDiagResponse(Diag,1500);
  if(diagGetLastResponseCode(Diag) == 0)
    testStepFail("未收到响应");
  else if(diagGetLastResponseCode(Diag) > 0)
    testStepFail("收到消极应答");
  else
  {
    if(DiagGetPrimitiveByte(Diag,5) != 0xFF)//未获取全部快照
      Group_Count = 1;
    Rx_Len = DiagGetRespPrimitiveSize(Diag);
    for(ii=0;ii<5;ii++) //前5字节判断
    {
      if(ii==0)
      {
        if((DiagGetPrimitiveByte(Diag,0)^0x40)!=diagGetRespPrimitiveByte(Diag,0))
          testStepFail("","预期结果为0x%02X,实测结果为0x%02X",DiagGetPrimitiveByte(Diag,0)^0x40,diagGetRespPrimitiveByte(Diag,ii));
      }
      else
      {
        if(DiagGetPrimitiveByte(Diag,ii)!=diagGetRespPrimitiveByte(Diag,ii))
          testStepFail("","预期结果为0x%02X,实测结果为0x%02X",DiagGetPrimitiveByte(Diag,ii),diagGetRespPrimitiveByte(Diag,ii));     
      }
    }
    if(DiagGetPrimitiveByte(Diag,5)==0xFF)
      Count_Len = (Rx_Len - 6)/(Freeze_Frame_Number_Count-1); //每组快照长度
    else
      Count_Len = Rx_Len;
    for(n=0;n<Freeze_Frame_Number_Count-1;n++)
    {
      if(DiagGetPrimitiveByte(Diag,5) == Freeze_Frame_Number[n])
      {
        Group_Start = 6 ;
        Count_Loop = 1;
        break;
      }
      else
      {
        Group_Start = 6 + (n*Count_Len);
        Count_Loop = Freeze_Frame_Number_Count-1;
      }
    }
    for(Group = 0;Group<Count_Loop;Group++)
    {
      Res1904_Data_Count = 0;
      if(DiagGetPrimitiveByte(Diag,5) == 0xFF)
      {
        Group_Start = 6 + (Group*Count_Len);
        if(diagGetRespPrimitiveByte(Diag,Group_Start)!= Freeze_Frame_Number[Group])
          testStepFail("快照号","预期结果为0x%02X,实测结果为0x%02X",Freeze_Frame_Number[Group],diagGetRespPrimitiveByte(Diag,Group_Start)); 
        if(diagGetRespPrimitiveByte(Diag,Group_Start+1)!= mixArray_Len)
          testStepFail("快照个数","预期结果为0x%02X,实测结果为0x%02X",mixArray_Len,diagGetRespPrimitiveByte(Diag,Group_Start+1)); 
      }
      else
      {
        if(diagGetRespPrimitiveByte(Diag,Group_Start)!= Freeze_Frame_Number[n])
          testStepFail("快照号","预期结果为0x%02X,实测结果为0x%02X",Freeze_Frame_Number[n],diagGetRespPrimitiveByte(Diag,Group_Start)); 
        if(diagGetRespPrimitiveByte(Diag,Group_Start+1)!= mixArray_Len)
          testStepFail("快照个数","预期结果为0x%02X,实测结果为0x%02X",mixArray_Len,diagGetRespPrimitiveByte(Diag,Group_Start+1)); 
      }
      for(ii=Group_Start+2;ii<Group_Start + Count_Len -2;ii++)
      {
        DID_Tmep[0] = diagGetRespPrimitiveByte(Diag,ii);
        DID_Tmep[1] = diagGetRespPrimitiveByte(Diag,ii+1);
        Possition = Array_Compare_1904(DID_Tmep);     //DID在结构体的位置
        Vaule_Temp = 0;
        if(Possition != -1)    //获取到的DID在结构体中
        {
          DID_Tmep_1[0] = diagGetRespPrimitiveByte(Diag,ii-2);
          DID_Tmep_1[1] = diagGetRespPrimitiveByte(Diag,ii-1);
          DID_Tmep_2[0] = diagGetRespPrimitiveByte(Diag,ii+2);
          DID_Tmep_2[1] = diagGetRespPrimitiveByte(Diag,ii+3);
          if(Array_Compare_1904(DID_Tmep_1)!=-1 && Array_Compare_1904(DID_Tmep_2)!=-1) //获取到的DID实际为数据
          {}
          else
          {
            snprintf(Comment,elCount(Comment),"%s","");
            Res1904_Data[Res1904_Data_Count].Res_DID[0] = DID_Tmep[0];
            Res1904_Data[Res1904_Data_Count].Res_DID[1] = DID_Tmep[1];
            snprintf(Comment,elCount(Comment),"%s %02X",Comment,DID_Tmep[0]);
            snprintf(Comment,elCount(Comment),"%s %02X",Comment,DID_Tmep[1]);
            Res1904_Data[Res1904_Data_Count].Res_DID_Data_Len = mixArray[Possition].DID_1904_Len;
            Res1904_Data[Res1904_Data_Count].Factor = mixArray[Possition].Factor;
            Res1904_Data[Res1904_Data_Count].Offset = mixArray[Possition].Offset;
            Res1904_Data[Res1904_Data_Count].Tolerance = mixArray[Possition].Tolerance;
            Res1904_Data[Res1904_Data_Count].Possition = Possition;
            snprintf( Res1904_Data[Res1904_Data_Count].Str,elcount(Res1904_Data[Res1904_Data_Count].Str),"%s",mixArray[Possition].Str_DID_1904);
            snprintf( Res1904_Data[Res1904_Data_Count].Symbol,elcount(Res1904_Data[Res1904_Data_Count].Symbol),"%s",mixArray[Possition].Symbol);
            for(n=0;n<mixArray[Possition].DID_1904_Len;n++)
              Res1904_Data[Res1904_Data_Count].Res_DID_Data_2[Group][n] = diagGetRespPrimitiveByte(Diag,ii+2+n);
            
            {
              if(strncmp(Res1904_Data[Res1904_Data_Count].Symbol,"signed",strlen(Res1904_Data[Res1904_Data_Count].Symbol)) == 0) //有符号
              {
                if((Res1904_Data[Res1904_Data_Count].Res_DID_Data_2[Group][0]&0x80)==0x80 )   //负数(最高位Bit为1)
                {
                  qword Da;
                  qword Tem;
                  Tem = 0;
                  for(n=0;n<Res1904_Data[Res1904_Data_Count].Res_DID_Data_Len;n++)
                    Tem = Tem + (Res1904_Data[Res1904_Data_Count].Res_DID_Data[n]<<(8*(Res1904_Data[Res1904_Data_Count].Res_DID_Data_Len-n-1)));
                  if(Res1904_Data[Res1904_Data_Count].Res_DID_Data_Len == 4)
                    Da = 0xFFFFFFFF;
                  else if(Res1904_Data[Res1904_Data_Count].Res_DID_Data_Len == 3)
                    Da = 0xFFFFFF;
                  else if(Res1904_Data[Res1904_Data_Count].Res_DID_Data_Len == 2)
                    Da = 0xFFFF;
                  else if(Res1904_Data[Res1904_Data_Count].Res_DID_Data_Len == 1)
                    Da = 0xFF;
                  Vaule_Temp = (0xFFFFFFFF - Tem) & Da;
                  Vaule_Temp = Vaule_Temp*(-1);
                }
                else
                {
                  for(n=0;n<Res1904_Data[Res1904_Data_Count].Res_DID_Data_Len;n++)
                    Vaule_Temp = Vaule_Temp + (Res1904_Data[Res1904_Data_Count].Res_DID_Data_2[Group][n]<<(8*(Res1904_Data[Res1904_Data_Count].Res_DID_Data_Len-n-1)));
                }
              }
              else   //无符号
              {
                for(n=0;n<Res1904_Data[Res1904_Data_Count].Res_DID_Data_Len;n++)
                  Vaule_Temp = Vaule_Temp + (Res1904_Data[Res1904_Data_Count].Res_DID_Data_2[Group][n]<<(8*(Res1904_Data[Res1904_Data_Count].Res_DID_Data_Len-n-1)));
              }
              Res1904_Data[Res1904_Data_Count].Vaule_Now_2[Group] = (Vaule_Temp*Res1904_Data[Res1904_Data_Count].Factor) + Res1904_Data[Res1904_Data_Count].Offset; //获取非时间数据
              if(strncmp(Res1904_Data[Res1904_Data_Count].Str,"CarSpd",strlen(Res1904_Data[Res1904_Data_Count].Str))==0 && CarSpd_mToKPH == 1 &&  Res1904_Data[Res1904_Data_Count].Vaule_Now_2[Group] != mixArray[Possition].Invalid)
                Res1904_Data[Res1904_Data_Count].Vaule_Now_2[Group] = Res1904_Data[Res1904_Data_Count].Vaule_Now_2[Group]*3.6;
              {
                int DA;
                DA = 0;
                for(n=0;n<Res1904_Data[Res1904_Data_Count].Res_DID_Data_Len;n++)
                {
                  if((Res1904_Data[Res1904_Data_Count].Res_DID_Data_2[Group][n] == 0) || (Res1904_Data[Res1904_Data_Count].Res_DID_Data_2[Group][n] == 0xFF) || (Res1904_Data[Res1904_Data_Count].Res_DID_Data_2[Group][n] == 0x7F))
                  {}
                  else
                    DA = 1;
                }
                if(DA == 0)
                {
                  Res1904_Data[Res1904_Data_Count].Vaule_Now_2[Group] = Vaule_Temp;
                }
              }
              if(strncmp(Res1904_Data[Res1904_Data_Count].Str,"LocalTime",strlen(Res1904_Data[Res1904_Data_Count].Str))==0)   //获取到的数据为时间
              {
                swhere = _Check_StrPossion("LocalTime",1,0);  //获取时间在预输入mixArray数据中的位置
                snprintf(Res1904_Data[Res1904_Data_Count].LocalTime_Value_2[Group],elCount(Res1904_Data[Res1904_Data_Count].LocalTime_Value_2[Group]),"%s","");
                if(strncmp(Res1904_Data[Res1904_Data_Count].Symbol,"BCD",strlen(Res1904_Data[Res1904_Data_Count].Symbol))==0)   //BCD格式,全原码拼接
                {
                  for(n=0;n<Res1904_Data[Res1904_Data_Count].Res_DID_Data_Len;n++)
                  {
                    snprintf(Vaule_Str_Temp,elCount(Vaule_Str_Temp),"%s","");
                    snprintf(Vaule_Str_Temp,elcount(Vaule_Str_Temp),"%s%x",Vaule_Str_Temp,Res1904_Data[Res1904_Data_Count].Res_DID_Data_2[Group][n]);
                    if(strlen(Vaule_Str_Temp)<2)
                      snprintf(Vaule_Str_Temp,elCount(Vaule_Str_Temp),"%c%s",'0',Vaule_Str_Temp);
                    snprintf(Res1904_Data[Res1904_Data_Count].LocalTime_Value_2[Group],elCount(Res1904_Data[Res1904_Data_Count].LocalTime_Value_2[Group]),"%s%s",Res1904_Data[Res1904_Data_Count].LocalTime_Value_2[Group],Vaule_Str_Temp);
                  }
                }
                else    //非BCD格式      注意排列顺序
                {
                  qword Temp_Time;
                  dword swhere_temp;
                  Possition_LocalTime[0] = _Check_StrPossion("year",Possition,0);
                  Possition_LocalTime[1] = _Check_StrPossion("month",Possition,0);
                  Possition_LocalTime[2] = _Check_StrPossion("day",Possition,0);
                  Possition_LocalTime[3] = _Check_StrPossion("hour",Possition,0);
                  Possition_LocalTime[4] = _Check_StrPossion("minute",Possition,0);
                  Possition_LocalTime[5] = _Check_StrPossion("second",Possition,0);
                  if(mixArray[Possition].LocalTime[Possition_LocalTime[0]][1]>1) // 当前 秒/分/时/日/月/年   
                    reverseNum(Res1904_Data[Res1904_Data_Count].Res_DID_Data_2[Group],Res1904_Data[Res1904_Data_Count].Res_DID_Data_Len); //年-月-日-时-分-秒
                  swhere_temp = 0;
                  for(n=0;n<6;n++)
                  {
                    Temp_Time =0;
                    snprintf(Vaule_Str_Temp,elCount(Vaule_Str_Temp),"%s","");
                    if(Possition_LocalTime[n] == -1)    //仅包含部分时间,不是完整的 年月日时分秒,舍弃未查询到的字符
                    {
                      //snprintf(Vaule_Str_Temp,elCount(Vaule_Str_Temp),"%c%s",'00',Vaule_Str_Temp);
                    }
                    else
                    {
                      for(k=swhere_temp;k<swhere_temp + mixArray[Possition].LocalTime[Possition_LocalTime[n]][0];k++)
                        Temp_Time = Temp_Time + (Res1904_Data[Res1904_Data_Count].Res_DID_Data_2[Group][k]<<(8*((mixArray[Possition].LocalTime[Possition_LocalTime[n]][0])-k-1+swhere_temp)));
                      swhere_temp+=mixArray[Possition].LocalTime[Possition_LocalTime[n]][0];
                      
                      Temp_Time = Temp_Time + mixArray[Possition].LocalTime[Possition_LocalTime[n]][2]; //计算后的值
                      snprintf(Vaule_Str_Temp,elcount(Vaule_Str_Temp),"%s%d",Vaule_Str_Temp,Temp_Time);
                      if(strlen(Vaule_Str_Temp)<2)
                        snprintf(Vaule_Str_Temp,elCount(Vaule_Str_Temp),"%c%s",'0',Vaule_Str_Temp);
                    }
                    if((Flage_SaveData_Geely == 1 && Flage_Invalid_Geely == 1) || Flage_Invalid_GAC == 1) //Geely时间无效值
                    {
                      Temp_Time = 0;
                      snprintf(Vaule_Str_Temp,elCount(Vaule_Str_Temp),"%s","");
                      for(k=swhere_temp;k<swhere_temp + mixArray[Possition].LocalTime[Possition_LocalTime[n]][0];k++)
                        Temp_Time = Temp_Time | (Res1904_Data[Res1904_Data_Count].Res_DID_Data_2[Group][k]<<(8*((mixArray[Possition].LocalTime[Possition_LocalTime[n]][0])-k-1+swhere_temp)));
                      
                      snprintf(Vaule_Str_Temp,elcount(Vaule_Str_Temp),"%s%02X",Vaule_Str_Temp,Temp_Time);
                      snprintf(Res1904_Data[Res1904_Data_Count].LocalTime_Value_2[Group],elCount(Res1904_Data[Res1904_Data_Count].LocalTime_Value_2[Group]),"%s%s",Res1904_Data[Res1904_Data_Count].LocalTime_Value_2[Group],Vaule_Str_Temp);  
                    }
                    else
                      snprintf(Res1904_Data[Res1904_Data_Count].LocalTime_Value_2[Group],elCount(Res1904_Data[Res1904_Data_Count].LocalTime_Value_2[Group]),"%s%s",Res1904_Data[Res1904_Data_Count].LocalTime_Value_2[Group],Vaule_Str_Temp);    
                  }
                }
              }
            }//获取到转换后的反馈值   时间 + 其余值
            Res1904_Data_Count++;
          }//判断是DID的处理循环
        }//判断获取到的值在预输入结构体中判断循环
      }//获取到完整的一组快照循环
    }//多组快照完全获取
  }
}

/*
    内部对多组快照有处理，若仅含一组情况下，直接对比该组快照数据
*/
_Check_1904_Specified(char Check_Str[],float Ex_Value[],dword type) //type = 0:有效值   type = 1:无效值  type = 2:仅获取值 (指定快照数据对比)
{
  int ii,n;
  char Comment[70];
  int swhere;             //字符串在Res1904_Data数据中的位置
  int Possition;          //DID在结构体mixArray的位置
  char Comment_2[8][70];  //用于打印原始数据
  dword Temp_Value;
  
  swhere = _Check_StrPossion_Res(Check_Str,2);
  Possition = _Check_StrPossion_Res(Check_Str,1);
  
  if(swhere != -1 && Possition != -1)
  {
    char Temp_Str[100];
    char Temp_Str_[100];
    snprintf(Temp_Str,elCount(Temp_Str),"%s","");
    snprintf(Temp_Str_,elCount(Temp_Str_),"%s","");
    snprintf(Temp_Str,elCount(Temp_Str),"/---------------   %s   ---------------/",Check_Str);
    _WriteEx_and_Report("",Temp_Str);
    snprintf(Temp_Str_,elCount(Temp_Str_),"0x%02X  0x%02X",mixArray[Possition].DID_1904[0],mixArray[Possition].DID_1904[1]);
    _WriteEx_and_Report("",Temp_Str_);
    for(ii=0;ii<Group_Count;ii++)
    {
      snprintf(Comment_2[ii],elCount(Comment_2[ii]),"%s","");
      for(n=0;n<Res1904_Data[swhere].Res_DID_Data_Len;n++)//此处装载原始数据
        snprintf(Comment_2[ii],elCount(Comment_2[ii]),"%s 0x%02X",Comment_2[ii],Res1904_Data[swhere].Res_DID_Data_2[ii][n]);
    }
    if(type==0)
    {
      for(ii=0;ii<Group_Count;ii++)
      {
        _WriteEx_and_Report("","第 %d 组快照",ii);
        _Check_ValueInRange_IsWrite(Res1904_Data[swhere].Vaule_Now_2[ii],Ex_Value[ii],Res1904_Data[swhere].Tolerance,Check_Str,0,1);
      }
    }
    else if(type==1)
    {
      for(ii=0;ii<Group_Count;ii++)
      {
        _WriteEx_and_Report("","第 %d 组快照",ii);
        Temp_Value = 0;
        if(mixArray[Possition].Invalid_LastValue == 0)
        {
          for(n=0;n<Res1904_Data[swhere].Res_DID_Data_Len;n++)
            Temp_Value = Temp_Value | Res1904_Data[swhere].Res_DID_Data_2[ii][n]<<(8*(Res1904_Data[swhere].Res_DID_Data_Len-n-1));
          if(Temp_Value != mixArray[Possition].Invalid)
          {
            testStepFail(Check_Str,"获取到的值与预期输入不一致,获取到的值为 0x%X ,预期值为 0x%X",Temp_Value,mixArray[Possition].Invalid);
            writeEx(-3,0,"获取到的值与预期输入不一致,获取到的值为 0x%X ,预期值为 0x%X",Temp_Value,mixArray[Possition].Invalid);
          }
          else
          {
            testStepPass(Check_Str,"获取到的值与预期输入一致");
            writeEx(-3,0,"获取到的值与预期输入一致");
          }
        }
        else  //最后一次有效值由外部输入
          _Check_ValueInRange_IsWrite(Res1904_Data[swhere].Vaule_Now_2[ii],Ex_Value[ii],Res1904_Data[swhere].Tolerance,Check_Str,0,0);
      }
    }
    else if(type==2)
    {
      for(ii=0;ii<Group_Count;ii++)
      {
        _WriteEx_and_Report("","第 %d 组快照",ii);
        _WriteEx_and_Report(Check_Str,Comment_2[ii]);
      }
    }
  }
  else
    testStepFail(Check_Str,"未查询到对应的字符串数据");
}
_Check_1904_Specified(char Check_Str[],char Ex_Str[][],dword type) //type = 0:有效值   type = 1:无效值  type = 2:仅获取值 (指定快照数据对比)
{
  int ii,n;
  char Comment[70];
  int swhere;             //字符串在Res1904_Data数据中的位置
  int Possition;          //DID在结构体mixArray的位置
  char Comment_2[8][70];  //用于打印原始数据
  qword Temp_Value;
  
  swhere = _Check_StrPossion_Res(Check_Str,2);
  Possition = _Check_StrPossion_Res(Check_Str,1);
  if(swhere != -1 && Possition != -1)
  {
    char Temp_Str[100];
    char Temp_Str_[100];
    snprintf(Temp_Str,elCount(Temp_Str),"%s","");
    snprintf(Temp_Str_,elCount(Temp_Str_),"%s","");
    snprintf(Temp_Str,elCount(Temp_Str),"/---------------   %s   ---------------/",Check_Str);
    _WriteEx_and_Report("",Temp_Str);
    snprintf(Temp_Str_,elCount(Temp_Str_),"0x%02X  0x%02X",mixArray[Possition].DID_1904[0],mixArray[Possition].DID_1904[1]);
    _WriteEx_and_Report("",Temp_Str_);
    for(ii=0;ii<Group_Count;ii++)
    {
      snprintf(Comment_2[ii],elCount(Comment_2[ii]),"%s","");
      for(n=0;n<Res1904_Data[swhere].Res_DID_Data_Len;n++)
        snprintf(Comment_2[ii],elCount(Comment_2[ii]),"%s 0x%02X",Comment_2[ii],Res1904_Data[swhere].Res_DID_Data_2[ii][n]);
    }
    if(type==0)
    {
      for(ii=0;ii<Group_Count;ii++)
      {
        _WriteEx_and_Report("","第 %d 组快照",ii);
        if(strncmp(Ex_Str[ii],Res1904_Data[swhere].LocalTime_Value_2[ii],strlen(Res1904_Data[swhere].LocalTime_Value_2[ii]))==0)
        {
          testStepPass(Check_Str,"实际值与预期一致为: %s",Ex_Str[ii]);
          writeEx(-3,0,"实际值与预期一致为：%s",Ex_Str[ii]);
        }
        else
        {
          testStepFail(Check_Str,"实际值为 %s ,预期值为 %s",Res1904_Data[swhere].LocalTime_Value_2[ii],Ex_Str[ii]);
          writeEx(-3,0,"实际值为 %s ,预期值为 %s",Res1904_Data[swhere].LocalTime_Value_2[ii],Ex_Str[ii]);
        }
      }
    }
    else if(type==1)
    {
      for(ii=0;ii<Group_Count;ii++)
      {
        _WriteEx_and_Report("","第 %d 组快照",ii);
        Temp_Value = 0;
        if(mixArray[Possition].Invalid_LastValue == 0)
        {
          for(n=0;n<Res1904_Data[swhere].Res_DID_Data_Len;n++)
            Temp_Value = Temp_Value | Res1904_Data[swhere].Res_DID_Data_2[ii][n]<<(8*(Res1904_Data[swhere].Res_DID_Data_Len-n-1));
          if(Temp_Value != mixArray[Possition].Invalid)
          {
            testStepFail(Check_Str,"获取到的值与预期输入不一致,获取到的值为 0x%X ,预期值为 0x%X",Temp_Value,mixArray[Possition].Invalid);
            writeEx(-3,0,"获取到的值与预期输入不一致,获取到的值为 0x%X ,预期值为 0x%X",Temp_Value,mixArray[Possition].Invalid);
          }
          else
          {
            testStepPass(Check_Str,"获取到的值与预期输入一致");
            writeEx(-3,0,"获取到的值与预期输入一致");
          }
        }
        else  //最后一次有效值由外部输入
        {
          if(TimeInvalid_FirstTime == 1)
          {
            for(n=0;n<Res1904_Data[swhere].Res_DID_Data_Len;n++)
              Temp_Value = Temp_Value | Res1904_Data[swhere].Res_DID_Data_2[ii][n]<<(8*(Res1904_Data[swhere].Res_DID_Data_Len-n-1));
            snprintf(Res1904_Data[swhere].LocalTime_Value_2[ii],elCount(Res1904_Data[swhere].LocalTime_Value_2[ii]),"%X",Temp_Value);
          }
          
          {
            if(strncmp(Ex_Str[ii],Res1904_Data[swhere].LocalTime_Value_2[ii],strlen(Res1904_Data[swhere].LocalTime_Value_2[ii]))==0)
            {
              testStepPass(Check_Str,"实际值与预期一致");
              writeEx(-3,0,"实际值与预期一致");
            }
            else
            {
              testStepFail(Check_Str,"预期值为 %s ,实际值为 %s",Ex_Str[ii],Res1904_Data[swhere].LocalTime_Value_2[ii]);
              writeEx(-3,0,"预期值为 %s ,实际值为 %s",Ex_Str[ii],Res1904_Data[swhere].LocalTime_Value_2[ii]);
            }
          }
        }
      }
    }
    else if(type==2)
    {
      for(ii=0;ii<Group_Count;ii++)
      {
        _WriteEx_and_Report("","第 %d 组快照",ii);
        _WriteEx_and_Report(Check_Str,Comment_2[ii]);
      }
    }
  }
  else
    testStepFail(Check_Str,"未查询到对应的字符串数据");
}
_Check_1906(diagRequest* Diag,char Check_Str[],dword ExValue)
{
  int m,Possion_DTCCount,Str_Possion;
  dword ExLen,DTC_Count_Byte,Start_Byte;
  char _Ex_Data_Record_Str[200];
  char _Check_Str[200];
  ExLen =0;
  Possion_DTCCount = -1;
  DTC_Count_Byte = 0;
  Start_Byte = 0;
  Str_Possion = -1;
  snprintf(_Check_Str,elcount(_Check_Str),"");
  if(diagGetLastResponseCode(Diag) == 0)
    testWaitForDiagResponse(Diag,1000);
  if(diagGetLastResponseCode(Diag) == 0)
    testStepFail("未收到响应");
  else if(diagGetLastResponseCode(Diag) > 0)
    testStepFail("收到消极应答");
  else
  {
    for(m=0;m<ExDataRecord_Count;m++)
    {
      ExLen = ExLen + ExDataRecord[m].Ex_Data_Record_Len;
      if(ExDataRecord[m].Ex_Data_Record_Num_Flage == 1)
        ExLen = ExLen+1;
      toUpper(_Check_Str,"Fault_Occurrence_counter",elCount(_Check_Str));
      toUpper(_Ex_Data_Record_Str,ExDataRecord[m].Ex_Data_Record_Str,elCount(_Ex_Data_Record_Str));
      if(strncmp(_Ex_Data_Record_Str,_Check_Str,strlen(ExDataRecord[m].Ex_Data_Record_Str))==0)
        Possion_DTCCount = m;
    }
    if(ExDataRecord[1].Ex_Data_Record_Num_Flage == 0)
      ExLen = ExLen+1;  //无单独拓展号时+1
    ExLen = ExLen + 6;
    if(DiagGetRespPrimitiveSize(Diag) != ExLen)
      testStepFail("","返回长度与预期长度不一致,实际长度为%d ,期望为%d",DiagGetRespPrimitiveSize(Diag),ExLen);
    else
    {
      testStepPass("","返回长度与预期长度一致");
      for(m=0;m<5;m++)
      {
        if(m==0)
        {
          if((DiagGetPrimitiveByte(Diag,m)^0x40) != DiagGetRespPrimitiveByte(Diag,m))
            testStepFail("","反馈与预期不一致,预期为 0x%2x ,实测为 0x%2x",(DiagGetPrimitiveByte(Diag,m)^0x40),DiagGetRespPrimitiveByte(Diag,m));
        }
        else
        {
          if(DiagGetPrimitiveByte(Diag,m) != DiagGetRespPrimitiveByte(Diag,m))
            testStepFail("","反馈与预期不一致,预期为 0x%2x ,实测为 0x%2x",DiagGetPrimitiveByte(Diag,m),DiagGetRespPrimitiveByte(Diag,m)); 
        }
      }
      
      Str_Possion = _Check_StrPossion_Res(Check_Str,3); //获取字符串所在位置
      _Str_Upper(Check_Str);
      if(strncmp(Check_Str,"ALL",strlen(Check_Str))==0)
      {
        if(Possion_DTCCount!= -1) //19 06当检测为ALL时，仅验证故障成熟测试
        {
          if(ExDataRecord[Possion_DTCCount].Ex_Data_Record_Num_Flage==1)
          {
            for(m=0;m<Possion_DTCCount-1;m++)
              DTC_Count_Byte = DTC_Count_Byte + ExDataRecord[m].Ex_Data_Record_Len +1;
            if(Possion_DTCCount == 0)
              DTC_Count_Byte = DTC_Count_Byte+1;
            DTC_Count_Byte = DTC_Count_Byte + 6;  //此时为数据位置
          }
          else
          {
            for(m=0;m<Possion_DTCCount-1;m++)
              DTC_Count_Byte = DTC_Count_Byte + ExDataRecord[m].Ex_Data_Record_Len;
            if(Possion_DTCCount == 0)
              DTC_Count_Byte = DTC_Count_Byte+1;
            DTC_Count_Byte = DTC_Count_Byte + 6;
          }
        }
        if(0x01 != DiagGetRespPrimitiveByte(Diag,6))
          testStepFail("","反馈与预期不一致,预期为 0x%2x ,实测为 0x%2x",0x01,DiagGetRespPrimitiveByte(Diag,6)); 
        if(0x01 != DiagGetRespPrimitiveByte(Diag,DTC_Count_Byte))
          testStepFail("","反馈与预期不一致,预期为 0x%2x ,实测为 0x%2x",0x01,DiagGetRespPrimitiveByte(Diag,DTC_Count_Byte)); 
        else
          testStepPass("","故障成熟次数为1次");
      }
      else
      {
        dword Data_Rx;
        Data_Rx = 0;
        Start_Byte = 6-1; //初始位置
        for(m=0;m<Str_Possion;m++)
        {
          Start_Byte = Start_Byte + ExDataRecord[m].Ex_Data_Record_Len;
          if(ExDataRecord[m].Ex_Data_Record_Num_Flage==1)
            Start_Byte = Start_Byte +1;
        }
        // if(Str_Possion==0)
          Start_Byte = Start_Byte +1;  //拓展号所在位置
        if(ExDataRecord[Str_Possion].Ex_Data_Record_Num_Flage==1)
        {
          if(Str_Possion != 0)
            Start_Byte = Start_Byte +1;//加上扩展数据记录号1位
          if(ExDataRecord[Str_Possion].Ex_Data_Record_Num!=DiagGetRespPrimitiveByte(Diag,Start_Byte))
            testStepFail(Check_Str,"拓展数据记录号与期望不一致,预期为%d，实际为%d",ExDataRecord[Str_Possion].Ex_Data_Record_Num,DiagGetRespPrimitiveByte(Diag,Start_Byte));
          else
            testStepPass(Check_Str,"拓展数据记录号与期望一致");
        }
        Start_Byte = Start_Byte +1;  //数据所在位置
        for(m=0;m<ExDataRecord[Str_Possion].Ex_Data_Record_Len;m++)
          Data_Rx = Data_Rx + (DiagGetRespPrimitiveByte(Diag,Start_Byte+m)<<(8*(ExDataRecord[Str_Possion].Ex_Data_Record_Len-m-1)));
        if(Data_Rx!= ExValue)
          testStepFail(Check_Str,"反馈值与预期不一致,期望结果为0x%02x,实测结果为0x%02x",ExValue,Data_Rx);
        else
          testStepPass(Check_Str,"反馈值与预期一致,");
      }
    }
  }
}

dword _Get_1906_(diagRequest* Diag,char Check_Str[])
{
  int m,Possion_DTCCount,Str_Possion;
  dword ExLen,DTC_Count_Byte,Start_Byte;
  char _Ex_Data_Record_Str[200];
  char _Check_Str[200];
  dword Value;
  ExLen =0;
  Possion_DTCCount = -1;
  DTC_Count_Byte = 0;
  Start_Byte = 0;
  Str_Possion = -1;
  Value = 0;
  snprintf(_Check_Str,elcount(_Check_Str),"");
  if(diagGetLastResponseCode(Diag) == 0)
    testWaitForDiagResponse(Diag,1000);
  if(diagGetLastResponseCode(Diag) == 0)
    testStepFail("未收到响应");
  else if(diagGetLastResponseCode(Diag) > 0)
    testStepFail("收到消极应答");
  else
  {
    for(m=0;m<ExDataRecord_Count;m++)
    {
      ExLen = ExLen + ExDataRecord[m].Ex_Data_Record_Len;
      if(ExDataRecord[m].Ex_Data_Record_Num_Flage == 1)
        ExLen = ExLen+1;
      toUpper(_Check_Str,"Fault_Occurrence_counter",elCount(_Check_Str));
      toUpper(_Ex_Data_Record_Str,ExDataRecord[m].Ex_Data_Record_Str,elCount(_Ex_Data_Record_Str));
      if(strncmp(_Ex_Data_Record_Str,_Check_Str,strlen(ExDataRecord[m].Ex_Data_Record_Str))==0)
        Possion_DTCCount = m;
    }
    if(ExDataRecord[1].Ex_Data_Record_Num_Flage == 0)
      ExLen = ExLen+1;  //无单独拓展号时+1
    ExLen = ExLen + 6;
    if(DiagGetRespPrimitiveSize(Diag) != ExLen)
      testStepFail("","返回长度与预期长度不一致,实际长度为%d ,期望为%d",DiagGetRespPrimitiveSize(Diag),ExLen);
    else
    {
      testStepPass("","返回长度与预期长度一致");
      Str_Possion = _Check_StrPossion_Res(Check_Str,3); //获取字符串所在位置
      _Str_Upper(Check_Str);
      {
        dword Data_Rx;
        Data_Rx = 0;
        Start_Byte = 6-1; //初始位置
        for(m=0;m<Str_Possion;m++)
        {
          Start_Byte = Start_Byte + ExDataRecord[m].Ex_Data_Record_Len;
          if(ExDataRecord[m].Ex_Data_Record_Num_Flage==1)
            Start_Byte = Start_Byte +1;
        }
        if(Str_Possion==0)
          Start_Byte = Start_Byte +1;  //拓展号所在位置
        if(ExDataRecord[Str_Possion].Ex_Data_Record_Num_Flage==1)
        {
          if(Str_Possion != 0)
            Start_Byte = Start_Byte +1;//加上扩展数据记录号1位
        }
        Start_Byte = Start_Byte +1;  //数据所在位置
        for(m=0;m<ExDataRecord[Str_Possion].Ex_Data_Record_Len;m++)
          Data_Rx = Data_Rx + (DiagGetRespPrimitiveByte(Diag,Start_Byte+m)<<(8*(ExDataRecord[Str_Possion].Ex_Data_Record_Len-m-1)));
        Value = Data_Rx;
      }
    }
  }
  return Value;
}
_Check_1906_Time(diagRequest* Diag,char ExValue_First[],char ExValue_Last[])
{
  int m,Str_Possion,LocalTime_Possion;
  dword ExLen,Start_Byte;
  byte Data_Rx_First[10];
  byte Data_Rx_Last[10];
  char Vaule_Str_Temp[50];
  char Value_First[50];
  char Value_Last[50];
  int Possition_LocalTime[6];
  ExLen =0;
  Start_Byte = 0;
  Str_Possion = -1;
  for(m=0;m<10;m++)
  {
    Data_Rx_First[m] = 0;
    Data_Rx_Last[m] = 0;
  }
  snprintf(Vaule_Str_Temp,elCount(Vaule_Str_Temp),"%s","");
  snprintf(Value_First,elCount(Value_First),"%s","");
  snprintf(Value_Last,elCount(Value_Last),"%s","");
  if(diagGetLastResponseCode(Diag) == 0)
    testWaitForDiagResponse(Diag,1000);
  if(diagGetLastResponseCode(Diag) == 0)
    testStepFail("未收到响应");
  else if(diagGetLastResponseCode(Diag) > 0)
    testStepFail("收到消极应答");
  else
  {    
    for(m=0;m<ExDataRecord_Count;m++)
    {
      ExLen = ExLen + ExDataRecord[m].Ex_Data_Record_Len;
      if(ExDataRecord[m].Ex_Data_Record_Num_Flage == 1)
        ExLen = ExLen+1;
    }
    if(ExDataRecord[1].Ex_Data_Record_Num_Flage == 0)
      ExLen = ExLen+1;  //无单独拓展号时+1
    ExLen = ExLen + 6;
    if(DiagGetRespPrimitiveSize(Diag) != ExLen)
      testStepFail("","返回长度与预期长度不一致,实际长度为%d ,期望为%d",DiagGetRespPrimitiveSize(Diag),ExLen);
    else
    {
      testStepPass("","返回长度与预期长度一致");
      for(m=0;m<6;m++)
      {
        if(m==0)
        {
          if((DiagGetPrimitiveByte(Diag,m)^0x40) != DiagGetRespPrimitiveByte(Diag,m))
            testStepFail("","反馈与预期不一致,预期为 0x%2x ,实测为 0x%2x",(DiagGetPrimitiveByte(Diag,m)^0x40),DiagGetRespPrimitiveByte(Diag,m));
        }
        else if(m==5)
          continue;
        else
        {
          if(DiagGetPrimitiveByte(Diag,m) != DiagGetRespPrimitiveByte(Diag,m))
            testStepFail("","反馈与预期不一致,预期为 0x%2x ,实测为 0x%2x",DiagGetPrimitiveByte(Diag,m),DiagGetRespPrimitiveByte(Diag,m)); 
        }
      }
      Str_Possion = _Check_StrPossion_Res("First_Time_Fault_Occurrence_Time",3); //获取字符串所在位置
      LocalTime_Possion = _Check_StrPossion_Res("LocalTime",1); //获取字符串所在位置
      {
        Start_Byte = 6-1; //初始位置
        for(m=0;m<Str_Possion;m++)
        {
          Start_Byte = Start_Byte + ExDataRecord[m].Ex_Data_Record_Len;
          if(ExDataRecord[m].Ex_Data_Record_Num_Flage==1)
            Start_Byte = Start_Byte +1;
        }
        if(Str_Possion==0)
          Start_Byte = Start_Byte +1;  //拓展号所在位置
        if(ExDataRecord[Str_Possion].Ex_Data_Record_Num_Flage==1)
        {
          if(Str_Possion != 0)
            Start_Byte = Start_Byte +1;//加上扩展数据记录号1位
          if(ExDataRecord[Str_Possion].Ex_Data_Record_Num!=DiagGetRespPrimitiveByte(Diag,Start_Byte))
            testStepFail("First_Time_Fault_Occurrence_Time","拓展数据记录号与期望不一致,预期为%d，实际为%d",ExDataRecord[Str_Possion].Ex_Data_Record_Num,DiagGetRespPrimitiveByte(Diag,Start_Byte));
          else
            testStepPass("First_Time_Fault_Occurrence_Time","拓展数据记录号与期望一致");
        }
        Start_Byte = Start_Byte +1;  //数据所在位置
        for(m=0;m<ExDataRecord[Str_Possion].Ex_Data_Record_Len;m++)
          Data_Rx_First[m] = DiagGetRespPrimitiveByte(Diag,Start_Byte+m);
        snprintf(Value_First,elCount(Value_First),"%s","");
        if(strncmp(mixArray[LocalTime_Possion].Symbol,"BCD",strlen(mixArray[LocalTime_Possion].Symbol))==0)   //BCD格式,全原码拼接
        {
          /*判断是:年/月/日/时/分/秒       还是:秒/分/时/日/月/年*/
          /************************待完善*************************/
          Possition_LocalTime[0] = _Check_StrPossion("year",LocalTime_Possion,0);
          if(mixArray[LocalTime_Possion].LocalTime[Possition_LocalTime[0]][1]>0)
            reverseNum(Data_Rx_First,ExDataRecord[Str_Possion].Ex_Data_Record_Len);   // 秒/分/时/日/月/年 逆向
          for(m=0;m<ExDataRecord[Str_Possion].Ex_Data_Record_Len;m++)
          {
            snprintf(Vaule_Str_Temp,elCount(Vaule_Str_Temp),"%s","");
            snprintf(Vaule_Str_Temp,elcount(Vaule_Str_Temp),"%s%x",Vaule_Str_Temp,Data_Rx_First[m]);
            if(strlen(Vaule_Str_Temp)<2)
              snprintf(Vaule_Str_Temp,elCount(Vaule_Str_Temp),"%c%s",'0',Vaule_Str_Temp);
            snprintf(Value_First,elCount(Value_First),"%s%s",Value_First,Vaule_Str_Temp);
          }  //拼接排序
        }
        else
        {
          qword Temp_Time;
          dword swhere_temp;
          Temp_Time = 0;
          swhere_temp = 0;
          Possition_LocalTime[0] = _Check_StrPossion("year",LocalTime_Possion,0);
          Possition_LocalTime[1] = _Check_StrPossion("month",LocalTime_Possion,0);
          Possition_LocalTime[2] = _Check_StrPossion("day",LocalTime_Possion,0);
          Possition_LocalTime[3] = _Check_StrPossion("hour",LocalTime_Possion,0);
          Possition_LocalTime[4] = _Check_StrPossion("minute",LocalTime_Possion,0);
          Possition_LocalTime[5] = _Check_StrPossion("second",LocalTime_Possion,0);
          for(m=0;m<ExDataRecord[Str_Possion].Ex_Data_Record_Len;m++)
          {
            snprintf(Vaule_Str_Temp,elCount(Vaule_Str_Temp),"%s","");
            if(Possition_LocalTime[m] == -1)    //仅包含部分时间,不是完整的 年月日时分秒,舍弃未查询到的字符
            {
              //snprintf(Vaule_Str_Temp,elCount(Vaule_Str_Temp),"%c%s",'00',Vaule_Str_Temp);
            }
            else
            {
              swhere_temp = mixArray[LocalTime_Possion].LocalTime[Possition_LocalTime[m]][1];    //预期所在位置
              Temp_Time = Data_Rx_First[swhere_temp] + mixArray[LocalTime_Possion].LocalTime[Possition_LocalTime[m]][2]; //计算后的值
              snprintf(Vaule_Str_Temp,elcount(Vaule_Str_Temp),"%s%d",Vaule_Str_Temp,Temp_Time);
              if(strlen(Vaule_Str_Temp)<2)
                snprintf(Vaule_Str_Temp,elCount(Vaule_Str_Temp),"%c%s",'0',Vaule_Str_Temp);
            }
            snprintf(Value_First,elCount(Value_First),"%s%s",Value_First,Vaule_Str_Temp);
          }
        }
      }
      {
        Str_Possion = _Check_StrPossion_Res("Latest_Time_Fault_Occurrence_Time",3); //获取字符串所在位置
        Start_Byte = 6-1; //初始位置
        for(m=0;m<Str_Possion;m++)
        {
          Start_Byte = Start_Byte + ExDataRecord[m].Ex_Data_Record_Len;
          if(ExDataRecord[m].Ex_Data_Record_Num_Flage==1)
            Start_Byte = Start_Byte +1;
        }
        if(Str_Possion==0)
          Start_Byte = Start_Byte +1;  //拓展号所在位置
        if(ExDataRecord[Str_Possion].Ex_Data_Record_Num_Flage==1)
        {
          if(Str_Possion != 0)
            Start_Byte = Start_Byte +1;//加上扩展数据记录号1位
          if(ExDataRecord[Str_Possion].Ex_Data_Record_Num!=DiagGetRespPrimitiveByte(Diag,Start_Byte))
            testStepFail("Latest_Time_Fault_Occurrence_Time","拓展数据记录号与期望不一致,预期为%d，实际为%d",ExDataRecord[Str_Possion].Ex_Data_Record_Num,DiagGetRespPrimitiveByte(Diag,Start_Byte));
          else
            testStepPass("Latest_Time_Fault_Occurrence_Time","拓展数据记录号与期望一致");
        }
        Start_Byte = Start_Byte +1;  //数据所在位置
        for(m=0;m<ExDataRecord[Str_Possion].Ex_Data_Record_Len;m++)
          Data_Rx_Last[m] = DiagGetRespPrimitiveByte(Diag,Start_Byte+m);
        snprintf(Value_Last,elCount(Value_Last),"%s","");
        if(strncmp(mixArray[LocalTime_Possion].Symbol,"BCD",strlen(mixArray[LocalTime_Possion].Symbol))==0)   //BCD格式,全原码拼接
        {
          /*判断是:年/月/日/时/分/秒       还是:秒/分/时/日/月/年*/
          /************************待完善*************************/
          Possition_LocalTime[0] = _Check_StrPossion("year",LocalTime_Possion,0);
          if(mixArray[LocalTime_Possion].LocalTime[Possition_LocalTime[0]][1]>0)
            reverseNum(Data_Rx_First,ExDataRecord[Str_Possion].Ex_Data_Record_Len);   // 秒/分/时/日/月/年 逆向
          for(m=0;m<ExDataRecord[Str_Possion].Ex_Data_Record_Len;m++)
          {
            snprintf(Vaule_Str_Temp,elCount(Vaule_Str_Temp),"%s","");
            snprintf(Vaule_Str_Temp,elcount(Vaule_Str_Temp),"%s%x",Vaule_Str_Temp,Data_Rx_Last[m]);
            if(strlen(Vaule_Str_Temp)<2)
              snprintf(Vaule_Str_Temp,elCount(Vaule_Str_Temp),"%c%s",'0',Vaule_Str_Temp);
            snprintf(Value_Last,elCount(Value_Last),"%s%s",Value_Last,Vaule_Str_Temp);
          }  //拼接排序
        }
        else
        {               
          qword Temp_Time;
          dword swhere_temp;
          Temp_Time = 0;
          swhere_temp = 0;
          Possition_LocalTime[0] = _Check_StrPossion("year",LocalTime_Possion,0);
          Possition_LocalTime[1] = _Check_StrPossion("month",LocalTime_Possion,0);
          Possition_LocalTime[2] = _Check_StrPossion("day",LocalTime_Possion,0);
          Possition_LocalTime[3] = _Check_StrPossion("hour",LocalTime_Possion,0);
          Possition_LocalTime[4] = _Check_StrPossion("minute",LocalTime_Possion,0);
          Possition_LocalTime[5] = _Check_StrPossion("second",LocalTime_Possion,0);
          for(m=0;m<ExDataRecord[Str_Possion].Ex_Data_Record_Len;m++)
          {
            snprintf(Vaule_Str_Temp,elCount(Vaule_Str_Temp),"%s","");
            if(Possition_LocalTime[m] == -1)    //仅包含部分时间,不是完整的 年月日时分秒,舍弃未查询到的字符
            {
              //snprintf(Vaule_Str_Temp,elCount(Vaule_Str_Temp),"%c%s",'00',Vaule_Str_Temp);
            }
            else
            {
              swhere_temp = mixArray[LocalTime_Possion].LocalTime[Possition_LocalTime[m]][1];    //预期所在位置
              Temp_Time = Data_Rx_Last[swhere_temp] + mixArray[LocalTime_Possion].LocalTime[Possition_LocalTime[m]][2]; //计算后的值
              snprintf(Vaule_Str_Temp,elcount(Vaule_Str_Temp),"%s%d",Vaule_Str_Temp,Temp_Time);
              if(strlen(Vaule_Str_Temp)<2)
                snprintf(Vaule_Str_Temp,elCount(Vaule_Str_Temp),"%c%s",'0',Vaule_Str_Temp);
            }
            snprintf(Value_Last,elCount(Value_Last),"%s%s",Value_Last,Vaule_Str_Temp);
          }
        }
      }
      if(strncmp(Value_First,ExValue_First,strlen(Value_First))==0)
        testStepPass("First_Time_Fault_Occurrence_Time","第一次发生故障时间与期望一致,为 %s",Value_First);
      else
        testStepFail("First_Time_Fault_Occurrence_Time","第一次发生故障时间与期望不一致,期望为: %s  ,实际为: %s",ExValue_First,Value_First);
      if(strncmp(Value_Last,ExValue_Last,strlen(Value_Last))==0)
        testStepPass("Latest_Time_Fault_Occurrence_Time","最近一次发生故障时间与期望一致,为 %s",Value_Last);
      else
        testStepFail("Latest_Time_Fault_Occurrence_Time","最近一次发生故障时间与期望不一致,期望为: %s  ,实际为: %s",ExValue_Last,Value_Last);
    }
  }
}

_Check_1906_Time_Geely(diagRequest* Diag,char ExValue_First[],char ExValue_Last[])
{
  int m,Str_Possion,LocalTime_Possion;
  dword ExLen,Start_Byte;
  byte Data_Rx_First[10];
  byte Data_Rx_Last[10];
  char Vaule_Str_Temp[50];
  char Value_First[50];
  char Value_Last[50];
  int Possition_LocalTime[6];
  byte Data_Rs[8] = {1,2,3,4,6,0x10,0x11,0x12};
  int Count;
  ExLen =0;
  Start_Byte = 0;
  Str_Possion = -1;
  for(m=0;m<10;m++)
  {
    Data_Rx_First[m] = 0;
    Data_Rx_Last[m] = 0;
  }
  snprintf(Vaule_Str_Temp,elCount(Vaule_Str_Temp),"%s","");
  snprintf(Value_First,elCount(Value_First),"%s","");
  snprintf(Value_Last,elCount(Value_Last),"%s","");
  if(diagGetLastResponseCode(Diag) == 0)
    testWaitForDiagResponse(Diag,1000);
  if(diagGetLastResponseCode(Diag) == 0)
    testStepFail("未收到响应");
  else if(diagGetLastResponseCode(Diag) > 0)
    testStepFail("收到消极应答");
  else
  {    
    for(m=0;m<ExDataRecord_Count;m++)
    {
      ExLen = ExLen + ExDataRecord[m].Ex_Data_Record_Len;
      if(ExDataRecord[m].Ex_Data_Record_Num_Flage == 1)
        ExLen = ExLen+1;
    }
    if(ExDataRecord[1].Ex_Data_Record_Num_Flage == 0)
      ExLen = ExLen+1;  //无单独拓展号时+1
    ExLen = 0x26;
    if(DiagGetRespPrimitiveSize(Diag) != ExLen)
      testStepFail("","返回长度与预期长度不一致,实际长度为%d ,期望为%d",DiagGetRespPrimitiveSize(Diag),ExLen);
    else
    {
      testStepPass("","返回长度与预期长度一致");
      for(m=0;m<6;m++)
      {
        if(m==0)
        {
          if((DiagGetPrimitiveByte(Diag,m)^0x40) != DiagGetRespPrimitiveByte(Diag,m))
            testStepFail("","反馈与预期不一致,预期为 0x%2x ,实测为 0x%2x",(DiagGetPrimitiveByte(Diag,m)^0x40),DiagGetRespPrimitiveByte(Diag,m));
        }
        else if(m==5)
          continue;
        else
        {
          if(DiagGetPrimitiveByte(Diag,m) != DiagGetRespPrimitiveByte(Diag,m))
            testStepFail("","反馈与预期不一致,预期为 0x%2x ,实测为 0x%2x",DiagGetPrimitiveByte(Diag,m),DiagGetRespPrimitiveByte(Diag,m)); 
        }
      }
      Count = 0;
      for(m=6;m<22;m=m+2)
      {
        if(DiagGetRespPrimitiveByte(Diag,m) != Data_Rs[m-6-Count])
          testStepFail("","反馈与预期不一致,预期为 0x%2x ,实测为 0x%2x",Data_Rs[m-6],DiagGetRespPrimitiveByte(Diag,m)); 
        Count++;
      }
      Str_Possion = _Check_StrPossion_Res("First_Time_Fault_Occurrence_Time",3); //获取字符串所在位置
      LocalTime_Possion = _Check_StrPossion_Res("LocalTime",1); //获取字符串所在位置
      {
        if(DiagGetRespPrimitiveByte(Diag,22) != 0x22)
          testStepFail("First_Time_Fault_Occurrence_Time","拓展数据记录号与期望不一致,预期为%d，实际为%d",0x22,DiagGetRespPrimitiveByte(Diag,22));
        Start_Byte = 22 +1;  //数据所在位置
        for(m=0;m<ExDataRecord[Str_Possion].Ex_Data_Record_Len;m++)
          Data_Rx_First[m] = DiagGetRespPrimitiveByte(Diag,Start_Byte+m);
        snprintf(Value_First,elCount(Value_First),"%s","");
        if(strncmp(mixArray[LocalTime_Possion].Symbol,"BCD",strlen(mixArray[LocalTime_Possion].Symbol))==0)   //BCD格式,全原码拼接
        {
          /*判断是:年/月/日/时/分/秒       还是:秒/分/时/日/月/年*/
          /************************待完善*************************/
          Possition_LocalTime[0] = _Check_StrPossion("year",LocalTime_Possion,0);
          if(mixArray[LocalTime_Possion].LocalTime[Possition_LocalTime[0]][1]>0)
            reverseNum(Data_Rx_First,ExDataRecord[Str_Possion].Ex_Data_Record_Len);   // 秒/分/时/日/月/年 逆向
          for(m=0;m<ExDataRecord[Str_Possion].Ex_Data_Record_Len;m++)
          {
            snprintf(Vaule_Str_Temp,elCount(Vaule_Str_Temp),"%s","");
            snprintf(Vaule_Str_Temp,elcount(Vaule_Str_Temp),"%s%x",Vaule_Str_Temp,Data_Rx_First[m]);
            if(strlen(Vaule_Str_Temp)<2)
              snprintf(Vaule_Str_Temp,elCount(Vaule_Str_Temp),"%c%s",'0',Vaule_Str_Temp);
            snprintf(Value_First,elCount(Value_First),"%s%s",Value_First,Vaule_Str_Temp);
          }  //拼接排序
        }
        else
        {
          qword Temp_Time;
          dword swhere_temp;
          Temp_Time = 0;
          swhere_temp = 0;
          Possition_LocalTime[0] = _Check_StrPossion("year",LocalTime_Possion,0);
          Possition_LocalTime[1] = _Check_StrPossion("month",LocalTime_Possion,0);
          Possition_LocalTime[2] = _Check_StrPossion("day",LocalTime_Possion,0);
          Possition_LocalTime[3] = _Check_StrPossion("hour",LocalTime_Possion,0);
          Possition_LocalTime[4] = _Check_StrPossion("minute",LocalTime_Possion,0);
          Possition_LocalTime[5] = _Check_StrPossion("second",LocalTime_Possion,0);
          for(m=0;m<ExDataRecord[Str_Possion].Ex_Data_Record_Len;m++)
          {
            snprintf(Vaule_Str_Temp,elCount(Vaule_Str_Temp),"%s","");
            if(Possition_LocalTime[m] == -1)    //仅包含部分时间,不是完整的 年月日时分秒,舍弃未查询到的字符
            {
              //snprintf(Vaule_Str_Temp,elCount(Vaule_Str_Temp),"%c%s",'00',Vaule_Str_Temp);
            }
            else
            {
              swhere_temp = mixArray[LocalTime_Possion].LocalTime[Possition_LocalTime[m]][1];    //预期所在位置
              Temp_Time = Data_Rx_First[swhere_temp] + mixArray[LocalTime_Possion].LocalTime[Possition_LocalTime[m]][2]; //计算后的值
              snprintf(Vaule_Str_Temp,elcount(Vaule_Str_Temp),"%s%d",Vaule_Str_Temp,Temp_Time);
              if(strlen(Vaule_Str_Temp)<2)
                snprintf(Vaule_Str_Temp,elCount(Vaule_Str_Temp),"%c%s",'0',Vaule_Str_Temp);
            }
            snprintf(Value_First,elCount(Value_First),"%s%s",Value_First,Vaule_Str_Temp);
          }
        }
      }
      {
        Str_Possion = _Check_StrPossion_Res("Latest_Time_Fault_Occurrence_Time",3); //获取字符串所在位置
        if(DiagGetRespPrimitiveByte(Diag,29) != 0x23)
          testStepFail("Latest_Time_Fault_Occurrence_Time","拓展数据记录号与期望不一致,预期为%d，实际为%d",0x23,DiagGetRespPrimitiveByte(Diag,29));
        Start_Byte = 23 + 6 +1;  //数据所在位置
        for(m=0;m<ExDataRecord[Str_Possion].Ex_Data_Record_Len;m++)
          Data_Rx_Last[m] = DiagGetRespPrimitiveByte(Diag,Start_Byte+m);
        snprintf(Value_Last,elCount(Value_Last),"%s","");
        if(strncmp(mixArray[LocalTime_Possion].Symbol,"BCD",strlen(mixArray[LocalTime_Possion].Symbol))==0)   //BCD格式,全原码拼接
        {
          /*判断是:年/月/日/时/分/秒       还是:秒/分/时/日/月/年*/
          /************************待完善*************************/
          Possition_LocalTime[0] = _Check_StrPossion("year",LocalTime_Possion,0);
          if(mixArray[LocalTime_Possion].LocalTime[Possition_LocalTime[0]][1]>0)
            reverseNum(Data_Rx_First,ExDataRecord[Str_Possion].Ex_Data_Record_Len);   // 秒/分/时/日/月/年 逆向
          for(m=0;m<ExDataRecord[Str_Possion].Ex_Data_Record_Len;m++)
          {
            snprintf(Vaule_Str_Temp,elCount(Vaule_Str_Temp),"%s","");
            snprintf(Vaule_Str_Temp,elcount(Vaule_Str_Temp),"%s%x",Vaule_Str_Temp,Data_Rx_Last[m]);
            if(strlen(Vaule_Str_Temp)<2)
              snprintf(Vaule_Str_Temp,elCount(Vaule_Str_Temp),"%c%s",'0',Vaule_Str_Temp);
            snprintf(Value_Last,elCount(Value_Last),"%s%s",Value_Last,Vaule_Str_Temp);
          }  //拼接排序
        }
        else
        {               
          qword Temp_Time;
          dword swhere_temp;
          Temp_Time = 0;
          swhere_temp = 0;
          Possition_LocalTime[0] = _Check_StrPossion("year",LocalTime_Possion,0);
          Possition_LocalTime[1] = _Check_StrPossion("month",LocalTime_Possion,0);
          Possition_LocalTime[2] = _Check_StrPossion("day",LocalTime_Possion,0);
          Possition_LocalTime[3] = _Check_StrPossion("hour",LocalTime_Possion,0);
          Possition_LocalTime[4] = _Check_StrPossion("minute",LocalTime_Possion,0);
          Possition_LocalTime[5] = _Check_StrPossion("second",LocalTime_Possion,0);
          for(m=0;m<ExDataRecord[Str_Possion].Ex_Data_Record_Len;m++)
          {
            snprintf(Vaule_Str_Temp,elCount(Vaule_Str_Temp),"%s","");
            if(Possition_LocalTime[m] == -1)    //仅包含部分时间,不是完整的 年月日时分秒,舍弃未查询到的字符
            {
              //snprintf(Vaule_Str_Temp,elCount(Vaule_Str_Temp),"%c%s",'00',Vaule_Str_Temp);
            }
            else
            {
              swhere_temp = mixArray[LocalTime_Possion].LocalTime[Possition_LocalTime[m]][1];    //预期所在位置
              Temp_Time = Data_Rx_Last[swhere_temp] + mixArray[LocalTime_Possion].LocalTime[Possition_LocalTime[m]][2]; //计算后的值
              snprintf(Vaule_Str_Temp,elcount(Vaule_Str_Temp),"%s%d",Vaule_Str_Temp,Temp_Time);
              if(strlen(Vaule_Str_Temp)<2)
                snprintf(Vaule_Str_Temp,elCount(Vaule_Str_Temp),"%c%s",'0',Vaule_Str_Temp);
            }
            snprintf(Value_Last,elCount(Value_Last),"%s%s",Value_Last,Vaule_Str_Temp);
          }
        }
      }
      if(strncmp(Value_First,ExValue_First,strlen(Value_First))==0)
        testStepPass("First_Time_Fault_Occurrence_Time","第一次发生故障时间与期望一致,为 %s",Value_First);
      else
        testStepFail("First_Time_Fault_Occurrence_Time","第一次发生故障时间与期望不一致,期望为: %s  ,实际为: %s",ExValue_First,Value_First);
      if(strncmp(Value_Last,ExValue_Last,strlen(Value_Last))==0)
        testStepPass("Latest_Time_Fault_Occurrence_Time","最近一次发生故障时间与期望一致,为 %s",Value_Last);
      else
        testStepFail("Latest_Time_Fault_Occurrence_Time","最近一次发生故障时间与期望不一致,期望为: %s  ,实际为: %s",ExValue_Last,Value_Last);
    }
  }
}

_Check_1903(diagRequest* Diag)
{
  dword DTC_Res[200][2];
  int Count_Res,i,Falge;
  if(diagGetLastResponseCode(Diag) == 0)
    testWaitForDiagResponse(Diag,1000);
  if(diagGetLastResponseCode(Diag) != -1)
    testStepFail("","未收到正响应");
  else
  {
    Falge = 0;
    Count_Res = (DiagGetRespPrimitiveSize(Diag)-2)/4;
    for(i=0;i<Count_Res;i++)
    {
      DTC_Res[i][0] = (diagGetRespPrimitiveByte(Diag,i*4+2+0)<<16) + (diagGetRespPrimitiveByte(Diag,i*4+2+1)<<8)+ (diagGetRespPrimitiveByte(Diag,i*4+2+2));
      DTC_Res[i][1] = diagGetRespPrimitiveByte(Diag,i*4+2+3);
    }
    for(i =0;i<Count_Res;i++)
    {
      if((DTC_Res[i][1]!= 0x20 && DTC_Res[i][1] != 0x21) )
      {
        Falge = 1;
        testStepFail("","DTC:0x%06X的快照ID与期望不符,实际结果为:0x%02X",DTC_Res[i][0],DTC_Res[i][1]);
      }
    }
    if(Falge == 0)
      testStepPass("","所有快照ID均与预期一致");
  }
}
//根据测试通过条件，在报告上标记结果，功能寻址不响应NRC11、12、13、31、7E、7F
int _TestResult(diagRequest* obj,dword  msgID,char stepid[],int passcondition)
{
  char comment[50];
  int Return_Va;
  Return_Va = 1;
  if((Res_NRC78 == 1) && (passcondition == 0)) /*收到NRC78且上一次预期为抑制肯定响应且预期结果为不响应情况下，修改预期响应为正响应  && ((DiagGetPrimitiveByte(obj,1)&0x80) != 0)*/
  {
    _WriteEx_and_Report("","由于收到NRC78，故下一次响应为正响应");
    passcondition = -1;
  }
  Res_NRC78 = 0;
  if(passcondition==-1)
    snprintf(comment,elCount(comment),"期望收到肯定响应");
  else if(passcondition==0)
    snprintf(comment,elCount(comment),"期望不响应");
  else
  {
    if(msgID==funreq_ID&&(passcondition==0X11||passcondition==0X12||(passcondition==0X13 && Fun_NRC13==0)||passcondition==0X31||passcondition==0X7E||passcondition==0X7F))
      snprintf(comment,elCount(comment),"期望不响应");
    else
      snprintf(comment,elCount(comment),"期望收到否定响应NRC%02X",passcondition);
  }
  if(diagGetLastResponseCode(obj)==-1)
  {
    byte Serve_Send,LenRx;
    Serve_Send = DiagGetPrimitiveByte(obj,0);
    LenRx = diagGetRespPrimitiveSize(obj);
    if(Serve_Send == 0x14 && LenRx != 1)
      testStepFail("","%02X服务响应长度异常,期望为 1，实际长度为 %d",Serve_Send,LenRx);
    else if((Serve_Send == 0x85 || Serve_Send == 0x11 || Serve_Send == 0x28 || Serve_Send == 0x3E) && LenRx != 2)
      testStepFail("","%02X服务响应长度异常,期望为 2，实际长度为 %d",Serve_Send,LenRx);
    else if((Serve_Send == 0x2E) && LenRx != 3)
      testStepFail("","%02X服务响应长度异常,期望为 3，实际长度为 %d",Serve_Send,LenRx);
    else if((Serve_Send == 0x27 && DiagGetPrimitiveByte(obj,1) == RequestSeed_27) && LenRx != SendKey_Len)
      testStepFail("","%02X服务响应长度异常,期望为 %d，实际长度为 %d",Serve_Send,SendKey_Len,LenRx);
    if(passcondition==-1)
      testStepPass(stepid,"%s，实际收到肯定响应",comment);
    else
    {
      Return_Va = -1;
      testStepFail(stepid,"%s，实际收到肯定响应",comment);
    }
  }
  else if(diagGetLastResponseCode(obj)==0)
  { 
    if((passcondition==0)||(msgID==funreq_ID&&(passcondition==0X11||passcondition==0X12||(passcondition==0X13 && Fun_NRC13==0)||passcondition==0X31||passcondition==0X7E||passcondition==0X7F)))
    {
      Return_Va = 1;
      testStepPass(stepid,"%s，实际未收到响应",comment);
      return Return_Va;
    }  
    if(passcondition==-1)
    { 
      if(DiagGetPrimitiveByte(obj,2) == 0x19 && DiagGetPrimitiveByte(obj,1) == 0x0A)
      {
        if(diagGetLastResponseCode(obj)==0 || diagGetLastResponseCode(obj)==0x78)
          testWaitForDiagResponse(obj,2000);
      }
      else
      {
        if(diagGetLastResponseCode(obj)==0)
          testWaitForDiagResponse(obj,200); //等待多帧响应完毕
      }

      if(diagGetLastResponseCode(obj)==0)
      {
        Return_Va = -1;
        testStepFail(stepid,"%s，实际未收到响应",comment);
      }
      else if(diagGetLastResponseCode(obj)==-1)
      {
        int Res_Len;
        Return_Va = 1;
        Res_Len = diagGetRespPrimitiveSize(obj);
        if((Response_CanFD == 0 && Res_Len<=7) || (Response_CanFD == 1 && Res_Len<=62))
          testStepfail(stepid,"%s，单帧响应超时",comment);
        testStepPass(stepid,"%s，实际收到肯定响应",comment);
      }
      else
      {
        if(diagGetLastResponseCode(obj)==0x78)
        {
          testStepFail(stepid,"0x%02X服务NRC78响应超时",DiagGetRespPrimitiveByte(obj,1));
          testWaitForDiagResponse(obj,p2cmax*100); //等待NRC78后续
          if(diagGetLastResponseCode(obj)==-1)
            testStepPass(stepid,"%s，实际收到肯定响应",comment);
          else
          {
            Return_Va = -1;
            testStepFail(stepid,"%s，实际收到否定响应",comment);
          }
        }
        else
        {
          Return_Va = -1;
          testStepFail(stepid,"%s，实际收到否定响应",comment);
        }
      }
    }
    else
    {
      Return_Va = -1;
      testStepFail(stepid,"%s，实际未收到响应",comment);
    }
  }
  else if(diagGetLastResponseCode(obj)==0X10)
  {
    if((passcondition==0X10)&&(msgID==phyreq_ID))
      testStepPass(stepid,"%s，实际收到否定响应NRC10",comment);
    else
    {
      Return_Va = -1;
      testStepFail(stepid,"%s，实际收到否定响应NRC10",comment);
    }
  }
  else if(diagGetLastResponseCode(obj)==0X11)
  {
    if((passcondition==0X11)&&(msgID==phyreq_ID))
      testStepPass(stepid,"%s，实际收到否定响应NRC11",comment);
    else
    {
      Return_Va = -1;
      testStepFail(stepid,"%s，实际收到否定响应NRC11",comment);
    }
  }
  else if(diagGetLastResponseCode(obj)==0X12)
  {
    if((passcondition==0X12)&&(msgID==phyreq_ID))
      testStepPass(stepid,"%s，实际收到否定响应NRC12",comment);
    else
    {
      Return_Va = -1;
      testStepFail(stepid,"%s，实际收到否定响应NRC12",comment);
    }
  }
  else if(diagGetLastResponseCode(obj)==0X13)
  {
    if((passcondition==0X13)&&(msgID==phyreq_ID))
      testStepPass(stepid,"%s，实际收到否定响应NRC13",comment);
    else if((passcondition==0X13)&&(msgID==funreq_ID && Fun_NRC13==1))
      testStepPass(stepid,"%s，实际收到否定响应NRC13",comment);
    else
    {
      Return_Va = -1;
      testStepFail(stepid,"%s，实际收到否定响应NRC13",comment);
    }
  }
  else if(diagGetLastResponseCode(obj)==0X22)
  {
    if(passcondition==0X22)
      testStepPass(stepid,"%s，实际收到否定响应NRC22",comment);
    else
    {
      Return_Va = -1;
      testStepFail(stepid,"%s，实际收到否定响应NRC22",comment);
    }
  }
  else if(diagGetLastResponseCode(obj)==0X24)
  {
    if(passcondition==0X24)
      testStepPass(stepid,"%s，实际收到否定响应NRC24",comment);
    else
    {
      Return_Va = -1;
      testStepFail(stepid,"%s，实际收到否定响应NRC24",comment);
    }
  }
  else if(diagGetLastResponseCode(obj)==0X31)
  {
    if((passcondition==0X31)&&(msgID==phyreq_ID))
      testStepPass(stepid,"%s，实际收到否定响应NRC31",comment);
    else
      testStepFail(stepid,"%s，实际收到否定响应NRC31",comment);
  }
  else if(diagGetLastResponseCode(obj)==0X33)
  {
    if(passcondition==0X33)
      testStepPass(stepid,"%s，实际收到否定响应NRC33",comment);
    else
    {
      Return_Va = -1;
      testStepFail(stepid,"%s，实际收到否定响应NRC33",comment);
    }
  }
  else if(diagGetLastResponseCode(obj)==0X7E)
  {
    if((passcondition==0X7E)&&(msgID==phyreq_ID))
      testStepPass(stepid,"%s，实际收到否定响应NRC7E",comment);
    else
    {
      Return_Va = -1;
      testStepFail(stepid,"%s，实际收到否定响应NRC7E",comment);
    }
  }
  else if(diagGetLastResponseCode(obj)==0X7F)
  {
    if((passcondition==0X7F)&&(msgID==phyreq_ID))
      testStepPass(stepid,"%s，实际收到否定响应NRC7F",comment);
    else
    {
      Return_Va = -1;
      testStepFail(stepid,"%s，实际收到否定响应NRC7F",comment);
    }
  }
  else if(diagGetLastResponseCode(obj)==0X78)
  {
    if((passcondition==0X78))
      testStepPass(stepid,"%s，实际收到否定响应NRC78",comment);
    else
    {
      Return_Va = -1;
      testStepFail(stepid,"%s，实际收到否定响应NRC78",comment);
    }
  }
  else if(diagGetLastResponseCode(obj)==0X35)
  {
    if((passcondition==0X35))
      testStepPass(stepid,"%s，实际收到否定响应NRC35",comment);
    else
    {
      Return_Va = -1;
      testStepFail(stepid,"%s，实际收到否定响应NRC35",comment);
    }
  }
  else if(diagGetLastResponseCode(obj)==0X36)
  {
    if((passcondition==0X36))
      testStepPass(stepid,"%s，实际收到否定响应NRC36",comment);
    else
    {
      Return_Va = -1;
      testStepFail(stepid,"%s，实际收到否定响应NRC36",comment);
    }
  }
  else if(diagGetLastResponseCode(obj)==0X37)
  {
    if((passcondition==0X37))
      testStepPass(stepid,"%s，实际收到否定响应NRC37",comment);
    else
    {
      Return_Va = -1;
      testStepFail(stepid,"%s，实际收到否定响应NRC37",comment);
    }
  }
  else if(diagGetLastResponseCode(obj)== passcondition)
    testStepPass(stepid,"%s，实际收到否定响应NRC%02X",comment,diagGetLastResponseCode(obj));
  else
  {
    Return_Va = -1;
    testStepFail(stepid,"%s，实际收到否定响应NRC%02X",comment,diagGetLastResponseCode(obj));
  }
  return Return_Va;
}

_Clear_BYD_Config_(byte type) /*type==0: 全0x00    type==1:全0xFF*/
{
  int m;
  byte size;
  qword checksum_config;
  diagRequest *BYD_Config_;
  byte config_1[3] = {0x2E,0xF1,0xA1};
  checksum_config = 0;
  size = 0x0B;
  _unlockECU();
  Get_Seed_Flage = 1;
  diagResize(BYD_Config_,size);
  for(m=0;m<3;m++)
    DiagSetPrimitiveByte(BYD_Config_,m,config_1[m]);
  if(type==0)
  {
    for(m=3;m<size-1;m++)
      DiagSetPrimitiveByte(BYD_Config_,m,0x00);
    DiagSetPrimitiveByte(BYD_Config_,m,0x55);
  }
  else
  {
    for(m=3;m<size;m++)
      DiagSetPrimitiveByte(BYD_Config_,m,0xff);
  }
  _SendAndWriteReport(BYD_Config_,phyreq_ID);
  _TestResult(BYD_Config_,phyreq_ID,"",-1);
}
void Init_For_14() //用于每次测试14服务时第一个Byte不一致
{
  int k,j,m;
  byte Temp_byte;
  Serve_14_31[0] = (ALL_DTC[0]>>16)&0xFF;
  m = 1;
  for(k=1;k<ALL_DTC_Num;k++)
  {
    Temp_byte = (ALL_DTC[k]>>16)&0xFF;
    for(j=0;j<m;j++)
    {
      if(Temp_byte == Serve_14_31[j])
        break;;
    }
    if(j == m)
    {
      Serve_14_31[m] = Temp_byte;
      m++;
    }
    if(m==4)
      break;
  }
  for(k=1;k<4;k++)
  {
    if(Serve_14_31[k]==0)
      Serve_14_31[k] = Serve_14_31[0];
  }
}

_Other_1002()
{
  if(Other_1002 == 1)
  {
    if(Pre_Programmed_1002 == 1 )
      _Pre_Programmed();
    if((Pre_Programmed_1002 == 0 && Unlock_1002 == 1) || (Pre_Programmed_1002 == 1 && Pre_Programmed_UnlockECU == 0 && Unlock_1002 == 1) )
      _unlockECU();
    if(Pre_Programmed_1002 == 0 && Unlock_1002 == 0 && Session_BIN == 0x01)
    {
      _SetSession(exsession);
      Session_BIN = 0x04;
    }
  }
  else if(Other_1002 == 0)
  {
    _WriteEx_and_Report("","无其余条件，即10 02可直接响应");
    if(Session_BIN == 0x01)
    {
      Session_BIN = 0x04;
    }
  }
}

_Pre_Programmed()
{
  dword Fun;
  int Pro_Pos;
  if(Pre_Programmed_UnlockECU==1)
    _unlockECU();
  _WriteEx_and_Report("","发送预编程报文");
  _get_Arry("Pre_Programmed");
  Fun = ((Arry_Data[2]<<8) | Arry_Data[3]);
  if(Pre_Programmed_UnlockECU == 0)
  {
    Pro_Pos = _Check_Serve(0x01,Fun,12);
    if(Pro_Pos != -1)
    {
      if((Serve_31_Hex[Pro_Pos].Serve_Session[0] & 0x1)==0)
      {
        if(Session_BIN == 1)
          _SetSession(exsession);
      }
    }
  }
  if(Arry_Len == 0)
    _WriteEx_and_Report("","未查询到对应预编程报文");
  else
  {
    _Send_Diag(Arry_Len,phyreq_ID,Arry_Data);
    _TestResult(SendData,phyreq_ID,"",-1);
  }
}

/// <Node>
_Set_Sig(char Sig[],float Vaule)
{
  char _str[120];
  char DBCName[300];
  char SigBefor[20] = "EV_ ";
  char ChangeStr[2];
  char buffer_ascii[500];
  char SearchStr[100] ;
  int SearchPos;
  int SigType;
  float Now_Value1,Now_Value2,Time0;
  
  snprintf(_str,elCount(_str),"%s","");
  snprintf(_str,elCount(_str),"EV_%s",Sig);
  snprintf(DBCName,elCount(DBCName),".\\CANDBC\\%s",DBC_Name);
  GlbHandlefile = OpenFileRead (DBCName,0);
  if(GlbHandlefile != 0)
  {
    snprintf(SearchStr,elCount(SearchStr),"%s%s:",SigBefor,_str);
    while(fileGetStringSZ(buffer_ascii,elcount(buffer_ascii),GlbHandlefile)!=0)  
    {
      if(strstr(buffer_ascii,SearchStr)!=-1)
      {
        SearchPos = strlen(SearchStr) + 2-1; //查询信号在DBC中获取到的位置
        snprintf(ChangeStr,elCount(ChangeStr),"%c",buffer_ascii[SearchPos]);
        SigType = atol(ChangeStr);
        break;
      }
    }
  }
  fileClose(GlbHandlefile);
  Now_Value1 = getSignal(Sig); Time0 = 0;
  setSignal(Sig,Vaule);                         /*信号赋值*/
  if(SigType == 0) //整形数据
  {
    putValue(Sig,(int64)Vaule);                          /*非系统变量赋值*/
    putValue(_str,(int64)Vaule);                         /*非系统变量赋值*/
    writeEx(-3,0,"设置信号 %s 值为 %.0f",Sig,Vaule);
    testStep("","设置信号 %s 值为 %.0f",Sig,Vaule);
  }
  else
  {
    putValue(Sig,(float)Vaule);                          /*非系统变量赋值*/
    putValue(_str,(float)Vaule);                         /*非系统变量赋值*/
    writeEx(-3,0,"设置信号 %s 值为 %.2f",Sig,(float)Vaule);
    testStep("","设置信号 %s 值为 %.2f",Sig,(float)Vaule);
  }
  do
  {
    if(Time0 != 0)
      testWaitForTimeout(10);
    Now_Value2 = getSignal(Sig);
    Time0 = Time0+10;
  }while((Now_Value2 == Now_Value1) && Time0<=200);
}

/// <Node>
_Set_SigNoTime(char Sig[],float Vaule)
{
  char _str[120];
  char DBCName[300];
  char SigBefor[20] = "EV_ ";
  char ChangeStr[2];
  char buffer_ascii[500];
  char SearchStr[100] ;
  int SearchPos;
  int SigType;
  float Now_Value1,Now_Value2;
  
  snprintf(_str,elCount(_str),"%s","");
  snprintf(_str,elCount(_str),"EV_%s",Sig);
  snprintf(DBCName,elCount(DBCName),".\\CANDBC\\%s",DBC_Name);
  GlbHandlefile = OpenFileRead (DBCName,0);
  if(GlbHandlefile != 0)
  {
    snprintf(SearchStr,elCount(SearchStr),"%s%s:",SigBefor,_str);
    while(fileGetStringSZ(buffer_ascii,elcount(buffer_ascii),GlbHandlefile)!=0)  
    {
      if(strstr(buffer_ascii,SearchStr)!=-1)
      {
        SearchPos = strlen(SearchStr) + 2-1; //查询信号在DBC中获取到的位置
        snprintf(ChangeStr,elCount(ChangeStr),"%c",buffer_ascii[SearchPos]);
        SigType = atol(ChangeStr);
        break;
      }
    }
  }
  fileClose(GlbHandlefile);
  Now_Value1 = getSignal(Sig); 
  setSignal(Sig,Vaule);                         /*信号赋值*/
  if(SigType == 0) //整形数据
  {
    putValue(Sig,(int64)Vaule);                          /*非系统变量赋值*/
    putValue(_str,(int64)Vaule);                         /*非系统变量赋值*/
    writeEx(-3,0,"设置信号 %s 值为 %.0f",Sig,Vaule);
    testStep("","设置信号 %s 值为 %.0f",Sig,Vaule);
  }
  else
  {
    putValue(Sig,(float)Vaule);                          /*非系统变量赋值*/
    putValue(_str,(float)Vaule);                         /*非系统变量赋值*/
    writeEx(-3,0,"设置信号 %s 值为 %.2f",Sig,(float)Vaule);
    testStep("","设置信号 %s 值为 %.2f",Sig,(float)Vaule);
  }
}

/// <Node>
float _Get_Signal(char str[])
{
  float value;
  if(strncmp(str,"NULL",strlen(str)) == 0 && strlen(str) == strlen("NULL"))
  {
    testStep("","当前信号异常,未获取到对应信号");
    Signal_Flage = 1;
    return -1;
  }
  else
  {
    value = getSignal(str);
    Signal_Flage = 0;
    return value;
  }
}

/// <Node>
_Check_SignalMacth(char SigName[],int Value,long time)
{
  int SignalValue;
  testWaitForTimeout(time);
  SignalValue = _Get_Signal(SigName);
  if(SignalValue != Value)
    testStepFail("","信号值不匹配,期望值:%d,实际值:%d",Value,SignalValue);
  else
    testStepPass("","信号值与期望一致均为:%d",Value);
}

/// <Node>
_Set_CarSpd(float Spd)
{
  char _str[80];
  char DBCName[300];
  char SigBefor[20] = "EV_ ";
  char ChangeStr[2];
  char buffer_ascii[500];
  char SearchStr[100] ;
  int SearchPos;
  int SigType;
  
  snprintf(_str,elCount(_str),"%s","");
  snprintf(_str,elCount(_str),"EV_%s",Struct_CarSpd.CarSpd_Sig);
  
  if(CarSpd_Type == -1)
  {
    snprintf(DBCName,elCount(DBCName),".\\CANDBC\\%s",DBC_Name);
    
    GlbHandlefile = OpenFileRead (DBCName,0);
    if(GlbHandlefile != 0)
    {
      snprintf(SearchStr,elCount(SearchStr),"%s%s:",SigBefor,_str);
      while(fileGetStringSZ(buffer_ascii,elcount(buffer_ascii),GlbHandlefile)!=0)  
      {
        if(strstr(buffer_ascii,SearchStr)!=-1)
        {
          SearchPos = strlen(SearchStr) + 2-1; //查询信号在DBC中获取到的位置
          snprintf(ChangeStr,elCount(ChangeStr),"%c",buffer_ascii[SearchPos]);
          SigType = atol(ChangeStr);
          break;
        }
      }
    }
    fileClose(GlbHandlefile);
    CarSpd_Type = SigType;
  }
  setSignal(Struct_CarSpd.CarSpd_Sig,Spd);                   /*信号赋值*/
  if(CarSpd_Type == 0) //整形数据
  {
    putValue(Struct_CarSpd.CarSpd_Sig,(int)Spd);                          /*非系统变量赋值*/
    putValue(_str,(int)Spd);                         /*非系统变量赋值*/
    writeEx(-3,0,"设置车速为 %d",(int)Spd);
    testStep("","设置车速为 %d",(int)Spd);
  }
  else if(CarSpd_Type == 1)
  {
    putValue(Struct_CarSpd.CarSpd_Sig,(float)Spd);                          /*非系统变量赋值*/
    putValue(_str,(float)Spd);                         /*非系统变量赋值*/
    writeEx(-3,0,"设置车速为 %.2f",(float)Spd);
    testStep("","设置车速为 %.2f",(float)Spd);
  }
  testWaitForTimeout(500);
}

/// <Node>
_Set_CarSpd_Invalid(byte State)
{
  _Set_Sig(Struct_CarSpd.CarSpdInvalid_Sig,State);
  _WriteEx_and_Report("","设置车速有效位状态为 %d",State);
  testWaitForTimeout(Struct_CarSpd.Invalid_Time*1.3);
}
/// <Node>
float _Get_CarSpd()
{
  CarSpd_Now = getSignal(Struct_CarSpd.CarSpd_Sig);
  return CarSpd_Now;
}
/// <Node>
float _Get_Ready()
{
  Engine_State = getSignal(Struct_Ready.Ready_Sig);
  return Engine_State;
}
/// <Node>
_Reset_CarSpd_Invalid()
{
  byte State;
  if(strncmp(ECU_project,"Geely3",strlen("Geely3")) == 0 )
    State=3;
  else
    State = Struct_CarSpd.Normal_Value[0];
  _Set_Sig(Struct_CarSpd.CarSpdInvalid_Sig,State);
  _WriteEx_and_Report("","恢复车速有效位状态为 %d",State);
  testWaitForTimeout(500);
}
/// <Node>
_Set_Ready(int Ready)
{
  char _str[80];
  snprintf(_str,elCount(_str),"%s","");
  snprintf(_str,elCount(_str),"EV_%s",Struct_Ready.Ready_Sig);
  setSignal(Struct_Ready.Ready_Sig,Ready);
  putValue(_str,Ready);
  _WriteEx_and_Report("","设置发动机状态为 %d",Ready);
  testWaitForTimeout(500);
}
/// <Node>
_Set_Gears(byte Value)
{
  char _str[80];
  snprintf(_str,elCount(_str),"%s","");
  snprintf(_str,elCount(_str),"EV_%s",Gears_Signal);
  setSignal(Gears_Signal,Value);
  putValue(_str,Value);
  _WriteEx_and_Report("","设置档位状态为 %d",Value);
  testWaitForTimeout(500);
}

int _Set_Battery(float Value)
{
  char str[100];
  int Return_Time;
  Return_Time = 0;
  diagStartTesterPresent(Cdd_Name);
  snprintf(str,elCount(str),"%s","");
  snprintf(str,elCount(str),"设置电压为 %.2f V",Value);
  if(Value>35)
  {
    testStep("Battery","设置电压值较大,后续测试时间较长会损坏控制器,建议人为测试精确时间");
  }
  else
  {
    if(Set_Battery_RS232==0)
      testWaitForTesterConfirmation(str,30000);
    else if(Set_Battery_RS232==1)
      @sysvar::Prog_power::K30Volt = Value;
    _WriteEx_and_Report("电压",str);
    if(Value > NRC22_Battery_Hight)
    {
      H_Battery_Time = _max(H_Battery_Time,100);
      Return_Time = H_Battery_Time*1.5;
      testWaitForTimeout(H_Battery_Time*1.5);
    }
    else if(Value < NRC22_Battery_Low)
    {
      L_Battery_Time = _max(L_Battery_Time,100);
      Return_Time = L_Battery_Time*1.5;
      testWaitForTimeout(L_Battery_Time*1.5);
    }
    else
    {
      L_Battery_Time = _max(L_Battery_Time,100);
      Return_Time =  L_Battery_Time*1.5;
      testWaitForTimeout(L_Battery_Time*1.5);
    }
  }
  _WriteEx_and_Report("","设置电压为 %.2f V",Value);
  diagStopTesterPresent(Cdd_Name);
  return Return_Time;
}


_Check_Error_Count(dword ID,int Count)
{
  int i;
  dword seed;
  _WriteEx_and_Report("","进行错误密钥计数");
  for(i=1;i<=Count;i++)
  {
    if(i==Error_Count)
    {
      _Send_Key(SendKey_Len,ID,_get_seed(ID),1);
      _TestResult(SendData,ID,"",0x36);
    }
    else
    {
      _Send_Key(SendKey_Len,ID,_get_seed(ID),1);
      _TestResult(SendData,ID,"",0x35);
    }
    testWaitForTimeout(50);
    Get_Seed_Flage = 1;
  }
}

/// <Security Access>
_Clear_Seed()
{
  int i,j;
  if(Seed_Count != 0) //2026.7.30加入判断减少运行负载
  {
    for(j=0;j<10000;j++)
      Seed_Count_List[j]=0; //清空之前存储的种子
    for(j=0;j<10000;j++)
    {
      Seed_Count_Rept[j][0]=0; //清空之前存储的种子
      Seed_Count_Rept[j][1]=0; //清空之前存储的种子
    }
    for(i=0;i<10000;i++)
    {
      for(j=0;j<16;j++)
      {
        Seed_Count_List_AES128[i][j]=0;//清空之前存储的种子
        Seed_Count_AES_Rept[i][j] = 0;
      }
      Seed_Count_List_AES128[i][16]=0;
      Seed_Count_AES_Rept[i][16]=0;
    }
  }
  Seed_Count = 0;    //清空种子计数
}

_get_Ang_Chery(dword ID)
{
  word Chery_Ang_Now;
  byte Temp[3]={0x22,0x32,0x07};
  word TempValue;
  _Send_Diag(3,ID,Temp);
  if(diagGetLastResponseCode(SendData) != -1)
    testStepFail("未收到积极响应");
  else
  {
    Chery_Ang_Now = (DiagGetRespPrimitiveByte(SendData,3)<<8)+DiagGetRespPrimitiveByte(SendData,4);
    TempValue = 0-Chery_Ang_Now;
    _get_Arry("Angle_Calibrationn");
    Arry_Data[4] = (TempValue>>8)&0xff;
    Arry_Data[5] = TempValue&0xff;
    Arry_Data[6] = 0;
  }
}
/*
  检测信号是否外发
  type = 0 期望停发
  type = 1 期望不停发
*/
int _Check_EPS_TX(byte Type,dword TxID)
{
  int Fla,Return_Value;
  Return_Value = 0;
  Fla = testWaitForMessage(TxID,1000);
  if(Type == 0)
  {
    writeEx(-3,0,"期望报文0x%03X停发",TxID);
    if(Fla==0)
    {
      testStepPass("","期望报文停发,实际未收到0x%X报文",TxID);
      writeEx(-3,0,"实际报文0x%03X停发",TxID);
    }
    else if(Fla==1)
    {
      Return_Value = -1;
      testStepFail("","期望报文停发,实际仍然存在0x%X报文",TxID);
      writeEx(-3,0,"实际仍然存在0x%03X报文",TxID);
    }
    else
      testStepWarning("","检测错误");
  }
  else
  {
    writeEx(-3,0,"期望报文0x%03X正常外发",TxID);
    if(Fla==0)
    {
      Return_Value = -1;
      testStepFail("","期望报文正常外发,实际未收到0x%X报文",TxID);
      writeEx(-3,0,"实际未收到0x%03X报文",TxID);
    }
    else if(Fla==1)
    {
      testStepPass("","期望报文正常外发,实际收到0x%X报文",TxID);
      writeEx(-3,0,"实际报文0x%03X正常外发",TxID);
    }
    else
      testStepWarning("","检测错误");
  }
  return Return_Value;
}
int _Get_Tx_Len()
{
  int len;
  if(CANFD_Flage==0)
    len = 7;
  else
    len =0x3E;
  return len;
}
/*
  Time：等待响应时间
  Flage = 0 无需安全访问
  Flage = 1 需安全访问
  用于高负载测试
*/
_Set_11_Restoration(dword Time,byte Flage)
{
  byte Temp[2]={0x11,0x01};
  byte flage;
  int k,Fun_Pos,Serve_Pos;
  flage=0;
  Serve_Pos = _Check_Serve(0x11,0,0);
  if(Serve_Pos == -1)
  {
    _WriteEx_and_Report("","未查询到支持11服务");
    return;
  }
  if(Flage == 1)
  {
    if(Serve_Data[Serve_Pos].Security_Access[Fun_Pos]==1)
      _Send_Key(SendKey_Len,phyreq_ID,_get_seed(phyreq_ID,500),0);
    if(diagGetLastResponseCode(SendData) == 0)
      testWaitForDiagResponse(SendData,Time);
  }
  Temp[1] = Serve_Data[Serve_Pos].Serve_Fun[Fun_Pos];
  _Send_Diag(2,phyreq_ID,Temp,Time);
  testWaitForTimeout(Wait_Time_11);/*复位时间*/
  /*11复位此处不检测响应时间，高负载情况下时间会被复位时间影响*/
//  _TestResult(SendData,phyreq_ID,"",-1);
  Session_BIN = 1;
}

_Set_11_Restoration()
{
  byte Temp[2]={0x11,0x01};
  byte flage;
  int k,Serve_Pos;
  flage=0;
  Serve_Pos = _Check_Serve(0x11,0,0);
  if(Serve_Data[Serve_Pos].Serve_NRC22[0]&0x01 == 1)
  {
    _Get_CarSpd();
    if(CarSpd_Now != 0)
    {
      flage = 1;
      _Set_CarSpd(0);
    }
  }
  if(Serve_Data[Serve_Pos].Serve_NRC22[0]&0x01 == 1)
  {
    _Get_Ready();
    if(Engine_State == Ready_NRC22)
    {
      flage = 2;
      if(Ready_NRC22 > 0)
        _Set_Ready(0);
      else
        _Set_Ready(Struct_Ready.Ready_Active);
    }
  }
  
  if(Serve_Pos == -1)
  {
    _WriteEx_and_Report("","未查询到支持11服务");
    return;
  }
  if(Serve_Data[Serve_Pos].Security_Access[0]==1)
    _unlockECU();
  else
  {
    if((Session_BIN != 4) && _Check_Serve_IDAndSess(0x11,phyreq_ID,1) == 0)
      _SetSession(exsession);
  }
  Temp[1] = Serve_Data[Serve_Pos].Serve_Fun[0];
  _Send_Diag(2,phyreq_ID,Temp);
  _TestResult(SendData,phyreq_ID,"",-1);
  if(flage == 1)
    _Set_CarSpd(CarSpd_Now);
  else if(flage == 2)
    _Set_Ready(Engine_State);
  
  testWaitForTimeout(Wait_Time_11); /*11复位后增加延时时间防止后续出错*/
  Session_BIN = 1;
}
/*
  Flage = 0 无需安全访问
  Flage = 1 需安全访问
*/
_Set_11_Restoration(byte Flage)
{
  byte Temp[2]={0x11,0x01};
  byte flage;
  int k,Serve_Pos;
  flage=0;
  Serve_Pos = _Check_Serve(0x11,0,0);
  if(Serve_Data[Serve_Pos].Serve_NRC22[0]&0x01 == 1)
  {
    _Get_CarSpd();
    if(CarSpd_Now != 0)
    {
      flage = 1;
      _Set_CarSpd(0);
    }
  }
  if(Serve_Pos == -1)
  {
    _WriteEx_and_Report("","未查询到支持11服务");
    return;
  }
  if(Flage == 1)
  {
    if(Serve_Data[Serve_Pos].Security_Access[0]==1)
      _unlockECU();
  }
  Temp[1] = Serve_Data[Serve_Pos].Serve_Fun[0];
  _Send_Diag(2,phyreq_ID,Temp);
  _TestResult(SendData,phyreq_ID,"",-1);
  if(flage == 1)
    _Set_CarSpd(CarSpd_Now);
  testWaitForTimeout(Wait_Time_11); /*11复位后增加延时时间防止后续出错*/
  Session_BIN = 1;
}
/*****************************************/
/*
    检测字符串在预输入时间中所在位置
    Type == 0:mixArray
    Type == 1:DID_Function
*/
int _Check_StrPossion(char sor[],dword poss,int Type)
{
  int po;
  int m;
  po = -1;
  if(Type == 0)
  {
    for(m=0;m<mixArray[poss].Sig_Name_Count;m++)
    {
      if(strncmp(sor,mixArray[poss].LocalTime_Str[m],strlen(sor)) == 0 && (strlen(sor) == strlen(mixArray[poss].LocalTime_Str[m])))
      {
        po = m;
        break;
      }
    }
  }
  else if(Type == 1)
  {
    for(m=0;m<6;m++)
    {
      if(strncmp(sor,DID_Function[poss].LocalTime_SigDef[m],strlen(sor)) == 0 && (strlen(sor) == strlen(DID_Function[poss].LocalTime_SigDef[m])))
      {
        po = m;
        break;
      }
    }
  }
  return po;
}
/*
    检测字符串在结构体中所在位置
    type ==1: mixArray  
    type ==2: Res1904_Data  
    type ==3: ExDataRecord
    type ==4: DID_Function
*/
int _Check_StrPossion_Res(char sor[],dword type) 
{
  int po;
  int m;
  char Sor[100];
  char _Str_DID_1904[40];
  char _Res1904_Data[40];
  char _Ex_Data_Record_Str[50];
  po = -1;
  toUpper(Sor,sor,elCount(Sor));
  if(type == 1)
  {
    for(m=0;m<mixArray_Len;m++)
    {
      toUpper(_Str_DID_1904,mixArray[m].Str_DID_1904,elCount(_Str_DID_1904));
      if(strncmp(Sor,_Str_DID_1904,strlen(Sor)) == 0 && (strlen(Sor) == strlen(_Str_DID_1904)))
      {
        po = m;break;
      }
    }
  }
  else if(type == 2)
  {
    for(m=0;m<Res1904_Data_Count;m++)
    {
      toUpper(_Res1904_Data,Res1904_Data[m].Str,elCount(_Res1904_Data));
      if(strncmp(Sor,_Res1904_Data,strlen(Sor)) == 0 && (strlen(Sor) == strlen(_Res1904_Data)))
      {
        po = m;break;
      }
    }
  }
  else if(type == 3)
  {
    for(m=0;m<ExDataRecord_Count;m++)
    {
      toUpper(_Ex_Data_Record_Str,ExDataRecord[m].Ex_Data_Record_Str,elCount(_Ex_Data_Record_Str));
      if(strncmp(Sor,_Ex_Data_Record_Str,strlen(Sor)) == 0 && (strlen(Sor) == strlen(_Ex_Data_Record_Str)))
      {
        po = m;break;
      }
    }
  }
  else if(type == 4)
  {
    for(m=0;m<DID_Function_Count;m++)
    {
      toUpper(_Ex_Data_Record_Str,DID_Function[m].Sig_Step,elCount(_Ex_Data_Record_Str));
      if(strncmp(Sor,_Ex_Data_Record_Str,strlen(Sor)) == 0 && (strlen(Sor) == strlen(_Ex_Data_Record_Str)))
      {
        po = m;break;
      }
    }
  }
  return po;
}

/*
  输入数据判断
  Type = 0:数据来源mixArray
  Type = 1:数据来源DID_Function
*/
int _Check_ValueInRange_IsWrite(float now_,float Target,float Tolerance,char str[],int Type,byte WriteFlage)  
{
  int Temp_s,Return_Value;
  Temp_s = 0;
  if(Type == 0)
    Temp_s = _Check_StrPossion_Res(str,1);
  else
    Temp_s = _Check_StrPossion_Res(str,4);
  Return_Value = 1;
  if((Type == 0 && Target == mixArray[Temp_s].Invalid) || (Type == 1 && Target == DID_Function[Temp_s].Invalid))
  {
    dword now_1,Target_1;
    now_1 = now_; Target_1 = Target;
    if(now_ !=  Target)
    {
      testStepFail(str,"当前值与预期不一致,预期为0x%X ,实际为0x%X",Target_1,now_1);
      if(WriteFlage == 1)
        writeEx(-3,0,"当前值与预期不一致,预期为0x%X ,实际为0x%X",Target_1,now_1);
      Return_Value = -1;
    }
    else
    {
      testStepPass(str,"当前值与预期一致,期望值为 0x%X",now_1);
      if(WriteFlage == 1)
        writeEx(-3,0,"当前值与预期一致,期望值为 0x%X",now_1);
    }
  }
  else
  {
    if(DataCheckGreater == 1)
    {
      if(now_>Target )
        testStepPass(str,"当前值大于预期,预期为%.2f ,实际为%.2f",Target,now_);
      else
        testStepFail(str,"当前值不大于预期,预期为%.2f ,实际为%.2f",Target,now_);
    }
    else
    {
      if((now_<(Target-Tolerance)) || (now_>(Target+Tolerance)) )
      {
        testStepFail(str,"当前值不在预期范围内,预期为%.2f ±%.2f,实际为%.2f",Target,Tolerance,now_);
        if(WriteFlage == 1)
          writeEx(-3,0,"当前值不在预期范围内,预期为%.2f ±%.2f,实际为%.2f",Target,Tolerance,now_);
        Return_Value = -1;
      }
      else
      {
        testStepPass(str,"当前值在预期范围内,预期为%.2f ±%.2f,实际为%.2f",Target,Tolerance,now_);
        if(WriteFlage == 1)
          writeEx(-3,0,"当前值在预期范围内,预期为%.2f ±%.2f,实际为%.2f",Target,Tolerance,now_);
      }
    }
  }
  return Return_Value;
}

int _Check_ValueInRange_IsWrite_(qword now_,qword Target,float Tolerance,char str[],int Type,byte WriteFlage)  
{
  int Temp_s,Return_Value;
  Temp_s = 0;
  if(Type == 0)
    Temp_s = _Check_StrPossion_Res(str,1);
  else
    Temp_s = _Check_StrPossion_Res(str,4);
  Return_Value = 1;
  if((Type == 0 && Target == mixArray[Temp_s].Invalid) || (Type == 1 && Target == DID_Function[Temp_s].Invalid))
  {
    char now_1[50],Target_1[50];
    snprintf(now_1,elcount(now_1),"%X",now_);
    snprintf(Target_1,elcount(Target_1),"%X",Target);
    if(strncmp (now_1,Target_1,_max(strlen(now_1),strlen(Target_1))) != 0)
    {
      testStepFail(str,"当前值与预期不一致,预期为0x%s ,实际为0x%s",Target_1,now_1);
      if(WriteFlage == 1)
        writeEx(-3,0,"当前值与预期不一致,预期为0x%s ,实际为0x%s",Target_1,now_1);
      Return_Value = -1;
    }
    else
    {
      testStepPass(str,"当前值与预期一致,期望值为 0x%s",now_1);
      if(WriteFlage == 1)
        writeEx(-3,0,"当前值与预期一致,期望值为 0x%s",now_1);
    }
  }
  else
  {
    if((now_<(Target-Tolerance)) || (now_>(Target+Tolerance)) )
    {
      testStepFail(str,"当前值不在预期范围内,预期为%.2f ±%.2f,实际为%.2f",Target,Tolerance,now_);
      if(WriteFlage == 1)
        writeEx(-3,0,"当前值不在预期范围内,预期为%.2f ±%.2f,实际为%.2f",Target,Tolerance,now_);
      Return_Value = -1;
    }
    else
    {
      testStepPass(str,"当前值在预期范围内,预期为%.2f ±%.2f,实际为%.2f",Target,Tolerance,now_);
      if(WriteFlage == 1)
        writeEx(-3,0,"当前值在预期范围内,预期为%.2f ±%.2f,实际为%.2f",Target,Tolerance,now_);
    }
  }
  return Return_Value;
}
/*
  判断输入数据是否为全0，全0情况下特殊处理用于跳过测试
*/
int _Check_mixArray_SetValue(char _Check_Str[],int Pos)
{
  int Return_Value,n;
  char Temp_Str[200];
  Return_Value = 0;
  toUpper(Temp_Str,_Check_Str,elCount(Temp_Str));
  if(strncmp(Temp_Str,"LOCALTIME",strlen(Temp_Str))==0)
  {
    for(n=0;n<4;n++)
    {
      if(strlen(mixArray[Pos].LocalTime_Set[n])!=0)
      {
        Return_Value = 1;
        break;
      }
    }
  }
  else
  {
    for(n=0;n<4;n++)
    {
      if(mixArray[Pos].Vaule_Set[n]!=0)
      {
        Return_Value = 1;
        break;
      }
    }
  }
  return Return_Value;
}
/*
  判断数组是否在输入1904的预期DID中，在则返回所在位置，不在则返回-1
*/
int Array_Compare_1904(byte Sour[])
{
  int Flage_Compare1904;
  int m;
  Flage_Compare1904 = -1;
  for(m=0;m<mixArray_Len;m++)
  {
    Flage_Compare1904 = Array_Compare(Sour,mixArray[m].DID_1904);
    if(Flage_Compare1904==1)
    {
      Flage_Compare1904 = m;
      break;
    }
  }
  return Flage_Compare1904;
}
/*
  对比两组字符串,第一组在第二组中则返回1
*/
int  Array_Compare(byte Sour[],byte Target[])
{
  int ii;
  int Flage_Compare;
  Flage_Compare = 1;
  for(ii=0;ii<elcount(Sour);ii++)
  {
    if(Sour[ii]!=Target[ii])
    {
      Flage_Compare = -1;
      break;
    }
  }
  return Flage_Compare;
}

/*
  将输入的数组按照输入格式进行转换并输出
  List_Input：输入数组
  Len_Input :输入长度
  List_Output：输出数据
  Type ：转换格式
  Type = 2：ASCII码格式转换
  Type = 3：整体转换至10进制 
  Type = 4：每个Byte分别转换至10进制后拼接
  Type = 5：16进制拼接
  Type = 7：前面为16进制 后面为ASCII码
  Type = 8：前面为16进制 后面为ASCII码 多组
  Type = 9：混合DID
*/
void Array_Change(byte List_Input[],int Len_Input,char List_Output[],char List_Ex[],byte Type)
{
  int Count_Size;
  char Temp_Buffer[20];
  snprintf(List_Output,elCount(List_Output),"%s","");
  snprintf(Temp_Buffer,elCount(Temp_Buffer),"%s","");
  if(Type == 2)
  {
    for(Count_Size=0;Count_Size<Len_Input;Count_Size++)
      snprintf(List_Output,elCount(List_Output),"%s%c",List_Output,HexToAsc(List_Input[Count_Size])); //ASCII码查表切换
  }
  else if(Type == 3)
  {
    qword Data_Temp ;
    Data_Temp = 0;
    snprintf(List_Output,elCount(List_Output),"0x%s");
    for(Count_Size=0;Count_Size<Len_Input;Count_Size++)
      snprintf(List_Output,elCount(List_Output),"%s%02X",List_Output,List_Input[Count_Size]);
    strtoull(List_Output,Data_Temp);
    snprintf(List_Output,elCount(List_Output),"%s","");
    snprintf(List_Output,elCount(List_Output),"%s%I64u",List_Output,Data_Temp);
  }
  else if(Type == 4)
  {
    for(Count_Size=0;Count_Size<Len_Input;Count_Size++)
    {
      ltoa(List_Input[Count_Size],Temp_Buffer,10);
      if(strlen(Temp_Buffer) == 1)
        snprintf(List_Output,300,"%s%s",List_Output,"0");
      snprintf(List_Output,300,"%s%s",List_Output,Temp_Buffer);
    }
  }
  else if(Type == 5)
  {
    for(Count_Size=0;Count_Size<Len_Input;Count_Size++)
    {
      ltoa(List_Input[Count_Size],Temp_Buffer,16);
      if(strlen(Temp_Buffer) == 1)
        snprintf(List_Output,300,"%s%s",List_Output,"0");
      snprintf(List_Output,300,"%s%s",List_Output,Temp_Buffer);
    }
  }
  else if(Type == 7)
  {
    for(Count_Size=0;Count_Size<Len_Input-3;Count_Size++)
    {
      ltoa(List_Input[Count_Size],Temp_Buffer,16);
      if(strlen(Temp_Buffer) == 1)
        snprintf(List_Output,300,"%s%s",List_Output,"0");
      snprintf(List_Output,300,"%s%s",List_Output,Temp_Buffer);
    }
    for(Count_Size = Len_Input-3; Count_Size<Len_Input;Count_Size++)
      snprintf(List_Output,elCount(List_Output),"%s%c",List_Output,HexToAsc(List_Input[Count_Size])); //ASCII码查表切换
    str_replace(List_Output,"/","  ");
  }
  else if(Type == 8)
  {
    int Group_Temp,i,RxLen_Temp;
    Group_Temp = (Len_Input-1)/List_Input[0];//取分组长度
    for(i=0;i<List_Input[0];i++)
    {
      RxLen_Temp = Group_Temp*(i+1);
      for(Count_Size =1+ Group_Temp*i;Count_Size<RxLen_Temp+1-3;Count_Size++)
      {
        ltoa(List_Input[Count_Size],Temp_Buffer,16);
        if(strlen(Temp_Buffer) == 1)
          snprintf(List_Output,300,"%s%s",List_Output,"0");
        snprintf(List_Output,300,"%s%s",List_Output,Temp_Buffer);
      }
      for(Count_Size =RxLen_Temp+1-3;Count_Size<RxLen_Temp+1;Count_Size++)
        snprintf(List_Output,elCount(List_Output),"%s%c",List_Output,HexToAsc(List_Input[Count_Size])); //ASCII码查表切换
      str_replace(List_Output,"/","  ");
    }
  }
  else if(Type == 9)
  {
    char str[500];
    int i,Len_Rx,j,m;
    char Buffer[500]; // 临时装载数据
    char Buffer_Check[500];//装载转换后的数据
    char DID_Str[20][10]; //装载裁剪区分后的字符串
    char DID_TempStr[20];//装载DID
    byte Did_byte[2];//装载DID
    int Return_Value;
    int Group_Temp;
    int Analysis_Temp,ExLen,Flage;
    char Rx_DataTemp[200];
    char Out[500];

    Group_Temp = CountChar(List_Ex,",")+1;
    Truncate_Str(List_Ex,DID_Str,",");
    for(j=0;j<Group_Temp;j++)
    {
      dword DID_;
      char DID_s[10];
      byte DataGet[50];
      Flage = 0;//该DID是否存在与返回中
      snprintf(DID_TempStr,elCount(DID_TempStr),"DID_%s",DID_Str[j]);
      toUpper(DID_TempStr,DID_TempStr,strlen(DID_TempStr));//大写数据类型防止后续判断时不匹配
      snprintf(DID_s,elCount(DID_s),"0x%s",DID_Str[j]);
      DID_ = atol(DID_s);
      Did_byte[0] = (DID_>>8)&0xFF;
      Did_byte[1] = DID_&0xFF;
      _Get_DID(DID_TempStr);
      Analysis_Temp = Analysis;
      ExLen = DID_len_Ex -3;//减去DID + Serve长度
      snprintf(Rx_DataTemp,elCount(Rx_DataTemp),"%s",DID_Data_str);
      if(Analysis_Temp == 7 || Analysis_Temp == 8)
        str_replace(Rx_DataTemp, "/", "  "); //将'/'替换为'  '
      for(i=0;i<Len_Input-1;i++)
      {
        if((List_Input[i] == Did_byte[0]) && (List_Input[i+1] == Did_byte[1]))
        {
          Flage = 1;
          for(m=i+2;m<ExLen+i+2;m++)
            DataGet[m-i-2] = List_Input[m];
        }
      }
      if(Flage == 0)
      {
        testStepFail(DID_s,"该DID未在返回数据中");
        continue;
      }
      if((Analysis_Temp == 1 && Len_Input == 0) || (strlen(Rx_DataTemp) == 0))
      {
        _WriteEx_and_Report(str,"未输入预期值，跳过内容检测");
        continue;
      }
      /*针对不同解析方式进行数据处理*/
      {
        DataChange_Analysis(Analysis_Temp,DataGet,ExLen,Out,Rx_DataTemp,UnUse_Byte,DID_s);
      }
    }
  }
  else
    _WriteEx_and_Report("","无对应解析,待完善");
}

void DID_Read_Some(dword ID,byte Session,char Str[])
{
  int Return_Va,n,Flage_Error;
  int Len_Rx,Len_Ex,Len_Start,Len_End;
  byte Send_Data[100],Temp_RxData[100],Temp_RxData_2[100];
  char DID[20];
  int i;
  Return_Va = _Check_Serve_IDAndSess(0x22,ID,Session);
  
  if(DID_22_Support==1)
    _WriteEx_and_Report("","该项目一次性只支持一个DID读取");
  else
  {
    Return_Va = _Check_Serve_IDAndSess(0x22,ID,Session);
    if(Return_Va == 1)
    {
      Send_Data[0] = 0x22;
      _Get_Read_Plural(Str);
      n = 1;
      for(i=0;i<DID_Read_Count;i++)
      {
        Send_Data[n++] = DID_Read[i].DID_byte[0];
        Send_Data[n++] = DID_Read[i].DID_byte[1];
      }
      _Send_Diag(1+DID_Read_Count*2,ID,Send_Data);
      if(diagGetLastResponseCode(SendData) == 0)
        testWaitForDiagResponse(SendData,2000);
      if(diagGetLastResponseCode(SendData) == -1)
      {
        Len_Ex = 0;
        Len_Rx = DiagGetRespPrimitiveSize(SendData);
        for(i=0;i<DID_Read_Count;i++)
        {
          if(DID_Read[i].LenExResp != 0)
            Len_Ex = Len_Ex + DID_Read[i].LenExResp + 2;
        }
        Len_Ex = Len_Ex + 1;
        if(Len_Rx != Len_Ex)
          testStepFail("读取多组DID","返回长度与预期长度不符,返回长度为 %d, 期望长度为 %d",Len_Rx,Len_Ex);
        else
        {
          /* 分组进行判断 */
          Len_Start = 0;
          Len_End = 0;
          for(i=0;i<DID_Read_Count;i++)
          {
            if( DID_Read[i].LenExResp != 0)
            {
              Flage_Error = 0;
              snprintf(DID,elCount(DID),"%s","");
              snprintf(DID,elCount(DID),"0x%02X 0x%02X",DID_Read[i].DID_byte[0],DID_Read[i].DID_byte[1]);
              Len_Start =  Len_End ;
              if(Len_End == 0)
                Len_Start = Len_Start +1;
              Len_End = Len_Start + DID_Read[i].LenExResp+2;
              for(n = 0; n< DID_Read[i].LenExResp+2 ; n++)
              {
                if((Len_Start+n) > Len_Rx)
                {
                  testStepFail("","出现异常长度导致无法获取到后续字节");
                  return;
                }
                Temp_RxData[n] = DiagGetRespPrimitiveByte(SendData,Len_Start+n);
              }
              if((Temp_RxData[0] != DID_Read[i].DID_byte[0]) || (Temp_RxData[1] != DID_Read[i].DID_byte[1]))
                testStepFail(DID,"DID与预期无法对应,接收到DID为: 0x%02X 0x%02X ,预期DID为: 0x%02X 0x%02X ",Temp_RxData[0],Temp_RxData[1],DID_Read[i].DID_byte[0],DID_Read[i].DID_byte[1]);
              else
                testStepPass(DID,"DID与预期一致");
              if(DID_Read[i].ExRspCheck == 0)
              {
                _WriteEx_and_Report(DID,"未输入预期值，不做内容判断");
                continue;
              }
              for(n=0;n<DID_Read[i].LenExResp;n++)
                Temp_RxData_2[n] = DiagGetRespPrimitiveByte(SendData,Len_Start+2+n); //全数据数组(剔除DID)
              if(DID_Read[i].Analysis_Read == 1)
              {
                char Temp_Rx[200];
                char Temp_Ex[200];
                snprintf(Temp_Rx,elCount(Temp_Rx),"%s","实际接收为: ");
                snprintf(Temp_Ex,elCount(Temp_Ex),"%s","期望接收为: ");
                for(n=0;n<DID_Read[i].LenExResp;n++)
                {
                  snprintf(Temp_Rx,elCount(Temp_Rx),"%s%02X",Temp_Rx,Temp_RxData_2[n]);
                  snprintf(Temp_Ex,elCount(Temp_Ex),"%s%02X",Temp_Ex,DID_Read[i].ExResp_Byte[n]);
                  if(Temp_RxData_2[n] != DID_Read[i].ExResp_Byte[n])
                    Flage_Error = 1;
                }
                if(Flage_Error == 1)
                {
                  _WriteEx_and_Report(DID,Temp_Rx);
                  _WriteEx_and_Report(DID,Temp_Ex);
                  testStepFail(DID,"接收到的数据与预期不符");
                }
                else
                  testStepPass(DID,"接收到的数据与预期一致");
              }
              else
              {
                char Buffer_Check[500];
                Array_Change(Temp_RxData_2,DID_Read[i].LenExResp,Buffer_Check,DID_Read[i].ExResp,DID_Read[i].Analysis_Read);
                if(DID_Read[i].Analysis_Read>=7 && DID_Read[i].Analysis_Read <= 9)
                  str_replace(DID_Read[i].ExResp,"/","  ");
                if(DID_Read[i].Analysis_Read != 9)
                  Check_information_(Buffer_Check,DID_Read[i].ExResp,DID);
              }
            }
          }
        }
      }
      else
        testStepFail("","未收到响应或收到消极应答");
    }
    else if(Return_Va == -1)
      _WriteEx_and_Report("","当前寻址不支持该服务");
    else if(Return_Va == 0)
      _WriteEx_and_Report("","当前会话不支持该服务");
  }
}
_Temp_For_1904_Clear(int Pos)
{
  /****************故障恢复并清除故障****************/
  _Open_One_Node(DTC_19[Pos]);
  _Clear_DTC(phyreq_ID);
}
_Temp_For_1904_Clear_1(int Pos)
{
  /****************故障恢复****************/
  _Open_One_Node(DTC_19[Pos]);
}
_Temp_For_1904_Set(int Pos,dword ID,byte Data_Send[])
{
  /****************制造故障并发送快照****************/
  _Close_One_Node(DTC_19[Pos]); //DTC掩码由后面获取,此处修改DTC故障节点后需要同步修改_Fun_1904中mask掩码
  _Send_Diag(6,ID,Data_Send);
}

/// <Node>
_Check_ID(char str_[])
{
  dword ID_Tmep;
  int x_x;
  ID_Tmep = atol(str_);
  if(ID_Tmep == 0 && (strncmp(str_,"XCP",strlen(str_)) == 0))
  {
    testStep(str_,"当前为内部XCP变量,无法进行节点操作");
    Canoe_Node_Flage = 0;
  }
  else if(ID_Tmep == 0 && (strncmp(str_,"XCP",strlen(str_)) != 0))
  {
    testStepFail(str_,"当前输入ID未查询到");
    Canoe_Node_Flage = -2;
  }
  else
  {
    for(x_x = 0;x_x < All_Node_Count;x_x++)
    {
      if(ID_Tmep == All_Node[x_x])
      {
        Canoe_Node_Flage = 1;  //可操作仿真ID
        break;
      }
      Canoe_Node_Flage = -1;
    }
    if(Canoe_Node_Flage==-1)
    {
      testStep(str_,"当前输入节点不属于Canoe仿真节点");
      writeEx(-3,0,"%s  当前输入节点不属于Canoe仿真节点",str_);
    }
  }
}
/// <Node>
_Check_ID_(char str_[])
{
  dword ID_Tmep;
  int x_x;
  ID_Tmep = atol(str_);
  if((strncmp(str_,"XCP",strlen(str_)) == 0) || (strncmp(str_,"xcp",strlen(str_)) == 0))
  {
    //testStep(str_,"当前为内部XCP变量,无法进行节点操作");
    Canoe_Node_Flage = 0;
  }
  else if(ID_Tmep == 0 && (strncmp(str_,"XCP",strlen(str_)) != 0))
  {
   // testStepFail(str_,"当前输入ID未查询到");
    Canoe_Node_Flage = -2;
  }
  else
  {
    Canoe_Node_Flage = 1;
    if(Canoe_Node_Flage==-1)
    {
      //writeEx(-3,0,"%s  当前输入节点不属于Canoe仿真节点",str_);
    }
  }
}
int _TestWaitForTesterConfirmation_(char str[])
{
  char Str_Temp[500];
  int Tem;
  snprintf(Str_Temp,elCount(Str_Temp),"%s","");
  snprintf(Str_Temp,elCount(Str_Temp),"%s",str);
  Tem = testWaitForTesterConfirmation(Str_Temp,60000);
  return Tem;
}
_TestWaitForTesterConfirmation(char str[])
{
  char Str_Temp[500];
  snprintf(Str_Temp,elCount(Str_Temp),"%s","");
  snprintf(Str_Temp,elCount(Str_Temp),"%s",str);
  _WriteEx_and_Report("",Str_Temp);
  testWaitForTesterConfirmation(Str_Temp,60000);
}
_TestWaitForTesterConfirmation(char str[],float Value)
{
  char Str_Temp[500];
  snprintf(Str_Temp,elCount(Str_Temp),"%s","");
  snprintf(Str_Temp,elCount(str),str,Value);
  _WriteEx_and_Report("",Str_Temp,Value);
  testWaitForTesterConfirmation(Str_Temp,60000);
}
_Fun_1904(char Check_Str[],dword ID,byte Session)
{
  byte DTC_H,DTC_M,DTC_L;
  byte mask;
  int Pos_1904;
  byte Data_Send[6] = {0x19,0x04,0,0,0,0};
  dword  Possion;
  char comment[100];
  char Check_Str_[100];
  snprintf(comment,elCount(comment),"%s","");
  snprintf(Check_Str_,elCount(Check_Str_),"%s","");
  snprintf(Check_Str_,elCount(Check_Str_),"%s",Check_Str);
  Pos_1904 = Get_Node_Pos(Node_1904,1);
  DTC_H = (DTC_19[Pos_1904][1]>>16);
  DTC_M = (DTC_19[Pos_1904][1]>>8);
  DTC_L = (DTC_19[Pos_1904][1]&0xFF);
  Data_Send[2] = DTC_H;
  Data_Send[3] = DTC_M;
  Data_Send[4] = DTC_L;
  Data_Send[5] = Freeze_Frame_Number[0];
  Possion = _Check_StrPossion_Res(Check_Str,1);
  Signal_Flage = 0;
  _Str_Upper(Check_Str_);
  if((strncmp(Check_Str_,"BATTERY",strlen(Check_Str_)) == 0) || (strncmp(Check_Str_,"VOLTAGE",strlen(Check_Str_)) == 0))
  {
    if(_Check_mixArray_SetValue(Check_Str,Possion)==1)
    {
      /****************制造故障并获取快照****************/
      _WriteEx_and_Report(Check_Str_,"正常范围内设置电压");
      _Set_Battery(mixArray[Possion].Vaule_Set[0]);/*正常范围内设置电压*/
      _Temp_For_1904_Set(Pos_1904,ID,Data_Send);
      mask = DTC_19[Pos_1904][2];
      _Check_1904(SendData,mask,Check_Str,mixArray[Possion].Vaule_Set[0],0);
      /****************故障恢复并清除故障****************/
      _Temp_For_1904_Clear(Pos_1904);
      /****************制造故障并获取快照****************/
      _WriteEx_and_Report(Check_Str_,"设置电压为第二次输入值");
      _Set_Battery(mixArray[Possion].Vaule_Set[1]);/*设置电压为物理最大值*/ /*电压由于最大值会导致诊断无响应，此处使用输入值*/
      _Temp_For_1904_Set(Pos_1904,ID,Data_Send);
      _Check_1904(SendData,mask,Check_Str,mixArray[Possion].Vaule_Set[1],0);
      /****************故障恢复并清除故障****************/
      _Temp_For_1904_Clear(Pos_1904);
      /****************制造故障并获取快照****************/
      _WriteEx_and_Report(Check_Str_,"设置电压为第三次输入值");
      _Set_Battery(mixArray[Possion].Vaule_Set[2]);/*设置电压为物理最大值+1  mixArray[Possion].DID_Value_max*/
      _Temp_For_1904_Set(Pos_1904,ID,Data_Send);
      _Check_1904(SendData,mask,Check_Str,mixArray[Possion].Vaule_Set[2],0);
      
      _Set_Battery(12);/*正常范围内设置电压*/
    }
    else
      _WriteEx_and_Report("","输入值为全0情况下跳过测试");
  }
  else if(strncmp(Check_Str_,"MOTOR_TEMPERATURE",strlen(Check_Str_)) == 0  || strncmp(Check_Str_,"ECU_TEMPERATURE",strlen(Check_Str_)) == 0)
  {
    _WriteEx_and_Report(Check_Str,"当前测试项次涉及热保护,无法自动化测试");
    testStepWarning("","");
  }
  else if(strncmp(Check_Str_,"ANGLE",strlen(Check_Str_)) == 0)
  {
    if(_Check_mixArray_SetValue(Check_Str,Possion)==1)
    {
    _Get_Signal(mixArray[Possion].Sig_Name[0]);
    if(Signal_Flage == 1)
      _WriteEx_and_Report("","无法获取到准确的角度信号,人为转动方向盘时注意保证角度的误差在范围内");
    _Get_Ready();
    if(Engine_State == 0)
      _Set_Ready(Struct_Ready.Ready_Active);
    snprintf(comment,elCount(comment),"%s","");
    snprintf(comment,elCount(comment),"转动方向盘到  %.1f°",mixArray[Possion].Vaule_Set[0]);
    _TestWaitForTesterConfirmation(comment);
    _WriteEx_and_Report(Check_Str_,"制造故障");
    _Temp_For_1904_Set(Pos_1904,ID,Data_Send);
    mask = DTC_19[Pos_1904][2];
//    if(Signal_Flage==0)//使用外发信号的具体值,暂时屏蔽
//      _Check_1904(SendData,mask,Check_Str,_Get_Signal(mixArray[Possion].Sig_Name[0]),0);
//    else
      _Check_1904(SendData,mask,Check_Str,mixArray[Possion].Vaule_Set[0],0);
    /****************故障恢复并清除故障****************/
    _WriteEx_and_Report(Check_Str_,"故障恢复并清除故障");
    _Temp_For_1904_Clear(Pos_1904);
    snprintf(comment,elCount(comment),"%s","");
    snprintf(comment,elCount(comment),"转动方向盘到  %.1f°",mixArray[Possion].Vaule_Set[0]*(-1));
    _TestWaitForTesterConfirmation(comment);
    _Temp_For_1904_Set(Pos_1904,ID,Data_Send);
//    if(Signal_Flage==0)  
//      _Check_1904(SendData,mask,Check_Str,_Get_Signal(mixArray[Possion].Sig_Name[0]),0);
//    else
      _Check_1904(SendData,mask,Check_Str,mixArray[Possion].Vaule_Set[0]*(-1),0);
    /****************故障恢复并清除故障****************/
    _Temp_For_1904_Clear(Pos_1904);
    _TestWaitForTesterConfirmation("转动方向盘到 %.1f",Res_Position);
    _Temp_For_1904_Set(Pos_1904,ID,Data_Send);
//    if(Signal_Flage==0)
//      _Check_1904(SendData,mask,Check_Str,_Get_Signal(mixArray[Possion].Sig_Name[0]),0);
//    else
      _Check_1904(SendData,mask,Check_Str,Res_Position,0);
    /****************故障恢复并清除故障****************/
    _Temp_For_1904_Clear(Pos_1904);
    _TestWaitForTesterConfirmation("转动方向盘到 %.1f",Res_Position*(-1));
    _Temp_For_1904_Set(Pos_1904,ID,Data_Send);
//    if(Signal_Flage==0)
//      _Check_1904(SendData,mask,Check_Str,_Get_Signal(mixArray[Possion].Sig_Name[0]),0);
//    else
      _Check_1904(SendData,mask,Check_Str,Res_Position*(-1),0);
    /****************故障恢复并清除故障****************/
    _Temp_For_1904_Clear(Pos_1904);
    _TestWaitForTesterConfirmation("转动方向盘到 -90°,并拔掉传感器");
    _Temp_For_1904_Set(Pos_1904,ID,Data_Send);
//    if(Signal_Flage==0)
//      _Check_1904(SendData,mask,Check_Str,_Get_Signal(mixArray[Possion].Sig_Name[0]),1);
//    else
      _Check_1904(SendData,mask,Check_Str,-90,1);
    _Temp_For_1904_Clear(Pos_1904);
    _TestWaitForTesterConfirmation("恢复传感器");
    if(Engine_State == 0)
      _Set_Ready(Engine_State);
    _Power_Down();
    testWaitForTimeout(1000);
    _Power_Up();
    if(Session != defsession)
      _SetSession(Session);
    testWaitForTimeout(CAN_Init_Time);
    }
    else
      _WriteEx_and_Report("","输入值为全0情况下跳过测试");
  }
  else if(strncmp(Check_Str_,"ANGSPD",strlen(Check_Str_)) == 0)
  {
    if(_Check_mixArray_SetValue(Check_Str,Possion)==1)
    {
    _Get_Signal(mixArray[Possion].Sig_Name[0]);
    if(Signal_Flage == 1)
    {
      _WriteEx_and_Report("","无法获取到准确的转速信号,无法获取到正确的判断值");
      snprintf(comment,elCount(comment),"是否仅获取快照解析值不做具体判断");
      _Get_Ready();
      if(Engine_State == 0)
        _Set_Ready(Struct_Ready.Ready_Active);
      if(testWaitForTesterConfirmation(comment,60000)==1)
      {
        _TestWaitForTesterConfirmation("向左匀速转动方向盘直到提示停止");
        _Temp_For_1904_Set(Pos_1904,ID,Data_Send);
        mask = DTC_19[Pos_1904][2];
        _Check_1904(SendData,mask,Check_Str,0,2);
        _TestWaitForTesterConfirmation("停止转动方向盘");
        /****************故障恢复并清除故障****************/
        _Temp_For_1904_Clear(Pos_1904);
        _TestWaitForTesterConfirmation("向右匀速转动方向盘直到提示停止");
        _Temp_For_1904_Set(Pos_1904,ID,Data_Send);
        _Check_1904(SendData,mask,Check_Str,0,2);
        _TestWaitForTesterConfirmation("停止转动方向盘");
        /****************故障恢复并清除故障****************/
        _Temp_For_1904_Clear(Pos_1904);
        _TestWaitForTesterConfirmation("拔掉传感器并匀速转动方向盘");
        _Temp_For_1904_Set(Pos_1904,ID,Data_Send);
        _Check_1904(SendData,mask,Check_Str,0,1);
        _TestWaitForTesterConfirmation("停止转动方向盘,并恢复传感器连接");
        _Temp_For_1904_Clear(Pos_1904);
        _Power_Down();
        testWaitForTimeout(1000);
        _Power_Up();
        if(Session != defsession)
          _SetSession(Session);
        testWaitForTimeout(CAN_Init_Time);
      }
    }
    else
    {
      _Get_Ready();
      if(Engine_State == 0)
        _Set_Ready(Struct_Ready.Ready_Active);
      _TestWaitForTesterConfirmation("向左匀速转动方向盘直到提示停止");
      _Temp_For_1904_Set(Pos_1904,ID,Data_Send);
      _Check_1904(SendData,mask,Check_Str,_Get_Signal(mixArray[Possion].Sig_Name[0]),0);
      _TestWaitForTesterConfirmation("停止转动方向盘");
      /****************故障恢复并清除故障****************/
      _Temp_For_1904_Clear(Pos_1904);
      _TestWaitForTesterConfirmation("向右匀速转动方向盘直到提示停止");
      _Close_One_Node(DTC_19[Pos_1904]);
      _Send_Diag(6,ID,Data_Send);
      _Check_1904(SendData,mask,Check_Str,_Get_Signal(mixArray[Possion].Sig_Name[0]),0);
      _TestWaitForTesterConfirmation("停止转动方向盘");
      /****************故障恢复并清除故障****************/
      _Temp_For_1904_Clear(Pos_1904);
      mask = DTC_19[Pos_1904][2];
      _TestWaitForTesterConfirmation("拔掉传感器并匀速转动方向盘");
      _Temp_For_1904_Clear(Pos_1904);
      _Check_1904(SendData,mask,Check_Str,_Get_Signal(mixArray[Possion].Sig_Name[0]),1);
      _TestWaitForTesterConfirmation("停止转动方向盘,并恢复传感器连接");
      _Temp_For_1904_Clear(Pos_1904);
      _Power_Down();
      testWaitForTimeout(1000);
      _Power_Up();
      if(Session != defsession)
        _SetSession(Session);
      testWaitForTimeout(CAN_Init_Time);
    }
    }
    else
      _WriteEx_and_Report("","输入值为全0情况下跳过测试");
  }
  else if(strncmp(Check_Str_,"TORQUE",strlen(Check_Str_)) == 0)
  {
    if(_Check_mixArray_SetValue(Check_Str,Possion)==1)
    {
    _Get_Signal(mixArray[Possion].Sig_Name[0]);
    if(Signal_Flage == 1)
    {
      _WriteEx_and_Report("","无法获取到准确的力矩信号,无法获取到正确的判断值,控制力矩时需注意误差范围");
      snprintf(comment,elCount(comment),"%s","");
      snprintf(comment,elCount(comment),"向左控制手力矩为 + %.1fNm并保持,直到提示松开方向",mixArray[Possion].Vaule_Set[0]);
      _TestWaitForTesterConfirmation(comment);
      _Temp_For_1904_Set(Pos_1904,ID,Data_Send);
      mask = DTC_19[Pos_1904][2];
      _Check_1904(SendData,mask,Check_Str,mixArray[Possion].Vaule_Set[0],0);   
      _TestWaitForTesterConfirmation("松开方向盘");
      _Temp_For_1904_Clear(Pos_1904);
      snprintf(comment,elCount(comment),"%s","");
      snprintf(comment,elCount(comment),"向左控制手力矩为 - %.1fNm并保持,直到提示松开方向",mixArray[Possion].Vaule_Set[0]);
      _TestWaitForTesterConfirmation(comment);
      _Temp_For_1904_Set(Pos_1904,ID,Data_Send);
      _Check_1904(SendData,mask,Check_Str,mixArray[Possion].Vaule_Set[0]*(-1),0);
      _TestWaitForTesterConfirmation("松开方向盘");
      _Temp_For_1904_Clear(Pos_1904);
      _TestWaitForTesterConfirmation("向左控制手力矩为 %.1f",mixArray[Possion].DID_Value_max);
      _Temp_For_1904_Set(Pos_1904,ID,Data_Send);
      _Check_1904(SendData,mask,Check_Str,mixArray[Possion].DID_Value_max,0);
      _TestWaitForTesterConfirmation("松开方向盘");
      _Temp_For_1904_Clear(Pos_1904);
      _TestWaitForTesterConfirmation("向右控制手力矩为 %.1f",mixArray[Possion].DID_Value_min);
      _Temp_For_1904_Set(Pos_1904,ID,Data_Send);
      _Check_1904(SendData,mask,Check_Str,mixArray[Possion].DID_Value_min,0);
      _TestWaitForTesterConfirmation("松开方向盘");
      _Temp_For_1904_Clear(Pos_1904);
      _TestWaitForTesterConfirmation("向左控制手力矩为 %.1f",mixArray[Possion].DID_Value_max+1);
      _Temp_For_1904_Set(Pos_1904,ID,Data_Send);
      _Check_1904(SendData,mask,Check_Str,mixArray[Possion].DID_Value_max,0);
      _TestWaitForTesterConfirmation("松开方向盘");
      _Temp_For_1904_Clear(Pos_1904);
      _TestWaitForTesterConfirmation("向右控制手力矩为 %.1f",mixArray[Possion].DID_Value_min-1);
      _Temp_For_1904_Set(Pos_1904,ID,Data_Send);
      _Check_1904(SendData,mask,Check_Str,mixArray[Possion].DID_Value_min,0);
      _TestWaitForTesterConfirmation("松开方向盘");
      _Temp_For_1904_Clear(Pos_1904);
      _TestWaitForTesterConfirmation("向右控制手力矩为 -2Nm,并断开传感器");
      _Temp_For_1904_Set(Pos_1904,ID,Data_Send);
      _Check_1904(SendData,mask,Check_Str,-2,1);
      _TestWaitForTesterConfirmation("松开方向盘,并恢复传感器");
      _Temp_For_1904_Clear(Pos_1904);
      _Power_Down();
      testWaitForTimeout(1000);
      _Power_Up();
      if(Session != defsession)
        _SetSession(Session);
      testWaitForTimeout(CAN_Init_Time);
    }
    else
    {
      snprintf(comment,elCount(comment),"%s","");
      snprintf(comment,elCount(comment),"向左控制手力矩为 + %.1fNm并保持,直到提示松开方向",mixArray[Possion].Vaule_Set[0]);
      _TestWaitForTesterConfirmation(comment);
      _Temp_For_1904_Set(Pos_1904,ID,Data_Send);
      mask = DTC_19[Pos_1904][2];
      _Check_1904(SendData,mask,Check_Str,_Get_Signal(mixArray[Possion].Sig_Name[0]),0);
      _TestWaitForTesterConfirmation("松开方向盘");
      _Temp_For_1904_Clear(Pos_1904);
      snprintf(comment,elCount(comment),"%s","");
      snprintf(comment,elCount(comment),"向左控制手力矩为 - %.1fNm并保持,直到提示松开方向",mixArray[Possion].Vaule_Set[0]);
      _TestWaitForTesterConfirmation(comment);
      _Temp_For_1904_Set(Pos_1904,ID,Data_Send);
      _Check_1904(SendData,mask,Check_Str,_Get_Signal(mixArray[Possion].Sig_Name[0]),0);
      _TestWaitForTesterConfirmation("松开方向盘");
      _Temp_For_1904_Clear(Pos_1904);
      _TestWaitForTesterConfirmation("向左控制手力矩为 %.1f",mixArray[Possion].DID_Value_max);
      _Temp_For_1904_Set(Pos_1904,ID,Data_Send);
      _Check_1904(SendData,mask,Check_Str,_Get_Signal(mixArray[Possion].Sig_Name[0]),0);
      _TestWaitForTesterConfirmation("松开方向盘");
      _Temp_For_1904_Clear(Pos_1904);
      _TestWaitForTesterConfirmation("向右控制手力矩为%.1f",mixArray[Possion].DID_Value_min);
      _Temp_For_1904_Set(Pos_1904,ID,Data_Send);
      _Check_1904(SendData,mask,Check_Str,_Get_Signal(mixArray[Possion].Sig_Name[0]),0);
      _TestWaitForTesterConfirmation("松开方向盘");
      _Temp_For_1904_Clear(Pos_1904);
      _TestWaitForTesterConfirmation("向左控制手力矩为 %.1f",mixArray[Possion].DID_Value_max+1);
      _Temp_For_1904_Set(Pos_1904,ID,Data_Send);
      _Check_1904(SendData,mask,Check_Str,_Get_Signal(mixArray[Possion].Sig_Name[0]),0);
      _TestWaitForTesterConfirmation("松开方向盘");
      _Temp_For_1904_Clear(Pos_1904);
      _TestWaitForTesterConfirmation("向右控制手力矩为 %.1f",mixArray[Possion].DID_Value_min-1);
      _Temp_For_1904_Set(Pos_1904,ID,Data_Send);
      _Check_1904(SendData,mask,Check_Str,_Get_Signal(mixArray[Possion].Sig_Name[0]),0);
      _TestWaitForTesterConfirmation("松开方向盘");
      _Temp_For_1904_Clear(Pos_1904);
      _TestWaitForTesterConfirmation("向右控制手力矩为 -2Nm,并断开传感器");
      _Temp_For_1904_Set(Pos_1904,ID,Data_Send);
      _Check_1904(SendData,mask,Check_Str,_Get_Signal(mixArray[Possion].Sig_Name[0]),1);
      _TestWaitForTesterConfirmation("松开方向盘,并恢复传感器");
      _Temp_For_1904_Clear(Pos_1904);
      _Power_Down();
      testWaitForTimeout(1000);
      _Power_Up();
      if(Session != defsession)
        _SetSession(Session);
      testWaitForTimeout(CAN_Init_Time);
    }
    }
    else
      _WriteEx_and_Report("","输入值为全0情况下跳过测试");
  }
  else if((strncmp(Check_Str_,"CARSPD",strlen(Check_Str_)) == 0) || (strncmp(Check_Str_,"VEHICLESPEED",strlen(Check_Str_)) == 0))
  {
    if(_Check_mixArray_SetValue(Check_Str,Possion)==1)
    {
    _Set_CarSpd(100);
    _WriteEx_and_Report("","制造故障");
    _Temp_For_1904_Set(Pos_1904,ID,Data_Send);
    mask = DTC_19[Pos_1904][2];
    _Check_1904(SendData,mask,Check_Str,100,0);
    _WriteEx_and_Report("","故障恢复并清除");
    _Temp_For_1904_Clear(Pos_1904);
    _WriteEx_and_Report("","设置车速为理论最大值");
    _Set_CarSpd(mixArray[Possion].DID_Value_max);
    testWaitForTimeout(3000);
    _Temp_For_1904_Set(Pos_1904,ID,Data_Send);
    _Check_1904(SendData,mask,Check_Str,mixArray[Possion].DID_Value_max,0);
    _Temp_For_1904_Clear(Pos_1904);
    _WriteEx_and_Report("","设置车速大于理论最大值");
    _Set_CarSpd(mixArray[Possion].DID_Value_max+2);
    testWaitForTimeout(3000);
    _Temp_For_1904_Set(Pos_1904,ID,Data_Send);
    _Check_1904(SendData,mask,Check_Str,mixArray[Possion].DID_Value_max,0);
    _Temp_For_1904_Clear(Pos_1904);
    _WriteEx_and_Report("","设置车速恢复正常范围");
    _Set_CarSpd(60);
    testWaitForTimeout(3000);
    _TestDisableMsg(mixArray[Possion].Sig_Name_Node);
    testWaitForTimeout(3000);
    _Temp_For_1904_Set(Pos_1904,ID,Data_Send);
    if(mixArray[Possion].Invalid == -1)
      _Check_1904(SendData,mask,Check_Str,60,0);
    else
      _Check_1904(SendData,mask,Check_Str,60,1);
    _TestEnableMsg(mixArray[Possion].Sig_Name_Node);
    testWaitForTimeout(3000);
    _Temp_For_1904_Clear(Pos_1904);
    _Set_CarSpd(80);
    testWaitForTimeout(2000);
    _K15_OFF();
    _Close_One_Node(DTC_19[Pos_1904]);
    testWaitForTimeout(1000);
    _Open_One_Node(DTC_19[Pos_1904]);
    testWaitForTimeout(1000);
    _K15_ON();
    testWaitForTimeout(CAN_Init_Time);
    _Send_Diag(6,ID,Data_Send);
    _Check_19_NoFreeze(SendData,Check_Str);
    _Temp_For_1904_Set(Pos_1904,ID,Data_Send);
    _Check_1904(SendData,mask,Check_Str,80,0);
    _Temp_For_1904_Clear(Pos_1904);
    _Set_CarSpd(120);
    testWaitForTimeout(1000);
    _Set_CarSpd_Invalid(Struct_CarSpd.Invalid_Value[0]);
    _Temp_For_1904_Set(Pos_1904,ID,Data_Send);
    if(mixArray[Possion].Invalid == -1)
      _Check_1904(SendData,mask,Check_Str,120,0);
    else
      _Check_1904(SendData,mask,Check_Str,120,1);
    _Reset_CarSpd_Invalid();
    _Set_CarSpd(0);
    _Temp_For_1904_Clear(Pos_1904);
    }
    else
      _WriteEx_and_Report("","输入值为全0情况下跳过测试");
  }
  else
    _WriteEx_and_Report(Check_Str,"未查询到对应的操作流程,待后续完善");
}
/*
  设置1904步骤中数据操作
    Type < 0x10:取第0-3组数据,用于1904操作,设置对应组数据
    Type = oxFF:使用无效值
    暂不使用 - Type ≥ 0x10:取 Type-0x10组数据,用于功能22DID操作,设置对应组数据
*/
 int _Step_1904(char str[],dword Type) //取第0-3组数据
{
  int n;
  int Sw_temp,Step_Flage;
  int Step_Flage_From;
  char str_T[500];
  char Te[500];
  snprintf(str_T,elCount(str_T),"%s","");
  snprintf(str_T,elCount(str_T),"%s",str);
  snprintf(Te,elCount(Te),"%s","");
  Step_Flage_From = 0;
  if(Type<0x10 || Type == 0xFF)
  {
    Sw_temp = _Check_StrPossion_Res(str,1); //检测字符串是否在预期输入中
    Step_Flage = -1;
    if(Sw_temp!= -1) 
      Step_Flage = _Check_mixArray_SetValue(str,Sw_temp); //判断是否跳过测试
  }
  _Str_Upper(str_T);
  snprintf(Te,elCount(Te),"%s","");
  if(Type == 0xFF)
    Step_Flage = 1;
  if(Sw_temp!= -1 && Step_Flage == 1)
  {
    if(((strncmp(str_T,"BATTERY",strlen(str_T)) == 0) || (strncmp(str_T,"VOLTAGE",strlen(str_T)) == 0)) )
    {
      _Set_Battery(mixArray[Sw_temp].Vaule_Set[Type]);
      mixArray[Sw_temp].Vaule_Ex = mixArray[Sw_temp].Vaule_Set[Type];
      mixArray[Sw_temp].Step_Flage = 1;
      mixArray[Sw_temp].Vaule_Ex_2[Type] = mixArray[Sw_temp].Vaule_Set[Type];
      return 0;
    }
    else if(((strncmp(str_T,"CARSPD",strlen(str_T)) == 0) || (strncmp(str_T,"VEHICLESPEED",strlen(str_T)) == 0)))
    {
      if(Type == 0xFF && Flage_SaveData_Geely == 1)
        _Set_Sig(mixArray[Sw_temp].Sig_Name[0],453.6);
      else
      {
        _Set_Sig(mixArray[Sw_temp].Sig_Name[0],mixArray[Sw_temp].Vaule_Set[Type]);
        mixArray[Sw_temp].Vaule_Ex = mixArray[Sw_temp].Vaule_Set[Type];
        mixArray[Sw_temp].Step_Flage = 1;
        mixArray[Sw_temp].Vaule_Ex_2[Type] = mixArray[Sw_temp].Vaule_Set[Type];
      }
      return 0;
    }
    else if((strncmp(str_T,"READY_STATE",strlen(str_T)) == 0 ) || (strncmp(str_T,"USGMODE",strlen(str_T)) == 0 ))
    {
      if(Type == 0xFF && Flage_SaveData_Geely == 1)
        _Set_Sig(mixArray[Sw_temp].Sig_Name[0],0x0F);
      else
      {
        _Set_Sig(mixArray[Sw_temp].Sig_Name[0],mixArray[Sw_temp].Vaule_Set[Type]);
        mixArray[Sw_temp].Vaule_Ex = mixArray[Sw_temp].Vaule_Set[Type];
        mixArray[Sw_temp].Step_Flage = 1;
        mixArray[Sw_temp].Vaule_Ex_2[Type] = mixArray[Sw_temp].Vaule_Set[Type];
      }
      return 0;
    }
    else if(strncmp(str_T,"ANGLE",strlen(str_T)) == 0 )
    {
      _Get_Ready();
      if(Engine_State == 0)
        _Set_Ready(Struct_Ready.Ready_Active);
      {
        snprintf(Te,elCount(Te),"转动方向盘到 %.1f°",mixArray[Sw_temp].Vaule_Set[Type]);
        _TestWaitForTesterConfirmation(Te);
        mixArray[Sw_temp].Vaule_Ex = mixArray[Sw_temp].Vaule_Set[Type];
        mixArray[Sw_temp].Step_Flage = 1;
        mixArray[Sw_temp].Vaule_Ex_2[Type] = mixArray[Sw_temp].Vaule_Set[Type];
      }
      if(Engine_State == 0)
        _Set_Ready(Engine_State);
      return 0;
    }
    else if(strncmp(str_T,"LOCALTIME",strlen(str_T)) == 0)
    {
      if(Type == 0xFF)
        snprintf(Te,elCount(Te),"100/0/0_24:60:60");
      else
        snprintf(Te,elCount(Te),"%s",mixArray[Sw_temp].LocalTime_Set[Type]);
      _WriteEx_and_Report("   设置LocalTime",Te);
      mixArray[Sw_temp].Step_Flage = 1;
      _Set_Time(Te,1);
      testWaitForTimeout(1000);
      if( Type!= 0xFF) 
        snprintf(mixArray[Sw_temp].LocalTime_Value_2[Type],elCount(mixArray[Sw_temp].LocalTime_Value_2[Type]),"%s",mixArray[Sw_temp].LocalTime_Value);
      return 0;
    }
    if(Step_Flage_From == 0)
    {
      for(n=0;n<mixArray_Len;n++)
      {
        if(strncmp(str,mixArray[n].Str_DID_1904,strlen(str)) == 0 )
        {
          _Check_ID_(mixArray[n].Sig_Name_Node);
          if(Canoe_Node_Flage == 1)
          {
            if(Type == 0xFF && Flage_SaveData_Geely == 1)
            {
              if((strncmp(str_T,"ECU_VOLTAGE",strlen(str_T))==0) || (strncmp(str_T,"MAIN_ECU_VOLTAGE_SUPPLY",strlen(str_T))==0))
                _Set_Sig(mixArray[n].Sig_Name[0],25.5);
              else if((strncmp(str_T,"MILEAGE",strlen(str_T))==0) || (strncmp(str_T,"TOTALDISTANCE",strlen(str_T))==0))
                _Set_Sig(mixArray[n].Sig_Name[0],2000016);
              else if(strncmp(str_T,"GLOBAL_REAL_TIME",strlen(str_T))==0)
                _Set_Sig(mixArray[n].Sig_Name[0],429496729.5);
              else if(strncmp(str_T,"POWER_LEV",strlen(str_T))==0)
              {
                _Set_Sig(PwrLvlElecMai_Sig,0x06);
                _Set_Sig(PwrLvlElecSubtyp_Sig,0x06);
              }
            }
            else
            {
              if(strncmp(str_T,"POWER_LEV",strlen(str_T))==0 && Flage_SaveData_Geely == 1)
              {
                _Set_Sig(PwrLvlElecMai_Sig,((int)mixArray[Sw_temp].Vaule_Set[Type])>>4);
                _Set_Sig(PwrLvlElecSubtyp_Sig,((int)mixArray[Sw_temp].Vaule_Set[Type])&0x0F);
              }
              else
                _Set_Sig(mixArray[n].Sig_Name[0],mixArray[Sw_temp].Vaule_Set[Type]);
              mixArray[Sw_temp].Vaule_Ex = mixArray[Sw_temp].Vaule_Set[Type];
            }
            mixArray[Sw_temp].Step_Flage = 1;
            testWaitForTimeout(100);
            if( Type!= 0xFF) //Group_Count>1 &&
              mixArray[Sw_temp].Vaule_Ex_2[Type] = mixArray[Sw_temp].Vaule_Set[Type];
            return 0;
          }
        }
      }
    }
  }
  else if(Step_Flage == 0)
  {
    mixArray[Sw_temp].Step_Flage = -1;
    _WriteEx_and_Report(str,"输入值为全0,跳过测试");
    return -1;
  }
  {
    mixArray[Sw_temp].Step_Flage = -1;
    _WriteEx_and_Report(str,"未查询到对应的操作流程,待后续完善");
    return -1;
  }
}

int _Step_1904_(char str[],dword Type,dword Tar) //取第0-3组数据(用于多组快照,把指定组数据赋给指定的其他组)
{
  int n;
  int Sw_temp;
  char Te[500];
  char Tem_St[500];
  Sw_temp = _Check_StrPossion_Res(str,1);
  snprintf(Te,elCount(Te),"%s","");
  snprintf(Tem_St,elCount(Tem_St),"%s","");
  snprintf(Tem_St,elCount(Tem_St),"%s",str);
  _Str_Upper(Tem_St);
  if(strncmp(Tem_St,"LOCALTIME",strlen(Tem_St)) == 0 && Sw_temp!= -1)
  {
    // if(Group_Count>1)
    // {
      _Set_Time(mixArray[Sw_temp].LocalTime_Value_Set[Type],0);
      snprintf(mixArray[Sw_temp].LocalTime_Value_2[Tar],elCount(mixArray[Sw_temp].LocalTime_Value_2[Tar]),"%s",mixArray[Sw_temp].LocalTime_Value);
    // }
    return 0;
  }
  else if(Sw_temp!= -1)
  {
    // if(Group_Count>1)
      mixArray[Sw_temp].Vaule_Ex_2[Tar] = mixArray[Sw_temp].Vaule_Set[Type];
    return 0;
  }
  for(n=0;n<mixArray_Len;n++)
  {
    if(strncmp(Tem_St,mixArray[n].Str_DID_1904,strlen(Tem_St)) == 0 && Sw_temp!= -1)
    {
      _Check_ID_(mixArray[n].Sig_Name_Node);
      if(Canoe_Node_Flage == 1)
      {
        // if(Group_Count>1)
          mixArray[Sw_temp].Vaule_Ex_2[Tar] = mixArray[Sw_temp].Vaule_Set[Type];
        return 0;
      }
    }
  }
  return -1;
}
/// <Node>
/*
  Type = 1:设置时间参数
  Type = 0：仅获取转换后的时间值
*/
 _Set_Time(char Str[],byte Type)
{
  char Temp_Str[100];
  char Temp_Str_[100];
  dword Value_Time[6];   //    Year/Month/Day_Hour:Minutes:Second
  int Swhere_0;
  int Cou;
  int i,j;
  int  Possion_Temp;
  int  Possion_Temp_1;
  Swhere_0 = 0; Cou = 0;
  snprintf(Temp_Str,elCount(Temp_Str),"%s","");
  snprintf(Temp_Str_,elCount(Temp_Str_),"%s","");
  snprintf(Time_TempForSave,elCount(Time_TempForSave),"%s","");
  Possion_Temp = _Check_StrPossion_Res("LocalTime",1);
  if(Possion_Temp!= -1)
    snprintf(mixArray[Possion_Temp].LocalTime_Value,elCount(mixArray[Possion_Temp].LocalTime_Value),"%s","");
  for(i=0;i<strlen(Str);i++)
  {
    if(Str[i]==47)//   '/'
    {
      if(Cou==0)
        Value_Time[0] = atol(Temp_Str);
      else 
        Value_Time[1] = atol(Temp_Str);
      Cou++;
      snprintf(Temp_Str,elCount(Temp_Str),"%s","");
    }
    else if(Str[i]==95)//   '_'
    {
      Value_Time[2] = atol(Temp_Str);
      Cou = 0;
      snprintf(Temp_Str,elCount(Temp_Str),"%s","");
    }
    else if(Str[i]==58) //   ':'
    {
      if(Cou==0)
        Value_Time[3] = atol(Temp_Str);
      else 
      {
        Value_Time[4] = atol(Temp_Str);
        for(j=i+1;j<strlen(Str);j++)
          snprintf(Temp_Str_,elCount(Temp_Str_),"%s%c",Temp_Str_,Str[j]);
        Value_Time[5] = atol(Temp_Str_);
        snprintf(Temp_Str_,elCount(Temp_Str_),"%s","");
      }
      Cou++;
      snprintf(Temp_Str,elCount(Temp_Str),"%s","");
    }
    else
      snprintf(Temp_Str,elCount(Temp_Str),"%s%c",Temp_Str,Str[i]);
  }
  for(i=0;i<6;i++)
  {
    snprintf(Temp_Str,elCount(Temp_Str),"%s","");
    if(i==0)
      snprintf(Temp_Str,elCount(Temp_Str),"%s","year");
    else if(i==1)
      snprintf(Temp_Str,elCount(Temp_Str),"%s","month");
    else if(i==2)
      snprintf(Temp_Str,elCount(Temp_Str),"%s","day");
    else if(i==3)
      snprintf(Temp_Str,elCount(Temp_Str),"%s","hour");
    else if(i==4)
      snprintf(Temp_Str,elCount(Temp_Str),"%s","minute");
    else if(i==5)
      snprintf(Temp_Str,elCount(Temp_Str),"%s","second");
    Swhere_0 = _Check_StrPossion(Temp_Str,Possion_Temp,0);
    if(Swhere_0 == -1)
    {
//      _WriteEx_and_Report(Temp_Str,"未查询到该信号");
    }
    else
    {
      if(Type == 1)
      {
        snprintf(Temp_Str,elCount(Temp_Str),"%s","");
        snprintf(Temp_Str,elCount(Temp_Str),"EV_%s",mixArray[Possion_Temp].Sig_Name[Swhere_0]);
        setSignal(mixArray[Possion_Temp].Sig_Name[Swhere_0],Value_Time[i]);
        putValue(Temp_Str,Value_Time[i]);
      }
      snprintf(Temp_Str,elCount(Temp_Str),"%s","");
      snprintf(Temp_Str,elCount(Temp_Str),"%d",Value_Time[i]);
      if(strlen(Temp_Str)<2)
        snprintf(Temp_Str,elCount(Temp_Str),"%c%s",'0',Temp_Str);
      snprintf(mixArray[Possion_Temp].LocalTime_Value,elCount(mixArray[Possion_Temp].LocalTime_Value),"%s%s",mixArray[Possion_Temp].LocalTime_Value,Temp_Str);
      snprintf(Time_TempForSave,elCount(Time_TempForSave),"%s%s",Time_TempForSave,Temp_Str);
    }
  }
}
_ALL_DTC_Add(dword Da)
{
  int n;
  if(Da == 0)
    return;
  for(n=0;n<ALL_DTC_Num;n++)
  {
    if(ALL_DTC[n] == Da)
      break;
  }
  if(n==ALL_DTC_Num)
  {
    ALL_DTC[n] = Da;
    ALL_DTC_Num = ALL_DTC_Num+1;
  }
}

int _Check_Dword_in_Num(qword Da,qword Data[],int Len)//检测数据是否在整形数组中
{
  int flage,n;
  flage = -1;
  for(n=0;n<Len;n++)
  {
    if(Da==Data[n])
    {
      flage = n;
      break;
    }
  }
  return flage;
}
int _Check_Dword_in_Num(dword Da,dword Data[],int Len)//检测数据是否在整形数组中
{
  int flage,n;
  flage = -1;
  for(n=0;n<Len;n++)
  {
    if(Da==Data[n])
    {
      flage = n;
      break;
    }
  }
  return flage;
}
int _Check_Dword_in_Num(byte Da,byte Data[],int Len)//检测数据是否在整形数组中
{
  int flage,n;
  flage = -1;
  for(n=0;n<Len;n++)
  {
    if(Da==Data[n])
    {
      flage = n;
      break;
    }
  }
  return flage;
}
int _Check_Dword_in_Num(dword Da,dword Data[][],int Len)//检测数据是否在整形数组中
{
  int flage,n;
  flage = -1;
  for(n=0;n<Len;n++)
  {
    if(Da==Data[n][0])
    {
      flage = n;
      break;
    }
  }
  return flage;
}
int _Check_Dword_in_Num(byte Da,byte Data[][],byte Len)//检测数据是否在整形数组中
{
  int flage,n;
  flage = -1;
  for(n=0;n<Len;n++)
  {
    if(Da==Data[n][0])
    {
      flage = n;
      break;
    }
  }
  return flage;
}

// /*
//     DTC:指定被清除DTC
//     Data_1:被清除前数组
//     Data_1_Len:被清除前数组长度
//     Data_2:被清除后数组
//     Data_2_Len:被清除前数组长度
// */
// int _Check_Clear_DTC_Ex(dword DTC,dword Data_1[],dword Data_1_Len,dword Data_2[],dword Data_2_Len)  //检测14服务清除指定DTC后,其余DTC无变化
// {
//   int Return_Value,m,n;
//   dword DTC_Check;
//   Return_Value = -1;
//   for(m=0;m<Data_1_Len;m++)
//   {
//     DTC_Check = Data_1[m];
//     if(_Check_Dword_in_Num(DTC_Check,Data_2,Data_2_Len)!= -1)
//       Return_Value = 1;
//     else if( (_Check_Dword_in_Num(DTC_Check,Data_2,Data_2_Len)== -1) && DTC_Check == DTC)
//       Return_Value = 1;
//     else
//       Return_Value = -1;
//   }
//   return Return_Value;
// }

void _Ang_Calibration_()
{
  Get_value();
  diagSetTarget(Cdd_Name);
  _get_Arry("Angle_Calibration");
  if(Arry_Len>0)
  {
    _unlockECU();
    _Send_Diag(Arry_Len,phyreq_ID,Arry_Data);
  }
}
/*
    清除对中
*/
void _ClearAngle(int Type)
{
  int FunPos;
  dword RID;
  if(Type == 0)
  {
    Get_value();_Init_Struct();
    diagSetTarget(Cdd_Name);
  }
  _get_Arry("Clear_Angle_Calibration");
  if(Arry_Len>0)
  {
    RID = (Arry_Data[2]<<8)|(Arry_Data[3]);
    FunPos = _Check_Serve(0x01,RID,12);
    if(FunPos != -1)
    {
      if(Serve_31_Hex[FunPos].Security_Access[0] == 1)
        _unlockECU();
      _Send_Diag(Arry_Len,phyreq_ID,Arry_Data);
      _Check_31Routine_Rx(Arry_Data,1);
    }
  }
}

/// <Node>
/*
  获取节点所在位置
  Node 节点
  Type = 1：DTC丢失数组
*/
int Get_Node_Pos(dword Node,byte Type)
{
  int i,Return_Value;
  Return_Value = -1;
  if(Type == 1)
  {
    for(i=0;i<DTC_19_Count;i++)
    {
      if(DTC_19[i][0]==Node)
        break;
    }
    Return_Value = i;
  }
  if(Return_Value == -1)
  {
    _WriteEx_and_Report("","未查询到节点 0x%03X",Node);
    Return_Value = 0;
  }
  return Return_Value;
}
/*
  验证输入数据是否为特殊数据处理
*/
void _Clear_Config(byte Data[],byte Session)
{  
  if(strncmp(ECU_project,"BYD",strlen(ECU_project)) == 0 && strlen(ECU_project) == strlen("BYD"))
  {
    byte Clear_[0xB] = {0x2E,0xF1,0xA1,0,0,0,0,0,0,0,0x55};
    if((Data[1] == 0x21 && Data[2] == 0x00) || (Data[1] == 0xF1 && Data[2] == 0xA1))
    {
      _WriteEx_and_Report("","BYD配置字需先擦除再写入");
      _unlockECU();
      _Send_Diag(0xB,phyreq_ID,Clear_);
      _TestResult(SendData,phyreq_ID,"",-1);
      if(Session != exsession)
        _SetSession(Session);
      _WriteEx_and_Report("","擦除完成");
    }
  }
}

/// <NRC优先级>
/*---------------------------------------------NRC优先级-------------------------------*/
/*
  NRC优先级测试步骤
  Serve：服务
  Pos：子功能
  Type：获取NRC数据方式
*/
_Set_NRC_Step(byte Serve,dword Pos,byte Type,byte Send_Data[]) 
{
  int k;
  int Routine_Pos,Control_Type_Pos;
  NRC31_Count = 0;
  NRC13_Count = 0;
  NRC31_total = 0;
  NRC13_total = 0;
  Serve_31_Len4_5 = 0;
  _Get_NRC_Mapping(Serve);
  if(Serve != 0x31 && Type != 0) 
    _Check_Serve(Serve,Pos,Type); //获取NRC列表装载到Fun_NRC中
  if(Type == 0)  /*对默认会话下的10 02特殊处理*/
  {
    _get_Arry("Def_1002_NRC");
    for(k=0;k<Arry_Len;k++)
      Fun_NRC[k] = Arry_Data[k];
    Fun_NRC_Count = Arry_Len;
  }
  if(Send_Data[0] == 0x31)
  {
    byte Da_1,Da_2;
    Da_1 = (Pos>>8)&0xFF;
    Da_2 = Pos&0xFF;
    Send_Data[0] = 0x31;
    Routine_Pos = -1;
    Control_Type_Pos = -1;
    for(k=0;k<Serve_31_Hex_Count;k++)
    {
      if((Serve_31_Hex[k].Routine[0] == Da_1) && (Serve_31_Hex[k].Routine[1] == Da_2))
      {
        Routine_Pos = k;
        break;
      }
    }
    if(Routine_Pos == -1)
      return;
    for(k=0;k<Serve_31_Hex[Routine_Pos].Control_Type_Count;k++)
    {
      if(Serve_31_Hex[Routine_Pos].Control_Type[k] == Type)
      {
        Control_Type_Pos = k;
        break;
      }
    }
    Len_31H = Serve_31_Hex[Routine_Pos].Routine_Len;
    for(k=0;k< Serve_31_Hex[Routine_Pos].Serve_NRC_Count[Control_Type_Pos];k++)
      Fun_NRC[k] = Serve_31_Hex[Routine_Pos].Serve_NRC[Control_Type_Pos][k];
    Fun_NRC_Count = Serve_31_Hex[Routine_Pos].Serve_NRC_Count[Control_Type_Pos];
    Serve_31_Len4_5 = _Get_31H_Len4AndLen5(); /*检测31服务是否同时存在长度为4和5两种情况*/
  }
  else
    Send_Data[0] = Serve;
  for(k=Fun_NRC_Count-1;k>=0;k--)  //获取共多少个NRC13或NRC31
  {
    if(Fun_NRC[k]==0x13)
      NRC13_total++;
    else if(Fun_NRC[k]==0x31)
      NRC31_total++;
  }
  for(k=Fun_NRC_Count-1;k>=0;k--)
  {
    if(Send_Data[0] == 0x31)
    {
      if(Fun_NRC[k]==0x22) //31服务NRC22
      {
        if(Serve_31_NewNRC22 == 1)
          _Geely_NewNRC22(Fun_NRC[k],1);
        else
          _Set_NRC22(1,Pos,0);
      }
      else if(Fun_NRC[k]==0x31 && NRC31_total==1) //RID无效
      {
        if(Len_31H == 5 && Serve_31_Len4_5 == 1 && NRC13_total == 1)/*当出现31服务中既有长度为4又存在长度为5时,RID无效会导致NRC13*/
        {
          Send_Data[2] = Serve_31_Hex[Routine_Pos].Routine[0];
          Send_Data[3] = Serve_31_Hex[Routine_Pos].Routine[1];
          Send_Data[4] = _Get_Invalid_RID_Control_Option(Serve,Pos,Type,0);
        }
        else
        {
          Send_Data[3] = _Get_Invalid_RID();
          if(Len_31H == 5)
            Send_Data[4] = _Get_Invalid_RID_Control_Option(Serve,Pos,Type,0);
        }
      }
      else if(Fun_NRC[k]==0x31 && NRC31_Count==0 && NRC31_total==2) //RID无效
      {
        Send_Data[3] = _Get_Invalid_RID();
        NRC31_Count++;
      }
      else if(Fun_NRC[k]==0x31 && NRC31_Count==1 && NRC31_total==2) //控制选项无效
      {
        Send_Data[4] = _Get_Invalid_RID_Control_Option(Serve,Pos,Type,0);
        NRC31_Count++;
      }
      else if(Fun_NRC[k]==0x13 && NRC13_Count==0 && NRC13_total==2) //total13
      {
        Fun_NRC_Send_Len = _Get_Serve_13_Len(0x31,0,0);
        NRC13_Count++;
      }
      else if(Fun_NRC[k]==0x13 && NRC13_Count==1 && NRC13_total==2) //mini13
      {
        Fun_NRC_Send_Len = 3;
        NRC13_Count++;
      }
      else if(Fun_NRC[k]==0x13 && NRC13_total==1) //mini13
        Fun_NRC_Send_Len = 3;
      else if(Fun_NRC[k]==0x12) //子功能无效
        Send_Data[1] = _Get_Invalid_RID_Control_Type(Pos);
      else if(Fun_NRC[k]==0x33)
        NRC33_Pos = k; //NRC33所在位置
      else 
      {
        if(Serve_31_NewNRC22 == 1)
          _Geely_NewNRC22(Fun_NRC[k],1);
      }
    }
    else
    {
      if(Fun_NRC[k]==0x13 && NRC13_Count==0 && NRC13_total==2) //total13
      {
        Fun_NRC_Send_Len = _Get_Serve_13_Len(Serve,Pos,0);//遍历该服务下所有支持子功能,并返回最大长度
        NRC13_Count++;
      }
      else if(Fun_NRC[k]==0x13 && NRC13_Count==1 && NRC13_total==2) //mini13
      {
        Fun_NRC_Send_Len = _Get_Serve_13_Len(Serve,Pos,1);//遍历该服务下所有支持子功能,并返回最小长度
        NRC13_Count++;
      }
      else if(Fun_NRC[k]==0x13 && NRC13_total==1 ) //total13
        Fun_NRC_Send_Len = _Get_Serve_13_Len(Serve,Pos,0);
      else if(Fun_NRC[k]==0x12 ) //子功能无效
        Send_Data[1] = _Get_Invalid_Fun(Serve,0);
      else if(Fun_NRC[k]==0x22 ) //NRC22条件  优先执行前面的0x22条件，不执行后面（若非0x22则执行具体的NRC22操作）
        _Set_NRC22(Serve,Pos,0);
      else if(Fun_NRC[k]==0x31 && NRC31_Count==0 && NRC31_total==2 ) //NRC31条件
      {
        if(Send_Data[0] == 0x23) //子功能无效
          Send_Data[1] = _Get_Invalid_Fun(Serve,0);
        NRC31_Count++;
      }
      else if(Fun_NRC[k]==0x31 && NRC31_Count==1 && NRC31_total==2 ) //NRC31条件
      {
        int i;
        if(Send_Data[0] == 0x23)  //参数地址无效
        {
          for(i=2;i<10;i++)
            Send_Data[i] = 0;
        }
        NRC31_Count++;
      }
      else if(Fun_NRC[k]==0x31 && NRC31_total==1 ) ///NRC31条件
        _Get_Serve_NRC31(Serve,0,Send_Data);
      else
        _NRC22SpecialStep(Fun_NRC[k],0);
    }
  }
  /*清除计数防止后续执行恢复操作时报错*/
  NRC31_Count = 0;
  NRC13_Count = 0;
}
/// <NRC优先级>
/*
  新增,用于特殊NRC22处理，对输入NRC进行匹配
  NRCInput：输入NRC
  Type = 0：制造NRC22条件
  Type = 1：恢复
*/
_NRC22SpecialStep(byte NRCInput,byte Type)
{
  if(Type == 0)
  {
    if(NRCInput == CarSpd_NRC)   //车速过大
      _Set_CarSpd(NRC22_CarSpd+1);
    else if(NRCInput == CarSpd_Invalid_NRC) //车速无效
      _Set_CarSpd_Invalid(Struct_CarSpd.Invalid_Value[0]);
    else if(NRCInput == Ready_NRC)  //发动机
      _Set_Ready(Ready_NRC22);
    else if(NRCInput == Gear_NRC)  //档位
    {
      int i;
      for(i=NRC_22_Gears_Range[0];i<NRC_22_Gears_Range[1];i++)
      {
        if(i != NRC_22_Gears_Normal)
          break;
      }
      _Set_Sig(Gears_Signal,i);
    }
    else if(NRCInput == H_Battery_NRC) //高压
      _Set_Battery(NRC22_Battery_Hight);
    else if(NRCInput == L_Battery_NRC)  //低压
      _Set_Battery(NRC22_Battery_Low);
    else if(NRCInput == TasTorque_NRC)  //力矩
    {
      char Str[200];
      snprintf(Str,elCount(Str),"控制力矩满足NRC22条件,大于 %.2f Nm,并保持",NRC22_TasTorque+0.2);
      testWaitForTesterConfirmation(Str,60000);
    }
    else if(NRCInput == Sensor_NRC)  //传感器
    {
      char Str[200];
      snprintf(Str,elCount(Str),"断开传感器");
      testWaitForTesterConfirmation(Str,60000);
    }
  }
  else if(Type == 1)
  {
    if(NRCInput == CarSpd_NRC)   //车速过大
      _Set_CarSpd(0);
    else if(NRCInput == CarSpd_Invalid_NRC) //车速无效
      _Reset_CarSpd_Invalid();
    else if(NRCInput == Ready_NRC)  //发动机
    {
      if(Ready_NRC22 == Struct_Ready.Ready_Active)
        _Set_Ready(0);
      else
        _Set_Ready(Struct_Ready.Ready_Active);
    }
    else if(NRCInput == Gear_NRC)  //档位
      _Set_Sig(Gears_Signal,NRC_22_Gears_Normal);
    else if(NRCInput == H_Battery_NRC) //高压
      _Set_Battery(12);
    else if(NRCInput == L_Battery_NRC)  //低压
      _Set_Battery(12);
    else if(NRCInput == TasTorque_NRC)  //力矩
    {
      char Str[200];
      snprintf(Str,elCount(Str),"松开方向盘");
      testWaitForTesterConfirmation("松开方向盘",60000);
    }
    else if(NRCInput == Sensor_NRC)  //传感器
    {
      char Str[200];
      snprintf(Str,elCount(Str),"恢复传感器");
      testWaitForTesterConfirmation(Str,60000);
    }
  }
}
/// <NRC优先级>
_Recover_NRC_Step(byte NRC,byte Pos,dword Fun_Pos,byte Send_Data[]) // Pos为所在结构体位置
{
  dword Fun_;
  if(Send_Data[0] != 0x31)
    Fun_ = Serve_Data[Pos].Serve_Fun[Fun_Pos];
  if( NRC == 0x33 )
  {
    NRC22_Recover_Sense = 1;
    _unlockECU();
  }
  /*---------------------------31服务------------------------*/
  else if(NRC != 0x33 && Send_Data[0] == 0x31)
  {
    if( NRC == 0x13 && NRC13_total ==2 && NRC13_Count==0)
    {
      Fun_NRC_Send_Len = Len_31H +1;
      NRC13_Count++;
    }
    else if( NRC == 0x13 && NRC13_total ==2 && NRC13_Count==1)
    {
      Fun_NRC_Send_Len = Len_31H;
      NRC13_Count++;
    }
    else if( NRC == 0x13 && NRC13_total ==1)
    {
      Fun_NRC_Send_Len = Len_31H;
    }
    else if( NRC == 0x31 && NRC31_total ==1)
    {
      if(Len_31H == 5 && Serve_31_Len4_5 == 1 && NRC13_total == 1)/*当出现31服务中既有长度为4又存在长度为5时,RID无效会导致NRC13*/
        Send_Data[4] = _Get_Invalid_RID_Control_Option(Send_Data[0],Pos,0,1);
      else
      {
        Send_Data[2] = Serve_31_Hex[Pos].Routine[0];
        Send_Data[3] = Serve_31_Hex[Pos].Routine[1];
        Send_Data[4] = _Get_Invalid_RID_Control_Option(Send_Data[0],Pos,0,1);
      }
    }
    else if( NRC == 0x31 && NRC31_Count==0 && NRC31_total == 2)
    {
      Send_Data[2] = Serve_31_Hex[Pos].Routine[0];
      Send_Data[3] = Serve_31_Hex[Pos].Routine[1];
      NRC31_Count++;
    }
    else if( NRC == 0x31 && NRC31_Count==1 && NRC31_total == 2)
    {
      Send_Data[4] = _Get_Invalid_RID_Control_Option(Send_Data[0],Pos,0,1);
      NRC31_Count++;
    }
    else if( NRC == 0x12)
    {
      Send_Data[1] = Serve_31_Hex[Pos].Control_Type[0];
    }
    else if( NRC == 0x22)
    {
      if(Serve_31_NewNRC22 == 1)
        _Geely_NewNRC22(NRC,1);
      else
        _Set_NRC22(Serve_31_Hex[Pos].Control_Type[0],Fun_Pos,1);
    }
    else 
    {
      if(Serve_31_NewNRC22 == 1)
        _Geely_NewNRC22(NRC,0);
    }
  }
  /*---------------------------非31服务------------------------*/
  else if(NRC != 0x33 && Send_Data[0] != 0x31)
  {
    if( NRC == 0x13 && NRC13_total ==2 && NRC13_Count==0)
    {
      Fun_NRC_Send_Len =  _Get_Serve_13_Len(Send_Data[0],Fun_,0);
      NRC13_Count++;
    }
    else if( NRC == 0x13 && NRC13_total ==2 && NRC13_Count==1)
    {
      Fun_NRC_Send_Len =  _Get_Serve_13_Len(Send_Data[0],Fun_,2);
      NRC13_Count++;
    }
    else if( NRC == 0x13 && NRC13_total ==1)
    {
      Fun_NRC_Send_Len =  _Get_Serve_13_Len(Send_Data[0],Fun_,2);
    }
    else if( NRC == 0x31 && NRC31_total ==1)
    {
      _Get_Serve_NRC31(Send_Data[0],1,Send_Data);
    }
    else if( NRC == 0x31 && NRC31_total ==2 && NRC31_Count==0)
    {
      if(Send_Data[0] == 0x23) //子功能无效
        Send_Data[1] = _Get_Invalid_Fun(0x23,1);
      NRC31_Count++;
    }
    else if( NRC == 0x31 && NRC31_total ==2 && NRC31_Count==1)
    {
      if(Send_Data[0] == 0x23) //子功能无效
      {
        int i;
        for(i=0;i<4;i++) //默认地址占4个长度
          Send_Data[i+2] = (Struct_VBF_Addr[0].StartAddr[0]>>((4-i-1)*8)&0xFF);
        Send_Data[6] = 0;
        Send_Data[7] = 3;
      }
      NRC31_Count++;
    }
    else if( NRC == 0x12)
      Send_Data[1] = Serve_Data[Pos].Serve_Fun[Fun_Pos];
    else if( NRC == 0x24 && Send_Data[0]==0x27 )
      _get_seed(phyreq_ID);
    else if( NRC == 0x22)
      _Set_NRC22(Send_Data[0],Fun_,1);
    else if( NRC == 0x10 && Send_Data[0]==0X2E)
      _Get_Serve_NRC10(Send_Data[0],1,Fun_NRC_Send_Len,10,Send_Data);
    else
      _NRC22SpecialStep(NRC,1);
  }
}

/// <NRC优先级>
/*
  NRC优先级测试步骤
  Serve：服务
  Pos：子功能
  Type：获取NRC数据方式
*/
_Set_NRC_Special_Step(byte Serve,dword Pos,byte Type,byte Send_Data[]) 
{
  int k;
  int Routine_Pos,Control_Type_Pos;
  byte Flage,Step;
  if(Serve != 0x31 && Type != 0) 
    _Check_Serve(Serve,Pos,Type); //获取NRC列表装载到Fun_NRC中
  if(Send_Data[0] == 0x31)
  {
    byte Da_1,Da_2;
    Da_1 = (Pos>>8)&0xFF;
    Da_2 = Pos&0xFF;
    Send_Data[0] = 0x31;
    Routine_Pos = -1;
    Control_Type_Pos = -1;
    for(k=0;k<Serve_31_Hex_Count;k++)
    {
      if((Serve_31_Hex[k].Routine[0] == Da_1) && (Serve_31_Hex[k].Routine[1] == Da_2))
      {
        Routine_Pos = k;
        break;
      }
    }
    if(Routine_Pos == -1)
      return;
    for(k=0;k<Serve_31_Hex[Routine_Pos].Control_Type_Count;k++)
    {
      if(Serve_31_Hex[Routine_Pos].Control_Type[k] == Type)
      {
        Control_Type_Pos = k;
        break;
      }
    }
    Len_31H = Serve_31_Hex[Routine_Pos].Routine_Len;
    
    for(k=0;k< Serve_31_Hex[Routine_Pos].Serve_NRC_Special_Count[Control_Type_Pos];k++)
      Fun_NRC[k] = Serve_31_Hex[Routine_Pos].Serve_NRC_Special[Control_Type_Pos][k];
    Fun_NRC_Count = Serve_31_Hex[Routine_Pos].Serve_NRC_Special_Count[Control_Type_Pos];
    if(Fun_NRC_Count == 0)
    {
      _WriteEx_and_Report("","无特殊优先级输入,跳过测试");
      return;
    }
  }
  else
    Send_Data[0] = Serve;
  Flage = 0;
  Step = 0;
  if((_Check_NRC_In_31H(Pos,0,0X92) != -1) && (_Check_NRC_In_31H(Pos,0,0X93) != -1)) //两个电压同时存在
    Flage = 1;
  for(k=0;k<Fun_NRC_Count;k++)
  {
    if(Send_Data[0] == 0x31)
    {
      if((Fun_NRC[k]==0x92 || Fun_NRC[k]==0x93) && Flage == 1)
      { }
      else
        _Geely_NewNRC22(Fun_NRC[k],1);
    }
    else
    {
      
    }
  }
  /*清除计数防止后续执行恢复操作时报错*/
  NRC31_Count = 0;
  NRC13_Count = 0;
}

/// <NRC优先级>
_Recover_NRC_Special_Step(byte NRC,byte Send_Data[]) // Pos为所在结构体位置
{
  byte Flage,Step;
  dword Pos;
  Pos = ((Send_Data[2]<<8)|(Send_Data[3]));
  Flage = 0;
  Step = 0;
  if((_Check_NRC_In_31H(Pos,0,0X92) != -1) && (_Check_NRC_In_31H(Pos,0,0X93) != -1)) //两个电压同时存在
    Flage = 1;
  if( NRC == 0x33 )
  {
    NRC22_Recover_Sense = 1;
    _unlockECU();
  }
  /*---------------------------31服务------------------------*/
  else if(NRC != 0x33 && Send_Data[0] == 0x31)
  {
    if((NRC==0x92 || NRC==0x93) && Flage == 1)
    {
      if(Step == 0)
      {
        _Geely_NewNRC22(NRC,1);
        Step++;
      }
      else if(Step == 1)
        _Geely_NewNRC22(NRC,0);
    }
    else
      _Geely_NewNRC22(NRC,0);
  }
  /*---------------------------非31服务------------------------*/
  else if(NRC != 0x33 && Send_Data[0] != 0x31)
  {
    
  }
}


/// <NRC优先级>
/*
  NRC10
  Type_ = 0：制造NRC10
  Type_ = 1: 恢复
  Len_Ex 数组长度
  Check_Pos：校验位所在位置
  Data数组,装载修改值
*/

void _Get_Serve_NRC10(byte Serve,byte Type_,byte Len_Ex,byte Check_Pos,byte Data[])
{
  int Serve_Pos_;
  int Fun_;
  Serve_Pos_ = _Check_Serve(Serve,0,0);
  if(Type_ == 0)
  {
    Data[Check_Pos] = 0;
  }
  else if(Type_ == 1)
  {
    if(strncmp(ECU_project,"BYD",strlen(ECU_project)) == 0 && strlen(ECU_project) == strlen("BYD"))
    {
      int i;
      dword Temp;
      Temp = 0;
      for(i=3;i<Len_Ex-1;i++)
        Temp = (Temp + Data[i])&0xFF;
      Temp = (Temp^0x55) &0xFF;
      Data[Check_Pos] = Temp;
    }
  }
}
/// <NRC优先级>
/*
  NRC31操作
  Type_ = 0：制造NRC31
  Type_ = 1: 恢复
  Data数组,装载修改值
*/
void _Get_Serve_NRC31(byte Serve,byte Type_,byte Data[])
{
  int Serve_Pos_;
  int Fun_;
  int n;
  Serve_Pos_ = _Check_Serve(Serve,0,0);
  if(Type_ == 0)
  {
    if(Serve == 0x2E)
    {
      do{
        Fun_ = random(0XFFFF);
      }while(_Check_Serve(Serve,Fun_,4)==1);
      Data[1] = (Fun_>>8);
      Data[2] = (Fun_&0xFF);
    }
    else if(Serve == 0x22)
    {
      do{
        Fun_ = random(0XFFFF);
      }while(_Check_Serve(Serve,Fun_,4)==1);
      Data[1] = (Fun_>>8);
      Data[2] = (Fun_&0xFF);
    }
    else if(Serve == 0x28)
    {
      for(Fun_=0;Fun_<0xFF;Fun_++)
      {
        for(n=0;n<Serve_Data[Serve_Pos_].Serve_Para_Count[0];n++)
        {
          if(Fun_ == Serve_Data[Serve_Pos_].Serve_Para[0][n])
            break;
        }
        if(n==Serve_Data[Serve_Pos_].Serve_Para_Count[0])
          break;
      }
      Data[2] = Fun_;
    }
    else if(Serve == 0x19)
    {
      byte DTC_H;
      dword Range;
      DTC_H = (DTC_19[1][1]>>16);
      do{
          Range = random(0xFFFFFE);
      }while(Range<(DTC_H) || ( _Check_Dword_in_Num(Range,ALL_DTC,ALL_DTC_Num)!=-1));
      Data[2] = (Range>>16);
      Data[3] = (Range>>8);
      Data[4] = (Range&0xFF);
      do{
          DTC_H = random(0xFF);
      }while(_Check_ByteIn19(Data[1],DTC_H)!=-1);
      Data[5] = DTC_H;
    }
    else if(Serve == 0x14)
    {
      for(n=1;n<4;n++)
        Data[n] = 0;
    }
  }
  else if(Type_ == 1)
  {
    if(Serve == 0x2E)
    {
      Data[1] = (Serve_Data[Serve_Pos_].Serve_Fun[0]>>8);
      Data[2] = (Serve_Data[Serve_Pos_].Serve_Fun[0]&0xFF);
    }
    else if(Serve == 0x28)
    {
      Data[2] = Serve_Data[Serve_Pos_].Serve_Para[0][0];
    }
    else if(Serve == 0x22)
    {
      Data[1] = (Serve_Data[Serve_Pos_].Serve_Fun[0]>>8);
      Data[2] = (Serve_Data[Serve_Pos_].Serve_Fun[0]&0xFF);
    }
    else if(Serve == 0x19)
    {
      byte DTC_H,DTC_M,DTC_L;
      DTC_H = (DTC_19[1][1]>>16);
      DTC_M = (DTC_19[1][1]>>8);
      DTC_L = (DTC_19[1][1]&0xFF);
      Data[2] = DTC_H;
      Data[3] = DTC_M;
      Data[4] = DTC_L;
    }
    else if(Serve == 0x14)
    {
      for(n=1;n<4;n++)
        Data[n] = 0xFF;
    }
  }
}
/// <NRC优先级>
/*
  Type_ = 0:获取Total 13 长度
  Type_ = 1:获取Mini 13 长度
  Type_ = 2:获取正常 长度
*/
dword _Get_Serve_13_Len(byte Serve,dword Fun,byte Type_)
{
  int Return_Len;
  if(Serve != 0x31)
  {
    int Temp_Len;
    int Loop_Get_Max, Serve_Poss_,Fun_Pos_;
    Serve_Poss_ = _Check_Serve(Serve,0,0);
    Fun_Pos_ = _Check_Serve(Serve,Fun,4);
    for(Loop_Get_Max=0;Loop_Get_Max<Serve_Data[Serve_Poss_].Serve_Fun_Count;Loop_Get_Max++)
    {
      Temp_Len = Serve_Data[Serve_Poss_].Serve_Fun_Len[Loop_Get_Max];
      if(Loop_Get_Max == 0)
        Return_Len = Temp_Len;
      if(Type_ == 0)
      {
        if(Temp_Len>=Return_Len)
          Return_Len = Temp_Len;
      }
      else if(Type_ == 1)
      {
        if(Temp_Len<=Return_Len)
          Return_Len = Temp_Len;
      }
      else if(Type_ == 2)
      {
        //Return_Len = Temp_Len;
        Return_Len = Serve_Data[Serve_Poss_].Serve_Fun_Len[Fun_Pos_];
        break;
      }
    }
    if(Type_ == 0)
      Return_Len = Return_Len +1;
    else if(Type_ == 1)
      Return_Len = Return_Len -1;
    if(Type_ == 0 && Serve == 0x22)
    {
      Return_Len = (DID_22_Support+1)*2+1;
    }
    if(Type_ == 1 && Serve == 0x2E)
      Return_Len = 3;
    else if(Type_ == 0 && Serve == 0x2E)
      Return_Len = Serve_Data[Serve_Poss_].Serve_Fun_Len[Fun_Pos_]+1;
    else if(Type_ == 2 && Serve == 0x2E)
      Return_Len = Serve_Data[Serve_Poss_].Serve_Fun_Len[Fun_Pos_];
  }
  else
  {
    int Temp_Len;
    int Loop_Get_Max;
    if(Type_ == 0)
    {
      for(Loop_Get_Max = 0;Loop_Get_Max<Serve_31_Hex_Count;Loop_Get_Max++)
      {
        Temp_Len = Serve_31_Hex[Loop_Get_Max].Routine_Len;
        if(Loop_Get_Max == 0)
          Return_Len = Temp_Len;
        else
        {
          if(Temp_Len>Return_Len)
            Return_Len = Temp_Len;
        }
      }
      Return_Len +=1;
    }
  }
  return Return_Len;
}
/// <NRC优先级>
/*
    Type = 1 最大长度
    Type = 0 最小长度
*/
int Get_ServeMaxLen(byte Serve,byte Type)
{
  int Return_Len,Serve_Pos;
  int i,MinLen,MaxLen,TempLen;
  if(Serve != 0x31)
  {
    Serve_Pos = _Check_Serve(Serve,0,0);
    if(Serve_Pos == -1)
      return 0;
    for(i=0;i<Serve_Data[Serve_Pos].Serve_Fun_Count;i++)
    {
      if(i==0)
      {
        MinLen  = Serve_Data[Serve_Pos].Serve_Fun_Len[i];
        MaxLen  = Serve_Data[Serve_Pos].Serve_Fun_Len[i];
        TempLen = Serve_Data[Serve_Pos].Serve_Fun_Len[i];
      }
      else
      {
        TempLen = Serve_Data[Serve_Pos].Serve_Fun_Len[i];
        MinLen = (TempLen<=MinLen)?TempLen:MinLen;
        MaxLen = (TempLen>=MaxLen)?TempLen:MaxLen;
      }
    }
  }
  else
  {
    for(i=0;i<Serve_31_Hex_Count;i++)
    {
      if(i==0)
      {
        MinLen  = Serve_31_Hex[i].Routine_Len;
        MaxLen  = Serve_31_Hex[i].Routine_Len;
        TempLen = Serve_31_Hex[i].Routine_Len;
      }
      else
      {
        TempLen = Serve_31_Hex[i].Routine_Len;
        MinLen = (TempLen<=MinLen)?TempLen:MinLen;
        MaxLen = (TempLen>=MaxLen)?TempLen:MaxLen;
      }
    }
  }
  Return_Len = (Type == 0)?MinLen:MaxLen;
  return Return_Len;
}
/// <NRC优先级>
/*
  获取子功能
  Type_ = 0:无效子功能
  Type_ = 1:正常子功能
*/
byte _Get_Invalid_Fun(byte Serve,byte Type_)  
{
  int Loop_Get_Max,Fun_Count;
  int Serve_Poss_;
  byte Return_Fun;
  dword hash[0xffff];
  Return_Fun = 0;
  Serve_Poss_ = _Check_Serve(Serve,0,0);
  for(Fun_Count = 0;Fun_Count<Serve_Data[Serve_Poss_].Serve_Fun_Count;Fun_Count++)
  {
    hash[Serve_Data[Serve_Poss_].Serve_Fun[Fun_Count]] = 1;
  }
  
  for(Loop_Get_Max=1;Loop_Get_Max<=0xFF;Loop_Get_Max++)
  {
    if(Type_ == 0 )
    {
      if(hash[Loop_Get_Max] != 1)
      {
        Return_Fun  = Loop_Get_Max;
        break;
      }
    }
    else
    {
      if(hash[Loop_Get_Max] == 1)
      {
        Return_Fun  = Loop_Get_Max;
        break;
      }
    }
  }
  if(Serve == 0x19 && Type_ == 0)
    Return_Fun = 0x05;
  else if(Serve == 0x19 && Type_ == 1)
    Return_Fun = 0x04;
  return Return_Fun;
}
/// <NRC优先级>
/*
  获取无效的RID
*/
byte _Get_Invalid_RID()   
{
  int n,m;
  for(n=0;n<=0xFF;n++)
  {
    for(m=0;m<Serve_31_Hex_Count;m++)
    {
      if( n== Serve_31_Hex[m].Routine[1])
        break;
    }
    if(m >= Serve_31_Hex_Count)
      return n;
  }
   return 0;
}

/// <NRC优先级>
/*
  获取无效的控制类型
*/
byte _Get_Invalid_RID_Control_Type(dword Pos)  
{
  int n,m;
  int i,RID_Pos_;
  byte Data[2];
  Data[0] = (Pos>>8)&0xFF;
  Data[1] = Pos &0xFF;
  for(i=0;i<Serve_31_Hex_Count;i++)
  {
    if((Serve_31_Hex[i].Routine[0] == Data[0]) && (Serve_31_Hex[i].Routine[1] == Data[1]))
    {
      RID_Pos_ = i;
      break;
    }
  }
  Pos = RID_Pos_;
  for(n=1;n<=0xFF;n++)
  {
    for(m=0;m<Serve_31_Hex[Pos].Control_Type_Count;m++)
    {
      if(n == Serve_31_Hex[Pos].Control_Type[m])
        break;
    }
    if(m >= Serve_31_Hex[Pos].Control_Type_Count)
      return n;
  }
  return 0;
}

/// <NRC优先级>
/*
  获取控制选项
 Type = 0:获取无效的控制选项
 Type = 1:获取正常的控制选项
*/
byte _Get_Invalid_RID_Control_Option(byte Serve,dword Pos,byte Control_Ty,byte Type)  
{
  int n,m;
  int RID_Pos_,Control_Type_Pos;
  byte Data[2];
  Data[0] = (Pos>>8)&0xFF;
  Data[1] = Pos &0xFF;
  for(m=0;m<Serve_31_Hex_Count;m++)
  {
    if((Serve_31_Hex[m].Routine[0] == Data[0]) && (Serve_31_Hex[m].Routine[1] == Data[1]))
    {
      RID_Pos_ = m;
      break;
    }
  }
  for(m=0;m<Serve_31_Hex[RID_Pos_].Control_Type_Count;m++)
  {
    if(Serve_31_Hex[RID_Pos_].Control_Type[m] == Control_Ty)
      break;
  }
  Control_Type_Pos = m;
  if(m>=Serve_31_Hex[RID_Pos_].Control_Type_Count)
    Control_Type_Pos = 0;
  if(Type == 0)
  {
    for(m=0;m<0xFF;m++)
    {
      for(n=0;n<Serve_31_Hex[RID_Pos_].Control_Option_Count[Control_Type_Pos];n++)
      {
        if(m==Serve_31_Hex[RID_Pos_].Control_Option[Control_Type_Pos][n])
          break;
      }
      if(n >= Serve_31_Hex[RID_Pos_].Control_Option_Count[Control_Type_Pos])
        return m;
    }
  }
  else
  {
    return Serve_31_Hex[RID_Pos_].Control_Option[Control_Type_Pos][0];
  }
  return 0;
}
/// <NRC优先级>
/*
    检测31服务中是否同时存在长度为4和长度为5的数据
*/
byte _Get_31H_Len4AndLen5()  
{
  int m,Len_4_Flage,Len_5_Flage;
  Len_4_Flage = 0;
  Len_5_Flage = 0;
  for(m=0;m<Serve_31_Hex_Count;m++)
  {
    if(Serve_31_Hex[m].Routine_Len == 4)
      Len_4_Flage = 1;
    else if(Serve_31_Hex[m].Routine_Len == 5)
      Len_5_Flage = 1;
  }
  if(Len_4_Flage == 1 && Len_5_Flage == 1)
    return 1;
  else
    return 0;
}
/// <NRC优先级>
/*
    吉利新NRC22匹配
    Type = 1：制造NRC条件
    Type = 0：恢复
*/
int _Geely_NewNRC22(byte NRC,byte Type)
{
  int Return_Value;
  Return_Value = NRC;
  if(NRC == 0x88)
  {
    if(Type == 1)
      _Set_CarSpd(NRC22_CarSpd+1);
    else if(Type == 0)
      _Set_CarSpd(0);
  }
  else if(NRC == 0x92)
  {
    if(Type == 1)
      _Set_Battery(NRC22_Battery_Hight+0.2);
    else if(Type == 0)
      _Set_Battery(12);
  }
  else if(NRC == 0x93)
  {
    if(Type == 1)
      _Set_Battery(NRC22_Battery_Low-0.2);
    else if(Type == 0)
      _Set_Battery(12);
  }
  else if(NRC == 0xF2)
  {
    if(Type == 1)
      _Set_CarSpd_Invalid(Struct_CarSpd.Invalid_Value[0]);
    else if(Type == 0)
      _Reset_CarSpd_Invalid();
  }
  else if(NRC == 0x84)
  {
    if(Type == 1)
      _Set_Ready(0);
    else if(Type == 0)
      _Set_Ready(Struct_Ready.Ready_Active);
  }
  else if(NRC == 0x22)
  {
    /*此处暂时屏蔽工厂模式部分*/
    if(Type == 1)
    {
      if(Serve_31_NRC22 == 0)
        _Set_Ready(0);
//      else if(Serve_31_NRC22 == 1)
//        _Factory_Mode(0);
    }
    else if(Type == 0)
    {
      if(Serve_31_NRC22 == 0)
        _Set_Ready(Struct_Ready.Ready_Active);
//      else if(Serve_31_NRC22 == 1)
//        _Factory_Mode(1);
    }
  }
  return Return_Value;
}
/// <NRC优先级>
/*
  获取NRC22条件并进行设置
  Serve: 服务
  Fun：子功能
  Type = 0：满足NRC22条件
  Type = 1：恢复NRC22条件
  Type = 2：查询NRC22条件
*/
int _Set_NRC22(byte Serve, dword Fun,byte Type)
{
  int Serve_Pos_22,Fun_Pos_22,Loop_22,NRC22_Flage;
  int Temp_NRC22;
  char Str_22[50];
  NRC22_Flage = 0;
  snprintf(Str_22,elCount(Str_22),"%s","");
  Fun_Pos_22 = -1;
  Serve_Pos_22 = -1;
  if(Fun<=0xFF)
    snprintf(Str_22,elCount(Str_22),"%s0x%02X 0x%02X",Str_22,Serve,Fun);
  else
    snprintf(Str_22,elCount(Str_22),"%s0x%02X 0x%02X 0x%02X",Str_22,Serve,(Fun>>8),(Fun & 0xFF));
  if((Serve != 0x01) && (Serve != 0x03))
  {
    Serve_Pos_22 = _Check_Serve(Serve,Fun,0);
    Fun_Pos_22 = _Check_Serve(Serve,Fun,4);
    if(Serve == 0x14)
      Fun_Pos_22 = 0;
    if(Fun_Pos_22 == -1)
    {
      _WriteEx_and_Report(Str_22,"未查询到该子功能");
      return -1;
    }
    else
    {
      NRC22_Flage = Serve_Data[Serve_Pos_22].Serve_NRC22[Fun_Pos_22]; //由查询NRC序列列表改为直接获取对应的条件
      if(Type == 2)
      {
        return NRC22_Flage;  //提前结束返回，不进行操作
      }
      if(NRC22_Flage == 0)
      {
        _WriteEx_and_Report(Str_22,"未查询到NRC22条件");
        return -1;
      }
      else
      {
        Temp_NRC22 = Serve_Data[Serve_Pos_22].Serve_NRC22[Fun_Pos_22];
        if(Type == 0)//满足NRC22
        {
          if((Temp_NRC22 & 0x1) != 0)//车速
          {
            _Set_CarSpd(NRC22_CarSpd+1);
            return 1;
          }
          else if((Temp_NRC22 & 0x20) != 0 ) //发动机
          {
            _Set_Ready(Ready_NRC22);
            return 0x20;
          }
          else if((Temp_NRC22 & 0x08) != 0 ) //档位
          {
            _Set_Gears(NRC_22_Gears_Normal+1);
            return 8;
          }
          else if((Temp_NRC22 & 0x02) != 0 ) //电压
          {
            _Set_Battery(NRC22_Battery_Hight+1);
            return 2;
          }        
          else if((Temp_NRC22 & 0x10) != 0 ) //传感器
          {
            diagStartTesterPresent(Cdd_Name);
            _TestWaitForTesterConfirmation("拔掉传感器");
            diagStopTesterPresent(Cdd_Name);
            return 16;
          }
          else if((Temp_NRC22 & 0x04) != 0 ) //手力矩
          {
            diagStartTesterPresent(Cdd_Name);
            _TestWaitForTesterConfirmation("控制手力矩为 %.1f",NRC22_TasTorque+1);
            diagStopTesterPresent(Cdd_Name);
            return 4;
          }
//          else if(Serve==0x10 && Fun==0x02)
//          {
//            /*10 02预编程*/
//            return 0x80;
//          }
          else
            return 0;
        }
        else if(Type == 1)//恢复NRC22
        {
          if((Temp_NRC22 & 0x1) != 0)//车速
          {
            _Set_CarSpd(0);
            return 0;
          }
          else if((Temp_NRC22 & 0x20) != 0 ) //发动机
          {
            if(Ready_NRC22 != 0)
              _Set_Ready(0);
            else
              _Set_Ready(Struct_Ready.Ready_Active);
            return 0;
          }
          else if((Temp_NRC22 & 0x08) != 0 ) //档位
          {
            _Set_Gears(NRC_22_Gears_Normal);
            return 0;
          }
          else if((Temp_NRC22 & 0x02) != 0 )//电压
          {
            _Set_Battery(12);
            return 0;
          }
          else if((Temp_NRC22 & 0x10) != 0 ) //传感器
          {
            diagStartTesterPresent(Cdd_Name);
            _TestWaitForTesterConfirmation("恢复传感器");
            if(testWaitForTesterConfirmation("恢复传感器存在上下电及会话问题,此部分会有风险,建议手动测试,是否上下电",60000)==1)
            {
              _Power_Down();
              testWaitForTimeout(1000);
              _Power_Up();
              if(Session_BIN == 4)
                _SetSession(exsession);
              if(NRC22_Recover_Sense == 1)
              {
                _unlockECU();
                NRC22_Recover_Sense = 0; // 重新过安全访问后立即恢复值防止影响后续
              }
            }
            diagStopTesterPresent(Cdd_Name);
            return 16;
          }
          else if((Temp_NRC22 & 0x04) != 0 )//手力矩
          {
            TestWaitForTesterConfirmation("松开方向盘",10000);
            return 0;
          }
//          else if(Serve==0x10 && Fun==0x02)
//          {
//            /*10 02预编程*/
//            _Pre_Programmed();
//            return 0;
//          }
        }
      }
    }
  }
  else
  {
    byte Da_1,Da_2;
    Da_1 = (Fun>>8)&0xFF;
    Da_2 = Fun&0xFF;
    for(Loop_22=0;Loop_22<Serve_31_Hex_Count;Loop_22++)
    {
      if((Serve_31_Hex[Loop_22].Routine[0] == Da_1) && (Serve_31_Hex[Loop_22].Routine[1] == Da_2))
      {
        Fun_Pos_22 = Loop_22;
        break;
      }
    }
    if(Fun_Pos_22 == -1)
    {
      _WriteEx_and_Report("","未查询到对应RID");
      return -1;
    }
    for(Loop_22=0;Loop_22<Serve_31_Hex[Fun_Pos_22].Control_Type_Count;Loop_22++)
    {
      if(Serve_31_Hex[Fun_Pos_22].Control_Type[Loop_22] == Serve)
      {
        Serve_Pos_22 = Loop_22;
        break;
      }
    }
    if(Serve_Pos_22 == -1)
    {
      _WriteEx_and_Report("","未查询到对应控制类型");
      return -1;
    }
    NRC22_Flage = _Check_Serve(Serve,Fun,10);
    {
      Temp_NRC22 = NRC22_Flage;
      if(Type == 2)
        return Temp_NRC22;  //提前结束返回，不进行操作
      if(Temp_NRC22 == 0)
      {
        _WriteEx_and_Report("","无NRC22条件");
        return -1;
      }
      if(Type == 0)//满足NRC22
      {
        if((Temp_NRC22 & 0x1) != 0)//车速
        {
          _Set_CarSpd(NRC22_CarSpd+1);
          return 1;
        }
        else if((Temp_NRC22 & 0x20) != 0 ) //发动机
        {
          _Set_Ready(Struct_Ready.Ready_Active);
          return 0x20;
        }
        else if((Temp_NRC22 & 0x08) != 0 ) //档位
        {
          _Set_Gears(NRC_22_Gears_Normal+1);
          return 8;
        }
        else if((Temp_NRC22 & 0x02) != 0 ) //电压
        {
          _Set_Battery(NRC22_Battery_Hight+1);
          return 2;
        }
        else if((Temp_NRC22 & 0x04) != 0 ) //手力矩
        {
          diagStartTesterPresent(Cdd_Name);
          _TestWaitForTesterConfirmation("控制手力矩为 %.1f",NRC22_TasTorque+1);
          diagStopTesterPresent(Cdd_Name);
          return 4;
        }
        else if((Temp_NRC22 & 0x10) != 0 ) //传感器
        {
          diagStartTesterPresent(Cdd_Name);
          _TestWaitForTesterConfirmation("拔掉传感器");
          diagStopTesterPresent(Cdd_Name);
          return 16;
        }
      }
      else if(Type == 1)//恢复NRC22
      {
        if((Temp_NRC22 & 0x1) != 0)//车速
        {
          _Set_CarSpd(0);
          return 0;
        }
        else if((Temp_NRC22 & 0x20) != 0 ) //发动机
        {
          _Set_Ready(0);
          return 0;
        }
        else if((Temp_NRC22 & 0x08) != 0 ) //档位
        {
          _Set_Gears(NRC_22_Gears_Normal);
          return 0;
        }
        else if((Temp_NRC22 & 0x02) != 0 )//电压
        {
          _Set_Battery(12);
          return 0;
        }
        else if((Temp_NRC22 & 0x04) != 0 )//手力矩
        {
          diagStartTesterPresent(Cdd_Name);
          TestWaitForTesterConfirmation("松开方向盘",10000);
          diagStopTesterPresent(Cdd_Name);
          return 0;
        }
        else if((Temp_NRC22 & 0x10) != 0 ) //传感器
        {
          diagStartTesterPresent(Cdd_Name);
          _TestWaitForTesterConfirmation("恢复传感器");
          if(testWaitForTesterConfirmation("恢复传感器存在上下电及会话问题,此部分会有风险,建议手动测试,是否上下电",60000)==1)
          {
            _Power_Down();
            testWaitForTimeout(1000);
            _Power_Up();
            if(Session_BIN == 4)
              _SetSession(exsession);
            if(NRC22_Recover_Sense == 1)
            {
              _unlockECU();
              NRC22_Recover_Sense = 0; // 重新过安全访问后立即恢复值防止影响后续
            }
          }
          diagStopTesterPresent(Cdd_Name);
          return 16;
        }
      }
    }
  }
  return 0xFF;
}
/**********************************************************************************/
/*
  肯定响应抑制位测试(根据子功能情况确定响应状态)
*/
_Step_Serve_RSP(byte Serve,dword ID,byte session)
{
  byte Send_Data[100];
  byte ReqSeed[2];
  int i,n,Fun_Poss,len,Serve_Poss;
  byte Size_Para;
  int Count_;
  Count_ = 0;
  Serve_Poss = _Check_Serve(Serve,0,0);
  Send_Data[0] = Serve;
  ReqSeed[0] = 0x27;
  ReqSeed[1] = RequestSeed_27;
  for(i=0;i<=0xFF;i++)
  {
    Fun_Poss = _Check_Serve(Serve,i,4);
    len = 1+1;//服务+子功能
    if(Fun_Poss != -1)
    {
      if((session != defsession) && (Count_ != 0))
        _SetSession(session);
      testWaitForTimeout(1000);
      Size_Para = Serve_Data[Serve_Poss].Serve_Para_Len[Fun_Poss][0];   //子功能对应的第一个参数长度
      if( Size_Para != 0)
      {
        for(n=0;n<Size_Para;n++)
          Send_Data[len+n] = Serve_Data[Serve_Poss].Serve_Para[Fun_Poss][n];
        len = len + Serve_Data[Serve_Poss].Serve_Para_Len[Fun_Poss][0];
      }
      Send_Data[1] = i;
      if(_Check_Serve(Serve,i,9)==1)
      {
        int Resp;
        Resp = _Check_Fun_IDAndSess(Serve,i,ID,session);
        if(Resp == 0) //寻址支持但会话不支持
        {
          if(Serve == 0x10 ) //10服务特殊处理
          {
            _WriteEx_and_Report("","开始测试0x%02X肯定响应抑制位",i|0x80);
            Send_Data[1] = i|0x80;
            _Send_Diag(len,ID,Send_Data);
            _TestResult(SendData,ID,"",0x7E);  
            if(Send_Data[1]==0x82 )
            {
              byte Temp_1[4]={0x14,0xff,0xff,0xff};
              _Send_Diag(4,phyreq_ID,Temp_1);
              _TestResult(SendData,phyreq_ID,"",-1);  
            }
            if(Send_Data[1]==0x83)
            {
              _Send_Diag(2,phyreq_ID,ReqSeed);
              _TestResult(SendData,phyreq_ID,"",0x7F); 
            }
            _Send_And_Check_NowSession(ID,session);
          }
          else if(Serve == 0x11 ) //11服务特殊处理
          {
            _WriteEx_and_Report("","开始测试0x%02X肯定响应抑制位",i|0x80);
            Send_Data[1] = i|0x80;
            _Send_Diag(len,ID,Send_Data);
            _TestResult(SendData,ID,"",0x7F); 
            _Send_And_Check_NowSession(ID,session); 
          }
          else
          {
            Send_Data[1] = i|0x80;
            _Send_Diag(len,ID,Send_Data);
            _TestResult(SendData,ID,"",0x7F);
          }
        }
        else if(Resp == 1)
        {
          if(Serve == 0x10 ) //10服务特殊处理
          {
            _WriteEx_and_Report("","开始测试0x%02X肯定响应抑制位",i|0x80);
            if((session == exsession) && (i==0x02)) //10 02特殊处理,加载前提条件
            {
              if(Pre_Programmed_1002 == 1)
              {
                _Pre_Programmed();
                if( (Pre_Programmed_UnlockECU == 0) && (_Check_Serve(Serve,i,5)==1))
                  _unlockECU();
              }
              else
              {
                if(_Check_Serve(Serve,i,5)==1)
                  _unlockECU();
              }
              testWaitForTimeout(300);
            }
            
            Send_Data[1] = i|0x80;
            _Send_Diag_NoTime(len,ID,Send_Data);
            {
              diagSetP2Extended(-1);
              testWaitForDiagResponse(SendData,p2cmax);
              if(diagGetLastResponseCode(SendData)==0x78)
              {
                if((_Check_Dword_in_Num(0x10,NotNRC78_Serve,NotNRC78_Serve_Count)!=-1) && (DiagGetPrimitiveByte(SendData,1)==0x82))
                  testStepFail("","0x82收到NRC78反馈,该项目预期0x82不响应NRC78");
                testWaitForDiagResponse(SendData,p2cmax*100);
                testReportWriteDiagResponse(SendData);
                _WriteEx_and_Report("","接收到NRC78响应,后续响应判断是否为正响应");
                _TestResult(SendData,ID,"",-1); 
              }
              else
              {
                if(diagGetLastResponseCode(SendData)==0)
                  testWaitForDiagResponse(SendData,1000);
                testReportWriteDiagResponse(SendData);
                _TestResult(SendData,ID,"",0); 
              }
            }
            if(Send_Data[1] == 0x81 )
            {
              _Send_Diag(2,phyreq_ID,ReqSeed);
              _TestResult(SendData,phyreq_ID,"",0x7F);  
              _Send_And_Check_NowSession(ID,defsession);
            }
            else if(Send_Data[1] == 0x82 )
            {
              byte Temp_1[4]={0x14,0xff,0xff,0xff};
              testWaitForTimeout(1000);
              _Send_Diag(4,phyreq_ID,Temp_1);
              _TestResult(SendData,phyreq_ID,"",0x11); 
              _Send_And_Check_NowSession(ID,2); 
              _SetSession(defsession);//10 01退出编程会话
              testWaitForTimeout(2000);
            }
            else if(Send_Data[1] == 0x83 )
            {
              _Send_Diag(2,phyreq_ID,ReqSeed);
              _TestResult(SendData,phyreq_ID,"",-1);  
              _Send_And_Check_NowSession(ID,exsession);
            }
          }
          else if(Serve == 0x11 ) //11服务特殊处理
          {
            _WriteEx_and_Report("","开始测试0x%02X肯定响应抑制位",i|0x80);
            Send_Data[1] = i|0x80;
            if(Serve_Data[Serve_Poss].Security_Access[Fun_Poss]==1)
            {
              _Send_Diag(len,ID,Send_Data);
              _TestResult(SendData,ID,"",0x33);  
              _unlockECU();
            }
            _Send_Diag(len,ID,Send_Data);
            _TestResult(SendData,ID,"",0);  
            testWaitForTimeout(Wait_Time_11);
            _Send_Diag(2,phyreq_ID,ReqSeed);
            _TestResult(SendData,phyreq_ID,"",0x7F);  
            _Send_And_Check_NowSession(ID,defsession);
          }
          else
          {
            Send_Data[1] = i|0x80;
            _Send_Diag(len,ID,Send_Data);
            _TestResult(SendData,ID,"",0); 
            testWaitForTimeout(2000); 
            _Send_And_Check_NowSession(ID,defsession);
          }
        }
        else if(Resp == -1)
        {
          if(Serve == 0x10 ) //10服务特殊处理
          {
            _WriteEx_and_Report("","开始测试0x%02X肯定响应抑制位",i|0x80);
            if((session == exsession) && (i==0x02)) //10 02特殊处理,加载前提条件
            {
              if(Pre_Programmed_1002 == 1)
              {
                _Pre_Programmed();
                if( (Pre_Programmed_UnlockECU == 0) && (_Check_Serve(Serve,i,5)==1))
                  _unlockECU();
              }
              else
              {
                if(_Check_Serve(Serve,i,5)==1)
                  _unlockECU();
              }
              testWaitForTimeout(300);
            }
            Send_Data[1] = i|0x80;
            _Send_Diag(len,ID,Send_Data);
            _TestResult(SendData,ID,"",0x7E); 
            if(Send_Data[1] == 0x82 )
            {
              byte Temp_1[4]={0x14,0xff,0xff,0xff};
              testWaitForTimeout(1000);
              _Send_Diag(4,phyreq_ID,Temp_1);
              _TestResult(SendData,phyreq_ID,"",-1); 
              _Send_And_Check_NowSession(ID,session); 
            }
          }
          else if(Serve == 0x11 ) //11服务特殊处理
          {
            _WriteEx_and_Report("","开始测试0x%02X肯定响应抑制位",i|0x80);
            Send_Data[1] = i|0x80;
            _Send_Diag(len,ID,Send_Data);
            _TestResult(SendData,ID,"",0x7F); 
            _Send_And_Check_NowSession(ID,session); 
            if(session == exsession)
            {
              _Send_Diag(2,phyreq_ID,ReqSeed);
              _TestResult(SendData,phyreq_ID,"",-1);  
            }
          }
        }
        testWaitForTimeout(500);
      }
      else
      {
        _WriteEx_and_Report("","当前子功能不支持肯定响应抑制位");
        Send_Data[1] = i|0x80;
        _Send_Diag(len,ID,Send_Data);
        _TestResult(SendData,ID,"",0x12);  
        testWaitForTimeout(1000);
      }
      Count_++;
    }
  }
}
/*
  min13优先级常高于total13
  Serve ：服务
  Type_NRC ：获取NRC方式
  Type = 0:返回输入NRC中优先级较高的NRC
  Type = 1:返回输入NRC中优先级较高的NRC(用于获取NRC13,需获取前一次的发送长度)
*/
byte Response_Serve_NRC(byte Serve,byte Type_NRC,byte NRC_1,byte NRC_2,byte Type)
{
  byte NRC;
  int Serve_Pos,i,NRC_1_Pos,NRC_2_Pos,k,Len_Send;
  int Min13_Flage,Total13_Flage,Min13_Pos,Total13_Pos;
  int Count;
  NRC31_Count = 0;
  NRC13_Count = 0;
  NRC31_total = 0;
  NRC13_total = 0;
  NRC_1_Pos = -1;NRC_2_Pos = -1;
  Min13_Flage = 0;Total13_Flage = 0;
  Min13_Pos = -1;Total13_Pos = -1;
  Count = 0;
  Serve_Pos = _Check_Serve(Serve,0,0);
  if(Serve_Pos == -1)
    return -1;
  _Check_Serve(Serve,0,Type_NRC); //获取NRC列表装载到Fun_NRC中
  
  for(k=Fun_NRC_Count-1;k>=0;k--)  //获取共多少个NRC13或NRC31
  {
    if(Fun_NRC[k]==0x13)
      NRC13_total++;
    else if(Fun_NRC[k]==0x31)
      NRC31_total++;
  }
  if(Type == 1 && NRC13_total == 2)
  {
    Len_Send = DiagGetPrimitiveSize(SendData);
    if(Len_Send<= 1 + 2 + 1)
      Min13_Flage = 1;
    else
      Total13_Flage = 1;
  }
  for(i=0;i<Serve_Data[Serve_Pos].Serve_NRC_Count[0];i++)
  {
    if(Serve_Data[Serve_Pos].Serve_NRC[0][i] == 0x13 && NRC13_total == 2) //NRC13且存在min13与total13
    {
      if( Count == 0 )//min13
        Min13_Pos = i;
      else   //total13
        Total13_Pos = i;
      Count++;
    }
    if(Serve_Data[Serve_Pos].Serve_NRC[0][i]==NRC_1)
      NRC_1_Pos = i;
    if(Serve_Data[Serve_Pos].Serve_NRC[0][i]==NRC_2)
      NRC_2_Pos = i;
  }
  if(NRC_1 == 0x13)
  {
    if(Min13_Flage == 1)
      NRC_1_Pos = Min13_Pos;
    else if(Total13_Flage == 1)
      NRC_1_Pos = Total13_Flage;
  }
  if(NRC_2 == 0x13)
  {
    if(Min13_Flage == 1)
      NRC_2_Pos = Min13_Pos;
    else if(Total13_Flage == 1)
      NRC_2_Pos = Total13_Flage;
  }
/*******************已获取全部位置**************************/
  if((NRC_1_Pos != -1) && (NRC_2_Pos != -1))
  {
    if(NRC_1_Pos < NRC_2_Pos)
      NRC = NRC_1_Pos;
    else
      NRC = NRC_2_Pos;
  }
  if(NRC_1_Pos == -1)
    NRC = NRC_2_Pos;
  else if(NRC_2_Pos == -1)
    NRC = NRC_1_Pos;
  NRC = Serve_Data[Serve_Pos].Serve_NRC[0][NRC];
  return NRC;
}
/**************************************************************************************************//*
/*
  检测该子功能在当前会话及寻址方式下是否支持
  适用于对子功能进行单独判断
  Serve ： 服务
  Fun ： 子功能
  ID ： 寻址方式
  session ： 会话
*/
int _Check_Fun_IDAndSess(byte Serve,dword Fun,dword ID,byte session)  
{
  int Temp_Serve_Pos,Temp_Fun_Pos;
  byte Add,Sess;
  char Tem_Fun[20];
  Temp_Serve_Pos = _Check_Serve(Serve,Fun,0);
  Temp_Fun_Pos = _Check_Serve(Serve,Fun,4);
  snprintf(Tem_Fun,elCount(Tem_Fun),"%s","");
  if(Fun<=0xFF)
    snprintf(Tem_Fun,elCount(Tem_Fun),"0x%02X 0x%02X",Serve,Fun);
  else
    snprintf(Tem_Fun,elCount(Tem_Fun),"0x%02X 0x%02X 0x%02X",Serve,(Fun>>8),(Fun & 0xFF));
  if((Temp_Serve_Pos == -1) || (Temp_Fun_Pos) == -1)
  {
    _WriteEx_and_Report(Tem_Fun,"当前服务不支持或子功能不支持");
    return -2;
  }
  if(ID == funreq_ID)
    Add = 2;
  else if(ID == phyreq_ID)
    Add = 1;
  if(session == defsession)
    Sess = 1;
  else if(session == exsession)
    Sess = 4;
  if((Serve_Data[Temp_Serve_Pos].Serve_Addres[Temp_Fun_Pos] & Add) != 0)
  {
    if((Serve_Data[Temp_Serve_Pos].Serve_Session[Temp_Fun_Pos] & Sess) != 0)
      return 1;//该会话及寻址方式下支持该子功能
    else
      return 0; //寻址支持但会话不支持   // NRC7E
  }
  else 
  {
    _WriteEx_and_Report(Tem_Fun,"当前寻址不支持该子功能");   // NRC7F
    return -1;
  }
}
/*
  检测输入的NRC是否在预期NRC列表中
  Serve ： 服务
  Fun ： 子功能
  NRC ： 输入NRC
*/
int _Check_NRC_In_List(byte Serve,dword Fun,byte NRC)  
{
  int Temp_Serve_Pos,Temp_Fun_Pos,Return_Value;
  int n;
  Return_Value = -1;
  Temp_Serve_Pos = _Check_Serve(Serve,Fun,0);
  Temp_Fun_Pos = _Check_Serve(Serve,Fun,4);
  if((Temp_Serve_Pos == -1) || (Temp_Fun_Pos) == -1)
  {
    return -2;
  }
  else
  {
    for(n=0;n<Serve_Data[Temp_Serve_Pos].Serve_NRC_Count[Temp_Fun_Pos];n++)
    {
      if(Serve_Data[Temp_Serve_Pos].Serve_NRC[Temp_Fun_Pos][n] == NRC)
      {
        Return_Value = 1;
        break;
      }
    }
  }
  return Return_Value;
}
/*
  检测该服务在当前会话及寻址方式下是否支持
  适用于整个服务支持的寻址及会话一致的情况下
  Serve ： 服务
  ID ： 寻址方式
  session ： 会话
*/
int _Check_Serve_IDAndSess(byte Serve,dword ID,byte session)  
{
  int Temp_Serve_Pos;
  byte Add,Sess;
  char Tem_Fun[20];
  if(Serve != 0x31)
    Temp_Serve_Pos = _Check_Serve(Serve,0,0);
  snprintf(Tem_Fun,elCount(Tem_Fun),"%s","");
  snprintf(Tem_Fun,elCount(Tem_Fun),"%02X服务",Serve);
  if(Temp_Serve_Pos == -1 && Serve !=0x31)
  {
    _WriteEx_and_Report(Tem_Fun,"当前服务不支持");
    return -2;
  }
  if(ID == funreq_ID)
    Add = 2;
  else if(ID == phyreq_ID)
    Add = 1;
  if(session == defsession)
    Sess = 1;
  else if(session == exsession)
    Sess = 4;
    
  if(Serve != 0x31)
  {
    if((Serve_Data[Temp_Serve_Pos].Serve_Addres[0] & Add) != 0)
    {
      if((Serve_Data[Temp_Serve_Pos].Serve_Session[0] & Sess) != 0)
        return 1;//该会话及寻址方式下支持该服务
      else
        return 0; //寻址支持但会话不支持
    }
    else 
    {
      _WriteEx_and_Report(Tem_Fun,"当前寻址不支持该服务");
      return -1;
    }
  }
  else
  {
    if((Serve_31_Hex[0].Serve_Addres[0] & Add) != 0)
    {
      if((Serve_31_Hex[0].Serve_Session[0] & Sess) != 0)
        return 1;//该会话及寻址方式下支持该服务
      else
        return 0; //寻址支持但会话不支持
    }
    else 
    {
      _WriteEx_and_Report(Tem_Fun,"当前寻址不支持该服务");
      return -1;
    }
  }
}

/*
  检测该服务对应位置的子功能在当前会话及寻址方式下是否支持
  Serve ： 服务
  Fun_Pos 子功能所在位置
  ID ： 寻址方式
  session ： 会话
*/
int _Check_Serve_IDAndSess(byte Serve,int Fun_Pos,dword ID,byte session)  
{
  byte Add,Sess;
  char Tem_Fun[20];
  snprintf(Tem_Fun,elCount(Tem_Fun),"%s","");
  snprintf(Tem_Fun,elCount(Tem_Fun),"%02X服务",Serve);
  if(ID == funreq_ID)
    Add = 2;
  else if(ID == phyreq_ID)
    Add = 1;
  if(session == defsession)
    Sess = 1;
  else if(session == exsession)
    Sess = 4;
    
  if(Serve != 0x31)
  {
    if((Serve_Data[Fun_Pos].Serve_Addres[0] & Add) != 0)
    {
      if((Serve_Data[Fun_Pos].Serve_Session[0] & Sess) != 0)
        return 1;//该会话及寻址方式下支持该服务
      else
        return 0; //寻址支持但会话不支持
    }
    else 
    {
      _WriteEx_and_Report(Tem_Fun,"当前寻址不支持该服务");
      return -1;
    }
  }
  else
  {
    if((Serve_31_Hex[Fun_Pos].Serve_Addres[0] & Add) != 0)
    {
      if((Serve_31_Hex[Fun_Pos].Serve_Session[0] & Sess) != 0)
        return 1;//该会话及寻址方式下支持该服务
      else
        return 0; //寻址支持但会话不支持
    }
    else 
    {
      _WriteEx_and_Report(Tem_Fun,"当前寻址不支持该服务");
      return -1;
    }
  }
}

/*
    检测NRC是否在31服务对应的例程中
*/
int _Check_NRC_In_31H(dword Fun,byte Control_Type_Pos,byte NRC)
{
  int Return_Value;
  int k,Fun_Pos;
  Return_Value = -1;
  Fun_Pos = -1;
  for(k=0;k<Serve_31_Hex_Count;k++)
  {
    if((Serve_31_Hex[k].Routine[0] == (Fun>>8)) && (Serve_31_Hex[k].Routine[1] == (Fun&0xFF)))
    {
      Fun_Pos = k;
      break;
    }
  }
  if(Fun_Pos == -1)
    return -2;//未查询到RID 提前终止
  for(k=0;k<Serve_31_Hex[Fun_Pos].Serve_NRC_Special_Count[Control_Type_Pos];k++)
  {
    if(Serve_31_Hex[Fun_Pos].Serve_NRC_Special[Control_Type_Pos][k]==NRC)
    {
      Return_Value = k;
    }
  }
  return Return_Value;
}
/*
    检测服务结构体中对应的数据
    Serve ：服务
    Fun ：子功能
    type = 0:检测服务是否支持(未查询到时表明服务不支持,位置为-1返回到外层)
    type = 1:检测服务所支持的寻址方式  (适用与整个服务所有子功能支持寻址方式均一致)
    type = 2:检测服务所支持的会话      (适用与整个服务所有子功能支持寻址方式均一致)
    type = 3:检测服务是否支持肯定响应抑制位      (适用与整个服务所有子功能支持寻址方式均一致)
    type = 4:检测子功能是否支持        (不支持返回-1,支持则返回所在列表位置)
    type = 5:检测子功能是否需要安全访问      (同时需要服务和子功能)
    type = 6:检测子功能对应的NRC列表      (同时需要服务和子功能)
    type = 7:检测子功能对应的NRC22条件      (同时需要服务和子功能)
    type = 8:检测子功能对应的NRC列表      (较为特殊,指定支持31服务,Serve改为对应的控制类型,子功能改为31H结构体中RID)
    type = 9:检测子功能是否支持肯定响应抑制位   
    type = 10:检测31服务对应的RID的控制类型下NRC22条件
    type = 11:检测31服务对应的RID的控制类型下安全访问条件
    type = 12:检测31服务对应的RID所在结构体位置 (指定支持31服务,Serve改为对应的控制类型,子功能改为31H结构体中RID)
*/
int _Check_Serve(byte Serve ,dword Fun,byte type)
{
  int Return_Value,Possion_Serve,Possion_Fun;
  int Check_Fun;
  int k;
  char Common[30];
  snprintf(Common,elCount(Common),"%s","");
  snprintf(Common,elCount(Common),"0x%02X服务",Serve);
  snprintf(Common,elCount(Common),"%s0x%02X子功能",Common,Fun);
  Possion_Serve = -1;
  Possion_Fun = -1;
  Fun = (word)Fun;
  for(k=0;k<Serve_Data_Count;k++)
  {
    if(Serve_Data[k].Serve==Serve)
    {
      Possion_Serve = k;  //查询服务所在结构体位置
      break;
    }
  }
  if( (type!=0) && (Possion_Serve==-1) && (type != 8) && (type != 10)&& (type != 11)&& (type != 12))
    return -1;//未查询到服务 提前终止
  if(type == 8 || type == 10 || type == 11 || type == 12)
  {
    for(k=0;k<Serve_31_Hex_Count;k++)
    {
      if((Serve_31_Hex[k].Routine[0] == (Fun>>8)) && (Serve_31_Hex[k].Routine[1] == (Fun&0xFF)))
      {
        Possion_Serve = k;
        break;
      }
    }
    if(Possion_Serve == -1)
      return -1;//未查询到RID 提前终止
    for(k=0;k<Serve_31_Hex[Possion_Serve].Control_Type_Count;k++)
    {
      if(Serve == Serve_31_Hex[Possion_Serve].Control_Type[k])
      {
        Possion_Fun = k;
        break;
      }
    }
    if(Possion_Fun == -1)
      return -1;//未查询到控制类型 提前终止
  }
  else if(type == 0)
  {
    /*仅检测服务，不做其他操作*/
  }
  else
  {
    for(k=0;k<Serve_Data[Possion_Serve].Serve_Fun_Count;k++)
    {
      if(Serve_Data[Possion_Serve].Serve_Fun[k]==Fun)
      {
        Possion_Fun = k;  //查询子功能所在列表位置
        break;
      }
    }
  }
  if(Fun == 0 && type != 4)  //未输入子功能默认选择第0个子功能,当检测子功能是否支持情况时除外
    Check_Fun = 0;
  else if(Fun>0)
    Check_Fun = Possion_Fun;
  if(((type>=5 && type< 8) || type == 9 ) && Possion_Fun == -1)
  {
    _WriteEx_and_Report(Common,"子功能不支持");
    return -1;//未查询到子功能 提前终止
  }
  if(type == 8)
  {
    snprintf(Common,elCount(Common),"%s","");
    snprintf(Common,elCount(Common),"31服务 0x%X RID",Fun);
    _WriteEx_and_Report(Common,"NRC列表");
  }
  if(type==0)
    Return_Value = Possion_Serve;  //返回结构体中所在位置
  else if(type==1)
    Return_Value = Serve_Data[Possion_Serve].Serve_Addres[Check_Fun];   //  Return_Value & 检测值 != 0即表示支持该寻址
  else if(type==2)
    Return_Value = Serve_Data[Possion_Serve].Serve_Session[Check_Fun];
  else if(type==3)
    Return_Value = Serve_Data[Possion_Serve].RSP[Check_Fun];
  else if(type==4)
    Return_Value = Possion_Fun;
  else if(type==5)
    Return_Value = Serve_Data[Possion_Serve].Security_Access[Check_Fun];
  else if(type==6)
  {
    for(k=0;k< Serve_Data[Possion_Serve].Serve_NRC_Count[Check_Fun];k++)
      Fun_NRC[k] = Serve_Data[Possion_Serve].Serve_NRC[Check_Fun][k];
    Fun_NRC_Count = Serve_Data[Possion_Serve].Serve_NRC_Count[Check_Fun];
    Return_Value = 1;
  }
  else if(type==7)
  {
    Return_Value = Serve_Data[Possion_Serve].Serve_NRC22[Check_Fun];
  }
  else if(type==8)
  {
    for(k=0;k< Serve_31_Hex[Possion_Serve].Serve_NRC_Count[Possion_Fun];k++)
    {
      Fun_NRC[k] = Serve_31_Hex[Possion_Serve].Serve_NRC[Possion_Fun][k];
    }
    Fun_NRC_Count = Serve_31_Hex[Possion_Serve].Serve_NRC_Count[Possion_Fun];
    Return_Value = 1;
  }
  else if(type==9)
    Return_Value = Serve_Data[Possion_Serve].RSP[Check_Fun];
  else if(type==10)
    Return_Value = Serve_31_Hex[Possion_Serve].Serve_NRC22[Possion_Fun];
  else if(type==11)
    Return_Value = Serve_31_Hex[Possion_Serve].Security_Access[Possion_Fun];
  else if(type==12)
    Return_Value = Possion_Serve;
  
  return Return_Value;
}

/// <NRC22_Loop>
/*
  Serve : 服务
  Fun_Pos : 功能所在位置
  Add : 寻址
  Session : 会话
  Type : 0:自动化测试部分 1:手动测试
*/
_NRC22_Test_Loop(int Serve,dword Fun_Pos,dword ID,byte Session,byte Type)
{
  byte Send_Data[500];
  dword Send_Len;
  byte Tar_NRC22;
  int m,n,Auto_Loop_22,Communication,Communication_Max;
  int Serve_Pos,IsNRC22;
  char Step_Write[50];
  int Special,Loop_RSP,Flage_Rsp_In,Check_Rsp,State_UnLock;
  Special = 0;
  _Clear_SendData(Send_Data);
  Send_Data[0] = Serve;
  Loop_RSP = 1;
  Check_Rsp = 0;
  _Get_NRC_Mapping(Serve);
  snprintf(Step_Write,elCount(Step_Write),"0x%02X",Serve);
  {
    if(Serve != 0x31)
    {
      Serve_Pos = _Check_Serve(Serve,0,0);
      Send_Data[1] = Serve_Data[Serve_Pos].Serve_Fun[Fun_Pos]; // 装载子功能
      Send_Len = Serve_Data[Serve_Pos].Serve_Fun_Len[Fun_Pos]; // 装载发送长度
      Tar_NRC22 = Serve_Data[Serve_Pos].Serve_NRC22[Fun_Pos]; // 装载NRC22条件
      State_UnLock = Serve_Data[Serve_Pos].Security_Access[Fun_Pos];
      if(Serve_Data[Serve_Pos].RSP[Fun_Pos] == 1)
      {
        Loop_RSP = 2;
        Check_Rsp = 1;
      }
      snprintf(Step_Write,elCount(Step_Write),"%s 0x%02X",Step_Write,Send_Data[1]);
      if(Send_Data[0] == 0x14)
      {
        Send_Data[1] = 0xFF;Send_Data[2] = 0xFF;Send_Data[3] = 0xFF;
      }
      else if(Send_Data[0] == 0x22)
      {
        Send_Data[1] = (Serve_Data[Serve_Pos].Serve_Fun[Fun_Pos]>>8);
        Send_Data[2] = (Serve_Data[Serve_Pos].Serve_Fun[Fun_Pos]&0xFF);
        snprintf(Step_Write,elCount(Step_Write),"0x%02X 0x%02X 0x%02X",Serve,Send_Data[1],Send_Data[2]);
      }
      else if(Send_Data[0] == 0x2E)
      {
        dword Fun;
        int Fun_Pos_Ser;
        _get_2E_DID(Traversal_DID[Fun_Pos]);
        Send_Len = DID_2E_SendData_1_Len;
        Send_Data[1] = DID_2E_SendData_1[1];
        Send_Data[2] = DID_2E_SendData_1[2];
        Fun = ((Send_Data[1]<<8) | Send_Data[2]);
        Fun_Pos_Ser = _Check_Serve(Serve,Fun,4);
        Tar_NRC22 = Serve_Data[Serve_Pos].Serve_NRC22[Fun_Pos_Ser];
        snprintf(Step_Write,elCount(Step_Write),"0x%02X 0x%02X 0x%02X",Serve,Send_Data[1],Send_Data[2]);
        for(m=0;m<Send_Len;m++)
          Send_Data[m] = DID_2E_SendData_1[m];
      }
    }
    else
    {
      Send_Data[1] = Serve_31_Hex[Fun_Pos].Control_Type[0];
      Send_Data[2] = Serve_31_Hex[Fun_Pos].Routine[0];
      Send_Data[3] = Serve_31_Hex[Fun_Pos].Routine[1];
      Send_Len = Serve_31_Hex[Fun_Pos].Routine_Len;
      State_UnLock = Serve_31_Hex[Fun_Pos].Security_Access[0];
      NRC22_Loop_FunPos = Fun_Pos;
      if(Serve_31_Hex[Fun_Pos].Control_Type_RSP[0] == 1)
      {
        Loop_RSP = 2;
        Check_Rsp = 1;
      }
      Serve_31_NewNRC22 = (Serve_31_Hex[Fun_Pos].Serve_NRC_Special_Count[0] != 0)?1:0;
      snprintf(Step_Write,elCount(Step_Write),"%s 0x%02X 0x%02X 0x%02X",Step_Write,Send_Data[1],Send_Data[2],Send_Data[3]);
      if(Serve_31_Hex[Fun_Pos].Control_Option_Count[0]  != 0)
      {
        Send_Data[4] = Serve_31_Hex[Fun_Pos].Control_Option[0][0];
        snprintf(Step_Write,elCount(Step_Write),"%s 0x%02X",Step_Write,Send_Data[4]);
      }
      Tar_NRC22 = Serve_31_Hex[Fun_Pos].Serve_NRC22[0]; 
    }
    
    Flage_Rsp_In = _Check_Dword_in_Num(Serve,NRC22_Loop_Rsp,NRC22_Loop_Rsp_Count);/*判断是否检测肯定响应抑制位*/
    if(Flage_Rsp_In == -1 && NRC22_Loop_Rsp_Count!= 0)
    {
      int Rsp_In;
      Loop_RSP = 1;
      Rsp_In = _Check_Dword_in_Num(Serve,NRC22_Loop_Fun_Pos,NRC22_Loop_Fun_Pos_Count);
      if(Rsp_In!= -1)
      {
        if((NRC22_Loop_Fun_Pos[Rsp_In][2] == 1) && (Check_Rsp == 1))
          Loop_RSP = 2;
        else
          Loop_RSP = 1;
      }
    }
    
    Communication_Max = (Send_Data[0] == 0x28)?Serve_Data[Serve_Pos].Serve_Para_Count[Fun_Pos]:1;// 28服务测试所有通讯类型
    for(n=0;n<Loop_RSP;n++)
    {
      if(n==1)
      {
        Send_Data[1] = Send_Data[1]|0x80;
        _WriteEx_and_Report("","-----------------------");
        _WriteEx_and_Report(Step_Write,"肯定响应抑制位测试");
        _WriteEx_and_Report("","-----------------------");
      }
      if((Send_Data[0] == 0x10) && ((Send_Data[1]&0x0F) == 0x02))
        Special = 1;//10 02特殊处理部分
      else if(Send_Data[0] == 0x11)
        Special = 2;
      else if(Send_Data[0] == 0x28 && (((Send_Data[1]&0x0F)==0x02) || ((Send_Data[1]&0x0F)==0x03)))
        Special = 3;
      else if(Send_Data[0] == 0x85 && (Send_Data[1]&0x0F)==0x02)
        Special = 3;
      else if(Send_Data[0] == 0x31 && NRC22_Loop_Serve_31 == 1)  //遍历全部控制类型
        Special = 4;
      if(Type == 0)
      {
        Auto_Loop_22 = 4;
        if(Set_Battery_RS232 == 1)
          Auto_Loop_22=5;
        for(Communication = 0;Communication < Communication_Max; Communication++)
        {
          if(Send_Data[0] == 0x28)
            Send_Data[2] = Serve_Data[Serve_Pos].Serve_Para[Fun_Pos][Communication];
          for(m=1;m<Auto_Loop_22;m++) 
          {
            if(NRC22_Select_Count != 0 && _Check_Dword_in_Num(m,NRC22_Select,NRC22_Select_Count) == -1)
              continue;
            _SetSession(defsession);
            if(Session != defsession)
              _SetSession(exsession);    /*会话切换防止上一次干扰*/
            if(Serve == 0x31 || Serve == 0x2E)
            {
              _Send_Key(SendKey_Len,phyreq_ID,_get_seed(phyreq_ID),0);
              _TestResult(SendData,phyreq_ID,"",-1);
              Get_Seed_Flage = 1;
              if(Serve == 0x31)
              {
                int Res;
                Res = (n == 1)?0:(-1);
                _Send_Diag(Send_Len,ID,Send_Data);
                _TestResult(SendData,ID,"",Res);
                writeEx(-3,0,"优先发送一次确保正响应，后续发送检测RID结果时能够正常测试到NRC22条件");
                testWaitForTimeout(500);
              }
            }
            testWaitForTimeout(100);
            if(m==0x01)//NRC22_车速
            {
              IsNRC22 = ((Tar_NRC22 & 0x1)!=0)?1:0;
              _NRC22_CarSpd(Send_Data,Send_Len,ID,Session,Step_Write,IsNRC22,Special,n,State_UnLock);
            }
            if(m==0x02)//NRC22_档位
            {
              IsNRC22 = ((Tar_NRC22 & 0x8)!=0)?1:0;
              _NRC22_Gears(Send_Data,Send_Len,ID,Session,Step_Write,IsNRC22,Special,n,State_UnLock);
            }
            if(m==0x03)//NRC22_发动机
            {
              IsNRC22 = ((Tar_NRC22 & 0x20)!=0)?1:0;
              _NRC22_Ready(Send_Data,Send_Len,ID,Session,Step_Write,IsNRC22,Special,n,State_UnLock);
            }
            if(m==0x04)//NRC22_电压
            {
              IsNRC22 = ((Tar_NRC22 & 0x02)!=0)?1:0;
              _NRC22_Battery(Send_Data,Send_Len,ID,Session,Step_Write,IsNRC22,Special,n,State_UnLock);
            }
          }
        }
      }
      else if(Type == 1)
      {
        Auto_Loop_22 = 2;
        if(Set_Battery_RS232 == 0)
          Auto_Loop_22=3;
        for(m=0;m<Auto_Loop_22;m++)
        {
          _SetSession(defsession);
          if(Session != defsession)
            _SetSession(exsession);    /*会话切换防止上一次干扰*/
          if(Serve == 0x31)
          {
            _Send_Key(SendKey_Len,phyreq_ID,_get_seed(phyreq_ID),0);
            _TestResult(SendData,phyreq_ID,"",-1);
            Get_Seed_Flage = 1;
          }
          if(m==0)//NRC22_力矩      /*暂时屏蔽无力矩条件导致的NRC22情况下进行力矩相关测试*/
          {
            if((Tar_NRC22 & 0x02)!=0)
              _NRC22_Torque(Send_Data,Send_Len,ID,Session,Step_Write,1,Special,n,State_UnLock);
          }
          else if(m==2)//NRC22_电压    /*暂时屏蔽无电压条件导致的NRC22情况下进行力矩相关测试*/
          {
            if((Tar_NRC22 & 0x04)!=0)
              _NRC22_Battery(Send_Data,Send_Len,ID,Session,Step_Write,1,Special,n,State_UnLock);
          }
        }
      }
    }
  }
}
/// <NRC22_Loop>
/*
    自动化测试NRC22车速条件
    Send_Data：发送数据
    Send_Len：发送长度
    ID：寻址
    Session: 会话
    Step ：打印内容
    Tpye ：0:正常响应,无NRC22条件   1:响应NRC22
    Rsp:是否为肯定响应抑制位
*/
_NRC22_CarSpd(byte Send_Data[],dword Send_Len,dword ID,byte Session,char Step[],byte Tpye,int Special,int Rsp,int UnLock_State)
{
  byte Temp_NRC22_HigCar;
  byte Temp_NRC22_InCar;
  int Response;
  dword Fun;
  int Flage_31,i;
  Temp_NRC22_HigCar = CarSpd_NRC;
  Temp_NRC22_InCar = CarSpd_Invalid_NRC;
  Flage_31 = 0;
  _WriteEx_and_Report("","-----------------------");
  _WriteEx_and_Report("","NRC22_车速测试");
  _WriteEx_and_Report("","-----------------------");
  if((Send_Data[0] == 0x31) && (Serve_31_NewNRC22 == 1) && (Tpye == 1))
  {
    Fun = ((Send_Data[2]<<8) | (Send_Data[3]));
    Temp_NRC22_HigCar = (_Check_NRC_In_31H(Fun,0,0x88) != -1)?0x88 : -1;
    Temp_NRC22_InCar = (_Check_NRC_In_31H(Fun,0,0xF2) != -1)?0xF2 : -1;
    Flage_31 = 1;
  }
  Response = (Rsp == 0)? -1:0;
  if(Special == 1)
    _Other_1002();
  if(UnLock_State == 1)
  {
    if((Special != 1) || (Special==1 && Other_1002==1 && ((Unlock_1002 == 1) || ((Unlock_1002==0) && Pre_Programmed_1002==1 && Pre_Programmed_UnlockECU==1))))
      _unlockECU();
  }
  
  if(Flage_31 == 0)
  {
    _WriteEx_and_Report("步骤1","设置车速 > NRC22车速");
    _Set_CarSpd(NRC22_CarSpd+1);
    if(Tpye == 0)
    {
      _Send_Diag(Send_Len,ID,Send_Data);
      _TestResult(SendData,ID,Step,Response);
      _Special_Step(diagGetLastResponseCode(SendData),Special,Step,Session,Rsp,UnLock_State,ID);
    }
    else if(Tpye == 1)
    {
      _Send_Diag(Send_Len,ID,Send_Data);
      _TestResult(SendData,ID,Step,Temp_NRC22_HigCar);
      _Special_Step(diagGetLastResponseCode(SendData),Special,Step,Session,Rsp,UnLock_State,ID);
    }
    _WriteEx_and_Report("步骤2","设置车速 = NRC22车速");
    _Set_CarSpd(NRC22_CarSpd);
    _Send_Diag(Send_Len,ID,Send_Data);
    _TestResult(SendData,ID,Step,Response);
    _Special_Step(diagGetLastResponseCode(SendData),Special,Step,Session,Rsp,UnLock_State,ID);
    _WriteEx_and_Report("步骤3","设置车速 > NRC22车速，再丢失车速");
    _Set_CarSpd(NRC22_CarSpd+1);
    testWaitForTimeout(300);
    _TestDisableMsg(Struct_CarSpd.Sig_Id);
    testWaitForTimeout(Struct_CarSpd.Lost_Time*1.3);
    _Send_Diag(Send_Len,ID,Send_Data);
    _TestResult(SendData,ID,Step,Response);
    _Special_Step(diagGetLastResponseCode(SendData),Special,Step,Session,Rsp,UnLock_State,ID);
    _TestEnableMsg(Struct_CarSpd.Sig_Id);
    _Set_CarSpd(0);
    testWaitForTimeout(Struct_CarSpd.Lost_Time*1.3);
    _WriteEx_and_Report("步骤4","设置车速 > NRC22车速，再无效车速");
    _Set_CarSpd(NRC22_CarSpd+1);
    for(i=0;i<Struct_CarSpd.Invalid_Value_Count;i++) //无效值遍历
    {
      _Set_CarSpd_Invalid(Struct_CarSpd.Invalid_Value[i]);
      if(Special == 1)
        testWaitForTimeout(200);  /*出现仅在1002会话下车速无效故障报出时间不够问题,故此处延长200ms*/
      _Send_Diag(Send_Len,ID,Send_Data);
      if(Geely3_Flage == 1)
        _TestResult(SendData,ID,Step,Temp_NRC22_InCar);
      else
        _TestResult(SendData,ID,Step,Response);
      _Special_Step(diagGetLastResponseCode(SendData),Special,Step,Session,Rsp,UnLock_State,ID);
      _Reset_CarSpd_Invalid();
      testWaitForTimeout(500);
    }
    _Set_CarSpd(0);
    testWaitForTimeout(500);
  }
  else
  {
    _WriteEx_and_Report("步骤1","设置车速 > NRC22车速");
    _Set_CarSpd(NRC22_CarSpd+1);
    if(Tpye == 0)
    {
      _Send_Diag(Send_Len,ID,Send_Data);
      _TestResult(SendData,ID,Step,Response);
      _Special_Step(diagGetLastResponseCode(SendData),Special,Step,Session,Rsp,UnLock_State,ID);
    }
    else if(Tpye == 1)
    {
      _Send_Diag(Send_Len,ID,Send_Data);
      _TestResult(SendData,ID,Step,Temp_NRC22_HigCar);
      _Special_Step(diagGetLastResponseCode(SendData),Special,Step,Session,Rsp,UnLock_State,ID);
    }
    _WriteEx_and_Report("步骤2","设置车速 = 0车速，再丢失车速");
    _Set_CarSpd(0);
    testWaitForTimeout(100);
    _TestDisableMsg(Struct_CarSpd.Sig_Id);
    testWaitForTimeout(Struct_CarSpd.Lost_Time*1.1);
    _Send_Diag(Send_Len,ID,Send_Data);
    if(Tpye == 0)
      _TestResult(SendData,ID,Step,Response);
    else if(Tpye == 1)
      _TestResult(SendData,ID,Step,Temp_NRC22_InCar);
    _Special_Step(diagGetLastResponseCode(SendData),Special,Step,Session,Rsp,UnLock_State,ID);
    _WriteEx_and_Report("步骤3","设置车速丢失恢复，再无效车速");
    _TestEnableMsg(Struct_CarSpd.Sig_Id);
    testWaitForTimeout(Struct_CarSpd.Lost_Time*1.1);
    _Set_CarSpd_Invalid(Struct_CarSpd.Invalid_Value[0]);
    if(Special == 1)
      testWaitForTimeout(200);  /*出现仅在1002会话下车速无效故障报出时间不够问题,故此处延长200ms*/
    _Send_Diag(Send_Len,ID,Send_Data);
    if(Geely3_Flage == 1)
      _TestResult(SendData,ID,Step,Temp_NRC22_InCar);
    else 
      _TestResult(SendData,ID,Step,Response);
    _Special_Step(diagGetLastResponseCode(SendData),Special,Step,Session,Rsp,UnLock_State,ID);
    _Reset_CarSpd_Invalid();
    _Set_CarSpd(0);
    testWaitForTimeout(500);
  }
}
/// <NRC22_Loop>
/*
    自动化测试NRC22档位条件
    Send_Data：发送数据
    Send_Len：发送长度
    ID：寻址
    Session: 会话
    Step ：打印内容
    Tpye ：0:正常响应,无NRC22条件   1:响应NRC22
    Rsp:是否为肯定响应抑制位
*/
_NRC22_Gears(byte Send_Data[],dword Send_Len,dword ID,byte Session,char Step[],byte Tpye,int Special,int Rsp,int UnLock_State)
{
  byte Temp_NRC22;
  byte Temp_14[4] = {0x14,0xFF,0xFF,0xFF};
  byte Temp_27[2] = {0x27,0x01};
  int j;
  int Response;
  Temp_NRC22 = Gear_NRC;
  Temp_27[1] = RequestSeed_27;
  if(Gears_ID != 0 && strncmp(Gears_Signal,"NULL",strlen(Gears_Signal)) != 0)
  {
    _WriteEx_and_Report("","-----------------------");
    _WriteEx_and_Report("","NRC22_档位测试");
    _WriteEx_and_Report("","-----------------------");
    Response = (Rsp == 0)? -1:0;
    if(Special == 1)
      _Other_1002();
    if(UnLock_State == 1)
    {
      if((Special != 1) || (Special==1 && Other_1002==1 && ((Unlock_1002 == 1) || ((Unlock_1002==0) && Pre_Programmed_1002==1 && Pre_Programmed_UnlockECU==1))))
        _unlockECU();
    }
    _WriteEx_and_Report("步骤1","设置档位为非正常档位");
    for(j=NRC_22_Gears_Range[0];j<NRC_22_Gears_Range[1];j++)
    {
      if(j==NRC_22_Gears_Normal)
        continue;
      
      _Set_Gears(j);
      if(Tpye == 0)
      {
        _Send_Diag(Send_Len,ID,Send_Data);
        _TestResult(SendData,phyreq_ID,Step,Response);
       _Special_Step(diagGetLastResponseCode(SendData),Special,Step,Session,Rsp,UnLock_State,ID);
      }
      else if(Tpye == 1)
      {
        _Send_Diag(Send_Len,ID,Send_Data);
        _TestResult(SendData,ID,Step,Temp_NRC22);
        _Special_Step(diagGetLastResponseCode(SendData),Special,Step,Session,Rsp,UnLock_State,ID);
      }
    }
      _WriteEx_and_Report("步骤2","丢失档位");
      _TestDisableMsg(Gears_ID);
      testWaitForTimeout(1000);
      _Send_Diag(Send_Len,ID,Send_Data);
      _TestResult(SendData,ID,Step,Response);
      _Special_Step(diagGetLastResponseCode(SendData),Special,Step,Session,Rsp,UnLock_State,ID);
      _TestEnableMsg(Gears_ID);
      testWaitForTimeout(1000);
      _WriteEx_and_Report("步骤3","设置档位为正常档位");
      _Set_Gears(NRC_22_Gears_Normal);
      _Send_Diag(Send_Len,ID,Send_Data);
      _TestResult(SendData,ID,Step,Response);
      _Special_Step(diagGetLastResponseCode(SendData),Special,Step,Session,Rsp,UnLock_State,ID);
      testWaitForTimeout(500);
  }
  else
    writeEx(-3,0,"未输入档位条件,跳过测试");
}
/// <NRC22_Loop>
/*
    自动化测试NRC22发动机条件
    Send_Data：发送数据
    Send_Len：发送长度
    ID：寻址
    Session: 会话
    Step ：打印内容
    Tpye ：0:正常响应,无NRC22条件   1:响应NRC22
    Rsp:是否为肯定响应抑制位
*/
_NRC22_Ready(byte Send_Data[],dword Send_Len,dword ID,byte Session,char Step[],byte Tpye,int Special,int Rsp,int UnLock_State)
{
  byte Temp_NRC22;
  byte Temp_14[4] = {0x14,0xFF,0xFF,0xFF};
  byte Temp_27[2] = {0x27,0x01};
  int Response,i;
  Temp_NRC22 = Ready_NRC;
  if((Send_Data[0] == 0x31) && (Serve_31_NewNRC22 == 1) && (Tpye == 1))
    Temp_NRC22 = 0x84;
  Temp_27[1] = RequestSeed_27;
  _WriteEx_and_Report("","-----------------------");
  _WriteEx_and_Report("","NRC22_发动机测试");
  _WriteEx_and_Report("","-----------------------");
  
  Response = (Rsp == 0)? -1:0;
  if(Special == 1)
    _Other_1002();
  if(UnLock_State == 1)
  {
    if((Special != 1) || (Special==1 && Other_1002==1 && ((Unlock_1002 == 1) || ((Unlock_1002==0) && Pre_Programmed_1002==1 && Pre_Programmed_UnlockECU==1))))
      _unlockECU();
  }
  _WriteEx_and_Report("步骤1","设置发动机满足NRC22条件");
  _Set_Ready(Ready_NRC22);
  if(Tpye == 0)
  {
    _Send_Diag(Send_Len,ID,Send_Data);
    _TestResult(SendData,phyreq_ID,Step,Response);
    _Special_Step(diagGetLastResponseCode(SendData),Special,Step,Session,Rsp,UnLock_State,ID);
  }
  else if(Tpye == 1)
  {
    _Send_Diag(Send_Len,ID,Send_Data);
    _TestResult(SendData,ID,Step,Temp_NRC22);
    _Special_Step(diagGetLastResponseCode(SendData),Special,Step,Session,Rsp,UnLock_State,ID);
  }
  
  _WriteEx_and_Report("步骤2","丢失发动机信号");
  _TestDisableMsg(Struct_Ready.Sig_Id);
  testWaitForTimeout(1000);
  _Send_Diag(Send_Len,ID,Send_Data);
  _TestResult(SendData,ID,Step,Response);
  _Special_Step(diagGetLastResponseCode(SendData),Special,Step,Session,Rsp,UnLock_State,ID);
  _TestEnableMsg(Struct_Ready.Sig_Id);
  testWaitForTimeout(1000);
  if(strlen(Struct_Ready.ReadyInvalid_Sig) == 0)
  {
    _WriteEx_and_Report("","无发动机无效相关测试");
    return;
  }
  _WriteEx_and_Report("步骤3","设置发动机无效");
  _Set_Sig(Struct_Ready.ReadyInvalid_Sig,Struct_Ready.Invalid_Value[0]);
  testWaitForTimeout(Struct_Ready.Invalid_Time*1.2);
  _Send_Diag(Send_Len,ID,Send_Data);
  _TestResult(SendData,ID,Step,Response);
  _Special_Step(diagGetLastResponseCode(SendData),Special,Step,Session,Rsp,UnLock_State,ID);
  _Set_Sig(Struct_Ready.ReadyInvalid_Sig,Struct_Ready.Normal_Value[0]);
  testWaitForTimeout(Struct_Ready.Invalid_Time*1.2);
  _WriteEx_and_Report("步骤4","设置发动机到正常状态");
  for(i=0;i<Struct_Ready.Ready_ValueRange_Count;i++)
  {
    if(Struct_Ready.Ready_ValueRange[i] == Ready_NRC22) //跳过NRC22发动机条件
      continue;
    _Set_Ready(Struct_Ready.Ready_ValueRange[i]);
    _Set_Sig(Struct_Ready.ReadyInvalid_Sig,Struct_Ready.Normal_Value[0]);
    testWaitForTimeout(Struct_Ready.Invalid_Time*1.2);
    _Send_Diag(Send_Len,ID,Send_Data);
    _TestResult(SendData,ID,Step,Response);
    _Special_Step(diagGetLastResponseCode(SendData),Special,Step,Session,Rsp,UnLock_State,ID);
    testWaitForTimeout(500);
  }
  _Set_Ready(0);
}
/// <NRC22_Loop>
/*
    自动化测试NRC22电压条件
    Send_Data：发送数据
    Send_Len：发送长度
    ID：寻址
    Session: 会话
    Step ：打印内容
    Tpye ：0:正常响应,无NRC22条件   1:响应NRC22
    Rsp:是否为肯定响应抑制位
*/
_NRC22_Battery(byte Send_Data[],dword Send_Len,dword ID,byte Session,char Step[],byte Tpye,int Special,int Rsp,int UnLock_State)
{
  byte Temp_NRC22_Hig,Temp_NRC22_Low;
  byte Temp_14[4] = {0x14,0xFF,0xFF,0xFF};
  byte Temp_27[2] = {0x27,0x01};
  int Response;
  Temp_NRC22_Hig = H_Battery_NRC;
  Temp_NRC22_Low = L_Battery_NRC;
  if((Send_Data[0] == 0x31) && (Serve_31_NewNRC22 == 1)&& (Tpye == 1))
  {
    Temp_NRC22_Hig = 0x92;
    Temp_NRC22_Low = 0x93;
  }
  Temp_27[1] = RequestSeed_27;
  _WriteEx_and_Report("","-----------------------");
  _WriteEx_and_Report("","NRC22_电压测试");
  _WriteEx_and_Report("","-----------------------");
  
  Response = (Rsp == 0)? -1:0;
  if(Special == 1)
    _Other_1002();
  if(UnLock_State == 1)
  {
    if((Special != 1) || (Special==1 && Other_1002==1 && ((Unlock_1002 == 1) || ((Unlock_1002==0) && Pre_Programmed_1002==1 && Pre_Programmed_UnlockECU==1))))
      _unlockECU();
  }
  _WriteEx_and_Report("步骤1","设置电压 > NRC22高压");
  _Set_Battery(NRC22_Battery_Hight+0.2);
  if(Tpye == 0)
  {
    _Send_Diag(Send_Len,ID,Send_Data);
    _TestResult(SendData,phyreq_ID,Step,Response);
    _Special_Step(diagGetLastResponseCode(SendData),Special,Step,Session,Rsp,UnLock_State,ID);
  }
  else if(Tpye == 1)
  {
    _Send_Diag(Send_Len,ID,Send_Data);
    _TestResult(SendData,ID,Step,Temp_NRC22_Hig);
    _Special_Step(diagGetLastResponseCode(SendData),Special,Step,Session,Rsp,UnLock_State,ID);
  }
  _WriteEx_and_Report("步骤2","设置电压 < NRC22高压");
  _Set_Battery(NRC22_Battery_Hight-0.2);
  _Send_Diag(Send_Len,ID,Send_Data);
  _TestResult(SendData,ID,Step,Response);
  _Special_Step(diagGetLastResponseCode(SendData),Special,Step,Session,Rsp,UnLock_State,ID);
  _WriteEx_and_Report("步骤3","设置电压 < NRC22低压");
  _Set_Battery(NRC22_Battery_Low-0.2);
  _Send_Diag(Send_Len,ID,Send_Data);
  if(Tpye == 0)
  {
    _TestResult(SendData,phyreq_ID,Step,Response);
    _Special_Step(diagGetLastResponseCode(SendData),Special,Step,Session,Rsp,UnLock_State,ID);
  }
  else if(Tpye == 1)
  {
    _TestResult(SendData,ID,Step,Temp_NRC22_Low);
    _Special_Step(diagGetLastResponseCode(SendData),Special,Step,Session,Rsp,UnLock_State,ID);
  }
  _WriteEx_and_Report("步骤4","设置电压 > NRC22低压");
  _Set_Battery(NRC22_Battery_Low+0.2);
  _Send_Diag(Send_Len,ID,Send_Data);
  _TestResult(SendData,ID,Step,Response);
  _Special_Step(diagGetLastResponseCode(SendData),Special,Step,Session,Rsp,UnLock_State,ID);
  testWaitForTimeout(500);
  _Set_Battery(12);
  testWaitForTimeout(500);
}

/// <NRC22_Loop>
/*
    自动化测试NRC22力矩条件
    Send_Data：发送数据
    Send_Len：发送长度
    ID：寻址
    Session: 会话
    Step ：打印内容
    Tpye ：0:正常响应,无NRC22条件   1:响应NRC22
    Rsp:是否为肯定响应抑制位
*/
_NRC22_Torque(byte Send_Data[],dword Send_Len,dword ID,byte Session,char Step[],byte Tpye,int Special,int Rsp,int UnLock_State)
{
  byte Temp_NRC22;
  byte Temp_14[4] = {0x14,0xFF,0xFF,0xFF};
  byte Temp_27[2] = {0x27,0x01};
  int Response,LeftAndRight;
  char Str_[200];
  Temp_NRC22 = TasTorque_NRC;
  
  Temp_27[1] = RequestSeed_27;
  _WriteEx_and_Report("","-----------------------");
  _WriteEx_and_Report("","NRC22_力矩测试");
  _WriteEx_and_Report("","-----------------------");
  
  Response = (Rsp == 0)? -1:0;
  if(Special == 1)
    _Other_1002();
  if(UnLock_State == 1)
  {
    if((Special != 1) || (Special==1 && Other_1002==1 && ((Unlock_1002 == 1) || ((Unlock_1002==0) && Pre_Programmed_1002==1 && Pre_Programmed_UnlockECU==1))))
      _unlockECU();
  }
  diagStartTesterPresent(Cdd_Name);
  for(LeftAndRight = 0;LeftAndRight<2;LeftAndRight++) //左右
  {
    _WriteEx_and_Report("步骤1","控制力矩满足NRC22条件,并保持");
    snprintf(Str_,elCount(Str_),"%s","");
    if(LeftAndRight==0)
      snprintf(Str_,elCount(Str_),"左侧，控制力矩满足NRC22条件,大于 %.2f Nm,并保持",NRC22_TasTorque+0.2);
    else
      snprintf(Str_,elCount(Str_),"右侧，控制力矩满足NRC22条件,大于 %.2f Nm,并保持",(NRC22_TasTorque+0.2)*(-1));
    testWaitForTesterConfirmation(Str_,30000);
    if(Tpye == 0)
    {
      _Send_Diag(Send_Len,ID,Send_Data);
      _TestResult(SendData,phyreq_ID,Step,Response);
      _Special_Step(diagGetLastResponseCode(SendData),Special,Step,Session,Rsp,UnLock_State,ID);
    }
    else if(Tpye == 1)
    {
      _Send_Diag(Send_Len,ID,Send_Data);
      _TestResult(SendData,ID,Step,Temp_NRC22);
      _Special_Step(diagGetLastResponseCode(SendData),Special,Step,Session,Rsp,UnLock_State,ID);
    }
    _WriteEx_and_Report("步骤2","控制力矩不满足NRC22条件",NRC22_TasTorque);
    if(LeftAndRight==0)
      snprintf(Str_,elCount(Str_),"左侧，控制力矩不满足NRC22条件,小于 %.2f Nm,并保持",NRC22_TasTorque-0.2);
    else
      snprintf(Str_,elCount(Str_),"右侧，控制力矩不满足NRC22条件,小于 %.2f Nm,并保持",(NRC22_TasTorque-0.2)*(-1));
    testWaitForTesterConfirmation(Str_,30000);
    _Send_Diag(Send_Len,ID,Send_Data);
    _TestResult(SendData,ID,Step,Response);
    _Special_Step(diagGetLastResponseCode(SendData),Special,Step,Session,Rsp,UnLock_State,ID);
    snprintf(Str_,elCount(Str_),"松开方向盘");
    testWaitForTesterConfirmation(Str_,30000);
    testWaitForTimeout(1000);
  }
  diagStopTesterPresent(Cdd_Name);
}
/// <NRC22_Loop>
/*
    用于统一NRC22时的特殊处理
    Code ：-1：上一次请求响应情况
    Special：特殊情况
    St：打印
    Session： 会话
    ID；发送ID
    Rsp:是否为肯定响应抑制位
*/
void _Special_Step(int Code,byte Special,char St[],byte Session,int Rsp,int UnLock_State,dword ID)
{
  byte Temp_27[2] = {0x27,0x01};
  int Response,Loop;
  Temp_27[1] = RequestSeed_27;
  
  if((Code == -1) || (Code == 0 && Rsp == 1))
  {
    if(Special == 1)
    {
      testWaitForTimeout(1000);
      _Clear_DTC(phyreq_ID,0x11,St);
      _Send_And_Check_NowSession(phyreq_ID,2); 
      _SetSession(defsession);
      testWaitForTimeout(1000);
      if(Session_BIN !=4 && Session==exsession)
        _SetSession(exsession);
      _Other_1002();
    }
    else if(Special == 2)
    {
      testWaitForTimeout(2000);
      _Send_Diag(2,phyreq_ID,Temp_27);
      _TestResult(SendData,phyreq_ID,St,0x7F);
      _Send_And_Check_NowSession(phyreq_ID,defsession); 
      testWaitForTimeout(200);
      if(UnLock_State == 1)
        _unlockECU();
      else
        _SetSession(Session);
    }
    else if(Special == 3)
    {
      testWaitForTimeout(200);
      _SetSession(defsession);
      _SetSession(Session);
      testWaitForTimeout(200);
    }
    else if(Special == 4)
    {
      byte Send_31_Data[10];
      int Send_Len_Last;
      testWaitForTimeout(200);
      Send_Len_Last = DiagGetPrimitiveSize(SendData);
      for(Loop = 0;Loop<Send_Len_Last;Loop++)
        Send_31_Data[Loop] = DiagGetPrimitiveByte(SendData,Loop);
      for(Loop = 1;Loop<Serve_31_Hex[NRC22_Loop_FunPos].Control_Type_Count;Loop++)
      {
        Send_31_Data[1] = Serve_31_Hex[NRC22_Loop_FunPos].Control_Type[Loop];
        if(Rsp == 1)
          Send_31_Data[1]|=0x80;
        _Send_Diag(Send_Len_Last,ID,Send_31_Data);
        _TestResult(SendData,ID,St,Code);
        testWaitForTimeout(200);
      }
    }
  }
  else if(Code > 0)
  {
    if(Special == 1)
    {
      testWaitForTimeout(1000);
      _Clear_DTC(phyreq_ID,-1,St);
      _Send_And_Check_NowSession(phyreq_ID,Session); 
    }
    else if(Special == 2)
    {
      testWaitForTimeout(2000);
      _Send_Diag(2,phyreq_ID,Temp_27);
      if(Session == exsession)
        _TestResult(SendData,phyreq_ID,St,-1);
      else
        _TestResult(SendData,phyreq_ID,St,0x7F);
      _Send_And_Check_NowSession(phyreq_ID,Session); 
      _SetSession(defsession);
      testWaitForTimeout(200);
      if(UnLock_State == 1)
        _unlockECU();
      else
        _SetSession(Session);
      testWaitForTimeout(200);
    }
    else if(Special == 3)
    {
//      _SetSession(defsession); //上一次消极响应情况下可不在进行重新复位
//      _SetSession(Session);
      testWaitForTimeout(200);
    }
    else if(Special == 4)
    {
      byte Send_31_Data[10];
      int Send_Len_Last;
      testWaitForTimeout(200);
      Send_Len_Last = DiagGetPrimitiveSize(SendData);
      for(Loop = 0;Loop<Send_Len_Last;Loop++)
        Send_31_Data[Loop] = DiagGetPrimitiveByte(SendData,Loop);
      for(Loop = 1;Loop<Serve_31_Hex[NRC22_Loop_FunPos].Control_Type_Count;Loop++)
      {
        Send_31_Data[1] = Serve_31_Hex[NRC22_Loop_FunPos].Control_Type[Loop];
        if(Rsp == 1)
          Send_31_Data[1]|=0x80;
        _Send_Diag(Send_Len_Last,ID,Send_31_Data);
        _TestResult(SendData,ID,St,Code);
        testWaitForTimeout(200);
      }
    }
  }
}

int Frame_Loop_Save(int FixDataSave_Pos,int Error_Type_Pos,byte GetData[],int Index_Save,dword AllFrameData[],int FrameCount)
{
  int Count,Temp_Count,i,sig,frame;
  int SigCount;
  const MaxSave = 8;
  Temp_Count = Index_Save;
  SigCount = FixDataSave[FixDataSave_Pos].SigSaveCount[Error_Type_Pos];
  //按信号遍历：同一个信号在所有帧中的值连续装载
  for(sig=0;sig<SigCount;sig++)
  {
    if(FixDataSave[FixDataSave_Pos].OccupancyByte[Error_Type_Pos][sig] == 1) //占用1Byte
    {
      //判断下一个信号是否也为1Byte，若是则两个组合按帧交错装载
      if(sig+1 < SigCount && FixDataSave[FixDataSave_Pos].OccupancyByte[Error_Type_Pos][sig+1] == 1)
      {
        //连续两个1Byte信号，按帧交错：S1_f0,S2_f0,S1_f1,S2_f1,...
        for(frame=0;frame<FrameCount;frame++)
        {
          GetData[Temp_Count] = AllFrameData[frame*SigCount+sig]&0xFF;
          Temp_Count++;
          GetData[Temp_Count] = AllFrameData[frame*SigCount+(sig+1)]&0xFF;
          Temp_Count++;
        }
        sig++;  //下一个信号已在此处理，跳过
      }
      else
      {
        //单个1Byte信号，每帧前补0：0,S_f0,0,S_f1,...
        for(frame=0;frame<FrameCount;frame++)
        {
          GetData[Temp_Count] = 0;
          Temp_Count++;
          GetData[Temp_Count] = AllFrameData[frame*SigCount+sig]&0xFF;
          Temp_Count++;
        }
      }
    }
    else if(FixDataSave[FixDataSave_Pos].OccupancyByte[Error_Type_Pos][sig] == 2) //占用2Byte
    {
      //同一个信号的所有帧值连续装载，每帧高字节在前低字节在后
      for(frame=0;frame<FrameCount;frame++)
      {
        GetData[Temp_Count] = (AllFrameData[frame*SigCount+sig]>>8)&0xFF;
        Temp_Count++;
        GetData[Temp_Count] = AllFrameData[frame*SigCount+sig]&0xFF;
        Temp_Count++;
      }
    }
  }
  return Temp_Count;
}


/*
  根据DTC匹配故障配置，制造故障并装载冻结帧数据(装载逻辑同Frame_Sig_Error/Frame_Loop_Save)
  DTC_Set:   需匹配的DTC
  ErrorFrame: 故障制造帧数(故障成熟帧)
  ErrorBefor: 故障前正常采集帧数
  ErrorAfter:  故障成熟后恢复采集正常帧数
  DataGet:   装载结果(byte型)
  返回值: 装载的总字节数；未匹配到DTC返回0
*/
int DataGet_ByDTC(dword DTC_Set, byte ErrorFrame1, int ErrorBefor, int ErrorAfter, byte DataGet[])
{
  int node,idx,frame,sig,i;
  int SigCount,DbcCycle,allCol,LoadLen,targetLen;
  int NormalBefCount;   //故障前正常采集帧数 = ErrorBefor - ErrorFrame1
  int hasBase;          //是否提前装载了故障前基线帧
  dword baseFrame[6];   //提前装载的故障前基线帧(每信号一个值)
  byte TempData[200];
  dword AllFrameData[200];

  //目标装载总字节数 = Res_FixData_Len - 6
  targetLen = Res_FixData_Len - 6;
  if(targetLen < 0)
    targetLen = 0;

  for(node=0;node<FixDataSave_Count;node++)
  {
    for(idx=0;idx<FixDataSave[node].Error_Type_Count;idx++)
    {
      if(FixDataSave[node].DTC[idx] == DTC_Set)
      {
        /* 命中DTC，开始故障采集与装载 */
        SigCount = FixDataSave[node].SigSaveCount[idx];
        if(SigCount > 6)
          SigCount = 6;   //防止越界，SigSave最多6个
        DbcCycle = _GetCycleFromDBC(FixDataSave[node].Node);
        if(DbcCycle < 1)
          DbcCycle = 1;
        allCol = 0;

        //故障前正常采集帧数 = ErrorBefor - ErrorFrame1，若为负则取0
        NormalBefCount = ErrorBefor - ErrorFrame1;
        if(NormalBefCount < 0)
          NormalBefCount = 0;

        hasBase = 0;
        /* 阶段0: 若故障前无正常帧(NormalBefCount==0)，则提前装载一帧作为故障段基线，
           避免故障一开始就丢节点导致取不到正确数据 */
        if(NormalBefCount == 0)
        {
          testWaitForMessage(FixDataSave[node].Node,1000);
          for(sig=0;sig<SigCount;sig++)
            baseFrame[sig] = GetRawSignal(FixDataSave[node].SigSave[idx][sig]);
          hasBase = 1;
        }
        _WriteEx_and_Report("","/*----------------开始抓取数据----------------*/");
        /* 阶段1: 故障前正常帧，采NormalBefCount帧 */
        for(frame=0;frame<NormalBefCount;frame++)
        {
          testWaitForMessage(FixDataSave[node].Node,1000);
          for(sig=0;sig<SigCount;sig++)
            AllFrameData[allCol*SigCount+sig] = GetRawSignal(FixDataSave[node].SigSave[idx][sig]);
          allCol++;
        }

        /* 阶段2: 制造故障，采集ErrorFrame1帧(故障成熟帧) */
        if(strncmp(FixDataSave[node].Error_Type[idx],"Lost",4)==0)  //Lost故障
        {
          _TestDisableMsg(FixDataSave[node].Node);
          for(frame=0;frame<ErrorFrame1;frame++)
          {
            testWaitForTimeout(DbcCycle);
            for(sig=0;sig<SigCount;sig++)
            {
              if(NormalBefCount > 0)
                AllFrameData[allCol*SigCount+sig] = AllFrameData[(NormalBefCount-1)*SigCount+sig]; //采用阶段1最后值
              else if(hasBase)
                AllFrameData[allCol*SigCount+sig] = baseFrame[sig]; //无阶段1时采用提前装载基线值
              else
                AllFrameData[allCol*SigCount+sig] = 0;
            }
            allCol++;
          }
        }
        else  //Invalid/Cntr等故障：信号置无效值
        {
          _Set_SigNoTime(FixDataSave[node].SigName[idx],FixDataSave[node].Invalid_Value[idx]);
          for(frame=0;frame<ErrorFrame1;frame++)
          {
            testWaitForMessage(FixDataSave[node].Node,1000);
            for(sig=0;sig<SigCount;sig++)
              AllFrameData[allCol*SigCount+sig] = GetRawSignal(FixDataSave[node].SigSave[idx][sig]);
            allCol++;
          }
        }

        _WriteEx_and_Report("","/*----------------故障恢复----------------*/");
        /* 阶段3: 累计帧数达到ErrorBefor后恢复故障 */
        if(strncmp(FixDataSave[node].Error_Type[idx],"Lost",4)==0)
          _TestEnableMsg(FixDataSave[node].Node);
        else
          _Set_SigNoTime(FixDataSave[node].SigName[idx],FixDataSave[node].Normal_Value[idx]);

        /* 阶段4: 恢复后继续采集，直到总帧数达到 ErrorBefor + ErrorAfter */
        for(frame=allCol;frame<ErrorBefor+ErrorAfter;frame++)
        {
          testWaitForMessage(FixDataSave[node].Node,1000);
          for(sig=0;sig<SigCount;sig++)
            AllFrameData[allCol*SigCount+sig] = GetRawSignal(FixDataSave[node].SigSave[idx][sig]);
          allCol++;
        }

        /* 按信号维度装载到TempData */
        LoadLen = Frame_Loop_Save(node,idx,TempData,0,AllFrameData,allCol);
        for(i=0;i<LoadLen;i++)
          writeEx(-3,0,"获取到的纯数据 GetData[%d] = 0x%02X",i,TempData[i]);
        _WriteEx_and_Report("","/*----------------抓取数据完毕----------------*/");
        /* 输出有效字节到DataGet，并补0至targetLen */
        for(i=0;i<LoadLen && i<targetLen;i++)
          DataGet[i] = (byte)(TempData[i] & 0xFF);
        for(i=LoadLen;i<targetLen;i++)
          DataGet[i] = 0;
        return targetLen;
      }
    }
  }
  return 0;
}

/*
    检测输入的参数是否被支持
    Type == 4 :19 04
    Type == 6 :19 06
*/
int _Check_ByteIn19(int Type,byte Byte_Input)
{
  int Serve_Pos,Fun_Pos,i;
  int Return_Value;
  Return_Value = -1;
  Serve_Pos = _Check_Serve(0x19,0,0);
  Fun_Pos = _Check_Serve(0x19,Type,4);
  if(Fun_Pos != -1)
  {
    for(i=0;i<Serve_Data[Serve_Pos].Serve_Para_Count[Fun_Pos];i++)
    {
      if(Byte_Input == Serve_Data[Serve_Pos].Serve_Para[Fun_Pos][i])
      {
        Return_Value = 1;
        break;
      }
    }
  }
  if(Type != 0x04 && Type != 0x06)
  {
    byte Count_Para[100];
    byte Count;
    Count = 0;
    Fun_Pos = _Check_Serve(0x19,0x04,4);
    if(Fun_Pos != -1)
    {
      for(i=0;i<Serve_Data[Serve_Pos].Serve_Para_Count[Fun_Pos];i++)
      {
        Count_Para[Count] = Serve_Data[Serve_Pos].Serve_Para[Fun_Pos][i];
        Count++;
      }
    }
    Fun_Pos = _Check_Serve(0x19,0x06,4);
    if(Fun_Pos != -1)
    {
      for(i=0;i<Serve_Data[Serve_Pos].Serve_Para_Count[Fun_Pos];i++)
      {
        Count_Para[Count] = Serve_Data[Serve_Pos].Serve_Para[Fun_Pos][i];
        Count++;
      }
    }
    for(i=0;i<Count;i++)
    {
      if(Byte_Input==Count_Para[i])
      {
        Return_Value = 1;
        break;
      }
    }
  }
  return Return_Value;
}

int _Check_DID_Pos(dword DID)
{
  int Return_Value;
  int i;
  Return_Value = -1;
  for(i=0;i<DID_Function_Count;i++)
  {
    if(DID_Function[i].DID == DID)
    {
      toUpper(DID_Function[i].Sig_Type,DID_Function[i].Sig_Type,strlen(DID_Function[i].Sig_Type));//大写数据类型防止后续判断时不匹配
      Return_Value = i;
      break;
    }
  }
  return Return_Value;
}

/// <DID_22>
/*
    Send_Data：  发送数据装载
    Fun_DIDPos： 所在结构体位置
    ID：         发送ID
    Step_Flage： 是否存在操作值
    Data_Pos：   预期结果所在位置 / 直接输入判断
    Invalid:     无效值判定 当其为1时，输入为无效值
    ValueGet:    1:正常取预设值  2:仅输出不做判断   其余值均直接判断Data_Pos,无数据转换
*/
int Check_ReadFunDID(byte Send_Data[],int Fun_DIDPos,dword ID,int Step_Flage,float Data_Pos,int Invalid,int ValueGet)
{
  int Return_Value;
  int Res_Len,i,Data_Temp_Write_OutPut_Flage;
  char Data_Res[200];
  char Data_Res_Change[200];
  dword Data_Temp;
  float Data_Temp_Write;
  int Data_Pos_Int;
  byte DataForTime[20];
  
  snprintf(Data_Res,elCount(Data_Res),"%s","");//装载原始数据打印
  snprintf(Data_Res_Change,elCount(Data_Res_Change),"%s","");//装载转换后数据
  Data_Temp = 0;
  Data_Temp_Write = 0;
  Data_Temp_Write_OutPut_Flage = 1;
  Data_Pos_Int = (int)Data_Pos;
  
  if(Fun_DIDPos == -1)
  {
    _WriteEx_and_Report("功能DID","未获取到对应的DID:0x%04X数据",((Send_Data[1]<<8)|(Send_Data[2])));
    return 0;
  }

  _Send_Diag(3,ID,Send_Data);
  if(diagGetLastResponseCode(SendData) == 0)
    testWaitForDiagResponse(SendData,500);
  if(diagGetLastResponseCode(SendData) == -1)
  {
    Res_Len = DiagGetRespPrimitiveSize(SendData);
    if(Res_Len != DID_Function[Fun_DIDPos].ExLen)
      testStepFail(DID_Function[Fun_DIDPos].DID_Index,"DID长度与期望不符，期望长度为%d ，实际长度为%d",DID_Function[Fun_DIDPos].ExLen,Res_Len);
    
    snprintf(Data_Res,elCount(Data_Res),"原始数据:");
    snprintf(Data_Res_Change,elCount(Data_Res_Change),"转换后数据:");
    DID_Function[Fun_DIDPos].ValueNow = 0;
    for(i=3;i<Res_Len;i++)
    {
      snprintf(Data_Res,elCount(Data_Res),"%s 0x%02X",Data_Res,DiagGetRespPrimitiveByte(SendData,i)); //原始数据存储
      DataForTime[i-3] = DiagGetRespPrimitiveByte(SendData,i);
      DID_Function[Fun_DIDPos].ValueNow += (DiagGetRespPrimitiveByte(SendData,i)<<(8*(Res_Len-i-1)));
    }
    /*此处需要对时间参数单独判定*/
    if(DID_Function[Fun_DIDPos].Time_Flage == 0) //非时间数据处理
    {
      if(strncmp(DID_Function[Fun_DIDPos].Sig_Type,"UNSIGNED",strlen(DID_Function[Fun_DIDPos].Sig_Type)) == 0 && strlen(DID_Function[Fun_DIDPos].Sig_Type) == strlen("UNSIGNED"))//无符号型数据
      {
        if(Res_Len>3)
        {
          for(i=3;i<Res_Len;i++)
            Data_Temp = Data_Temp + (DiagGetRespPrimitiveByte(SendData,i)<<(8*(Res_Len-i-1)));
          Data_Temp_Write = Data_Temp*DID_Function[Fun_DIDPos].Factor + DID_Function[Fun_DIDPos].Offset;
          snprintf(Data_Res_Change,elCount(Data_Res_Change),"%s %.2f",Data_Res_Change,Data_Temp_Write);
        }
      }
      else if(strncmp(DID_Function[Fun_DIDPos].Sig_Type,"SIGNED",strlen(DID_Function[Fun_DIDPos].Sig_Type)) == 0 && strlen(DID_Function[Fun_DIDPos].Sig_Type) == strlen("SIGNED"))//有符号型数据
      {
        if((DiagGetRespPrimitiveByte(SendData,3)&0x80)==0x80 )   //负数
        {
          qword Da;
          qword Tem;
          qword Da_1;
          Tem = 0;
          Da_1 = 1;
          if(Res_Len - 3>8)
            Data_Temp_Write_OutPut_Flage = 0;//数据过长不可信,qword类型仅能装载长度为8byte
          for(i=0;i<Res_Len-3;i++)
            Da = (Da<<8)|0xFF;
          for(i=0;i<(Res_Len-3)*8;i++)
            Da_1 = Da_1*2;
          for(i=3;i<Res_Len;i++)
            Tem = Tem + (DiagGetRespPrimitiveByte(SendData,i)<<(8*(Res_Len-i-1)));
          Data_Temp = (Da_1 - Tem) & Da;
          Data_Temp = Data_Temp*(-1);
        }
        else//正数
        {
          for(i=3;i<Res_Len;i++)
            Data_Temp = Data_Temp + (DiagGetRespPrimitiveByte(SendData,i)<<(8*(Res_Len-i-1)));
        }
        Data_Temp_Write = Data_Temp*DID_Function[Fun_DIDPos].Factor + DID_Function[Fun_DIDPos].Offset;
        snprintf(Data_Res_Change,elCount(Data_Res_Change),"%s %.2f",Data_Res_Change,Data_Temp_Write);
      }
      {
        writeEx(-3,0,"/*---------  %s  ---------*/",DID_Function[Fun_DIDPos].DID_Index);
        writeEx(-3,0,"%s",Data_Res);
        if(Data_Temp_Write_OutPut_Flage == 1)
          writeEx(-3,0,"%s",Data_Res_Change);
        writeEx(-3,0,"/*---------------------------------*/");
      }
      if(Step_Flage == 1 && DID_Function[Fun_DIDPos].Value_Set_Flage == 1)
      {
        if(Invalid == 0)
        {
          if(ValueGet == 1) //来源于Fun_DID预设值
            _Check_ValueInRange_IsWrite(Data_Temp_Write,DID_Function[Fun_DIDPos].Value_Ex[Data_Pos_Int],DID_Function[Fun_DIDPos].Tolerance,DID_Function[Fun_DIDPos].Sig_Step,1,1);
          else if(ValueGet == 2) //仅输出，不做判断
          {
            teststep("","/*---------  %s  ---------*/",DID_Function[Fun_DIDPos].DID_Index);
            teststep("","%s",Data_Res);
            if(Data_Temp_Write_OutPut_Flage == 1)
              teststep("","%s",Data_Res_Change);
            teststep("","/*---------------------------------*/");
          }
          else //来源于直接输入
          {
//            if(Data_Pos>=DID_Function[Fun_DIDPos].Max_Value) //大于等于最大值时取最大值
//              _Check_ValueInRange_IsWrite(Data_Temp_Write,DID_Function[Fun_DIDPos].Max_Value,0,DID_Function[Fun_DIDPos].Sig_Step,1,1);
//            else
               _Check_ValueInRange_IsWrite(Data_Temp_Write,Data_Pos,DID_Function[Fun_DIDPos].Tolerance,DID_Function[Fun_DIDPos].Sig_Step,1,1);
          }
        }
        else  //无效值处理
        {
          if(DID_Function[Fun_DIDPos].Invalid_LastValue == 1) //取最后一次输入有效值
            _Check_ValueInRange_IsWrite(Data_Temp_Write,Data_Pos_Int,DID_Function[Fun_DIDPos].Tolerance,DID_Function[Fun_DIDPos].Sig_Step,1,1);
          else
            _Check_ValueInRange_IsWrite_(DID_Function[Fun_DIDPos].ValueNow,DID_Function[Fun_DIDPos].Invalid,DID_Function[Fun_DIDPos].Tolerance,DID_Function[Fun_DIDPos].Sig_Step,1,1);
        }
      }
    } 
    else //时间数据处理
    {
      LocalTime_ChangeAndOutPut(DataForTime,Res_Len-3,DID_Function[Fun_DIDPos].Sig_Type,Invalid,1);
      snprintf(Data_Res_Change,elCount(Data_Res_Change),"%s%s",Data_Res_Change,Time_GetNow);
      {
        writeEx(-3,0,"/*---------  %s  ---------*/",DID_Function[Fun_DIDPos].DID_Index);
        writeEx(-3,0,"%s",Data_Res);
        writeEx(-3,0,"%s",Data_Res_Change);
        writeEx(-3,0,"/*---------------------------------*/");
      }
      if(ValueGet != 2)
      {
        if(strncmp(Time_GetNow,DID_Function[Fun_DIDPos].LocalTime_Ex[Data_Pos_Int],strlen(Time_GetNow)) == 0 && strlen(Time_GetNow) == strlen(DID_Function[Fun_DIDPos].LocalTime_Ex[Data_Pos_Int]))
          testStepPass("","返回数据与预期数据一致");
        else
          testStepFail("","返回数据与预期数据不一致,期望为: %s  ,实际为: %s",DID_Function[Fun_DIDPos].LocalTime_Ex[Data_Pos_Int],Time_GetNow);
      }
      else
      {
        teststep("","/*---------  %s  ---------*/",DID_Function[Fun_DIDPos].DID_Index);
        teststep("","%s",Data_Res);
        teststep("","%s",Data_Res_Change);
        teststep("","/*---------------------------------*/");
      }
    }
  }
  else
    testStepFail("","未收到正响应");
  return Return_Value;
}
/*
  对时间数据进行转换输出(仅当LocalTime确保在数组中可使用)
  Data_Get:     原始数据
  Len：         原始数据长度
  DataSymbol:   数据类型
  Type:         数组来源  Type = 0:mixArray    Type = 1:DID_Function  
  Invalid
*/
void LocalTime_ChangeAndOutPut(byte Data_Get[],int Len_Data,char DataSymbol[],int Invalid,int Type)
{
  int DID_Pos,i;
  int ReadType;
  int Possition_LocalTime[6];
  char LocalTime_Str_Get[40];
  qword Temp_Time;
  
  DID_Pos = -1;
  Temp_Time = 0;
  snprintf(LocalTime_Str_Get,elCount(LocalTime_Str_Get),"");
  snprintf(Time_GetNow,elCount(Time_GetNow),"");
  if(Type == 0)
    ReadType = 1;
  else if(Type == 1)
    ReadType = 4;
  DID_Pos = _Check_StrPossion_Res("LocalTime",ReadType);
  if(DID_Pos != -1)
  {
    if(Type == 0)
      ReadType = 0;
    else if(Type == 1)
      ReadType = 1;
    Possition_LocalTime[0] = _Check_StrPossion("year",DID_Pos,ReadType);
    if(strncmp(DataSymbol,"BCD",strlen(DataSymbol)) == 0 && strlen(DataSymbol) == strlen("BCD"))//BCD格式直接拼接
    {
      if((Type == 0 && mixArray[DID_Pos].LocalTime[Possition_LocalTime[0]][1]>0) || (Type == 1 && DID_Function[DID_Pos].LocalTime_Config[Possition_LocalTime[0]][1]>0))
      {
        /*  秒/分/时/日/月/年  */
        for(i=Len_Data-1;i>=0;i--)
          snprintf(LocalTime_Str_Get,elcount(LocalTime_Str_Get),"%s%02X",LocalTime_Str_Get,Data_Get[i]);
      }
      else
      {
        /*  年/月/日/时/分/秒  */
        for(i=0;i<Len_Data;i++)
          snprintf(LocalTime_Str_Get,elcount(LocalTime_Str_Get),"%s%02X",LocalTime_Str_Get,Data_Get[i]);
      }
    }
    else //无符号类型进行处理 (时间仅涉及无符号类型)
    {
      /*目前无符号类型数据处理中，年份均不涉及占用2Byte情况，暂不处理*/
      dword Time_TempPos;
      int Check_Pos;
      int Count;
      Count = 0;
      Possition_LocalTime[1] = _Check_StrPossion("month",DID_Pos,ReadType);
      Possition_LocalTime[2] = _Check_StrPossion("day",DID_Pos,ReadType);
      Possition_LocalTime[3] = _Check_StrPossion("hour",DID_Pos,ReadType);
      Possition_LocalTime[4] = _Check_StrPossion("minute",DID_Pos,ReadType);
      Possition_LocalTime[5] = _Check_StrPossion("second",DID_Pos,ReadType);
      for(i=0;i<6;i++)
      {
        if(Possition_LocalTime[i]!= -1)
          Count++;
      }
      if(Possition_LocalTime[0] != -1) //year存在与输入中
      {
        if((Type == 0 && mixArray[DID_Pos].LocalTime[Possition_LocalTime[0]][1]>0) || (Type == 1 && DID_Function[DID_Pos].LocalTime_Config[Possition_LocalTime[0]][1]>0))
        {
  //        testWaitForTesterConfirmation(" 秒/分/时/日/月/年 ",10000);
          for(i=0;i<Len_Data;i++)
          {
            if(Possition_LocalTime[i] == -1)  //仅包含部分时间,不是完整的 年月日时分秒,舍弃未查询到的字符
              continue;
            if(Type == 0)
            {
              Time_TempPos = mixArray[DID_Pos].LocalTime[Possition_LocalTime[Count-1-i]][1];
              Time_TempPos = Len_Data - Time_TempPos - 1;
              Temp_Time = Data_Get[Time_TempPos] + mixArray[DID_Pos].LocalTime[Possition_LocalTime[i]][2]; //计算后的值
            }
            else if(Type == 1)
            {
              Time_TempPos = DID_Function[DID_Pos].LocalTime_Config[Possition_LocalTime[Count-1-i]][1];
              Time_TempPos = Len_Data - Time_TempPos - 1;
              Temp_Time = Data_Get[Time_TempPos] + DID_Function[DID_Pos].LocalTime_Config[Possition_LocalTime[i]][2]; //计算后的值
            }
            if(Invalid == 1)
              snprintf(LocalTime_Str_Get,elcount(LocalTime_Str_Get),"%s%02X",LocalTime_Str_Get,Data_Get[Time_TempPos]);
            else
            {
              if(Temp_Time>0xFF)
                snprintf(LocalTime_Str_Get,elcount(LocalTime_Str_Get),"%s%04d",LocalTime_Str_Get,Temp_Time);
              else
                snprintf(LocalTime_Str_Get,elcount(LocalTime_Str_Get),"%s%02d",LocalTime_Str_Get,Temp_Time);
            }
          }
        }
        else
        {
  //        testWaitForTesterConfirmation(" 年/月/日/时/分/秒 ",10000);
          for(i=0;i<Len_Data;i++)
          {
            if(Possition_LocalTime[i] == -1)  //仅包含部分时间,不是完整的 年月日时分秒,舍弃未查询到的字符
              continue;
            if(Type == 0)
            {
  	          Time_TempPos = mixArray[DID_Pos].LocalTime[Possition_LocalTime[i]][1];    //预期所在位置
  	          Time_TempPos = Len_Data - 1;  //装载后位置反向排序后取正确位置
              Temp_Time = Data_Get[i] ;
              if(Flage_Invalid_GAC == 0) //广汽无效值计算时不考虑偏差
                Temp_Time = Temp_Time + mixArray[DID_Pos].LocalTime[Possition_LocalTime[i]][2]; //计算后的值
            }
            else if(Type == 1)
            {
  	          Time_TempPos = DID_Function[DID_Pos].LocalTime_Config[Possition_LocalTime[i]][1];    //预期所在位置
  	          Time_TempPos = Len_Data - 1;  //装载后位置反向排序后取正确位置
              Temp_Time = Data_Get[i] ;
              if(Flage_Invalid_GAC == 0) //广汽无效值计算时不考虑偏差
                Temp_Time = Temp_Time + DID_Function[DID_Pos].LocalTime_Config[Possition_LocalTime[i]][2]; //计算后的值
            }
            if(Invalid == 1)
              snprintf(LocalTime_Str_Get,elcount(LocalTime_Str_Get),"%s%02X",LocalTime_Str_Get,Data_Get[i]);
            else
            {
              if(Temp_Time>0xFF)
                snprintf(LocalTime_Str_Get,elcount(LocalTime_Str_Get),"%s%04d",LocalTime_Str_Get,Temp_Time);
              else
                snprintf(LocalTime_Str_Get,elcount(LocalTime_Str_Get),"%s%02d",LocalTime_Str_Get,Temp_Time);
            }
          }
        }
      }
      else //year不存在，仅包含部分时间如 时/分/秒
      {
        if((Type == 0 && mixArray[DID_Pos].LocalTime[Possition_LocalTime[5]][1]>0) || (Type == 1 && DID_Function[DID_Pos].LocalTime_Config[Possition_LocalTime[5]][1]>0))
        {
//          writeEx(-3,0," 时/分/秒 ");
          for(i=3;i<Len_Data+3;i++)
          {
            if(Possition_LocalTime[i] == -1)  //仅包含部分时间,不是完整的 年月日时分秒,舍弃未查询到的字符
              continue;
            if(Type == 0)
            {
  	          Time_TempPos = mixArray[DID_Pos].LocalTime[Possition_LocalTime[i]][1];    //预期所在位置
              Temp_Time = Data_Get[i-3] + mixArray[DID_Pos].LocalTime[Possition_LocalTime[i]][2]; //计算后的值
            }
            else if(Type == 1)
            {
  	          Time_TempPos = DID_Function[DID_Pos].LocalTime_Config[Possition_LocalTime[i]][1];    //预期所在位置
              Temp_Time = Data_Get[i-3] + DID_Function[DID_Pos].LocalTime_Config[Possition_LocalTime[i]][2]; //计算后的值
            }
            if(Invalid == 1)
              snprintf(LocalTime_Str_Get,elcount(LocalTime_Str_Get),"%s%02X",LocalTime_Str_Get,Data_Get[i-3]);
            else
            {
              if(Temp_Time>0xFF)
                snprintf(LocalTime_Str_Get,elcount(LocalTime_Str_Get),"%s%04d",LocalTime_Str_Get,Temp_Time);
              else
                snprintf(LocalTime_Str_Get,elcount(LocalTime_Str_Get),"%s%02d",LocalTime_Str_Get,Temp_Time);
            }
          }
        }
        else
        {
//          writeEx(-3,0," 秒/分/时 ");
          for(i=3;i<Len_Data+3;i++)
          {
            if(Possition_LocalTime[i] == -1)  //仅包含部分时间,不是完整的 年月日时分秒,舍弃未查询到的字符
              continue;
            if(Type == 0)
            {
              Time_TempPos = mixArray[DID_Pos].LocalTime[Possition_LocalTime[i]][1];
              Temp_Time = Data_Get[Len_Data-i+2] + mixArray[DID_Pos].LocalTime[Possition_LocalTime[i]][2]; //计算后的值
            }
            else if(Type == 1)
            {
              Time_TempPos = DID_Function[DID_Pos].LocalTime_Config[Possition_LocalTime[i]][1];
              Temp_Time = Data_Get[Len_Data-i+2] + DID_Function[DID_Pos].LocalTime_Config[Possition_LocalTime[i]][2]; //计算后的值
            }
            if(Invalid == 1)
              snprintf(LocalTime_Str_Get,elcount(LocalTime_Str_Get),"%s%02X",LocalTime_Str_Get,Data_Get[Len_Data-i+2]);
            else
            {
              if(Temp_Time>0xFF)
                snprintf(LocalTime_Str_Get,elcount(LocalTime_Str_Get),"%s%04d",LocalTime_Str_Get,Temp_Time);
              else
                snprintf(LocalTime_Str_Get,elcount(LocalTime_Str_Get),"%s%02d",LocalTime_Str_Get,Temp_Time);
            }
          }
        }
      }
    }
    //输出接口，传递到外部进行判断
    snprintf(Time_GetNow,elcount(Time_GetNow),"%s",LocalTime_Str_Get);
  }
}
void FunDID_ReadAndSet(dword FunDID,dword ID,byte Session)
{
  int Fun_DIDPos;
  byte Send_Data[3];
  int i,Step_Flage;
  char DIDStr[50];
  Send_Data[0] = 0x22;
  Send_Data[1] = (FunDID>>8)&0xFF;
  Send_Data[2] = FunDID&0xFF;
  _Get_FunDID_Data();
  Fun_DIDPos = _Check_DID_Pos(FunDID);
  
  Step_Flage = 0;
  snprintf(DIDStr,elCount(DIDStr),"");
  if(Fun_DIDPos == -1)
    _WriteEx_and_Report("功能DID","未获取到对应的DID:0x%04X数据",FunDID);
  else if(Fun_DIDPos >= 0)
  {
    snprintf(DIDStr,elCount(DIDStr),"%s",DID_Function[Fun_DIDPos].Sig_Step);
    _Str_Upper(DIDStr);
    if(DID_Function[Fun_DIDPos].Value_Set_Count == 0)
      Step_Flage = 0;
    else
      Step_Flage = 1;
    if(Step_Flage == 0)
    {
      _WriteEx_and_Report("","DID:0x%04X未查询到对应操作,仅进行数据读取输出",FunDID);
      Check_ReadFunDID(Send_Data,Fun_DIDPos,ID,Step_Flage,0,0,1);
    }
    else
    {
      for(i=0;i<DID_Function[Fun_DIDPos].Value_Set_Count;i++)
      {
        /*进行相关操作步骤留白*/
        _Step_FunDID(DID_Function[Fun_DIDPos].Sig_Step,i);//设置第i组值
        Check_ReadFunDID(Send_Data,Fun_DIDPos,ID,Step_Flage,i,0,1);
      }
    }
    if((strncmp(DIDStr,"CARSPD",strlen(DIDStr)) == 0 && strlen(DIDStr) == strlen("CARSPD")) 
        || (strncmp(DIDStr,"VEHICLESPEED",strlen(DIDStr)) == 0 && strlen(DIDStr) == strlen("VEHICLESPEED")) 
        || strncmp(DIDStr,"READY_STATE",strlen(DIDStr)) == 0 && strlen(DIDStr) == strlen("READY_STATE"))
    {
      _Set_Sig(DID_Function[Fun_DIDPos].Sig_Name,DID_Function[Fun_DIDPos].Max_Value);
      testWaitForTimeout(500);
      Check_ReadFunDID(Send_Data,Fun_DIDPos,ID,Step_Flage,DID_Function[Fun_DIDPos].Max_Value,0,0);
      _Set_Sig(DID_Function[Fun_DIDPos].Sig_Name,DID_Function[Fun_DIDPos].Max_Value+2);
      testWaitForTimeout(500);
      Check_ReadFunDID(Send_Data,Fun_DIDPos,ID,Step_Flage,DID_Function[Fun_DIDPos].Max_Value+2,0,0);
      _Step_FunDID(DID_Function[Fun_DIDPos].Sig_Step,0);
      testWaitForTimeout(500);
      _TestDisableMsg(DID_Function[Fun_DIDPos].Sig_From);
      testWaitForTimeout(2000);
      Check_ReadFunDID(Send_Data,Fun_DIDPos,ID,Step_Flage,DID_Function[Fun_DIDPos].Value_Set[0],1,0);
      _TestEnableMsg(DID_Function[Fun_DIDPos].Sig_From);
      testWaitForTimeout(2000);
      if(strncmp(DIDStr,"READY_STATE",strlen(DIDStr)) == 0 && strlen(Struct_Ready.ReadyInvalid_Sig) == 0)
      {
        _WriteEx_and_Report("","无发动机无效相关测试");
        return;
      }
      _Set_Sig(DID_Function[Fun_DIDPos].Sig_Name,DID_Function[Fun_DIDPos].Value_Set[1]);
      testWaitForTimeout(500);
      _Invalid_Node(atol(DID_Function[Fun_DIDPos].Sig_From));
      Check_ReadFunDID(Send_Data,Fun_DIDPos,ID,Step_Flage,DID_Function[Fun_DIDPos].Value_Set[1],1,0);
      _Recover_Invalid_Node(atol(DID_Function[Fun_DIDPos].Sig_From));
      if((strncmp(DIDStr,"CARSPD",strlen(DIDStr)) == 0) || (strncmp(DIDStr,"VEHICLESPEED",strlen(DIDStr)) == 0))
        _Set_Sig(DID_Function[Fun_DIDPos].Sig_Name,0);
    }
  }
}

// 函数功能：计算字符 charToFind 在字符串 sourceStr 中出现的次数
long CountChar(char sourceStr[], char charToFind[])
{
  long count ;       // 计数器，记录出现次数
  long offset;      // 查找的起始偏移量
  long pos;
  pos = 0;count = 0;offset = 0;
  while (1)
  {
    // strstr_off 返回找到的位置索引，如果没找到则返回 -1
    pos = strstr_off(sourceStr, offset, charToFind);
    if (pos == -1)
      break;// 没找到，跳出循环
    // 找到了，计数器加一
    count++;
    // 更新下一次查找的起始位置，从本次找到位置的下一个字符开始
    offset = pos + 1;
  }
  return count;
}

void Truncate_Str(char Sor[],char Output[][],char Flage[])
{
  long startPos;  // 当前截取的起始位置
  long commaPos;  // 逗号的位置
  long len;
  long subLen;
  int i;
  startPos = 0;commaPos = 0;len = strlen(Sor);subLen = 0;i = 0;
  while (startPos < len)
  {
    commaPos = strstr_off(Sor, startPos, Flage);
    if (commaPos == -1) 
      subLen = len - startPos;
    else 
      subLen = commaPos - startPos;
    substr_cpy(Output[i], Sor, startPos, subLen, elCount(Output[i]));
    if (commaPos == -1) 
      break; // 没有更多逗号，退出循环
    startPos = commaPos + 1;
    i++;
  }
}
/*
    将输入的数据按照不同的解析方式进行转换后输出判断
    Analysis    解析方式
    DataRx      原始数据输入
    LenRx       原始数据长度
    Output      转换后字符输出
    Input       期望原始字符串
*/
int DataChange_Analysis(int Analysis,byte DataRx[],int LenRx,char Output[],char Input[],byte Padding ,char Report[])
{
  int i,j,Group_Temp;
  char Buffer_Temp[500];
  char Buffer_Check[500];
  char Temp_Rx_Data[500];
  qword Data_Temp ;
  int LenInput_Get;
  int Return_Value,Temp_Return_Flage;
  int InPut_Len;
  Return_Value = 0;
  snprintf(Buffer_Temp,elCount(Buffer_Temp),"");
  snprintf(Buffer_Check,elCount(Buffer_Check),"");
  LenInput_Get = strlen(Input);
  if(Analysis == 2)
  {
    for(i=0;i<LenInput_Get;i++)
      snprintf(Buffer_Check,elCount(Buffer_Check),"%s%c",Buffer_Check,DataRx[i]); //ASCII码查表切换
    Temp_Return_Flage = Check_information_(Buffer_Check,Input,Report);
    if(LenInput_Get<LenRx)
    {
      _WriteEx_and_Report("","存在未使用填充值");
      for(i=LenInput_Get;i<LenRx;i++)
      {
        if(DataRx[i] != Padding)
        {
          testStepFail(Report,"未使用位填充值存在非预期情况，默认填充值为；0x%02X,第%d 位实际反馈值为:0x%2X",Padding,i+1,DataRx[i]);
          Return_Value = -1;
        }
      }
    }
  }
  else if(Analysis == 3)
  {
    for(i=0;i<LenRx;i++)
      snprintf(Buffer_Temp,elCount(Buffer_Temp),"%s%02X",Buffer_Temp,DataRx[i]);
    strtoull(Buffer_Temp,Data_Temp);
    snprintf(Buffer_Check,elCount(Buffer_Check),"%s%I64u",Buffer_Check,Data_Temp);
    Temp_Return_Flage = Check_information_(Buffer_Check,Input,Report);
    if(Temp_Return_Flage == -1)
      Return_Value = -1;
  }
  else if(Analysis == 4)
  {
    for(i=0;i<LenRx;i++)
    {
      ltoa(DataRx[i],Buffer_Temp,10);
      if(strlen(Buffer_Temp) == 1)
        snprintf(Buffer_Check,200,"%s%s",Buffer_Check,"0");
      snprintf(Buffer_Check,200,"%s%s",Buffer_Check,Buffer_Temp);
    }
    Temp_Return_Flage = Check_information_(Buffer_Check,Input,Report);
    if(Temp_Return_Flage == -1)
      Return_Value = -1;
  }
  else if(Analysis == 5)
  {
    for(i=0;i<strlen(Input)/2;i++)
    {
      ltoa(DataRx[i],Buffer_Temp,16);
      if(strlen(Buffer_Temp) == 1)
      {
        snprintf(Buffer_Check,200,"%s%s",Buffer_Check,"0");
      }
      snprintf(Buffer_Check,200,"%s%s",Buffer_Check,Buffer_Temp);
    }
    toUpper(Buffer_Check, Buffer_Check, elcount(Buffer_Check));
    Temp_Return_Flage = Check_information_(Buffer_Check,Input,Report);
    if(Temp_Return_Flage == -1)
      Return_Value = -1;
    if(LenInput_Get/2 < LenRx)
    {
      _WriteEx_and_Report("","存在未使用的填充位");
      for(i=LenInput_Get/2;i<LenRx;i++)
      {
        if(DataRx[i] != Padding)
        {
          Return_Value = -1;
          testStepFail(Report,"未使用位填充值存在非预期情况，默认填充值为；0x%02X,第%d 位实际反馈值为:0x%02X",Padding,i+1,DataRx[i]);
        }
      }
    }
  }
  else if(Analysis == 7)
  {
    for(i=0;i<LenRx-3;i++) //前面为BCD拼接
    {
      ltoa(DataRx[i],Buffer_Temp,16);
      if(strlen(Buffer_Temp) == 1)
        snprintf(Buffer_Check,200,"%s%s",Buffer_Check,"0");
      snprintf(Buffer_Check,200,"%s%s",Buffer_Check,Buffer_Temp);
      snprintf(Buffer_Temp,200,"");
    }
    for(i=LenRx-3;i<LenRx;i++)  //后三字节为ASCII码
    {
      snprintf(Buffer_Check,elCount(Buffer_Check),"%s%c",Buffer_Check,DataRx[i]); //ASCII码查表切换
    }
    Temp_Return_Flage = Check_information_(Buffer_Check,Input,Report);
    if(Temp_Return_Flage == -1)
      Return_Value = -1;
  }
  else if(Analysis == 8)
  {
    Group_Temp = (LenRx-1)/3;
    for(j=0;j<3;j++)
    {
      int RxLen_Temp;
      snprintf(Buffer_Temp,elCount(Buffer_Temp),"%s","");
      snprintf(Buffer_Check,elCount(Buffer_Check),"%s","");
      snprintf(Temp_Rx_Data,elCount(Temp_Rx_Data),"%s","");
      RxLen_Temp = Group_Temp*(j+1);
      substr_cpy(Temp_Rx_Data, Input, (LenInput_Get/3)*j, LenInput_Get/3, elcount(Temp_Rx_Data));
      for(i=1+Group_Temp*j;i<RxLen_Temp+1-3;i++) //前面为BCD拼接
      {
        ltoa(DataRx[i],Buffer_Temp,16);
        if(strlen(Buffer_Temp) == 1)
          snprintf(Buffer_Check,200,"%s%s",Buffer_Check,"0");
        snprintf(Buffer_Check,200,"%s%s",Buffer_Check,Buffer_Temp);
        snprintf(Buffer_Temp,200,"");
      }
      for(i=RxLen_Temp+1-3;i<RxLen_Temp+1;i++)  //后三字节为ASCII码
      {
        snprintf(Buffer_Check,elCount(Buffer_Check),"%s%c",Buffer_Check,DataRx[i]); //ASCII码查表切换
      }
      writeEx(-3,0,"第 %d 组数据",j+1);
      Temp_Return_Flage = Check_information_(Buffer_Check,Temp_Rx_Data,Report);
      if(Temp_Return_Flage == -1)
        Return_Value = -1;
    }
  }
  else if(Analysis == 1)
  {
    if(Len_Input != 0)
    {
      Temp_Return_Flage = 0;
      for(i=0;i<Len_Input;i++)
      {
        if(DataRx[i] != DID_Data[i])
        {
          testStepFail(Report,"第 %d 位与预期不一致,期望为0x%02X,实际为0x%02X",i+1,DID_Data[i],DataRx[i]);
          Temp_Return_Flage = -1;
        }
      }
      if(Len_Input<LenRx)
      {
        _WriteEx_and_Report(Report,"存在填充值");
        for(i=Len_Input;i<LenRx;i++)
        {
          if(DataRx[i] != Padding)
          {
            testStepFail(Report,"第 %d 位填充值异常,期望为0x%02X,实际为0x%02X",i+1,Padding,DataRx[i]);
            Temp_Return_Flage = -1;
          }
        }
      }
      if(Temp_Return_Flage == 0)
      {
        testStepPass(Report,"返回值与期望一致");
        writeEx(-3,0,"%s  返回值与期望一致",Report);
      }
      else
        Return_Value = -1;
    }
    else
      _WriteEx_and_Report(Report,"未输入数据，跳过检测");
  }
  snprintf(Output,elCount(Output),"%s",Buffer_Check);
  return Return_Value;
}

/// <DTC_Diag>
/*
    发送读取故障
    判断DTC是否存在/不存在
*/
void _Check_DTC_Res(byte mask,dword DTCEx_In,dword DTCEx_Not)
{
  dword DTC_Res[100];
  byte DTC_Res_Count,Get_DTC[3];
  byte Byte_H,Byte_M,Byte_L;
  int i,size,Flage;
  Get_DTC[0] = 0x19;
  Get_DTC[1] = 0x02;
  Get_DTC[2] = mask;
  _Send_Diag(3,phyreq_ID,Get_DTC);
  if(diagGetLastResponseCode(SendData) == 0)
    testWaitForDiagResponse(SendData,2000);
  if(diagGetLastResponseCode(SendData) == -1)
  {
    size = DiagGetRespPrimitiveSize(SendData);
    DTC_Res_Count = (size-3)/4;
    testStep("DTC","共%d个DTC",DTC_Res_Count);
    for(i = 0;i< DTC_Res_Count ; i ++) 
    {      
       Byte_H = (dword)diagGetRespPrimitiveByte(SendData,i*4 + 3 + 0);
       Byte_M = (dword)diagGetRespPrimitiveByte(SendData,i*4 + 3 + 1);
       Byte_L = (dword)diagGetRespPrimitiveByte(SendData,i*4 + 3 + 2);
       DTC_Res[i] = Byte_H<<16 | Byte_M<<8 | Byte_L ;    
       testStep("DTC","第%d个DTC为 0x%06X",i,DTC_Res[i]);
    }
    Flage = 0;
    if(DTCEx_In != 0 )
    {
      Flage = _Check_Dword_in_Num(DTCEx_In,DTC_Res,DTC_Res_Count);
      if(Flage == -1)
        testStepFail("","DTC: 0x%06X ,期望存在,实际不存在",DTCEx_In);
      else
        testStepPass("","DTC: 0x%06X ,已收到",DTCEx_In);
    }
    if(DTCEx_Not != 0)
    {
      Flage = _Check_Dword_in_Num(DTCEx_Not,DTC_Res,DTC_Res_Count);
      if(Flage != -1)
        testStepFail("","DTC: 0x%06X ,期望不存在,实际存在",DTCEx_Not);
      else
        testStepPass("","DTC: 0x%06X ,与期望一致,无该DTC",DTCEx_Not);
    }
  }
  else
    _WriteEx_and_Report("","未收到正响应");
}
/// <DTC_Diag>
void _Check_DTC_Res(byte mask,dword DTCEx_In[],dword DTCEx_Not[])
{
  dword DTC_Res[100];
  byte DTC_Res_Count,Get_DTC[3];
  byte Byte_H,Byte_M,Byte_L;
  int i,size,Flage,ExInCount,ExNotInCount;
  dword DTCEx_In_Change[20],DTCEx_Not_Change[20];
  Get_DTC[0] = 0x19;
  Get_DTC[1] = 0x02;
  Get_DTC[2] = mask;
  ExInCount = 0;ExNotInCount = 0;
  for(i=0;i<elcount(DTCEx_In);i++)
  {
    if(DTCEx_In[i]!=0)
    {
      DTCEx_In_Change[ExInCount] = DTCEx_In[i];
      ExInCount++;
    }
  }
  for(i=0;i<elcount(DTCEx_Not);i++)
  {
    if(DTCEx_Not[i]!=0)
    {
      DTCEx_Not_Change[ExNotInCount] = DTCEx_Not[i];
      ExNotInCount++;
    }
  }
  _Send_Diag(3,phyreq_ID,Get_DTC);
  if(diagGetLastResponseCode(SendData) == 0)
    testWaitForDiagResponse(SendData,2000);
  if(diagGetLastResponseCode(SendData) == -1)
  {
    size = DiagGetRespPrimitiveSize(SendData);
    DTC_Res_Count = (size-3)/4;
    testStep("DTC","共%d个DTC",DTC_Res_Count);
    for(i = 0;i< DTC_Res_Count ; i ++) 
    {      
       Byte_H = (dword)diagGetRespPrimitiveByte(SendData,i*4 + 3 + 0);
       Byte_M = (dword)diagGetRespPrimitiveByte(SendData,i*4 + 3 + 1);
       Byte_L = (dword)diagGetRespPrimitiveByte(SendData,i*4 + 3 + 2);
       DTC_Res[i] = Byte_H<<16 | Byte_M<<8 | Byte_L ;    
       testStep("DTC","第%d个DTC为 0x%06X",i,DTC_Res[i]);
    }
    Flage = 0;
    if(ExInCount != 0 )
    {
      for(i=0;i<ExInCount;i++)
      {
        Flage = _Check_Dword_in_Num(DTCEx_In_Change[i],DTC_Res,DTC_Res_Count);
        if(Flage == -1)
          testStepFail("","DTC: 0x%06X ,期望存在,实际不存在",DTCEx_In_Change[i]);
        else
          testStepPass("","DTC: 0x%06X ,已收到",DTCEx_In_Change[i]);
      }
    }
    if(ExNotInCount != 0)
    {
      for(i=0;i<ExNotInCount;i++)
      {
        Flage = _Check_Dword_in_Num(DTCEx_Not_Change[i],DTC_Res,DTC_Res_Count);
        if(Flage != -1)
          testStepFail("","DTC: 0x%06X ,期望不存在,实际存在",DTCEx_Not_Change[i]);
        else
          testStepPass("","DTC: 0x%06X ,与期望一致,无该DTC",DTCEx_Not_Change[i]);
      }
    }
  }
  else
    _WriteEx_and_Report("","未收到正响应");
}
/*
    查询输入的服务中是否存在子功能需要安全访问
    若有则输出1 ，否则输出0
*/
int LoopServe_Search_SecurityAccess(byte Serve)
{
  int i,Servepos;
  int Return_Value;
  Return_Value = 0;
  Servepos = _Check_Serve(Serve,0,0);
  if(Serve != 0x31)
  {
    for(i=0;i<Serve_Data[Servepos].Serve_Fun_Count;i++)
    {
      if(Serve_Data[Servepos].Security_Access[i] == 1)
      {
        Return_Value = 1;break;
      }
    }
  }
  else if(Serve == 0x31)
  {
    for(i=0;i<Serve_31_Hex_Count;i++)
    {
      if(Serve_31_Hex[i].Security_Access[0] == 1)
      {
        Return_Value = 1;break;
      }
    }
  }
  return Return_Value;
}
/*
    查询输入的服务中当前子功能是否需要安全访问
*/
int LoopServe_Search_SecurityAccess(byte Serve,byte Fun_Pos)
{
  int i,Servepos;
  int Return_Value;
  Return_Value = 0;
  Servepos = _Check_Serve(Serve,0,0);
  if(Serve != 0x31)
  {
    Return_Value = Serve_Data[Servepos].Security_Access[Fun_Pos];
  }
  else if(Serve == 0x31)
  {
    Return_Value = Serve_31_Hex[Fun_Pos].Security_Access[0];
  }
  return Return_Value;
}
/*
    Geely3.0以及以上平台特殊操作步骤
    Serve：对应服务
    Type：执行操作类型
*/
void StepByGeely3_0(byte Serve,int Type)
{
  int SigValue;
  if(Geely3_Flage == 1)
  {
    if(Serve == 0x85)
    {
      diagStartTesterPresent(Cdd_Name);
      SigValue = getSignal(Struct_Ready.Ready_Sig);
      if(Type == 1 && SigValue != Struct_Ready.Ready_Active)/*85服务相关，测试前需开启发动机才能报出故障*/
      {
        _Set_Ready(Struct_Ready.Ready_Active);
        testWaitForTimeout(6000);
      }
      else if(Type == 0 && SigValue != 0) /*85服务受发动机影响会回NRC22故关闭发动机*/
      {
        _Set_Ready(0);
      }
      diagStopTesterPresent(Cdd_Name);
    }
    else if(Serve == 0x19)
    {
      diagStartTesterPresent(Cdd_Name);
      SigValue = getSignal(Struct_Ready.Ready_Sig);
      if(Type == 1 && SigValue != Struct_Ready.Ready_Active)/*需开启发动机才能报出故障*/
      {
        _Set_Ready(Struct_Ready.Ready_Active);
        testWaitForTimeout(6000);
      }
      diagStopTesterPresent(Cdd_Name);
    }
  }
  else if(strncmp(ECU_project,"ChangAn",strlen(ECU_project)) == 0 && strlen(ECU_project) == strlen("ChangAn"))
  {
    if(Serve == 0x19) //长安读取故障需要开启发动机
    {
      SigValue = getSignal(Struct_Ready.Ready_Sig);
      if(Type == 1 && SigValue != Struct_Ready.Ready_Active)
        _Set_Ready(Struct_Ready.Ready_Active);
      else if(Type == 0 && SigValue != 0)
        _Set_Ready(0);
    }
  }
}
/*简化吉利3.0 11服务NRC22测试步骤输入*/
void StepForGeelyServe11(byte Session)
{
  testWaitForTimeout(2000);
  if(Session != defsession)
    _SetSession(Session);
  testWaitForTimeout(200);
}

/*
  查找目标字符串chararray在hexarray中的结束位置
  参数hexarray：数据
  参数offset：查找的起始位
  参数chararray：查找的目标字符串
  返回值a：查找到的结束位
*/
long Hexandchar_strstr(byte hexarray[],long offset,char chararray[])
{
  long i,j,a;
  i=0;a=0;
  for(i=offset;i<elcount(hexarray);i++)
  {
    for(j=0;j<strlen(chararray);j++)
    {
      if(hexarray[i+j]!=chararray[j])
        break;
    }
    if(j==strlen(chararray))
    {
      a=i+strlen(chararray);
      for(j=a;j<strlen(chararray);j++)
      {}
      break;
    }
  }
  return a;
}

void FunDID_ReadAndSet_Snapshot(dword FunDID,dword ID,byte Session)
{
  int Fun_DIDPos;
  byte Send_Data[3];
  int i,Step_Flage;
  char DIDStr[50];
  byte mask;
  byte Send_Data_22[3] = {0x22,0x33,0x0C};
  byte Data_Send[6] = {0x19,0x04,0,0,0,0x20};
  Init_For_Snapshot();
  DTC_H = (DTC_19[Node_1904_Pos][1]>>16);
  DTC_M = (DTC_19[Node_1904_Pos][1]>>8);
  DTC_L = (DTC_19[Node_1904_Pos][1]&0xFF);
  Data_Send[2] = DTC_H;
  Data_Send[3] = DTC_M;
  Data_Send[4] = DTC_L;
  Send_Data_22[1] = (FunDID>>8)&0xFF;
  Send_Data_22[2] = (FunDID)&0xFF;
  
  Send_Data[0] = 0x22;
  Send_Data[1] = (FunDID>>8)&0xFF;
  Send_Data[2] = FunDID&0xFF;
  _Get_FunDID_Data();
  Fun_DIDPos = _Check_DID_Pos(FunDID);
  
  Step_Flage = 0;
  snprintf(DIDStr,elCount(DIDStr),"");
  if(Fun_DIDPos == -1)
    _WriteEx_and_Report("功能DID","未获取到对应的DID:0x%04X数据",FunDID);
  else if(Fun_DIDPos >= 0)
  {
    StepByGeely3_0(0x19,1);
    snprintf(DIDStr,elCount(DIDStr),"%s",DID_Function[Fun_DIDPos].Sig_Step);
    _Str_Upper(DIDStr);
    if(DID_Function[Fun_DIDPos].Value_Set_Count == 0)
      Step_Flage = 0;
    else
      Step_Flage = 1;
    if(Step_Flage == 0)
    {
      _WriteEx_and_Report("","DID:0x%04X未查询到对应操作,仅进行数据读取输出",FunDID);
      _Close_One_Node(DTC_19[Node_1904_Pos]);
      mask = DTC_19[Node_1904_Pos][2];
      Check_ReadFunDID(Send_Data,Fun_DIDPos,ID,Step_Flage,0,0,1);
      _Send_Diag(6,phyreq_ID,Data_Send);
      _Check_1904ForFunDID(SendData,mask,DID_Function[Fun_DIDPos].Sig_Step,0,2);
      _Open_One_Node(DTC_19[Node_1904_Pos]);
      _Clear_DTC(phyreq_ID);
      testWaitForTimeout(200);
    }
    else
    {
      for(i=0;i<DID_Function[Fun_DIDPos].Value_Set_Count;i++)
      {
        _Close_One_Node(DTC_19[Node_1904_Pos]);
        mask = DTC_19[Node_1904_Pos][2];
        _Step_FunDID(DID_Function[Fun_DIDPos].Sig_Step,i);//设置第i组值
        Check_ReadFunDID(Send_Data,Fun_DIDPos,ID,Step_Flage,i,0,1);
        _Send_Diag(6,phyreq_ID,Data_Send);
        _Check_1904ForFunDID(SendData,mask,DID_Function[Fun_DIDPos].Sig_Step,DID_Function[Fun_DIDPos].Value_Ex[i],0);
        _Open_One_Node(DTC_19[Node_1904_Pos]);
        _Clear_DTC(phyreq_ID);
        testWaitForTimeout(200);
      }
    }
//    if((strncmp(DIDStr,"CARSPD",strlen(DIDStr)) == 0 && strlen(DIDStr) == strlen("CARSPD")) 
//        || (strncmp(DIDStr,"VEHICLESPEED",strlen(DIDStr)) == 0 && strlen(DIDStr) == strlen("VEHICLESPEED")) 
//        || strncmp(DIDStr,"READY_STATE",strlen(DIDStr)) == 0 && strlen(DIDStr) == strlen("READY_STATE"))
//    {
//      _Set_Sig(DID_Function[Fun_DIDPos].Sig_Name,DID_Function[Fun_DIDPos].Max_Value);
//      testWaitForTimeout(500);
//      Check_ReadFunDID(Send_Data,Fun_DIDPos,ID,Step_Flage,DID_Function[Fun_DIDPos].Max_Value,0,0);
//      _Set_Sig(DID_Function[Fun_DIDPos].Sig_Name,DID_Function[Fun_DIDPos].Max_Value+2);
//      testWaitForTimeout(500);
//      Check_ReadFunDID(Send_Data,Fun_DIDPos,ID,Step_Flage,DID_Function[Fun_DIDPos].Max_Value+2,0,0);
//      _Step_FunDID(DID_Function[Fun_DIDPos].Sig_Step,0);
//      testWaitForTimeout(500);
//      _TestDisableMsg(DID_Function[Fun_DIDPos].Sig_From);
//      testWaitForTimeout(2000);
//      Check_ReadFunDID(Send_Data,Fun_DIDPos,ID,Step_Flage,DID_Function[Fun_DIDPos].Value_Set[0],1,0);
//      _TestEnableMsg(DID_Function[Fun_DIDPos].Sig_From);
//      testWaitForTimeout(2000);
//      if(strncmp(DIDStr,"READY_STATE",strlen(DIDStr)) == 0 && strlen(Struct_Ready.ReadyInvalid_Sig) == 0)
//      {
//        _WriteEx_and_Report("","无发动机无效相关测试");
//        return;
//      }
//      _Set_Sig(DID_Function[Fun_DIDPos].Sig_Name,DID_Function[Fun_DIDPos].Value_Set[1]);
//      testWaitForTimeout(500);
//      _Invalid_Node(atol(DID_Function[Fun_DIDPos].Sig_From));
//      Check_ReadFunDID(Send_Data,Fun_DIDPos,ID,Step_Flage,DID_Function[Fun_DIDPos].Value_Set[1],1,0);
//      _Recover_Invalid_Node(atol(DID_Function[Fun_DIDPos].Sig_From));
//      if((strncmp(DIDStr,"CARSPD",strlen(DIDStr)) == 0) || (strncmp(DIDStr,"VEHICLESPEED",strlen(DIDStr)) == 0))
//        _Set_Sig(DID_Function[Fun_DIDPos].Sig_Name,0);
//    }
  }
}
/*
  设置功能DID步骤中数据操作
*/
 int _Step_FunDID(char str[],dword Type) //取第Type组数据
{
  int n;
  int Sw_temp,Step_Flage;
  char str_T[500];
  char Te[500];
  snprintf(str_T,elCount(str_T),"%s","");
  snprintf(str_T,elCount(str_T),"%s",str);
  Sw_temp = _Check_StrPossion_Res(str,4); //检测字符串是否在预期输入中
  Step_Flage = 1;
  _Str_Upper(str_T);
  snprintf(Te,elCount(Te),"%s","");
  
  if(Sw_temp!= -1 && Step_Flage == 1)
  {
    if(((strncmp(str_T,"BATTERY",strlen(str_T)) == 0) || (strncmp(str_T,"VOLTAGE",strlen(str_T)) == 0)) )
    {
      _Set_Battery(DID_Function[Sw_temp].Value_Set[Type]);
      DID_Function[Sw_temp].Value_Set_Flage = 1;
      return 0;
    }
    else if(strncmp(str_T,"ANGLE",strlen(str_T)) == 0 )
    {
      _Get_Ready();
      if(Engine_State == 0)
        _Set_Ready(Struct_Ready.Ready_Active);
      snprintf(Te,elCount(Te),"转动方向盘到 %.1f°",DID_Function[Sw_temp].Value_Set[Type]);
      _TestWaitForTesterConfirmation(Te);
      DID_Function[Sw_temp].Value_Set_Flage = 1;
      if(Engine_State == 0)
        _Set_Ready(Engine_State);
      return 0;
    }
    else if(strncmp(str_T,"LOCALTIME",strlen(str_T)) == 0)
    {
      snprintf(Te,elCount(Te),"%s",DID_Function[Sw_temp].LocalTime_Set[Type]);
      _WriteEx_and_Report("   设置LocalTime",Te);
      _Set_Time(Te,1);
      DID_Function[Sw_temp].Value_Set_Flage = 1;
      return 0;
    }
    else
    {
      for(n=0;n<DID_Function_Count;n++)
      {
        if(strncmp(str,DID_Function[n].Sig_Step,strlen(str)) == 0 )
        {
          _Check_ID_(DID_Function[n].Sig_From);
          if(Canoe_Node_Flage == 1)
          {
            _Set_Sig(DID_Function[n].Sig_Name,DID_Function[Sw_temp].Value_Set[Type]);
            DID_Function[Sw_temp].Value_Set_Flage = 1;
            testWaitForTimeout(100);
            return 0;
          }
        }
      }
    }
  }
  {
    Sw_temp = -1;
    _WriteEx_and_Report(str,"未查询到对应的操作流程,待后续完善");
    return -1;
  }
}

_Check_1904ForFunDID(diagRequest* Diag,dword mask,char Check_Str[],float Ex_Value,dword type) //type = 0:有效值   type = 1:无效值  type = 2:仅获取值 
{
  int ii,n;
  char Comment[70];
  dword Rx_Len;
  int swhere;
  int swhere_1;
  int Possition_LocalTime[6];
  byte DID_Tmep[2];
  byte DID_Tmep_1[2];
  byte DID_Tmep_2[2];
  byte Res_Data[100];
  byte Check_Flage_Value;
  char Vaule_Str_Temp[20];
  float Vaule_Temp;
  int Possition;
  Res1904_Data_Count = 0;
  Check_Flage_Value = 0;
  if(diagGetLastResponseCode(Diag) == 0)
    testWaitForDiagResponse(Diag,1000);
  if(diagGetLastResponseCode(Diag) == 0)
    testStepFail("未收到响应");
  else if(diagGetLastResponseCode(Diag) > 0)
    testStepFail("收到消极应答");
  else
  {
    Rx_Len = DiagGetRespPrimitiveSize(Diag);
    for(ii=0;ii<5;ii++)
    {
      if(ii==0)
      {
        if((DiagGetPrimitiveByte(Diag,0)^0x40)!=diagGetRespPrimitiveByte(Diag,0))
          testStepFail("","预期结果为0x%02X,实测结果为0x%02X",DiagGetPrimitiveByte(Diag,0)^0x40,diagGetRespPrimitiveByte(Diag,ii));
      }
      else
      {
        if(DiagGetPrimitiveByte(Diag,ii)!=diagGetRespPrimitiveByte(Diag,ii))
          testStepFail("","预期结果为0x%02X,实测结果为0x%02X",DiagGetPrimitiveByte(Diag,ii),diagGetRespPrimitiveByte(Diag,ii));     
      }
    }
    {
      if(((mask &0x01) == (diagGetRespPrimitiveByte(Diag,5)&0x01)) && ((mask &0x08) == (diagGetRespPrimitiveByte(Diag,5)&0x08)))
        testStepPass("","当前掩码状态与预期一致");
      else
        testStepFail("","当前掩码状态与预期不一致，预期为 0x%02X ,实际为0x%02X",mask,diagGetRespPrimitiveByte(Diag,5));
    }
    if(diagGetRespPrimitiveByte(Diag,6)!= Freeze_Frame_Number[0])
      testStepFail("快照号","预期结果为0x%02X,实测结果为0x%02X",Freeze_Frame_Number[0],diagGetRespPrimitiveByte(Diag,6)); 
    else
      testStepPass("快照号","预期与实测结果一致为: 0x%02X",diagGetRespPrimitiveByte(Diag,6)); 
    if(diagGetRespPrimitiveByte(Diag,7)!= mixArray_Len)
      testStepFail("快照个数","预期结果为0x%02X,实测结果为0x%02X",mixArray_Len,diagGetRespPrimitiveByte(Diag,7)); 
    else
      testStepPass("快照个数","预期与实测结果一致为: 0x%02X",diagGetRespPrimitiveByte(Diag,7)); 
    for(ii=8;ii<Rx_Len-2;ii++)
    {
      int Flage_DID_Tmep_2;
      
      DID_Tmep[0] = diagGetRespPrimitiveByte(Diag,ii);
      DID_Tmep[1] = diagGetRespPrimitiveByte(Diag,ii+1);
      Possition = Array_Compare_1904(DID_Tmep);     //DID在结构体的位置
      Vaule_Temp = 0;
      if(Possition != -1)
      {
        DID_Tmep_1[0] = diagGetRespPrimitiveByte(Diag,ii-2);
        DID_Tmep_1[1] = diagGetRespPrimitiveByte(Diag,ii-1);
        if(Rx_Len<Rx_Len-4)
        {
          DID_Tmep_2[0] = diagGetRespPrimitiveByte(Diag,ii+2);
          DID_Tmep_2[1] = diagGetRespPrimitiveByte(Diag,ii+3);
          Flage_DID_Tmep_2 =  Array_Compare_1904(DID_Tmep_2);
        }
        else
          Flage_DID_Tmep_2 = 1;
        if(Array_Compare_1904(DID_Tmep_1)!=-1 && Flage_DID_Tmep_2 !=-1) //判断是数据还是DID
        { }
        else
        {
          snprintf(Comment,elCount(Comment),"%s","");
          Res1904_Data[Res1904_Data_Count].Res_DID[0] = DID_Tmep[0];
          Res1904_Data[Res1904_Data_Count].Res_DID[1] = DID_Tmep[1];
          snprintf(Comment,elCount(Comment),"%s %02X",Comment,DID_Tmep[0]);
          snprintf(Comment,elCount(Comment),"%s %02X",Comment,DID_Tmep[1]);
          Res1904_Data[Res1904_Data_Count].Res_DID_Data_Len = mixArray[Possition].DID_1904_Len;
          Res1904_Data[Res1904_Data_Count].Factor = mixArray[Possition].Factor;
          Res1904_Data[Res1904_Data_Count].Offset = mixArray[Possition].Offset;
          Res1904_Data[Res1904_Data_Count].Tolerance = mixArray[Possition].Tolerance;
          Res1904_Data[Res1904_Data_Count].Possition = Possition;
          snprintf( Res1904_Data[Res1904_Data_Count].Str,elcount(mixArray[Possition].Str_DID_1904),"%s",mixArray[Possition].Str_DID_1904);
          snprintf( Res1904_Data[Res1904_Data_Count].Symbol,elcount(mixArray[Possition].Symbol),"%s",mixArray[Possition].Symbol);
          for(n=0;n<mixArray[Possition].DID_1904_Len;n++)
             Res1904_Data[Res1904_Data_Count].Res_DID_Data[n] = diagGetRespPrimitiveByte(Diag,ii+2+n);
          {
            if(strncmp(Res1904_Data[Res1904_Data_Count].Symbol,"signed",strlen(Res1904_Data[Res1904_Data_Count].Symbol)) == 0)
            {
              if((Res1904_Data[Res1904_Data_Count].Res_DID_Data[0]&0x80)==0x80 )   //负数
              {
                qword Da;
                qword Tem;
                Tem = 0;
                for(n=0;n<Res1904_Data[Res1904_Data_Count].Res_DID_Data_Len;n++)
                  Tem = Tem + (Res1904_Data[Res1904_Data_Count].Res_DID_Data[n]<<(8*(Res1904_Data[Res1904_Data_Count].Res_DID_Data_Len-n-1)));
                if(Res1904_Data[Res1904_Data_Count].Res_DID_Data_Len == 4)
                  Da = 0xFFFFFFFF;
                else if(Res1904_Data[Res1904_Data_Count].Res_DID_Data_Len == 3)
                  Da = 0xFFFFFF;
                else if(Res1904_Data[Res1904_Data_Count].Res_DID_Data_Len == 2)
                  Da = 0xFFFF;
                else if(Res1904_Data[Res1904_Data_Count].Res_DID_Data_Len == 1)
                  Da = 0xFF;
                Vaule_Temp = (0xFFFFFFFF - Tem) & Da;
                Vaule_Temp = Vaule_Temp*(-1);
              }
              else
              {
                for(n=0;n<Res1904_Data[Res1904_Data_Count].Res_DID_Data_Len;n++)
                  Vaule_Temp = Vaule_Temp + (Res1904_Data[Res1904_Data_Count].Res_DID_Data[n]<<(8*(Res1904_Data[Res1904_Data_Count].Res_DID_Data_Len-n-1)));
              }
            }
            else
            {
              for(n=0;n<Res1904_Data[Res1904_Data_Count].Res_DID_Data_Len;n++)
                Vaule_Temp = Vaule_Temp + (Res1904_Data[Res1904_Data_Count].Res_DID_Data[n]<<(8*(Res1904_Data[Res1904_Data_Count].Res_DID_Data_Len-n-1)));    
            }
            Res1904_Data[Res1904_Data_Count].Vaule_Now = (Vaule_Temp*Res1904_Data[Res1904_Data_Count].Factor) + Res1904_Data[Res1904_Data_Count].Offset;
          }
          Res1904_Data_Count++;
        } //数据DID循环
      }
    }  // for循环结束,获取到全部数据装入结构体Res1904_Data中
    
    if(strncmp(Check_Str,"ALL",strlen(Check_Str))!=0)
      swhere_1 =  _Check_StrPossion_Res(Check_Str,2);  //字符串在返回数据中的位置
    if(strncmp(Check_Str,"LocalTime",strlen(Check_Str))==0 && strlen(Check_Str)!=0)
    {
      swhere = _Check_StrPossion_Res("LocalTime",1); //字符串在预输入数据中的位置
      if(swhere == -1)
        _WriteEx_and_Report("LocalTime","当前预输入中无时间快照信息");
      else         //时间拼接计算 真实时间
      {
        if(strncmp(Res1904_Data[swhere_1].Symbol,"BCD",strlen(Res1904_Data[swhere_1].Symbol))==0)   //BCD格式,全原码拼接
        {
          /*判断是:年/月/日/时/分/秒       还是:秒/分/时/日/月/年*/
          /************************待完善*************************/
          Possition_LocalTime[0] = _Check_StrPossion("year",swhere,0);
          if(mixArray[swhere].LocalTime[Possition_LocalTime[0]][1]>0)
          {
            for(n=0;n<Res1904_Data[swhere_1].Res_DID_Data_Len;n++)
            {
              snprintf(Vaule_Str_Temp,elCount(Vaule_Str_Temp),"%s","");
              snprintf(Vaule_Str_Temp,elcount(Vaule_Str_Temp),"%s%X",Vaule_Str_Temp,Res1904_Data[swhere_1].Res_DID_Data[n]);
              if(strlen(Vaule_Str_Temp)<2)
                snprintf(Vaule_Str_Temp,elCount(Vaule_Str_Temp),"%c%s",'0',Vaule_Str_Temp);
              snprintf(Res1904_Data[swhere_1].LocalTime_Value,elCount(Res1904_Data[swhere_1].LocalTime_Value),"%s%s",Res1904_Data[swhere_1].LocalTime_Value,Vaule_Str_Temp);
            }
          }
          else
          {
            for(n=Res1904_Data[swhere_1].Res_DID_Data_Len;n>=0;n--)
            {
              snprintf(Vaule_Str_Temp,elCount(Vaule_Str_Temp),"%s","");
              snprintf(Vaule_Str_Temp,elcount(Vaule_Str_Temp),"%s%x",Vaule_Str_Temp,Res1904_Data[swhere_1].Res_DID_Data[n]);
              if(strlen(Vaule_Str_Temp)<2)
                snprintf(Vaule_Str_Temp,elCount(Vaule_Str_Temp),"%c%s",'0',Vaule_Str_Temp);
              snprintf(Res1904_Data[swhere_1].LocalTime_Value,elCount(Res1904_Data[swhere_1].LocalTime_Value),"%s%s",Res1904_Data[swhere_1].LocalTime_Value,Vaule_Str_Temp);
            }
          }
        }
        else
        {
          qword Temp_Time;
          dword swhere_temp;
          Possition_LocalTime[0] = _Check_StrPossion("year",swhere,0);
          Possition_LocalTime[1] = _Check_StrPossion("month",swhere,0);
          Possition_LocalTime[2] = _Check_StrPossion("day",swhere,0);
          Possition_LocalTime[3] = _Check_StrPossion("hour",swhere,0);
          Possition_LocalTime[4] = _Check_StrPossion("minute",swhere,0);
          Possition_LocalTime[5] = _Check_StrPossion("second",swhere,0);
          Temp_Time =0;
          if(mixArray[swhere].LocalTime[Possition_LocalTime[0]][1]>0)
          {
            for(n=0;n<Res1904_Data[swhere_1].Res_DID_Data_Len;n++)
            {
              snprintf(Vaule_Str_Temp,elCount(Vaule_Str_Temp),"%s","");
              if(Possition_LocalTime[n] == -1)    //仅包含部分时间,不是完整的 年月日时分秒,舍弃未查询到的字符
              {
                //snprintf(Vaule_Str_Temp,elCount(Vaule_Str_Temp),"%c%s",'00',Vaule_Str_Temp);
              }
              else
              {
                swhere_temp = mixArray[swhere_1].LocalTime[Possition_LocalTime[n]][1];    //预期所在位置
                swhere_temp = Res1904_Data[swhere_1].Res_DID_Data_Len - swhere_temp - 1;  //装载后位置反向排序后取正确位置
                Temp_Time = Res1904_Data[swhere_1].Res_DID_Data[swhere_temp] + mixArray[swhere_1].LocalTime[Possition_LocalTime[n]][2]; //计算后的值
                snprintf(Vaule_Str_Temp,elcount(Vaule_Str_Temp),"%s%X",Vaule_Str_Temp,Temp_Time);
                if(strlen(Vaule_Str_Temp)<2)
                  snprintf(Vaule_Str_Temp,elCount(Vaule_Str_Temp),"%c%s",'0',Vaule_Str_Temp);
              }
              snprintf(Res1904_Data[swhere_1].LocalTime_Value,elCount(Res1904_Data[swhere_1].LocalTime_Value),"%s%s",Res1904_Data[swhere_1].LocalTime_Value,Vaule_Str_Temp);
            }
          }
          else
          {
            for(n=0;n<Res1904_Data[swhere_1].Res_DID_Data_Len;n++)
            {
              snprintf(Vaule_Str_Temp,elCount(Vaule_Str_Temp),"%s","");
              if(Possition_LocalTime[n] == -1)    //仅包含部分时间,不是完整的 年月日时分秒,舍弃未查询到的字符
              {
                //snprintf(Vaule_Str_Temp,elCount(Vaule_Str_Temp),"%c%s",'00',Vaule_Str_Temp);
              }
              else
              {
                swhere_temp = mixArray[swhere_1].LocalTime[Possition_LocalTime[n]][1];    //预期所在位置
                swhere_temp = Res1904_Data[swhere_1].Res_DID_Data_Len - 1;  //装载后位置反向排序后取正确位置
                Temp_Time = Res1904_Data[swhere_1].Res_DID_Data[swhere_temp] + mixArray[swhere_1].LocalTime[Possition_LocalTime[n]][2]; //计算后的值
                snprintf(Vaule_Str_Temp,elcount(Vaule_Str_Temp),"%s%X",Vaule_Str_Temp,Temp_Time);
                if(strlen(Vaule_Str_Temp)<2)
                  snprintf(Vaule_Str_Temp,elCount(Vaule_Str_Temp),"%c%s",'0',Vaule_Str_Temp);
              }
              snprintf(Res1904_Data[swhere_1].LocalTime_Value,elCount(Res1904_Data[swhere_1].LocalTime_Value),"%s%s",Res1904_Data[swhere_1].LocalTime_Value,Vaule_Str_Temp);
            }
          }
        }
      }
      _WriteEx_and_Report("","/---------------   LocalTime   ---------------/");
      if(strncmp(Res1904_Data[swhere_1].LocalTime_Value,mixArray[swhere].LocalTime_Value,strlen(Res1904_Data[swhere_1].LocalTime_Value))==0 &&strncmp(mixArray[swhere].LocalTime_Value,Res1904_Data[swhere_1].LocalTime_Value,strlen(mixArray[swhere].LocalTime_Value))==0)
        testStepPass(Check_Str,"预期时间与实际返回时间一致,均为 %s",Res1904_Data[swhere_1].LocalTime_Value);
      else
        testStepFail(Check_Str,"预期时间为 %s  ,实际返回为 %s",mixArray[swhere].LocalTime_Value,Res1904_Data[swhere_1].LocalTime_Value);
    }
    else
    {
      dword Temp_Possion;
      qword Invalid_Value_;
      char Cmment_S[200];
      char Cmment_T[200];
      char Cmment_D[200];
      snprintf(Cmment_S,elCount(Cmment_S),"%s","");
      snprintf(Cmment_D,elCount(Cmment_D),"%s","");
      snprintf(Cmment_T,elCount(Cmment_T),"%s","");
      if(strncmp(Check_Str,"ALL",strlen(Check_Str))==0 && strlen(Check_Str)!=0)
        return;
      Temp_Possion = _Check_StrPossion_Res(Check_Str,1);  //字符串预期输入数据中的位置
      // writeEx(-3,0,"%s  %d  %d",Check_Str,Temp_Possion,swhere_1);
      if(Temp_Possion == -1 || swhere_1 == -1 ) 
      { 
//        if(strncmp(Check_Str,"ALL",strlen(Check_Str))!=0)
          _WriteEx_and_Report(Check_Str,"所输入判断数据不在预期列表中");
      }
      else
      {
        snprintf(Cmment_D,elCount(Cmment_D),"%02X  %02X",Res1904_Data[swhere_1].Res_DID[0],Res1904_Data[swhere_1].Res_DID[1]);
        for(n=0;n<Res1904_Data[swhere_1].Res_DID_Data_Len;n++)
          snprintf(Cmment_T,elCount(Cmment_T),"%s %02X",Cmment_T,Res1904_Data[swhere_1].Res_DID_Data[n]);
        snprintf(Cmment_S,elCount(Cmment_S),"/---------------   %s   ---------------/",mixArray[Temp_Possion].Str_DID_1904);
        _WriteEx_and_Report("",Cmment_S);
        _WriteEx_and_Report("","DID: ",Cmment_D);
        _WriteEx_and_Report("","接收到的数据为 ",Cmment_T);
        if(type == 0)   //正常有效值
        {
          _WriteEx_and_Report("","预期结果为 %.2f",Ex_Value);
          _WriteEx_and_Report("","实际结果为 %.2f",Res1904_Data[swhere_1].Vaule_Now);
          if(Ex_Value <= mixArray[Temp_Possion].DID_Value_min || Ex_Value >= mixArray[Temp_Possion].DID_Value_max)
            _Check_ValueInRange_IsWrite(Res1904_Data[swhere_1].Vaule_Now,Ex_Value,0,Check_Str,0,0);
          else
            _Check_ValueInRange_IsWrite(Res1904_Data[swhere_1].Vaule_Now,Ex_Value,Res1904_Data[swhere_1].Tolerance,Check_Str,0,0);
        }
        else if(type == 1)    // 无效值
        {
          if(mixArray[Temp_Possion].Invalid_LastValue == 0)
          {
            char Ex_Invalid[30];
            char Now_Invalid[30];
            _WriteEx_and_Report("","使用无效值");
            snprintf(Ex_Invalid,elCount(Ex_Invalid),"%s","");
            snprintf(Now_Invalid,elCount(Now_Invalid),"%s","");
            for(n=0;n<Res1904_Data[swhere_1].Res_DID_Data_Len;n++)
            {
//              Invalid_Value_ = Invalid_Value_ +  Res1904_Data[swhere_1].Res_DID_Data[n]<<(8*(Res1904_Data[swhere_1].Res_DID_Data_Len - n - 1));
              snprintf(Now_Invalid,elCount(Now_Invalid),"%s%02X",Now_Invalid,Res1904_Data[swhere_1].Res_DID_Data[n]);
            }
            ltoa(mixArray[Temp_Possion].Invalid,Ex_Invalid,16);
            _Str_Upper(Ex_Invalid);
            _WriteEx_and_Report("","预期结果为 ",Ex_Invalid);
            _WriteEx_and_Report("","实际结果为 ",Now_Invalid);
//            if(Invalid_Value_ != mixArray[Temp_Possion].Invalid)
            if((strncmp(Ex_Invalid,Now_Invalid,strlen(Ex_Invalid)) != 0))
              testStepFail(Check_Str,"无效值状态异常,期望无效值为 %s ,实际无效值为 %s",Ex_Invalid,Now_Invalid);
//              testStepFail(Check_Str,"无效值状态异常,期望无效值为0x%X,实际无效值为0x%X",mixArray[Temp_Possion].Invalid,Invalid_Value_);
            else
              testStepPass(Check_Str,"无效值与期望一致,为 %s",Now_Invalid);
//              testStepPass(Check_Str,"无效值与期望一致,为0x%X",Invalid_Value_);
          }
          else   //最后一次有效值
          {
            /************************待完善*************************/
          }
        }
        else if(type == 2)    // 仅获取值并打印到报告中,不判断
        {
          char comment[200];
          snprintf(comment,elCount(comment),"%s","");
          snprintf(comment,elCount(comment),"%s  获取到的数据为",Check_Str);
          _WriteEx_and_Report("","实际结果为 %.2f",Res1904_Data[swhere_1].Vaule_Now);
          _WriteEx_and_Report("","解析后的值为 %.2f",Check_Str,Res1904_Data[swhere_1].Vaule_Now);
          for(n=0;n<Res1904_Data[swhere_1].Res_DID_Data_Len;n++)
            snprintf(comment,elCount(comment),"%s %02X",comment,Res1904_Data[swhere_1].Res_DID_Data[n]);
          testCaseComment(comment);
          writeEx(-3,0,comment);
        }
      }
    }
  }
}

void Init_For_Snapshot()
{
  int i;
  if(State_Loop == 0)
  {
    for(i=0;i<DTC_19_Count;i++)
    {
      if(DTC_19[i][0]==Node_1904)
      {
        Node_1904_Pos = i;
        break;
      }
    }
    State_Loop = 1;
  }
}

_get_NRC11(dword ID)
{
  message 0x00 msg;
  double starttime;
  double endtime1;
  double endtime2;
  byte result;
  byte sid;
  sid=DiagGetPrimitiveByte(SendData,0);
  starttime=(double)timeNow()/100;
  result=testWaitForMessage(Response_ID,p2cmax);
  if(ID==phyreq_ID)
  {
    if(result==1)
    {
      endtime1=(double)timeNow()/100;
      testGetWaitEventMsgData(msg);
      if((msg.byte(0)==0x03)&&(msg.byte(1)==0x7F)&&(msg.byte(2)==sid)&&(msg.byte(3)==0x11))
      {
        testStepPass("","收到否定响应NRC11");
        if((endtime1-starttime)<=p2cmax)
          testStepPass("","NRC11实际响应时间为%fms",endtime1-starttime);
        else
          testStepFail("","NRC11实际响应时间为%fms",endtime1-starttime);
      }
      else
        testStepFail("","收到非NRC11响应");
    }
    else
    {
      testStepFail("","未在规定时间内收到响应");
      return;
    }
  }
  else if(ID == funreq_ID)
  {
    if(result==1)
    {
      endtime1=(double)timeNow()/100;
      testGetWaitEventMsgData(msg);
      if((msg.byte(0)==0x03)&&(msg.byte(1)==0x7F)&&(msg.byte(2)==sid)&&(msg.byte(3)==0x11))
      {
        testStepFail("","收到否定响应NRC11");
        if((endtime1-starttime)<=p2cmax)
          testStepPass("","NRC11实际响应时间为%fms",endtime1-starttime);
        else
          testStepFail("","NRC11实际响应时间为%fms",endtime1-starttime);
      }
      else
        testStepFail("","收到非NRC11响应");
    }
    else
    {
      testStepPass("","功能寻址下NRC11不响应");
      return;
    }
  }
}

void Wait(dword Time)
{
  if(Time <= 0)
    Time = 1;
  _WriteEx_and_Report("","等待 %d ms",Time);
  testWaitForTimeout(Time);
}

void EOL_Serve_22_Send(byte Send_Num[])
{
  char Str_22_Send[30];
  snprintf(Str_22_Send,elCount(Str_22_Send),"DID_%02X%02X",Send_Num[1],Send_Num[2]);
  _Get_DID(Str_22_Send);
  Analysis_Select(Analysis,phyreq_ID,Send_Num,-1);
}


 _Str_Upper(char Str[])
{
  char Tem_Str[200];
  toUpper(Tem_Str,Str,elCount(Tem_Str));
  snprintf(Str,elcount(Str),"%s",Tem_Str);
}
/****************************************************************************************************
 * 辅助函数：_HexStrToQword
 * 功能  ：将 "0xHHHH..."(十六进制) 或 "123456"(十进制) 字符串转换为 64位无符号整数 qword
 *        - 十六进制支持 1~16 个字符(即 1~8 字节)，自动补偶数字节
 *        - 十进制支持任意长度(内部使用 qword 逐字符乘10累加，最大到 0xFFFFFFFFFFFFFFFF)
 * 解决问题：
 *        atol()   32位有符号容器 -> 4字节高位为1时符号位错误 / >4字节直接截断丢高位
 *        atodbl() 53位尾数精度  -> >7字节整数丢失低精度位
 ****************************************************************************************************/
qword _HexStrToQword(char s[])
{
  int   i, len, pos_start;
  qword result;
  byte  b, nib_hi, nib_lo;

  result = 0;
  len    = strlen(s);

  /* ---- 十六进制分支（带 0x / 0X 前缀） ---- */
  if (strstr(s,"0x") != -1 || strstr(s,"0X") != -1)
  {
    pos_start = 2;
    /* 奇数个十六进制字符 -> 先处理最高半字节（相当于前补0） */
    if ((len - pos_start) % 2 == 1)
    {
      nib_hi = 0;
      if      (s[pos_start] >= '0' && s[pos_start] <= '9') nib_hi = s[pos_start] - '0';
      else if (s[pos_start] >= 'A' && s[pos_start] <= 'F') nib_hi = s[pos_start] - 'A' + 10;
      else if (s[pos_start] >= 'a' && s[pos_start] <= 'f') nib_hi = s[pos_start] - 'a' + 10;
      result = (result << 4) | nib_hi;
      pos_start++;
    }
    /* 每 2 个十六进制字符拼成 1 字节，从高到低左移拼接到 qword */
    for (i = pos_start; i < len; i += 2)
    {
      nib_hi = 0; nib_lo = 0;
      if      (s[i] >= '0' && s[i] <= '9') nib_hi = s[i] - '0';
      else if (s[i] >= 'A' && s[i] <= 'F') nib_hi = s[i] - 'A' + 10;
      else if (s[i] >= 'a' && s[i] <= 'f') nib_hi = s[i] - 'a' + 10;
      if (i + 1 < len)
      {
        if      (s[i+1] >= '0' && s[i+1] <= '9') nib_lo = s[i+1] - '0';
        else if (s[i+1] >= 'A' && s[i+1] <= 'F') nib_lo = s[i+1] - 'A' + 10;
        else if (s[i+1] >= 'a' && s[i+1] <= 'f') nib_lo = s[i+1] - 'a' + 10;
      }
      b      = (nib_hi << 4) | nib_lo;
      result = (result << 8) | b;
    }
  }
  /* ---- 十进制分支 ---- */
  else
  {
    /* 短十进制(<=15位约<2^53)直接走 atodbl 转 qword */
    if (len <= 15)
      result = (qword)atodbl(s);
    else
    {
      /* 长十进制逐字符 *10 + digit 累加，避免 atodbl 精度丢失 */
      for (i = 0; i < len; i++)
      {
        if (s[i] >= '0' && s[i] <= '9')
          result = result * 10 + (s[i] - '0');
      }
    }
  }
  return result;
}

/* --------------------------------------------------------------------------
   函数：_Init_Shuffle_Seed
   作用：初始化随机数种子（基于系统日期时间 + 测量运行时间，避免每次运行顺序相同）
   说明：CAPL 中 getLocalTime(long tm[9]) 是按 tm[0..8] 写入时分秒/年月日等，无返回值
   -------------------------------------------------------------------------- */
void _Init_Shuffle_Seed()
{
  long tm[9];
  long seed_val;
  dword runtime_ms;

  // 获取本地日期时间：tm[0]=秒, [1]=分, [2]=时, [3]=日, [4]=月, [5]=年, ...
  getLocalTime(tm);

  // 获取当前测量运行时间（毫秒），再叠加一层随机性
  runtime_ms = (dword)timeNow();

  // 组合：年-月-日-时-分-秒 做哈希，再异或运行毫秒
  seed_val = (tm[5] << 25)
           | (tm[4] << 21)
           | (tm[3] << 16)
           | (tm[2] << 11)
           | (tm[1] << 6)
           |  tm[0];
  seed_val = seed_val ^ (long)runtime_ms;

  random(seed_val);
}

/* --------------------------------------------------------------------------
   函数：_Shuffle_And_Load_Msg
   作用：将 ArrySour 的行顺序打乱后复制到 ArryTar
   参数：DataCount_  -> 实际有效的消息条数（<=100）
   返回：1 = 成功，0 = 参数非法
   说明：使用 Fisher-Yates (Knuth) 洗牌算法，保证每条排列等概率
   -------------------------------------------------------------------------- */
byte _Shuffle_And_Load_Msg(dword DataCount_,dword ArrySour[][],dword ArryTar[][])
{
  dword idx_i;
  dword idx_j;
  dword pos_start;
  dword tmp0;
  dword tmp1;
  dword work_arr[100][2];
  // 参数合法性校验
  if (DataCount_ == 0 || DataCount_ > 100)
  {
    write("ERROR:输入数组超过预期范围 [1,100]", DataCount_);
    return 0;
  }
  // 步骤1：先将 Save_All_Msg 拷贝到临时数组 work_arr（保持原始数据不被破坏）
  for (idx_i = 0; idx_i < DataCount_; idx_i++)
  {
    work_arr[idx_i][0] = ArrySour[idx_i][0];
    work_arr[idx_i][1] = ArrySour[idx_i][1];
  }
  // 步骤2：Fisher-Yates 洗牌
  // 从最后一个元素开始，依次与前面随机位置的元素交换
  for (pos_start = DataCount_; pos_start > 1; pos_start--)
  {
    // 生成 [0, pos_start-1] 范围内的随机索引
    idx_j = random(pos_start);
    idx_i = pos_start - 1;
    // 交换 work_arr[idx_i] 和 work_arr[idx_j] 两行
    if (idx_i != idx_j)
    {
      tmp0 = work_arr[idx_i][0];
      tmp1 = work_arr[idx_i][1];
      work_arr[idx_i][0] = work_arr[idx_j][0];
      work_arr[idx_i][1] = work_arr[idx_j][1];
      work_arr[idx_j][0] = tmp0;
      work_arr[idx_j][1] = tmp1;
    }
  }
  // 步骤3：将打乱后的 work_arr 装入 Change_All_Msg
  for (idx_i = 0; idx_i < DataCount_; idx_i++)
  {
    ArryTar[idx_i][0] = work_arr[idx_i][0];
    ArryTar[idx_i][1] = work_arr[idx_i][1];
  }
  // 超出 DataCount_ 的位置用 0 填充，避免残留脏数据
  for (idx_i = DataCount_; idx_i < 100; idx_i++)
  {
    ArryTar[idx_i][0] = 0;
    ArryTar[idx_i][1] = 0;
  }
  return 1;
}


/* --------------------------------------------------------------------------
   函数：_Shuffle_And_Load_Msg
   作用：将 ArrySour 的行顺序打乱后复制到 ArryTar
   参数：DataCount_  -> 实际有效的消息条数（<=100）
   返回：1 = 成功，0 = 参数非法
   说明：使用 Fisher-Yates (Knuth) 洗牌算法，保证每条排列等概率
   -------------------------------------------------------------------------- */
byte _Shuffle_And_Load_Msg(dword DataCount_,byte ArrySour[],byte ArryTar[])
{
  dword idx_i;
  dword idx_j;
  dword pos_start;
  dword tmp0;
  byte work_arr[100];
  // 参数合法性校验
  if (DataCount_ == 0 || DataCount_ > 100)
  {
    write("ERROR:输入数组超过预期范围 [1,100]", DataCount_);
    return 0;
  }
  // 步骤1：先将 Save_All_Msg 拷贝到临时数组 work_arr（保持原始数据不被破坏）
  for (idx_i = 0; idx_i < DataCount_; idx_i++)
    work_arr[idx_i] = ArrySour[idx_i];
  // 步骤2：Fisher-Yates 洗牌
  // 从最后一个元素开始，依次与前面随机位置的元素交换
  for (pos_start = DataCount_; pos_start > 1; pos_start--)
  {
    // 生成 [0, pos_start-1] 范围内的随机索引
    idx_j = random(pos_start);
    idx_i = pos_start - 1;
    // 交换 work_arr[idx_i] 和 work_arr[idx_j] 两行
    if (idx_i != idx_j)
    {
      tmp0 = work_arr[idx_i];
      work_arr[idx_i] = work_arr[idx_j];
      work_arr[idx_j] = tmp0;
    }
  }
  // 步骤3：将打乱后的 work_arr 装入 Change_All_Msg
  for (idx_i = 0; idx_i < DataCount_; idx_i++)
    ArryTar[idx_i] = work_arr[idx_i];
  return 1;
}


/* --------------------------------------------------------------------------
   函数：_Sort_InPut_Arry
   作用  ：按 arr_ptr[i][0] 从小到大排序（升序）
   参数  ：arr_ptr    -> 二维 dword 数组
           elem_cnt   -> 实际有效元素个数（外部输入，例如 40）
           arr_max    -> 数组声明的最大行数（防止越界，例如 100）
   返回  ：1=成功  0=参数非法
   -------------------------------------------------------------------------- */
byte _Sort_InPut_Arry(dword arr_ptr[][], dword elem_cnt, dword arr_max)
{
  dword idx_i;
  dword idx_k;
  dword tmp0;
  dword tmp1;
  byte  swapped;

  // ---- 参数合法性 ----
  if (elem_cnt == 0 || arr_max == 0)
  {
    write("ERROR: _Sort_OutPut_Msg: elem_cnt=%d or arr_max=%d is zero", elem_cnt, arr_max);
    return 0;
  }
  if (elem_cnt > arr_max)
  {
    write("ERROR: _Sort_OutPut_Msg: elem_cnt=%d > arr_max=%d overflow", elem_cnt, arr_max);
    return 0;
  }
  // ---- 冒泡排序：按 [0] 列升序 ----
  // 外层：趟数，每趟把当前最大的"冒"到末尾
  for (idx_i = 0; idx_i < elem_cnt - 1; idx_i++)
  {
    swapped = 0;
    // 内层：相邻两两比较，已冒到末尾的不再参与
    for (idx_k = 0; idx_k < elem_cnt - 1 - idx_i; idx_k++)
    {
      if (arr_ptr[idx_k][0] > arr_ptr[idx_k + 1][0])
      {
        // 交换 [idx_k] 与 [idx_k+1] 两行
        tmp0 = arr_ptr[idx_k][0];tmp1 = arr_ptr[idx_k][1];
        arr_ptr[idx_k][0] = arr_ptr[idx_k + 1][0];arr_ptr[idx_k][1] = arr_ptr[idx_k + 1][1];
        arr_ptr[idx_k + 1][0] = tmp0;arr_ptr[idx_k + 1][1] = tmp1;
        swapped = 1;
      }
    }
    // 本趟没发生任何交换 -> 已全部有序，提前退出
    if (swapped == 0)
      break;
  }
  return 1;
}

// 从 str 的 startPos 位置开始，截取 length 个字符到 dest
void SubString(char str[], char dest[], int startPos, int length)
{
  int i,Len;
  Len = strlen(str);
  if (startPos < 0 || startPos >= Len || length <= 0)
  {
    dest[0] = '\0';
    return;
  }
  for (i = 0; i < length && (startPos + i) < Len; i++)
    dest[i] = str[startPos + i];
  dest[i] = '\0';
}

/* 只保留字符串中的数字字符(0-9) */
void KeepDigitsOnly(char str[])
{
  int len;
  int i, j;
  byte c;
  len = strlen(str);
  j = 0;
  for (i = 0; i < len; i++)
  {
    c = str[i];
    if (c >= '0' && c <= '9')
    {
      str[j] = c; j++;
    }
  }
  str[j] = '\0';  /* 字符串结束符 */
}

/*
    给指定的快照赋值，  SetPos第几组快照
    StrValue:用于时间快照赋值
    type = 1:赋值到无效值
*/
void SetVaule_For_Snapshot(char Str[],dword Value,char StrValue[],byte SetPos,byte type)
{
  int StrPos;
  char str_T[100];
  snprintf(str_T,elCount(str_T),"%s",Str);
  _Str_Upper(str_T);
  StrPos = _Check_StrPossion_Res(Str,1);
  if(type == 1)
  {
    if(strncmp(str_T,"LOCALTIME",strlen(str_T)) == 0)
      mixArray[StrPos].Invalid = _HexStrToQword(StrValue);
    else
      mixArray[StrPos].Invalid = Value;
  }
  else
  {
    if(strncmp(str_T,"LOCALTIME",strlen(str_T)) == 0)
      snprintf(mixArray[StrPos].LocalTime_Value_2[SetPos],elCount(mixArray[StrPos].LocalTime_Value_2[SetPos]),"%s",StrValue);
    else
      mixArray[StrPos].Vaule_Ex_2[SetPos] = Value;
  }
}

/// <Node>
/*
    依据输入的报文ID以及配置的DBC名称查询报文的帧周期
*/
int _GetCycleFromDBC(dword MsgID)
{
  char DBCName[300];
  char SigBefor[200] = "GenMsgCycleTime";
  char buffer_ascii[500];
  char SigSearch[200];
  char ChangeStr[50];
  int SearchPos,SearchPos2,CycleTime,i;
  snprintf(DBCName,elCount(DBCName),".\\CANDBC\\%s",DBC_Name);
  snprintf(SigSearch,elCount(SigSearch),"%d",MsgID);
  snprintf(ChangeStr,elCount(ChangeStr),"");
  GlbHandlefile = OpenFileRead (DBCName,0);
  if(GlbHandlefile != 0)
  {
    while (fileGetString(buffer_ascii, elcount(buffer_ascii), GlbHandlefile) != 0 )
    {
      if(strstr(buffer_ascii,SigBefor)!=-1 && strstr(buffer_ascii,"BA_")!=-1 && strstr(buffer_ascii,"BO_")!=-1 && strstr(buffer_ascii,"BO_")!=-1 && strstr(buffer_ascii,SigSearch)!=-1)
      {
        SearchPos = 26 + strlen(SigSearch)+1;
        SearchPos2 = strstr(buffer_ascii,";");
        for(i=SearchPos;i<SearchPos2+1;i++)
          snprintf(ChangeStr,elCount(ChangeStr),"%s%c",ChangeStr,buffer_ascii[i]);
        CycleTime = atol(ChangeStr);
        fileClose(GlbHandlefile);
        return CycleTime;
      }
    }
  }
  fileClose(GlbHandlefile);
  return 1;
}
